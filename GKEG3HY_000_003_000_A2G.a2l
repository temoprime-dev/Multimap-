ASAP2_VERSION 1 51
/begin PROJECT _929_929 "Gen2_BMW_System_Supplier_Lib"
/begin HEADER "" VERSION "C_03_03" PROJECT_NO _929_929 /end HEADER
/begin MODULE DIM ""
/begin MOD_COMMON "" BYTE_ORDER MSB_FIRST ALIGNMENT_BYTE 1 ALIGNMENT_WORD 2 ALIGNMENT_LONG 4 ALIGNMENT_FLOAT32_IEEE 4 /end MOD_COMMON
/begin CHARACTERISTIC F_PRA87 "Druckfaktor waehrend Rampe auf Schaltdruck" VALUE 0x26E929 kw_ui8_S6_S3 1 UMR___1_100_0_S6_S3 0 1 /end CHARACTERISTIC
/begin CHARACTERISTIC F_PRA87_EL "Druckfaktor waehrend Rampe auf Schaltdruck" VALUE 0x26E92A kw_ui8_S6_S3 1 UMR___1_100_0_S6_S3 0 1 /end CHARACTERISTIC
/begin CHARACTERISTIC F_TRA87 "Zeitfaktor waehrend Rampe auf Schaltdruck" VALUE 0x26E92B kw_ui8_S6_S3 1 UMR___1_100_0_S6_S3 0 1 /end CHARACTERISTIC
/begin CHARACTERISTIC F_TRA87_EL "Zeitfaktor waehrend Rampe auf Schaltdruck" VALUE 0x26E92C kw_ui8_S6_S3 1 UMR___1_100_0_S6_S3 0 1 /end CHARACTERISTIC
/begin CHARACTERISTIC T_F87 "Fuellzeit" VALUE 0x26E92D kw_ui8_S6_S3 2540 UMR_MSEC__10_1_0_S6_S3 0 2540 /end CHARACTERISTIC
/begin CHARACTERISTIC T_F87_EL "Fuellzeit" VALUE 0x26E92E kw_ui8_S6_S3 2540 UMR_MSEC__10_1_0_S6_S3 0 2540 /end CHARACTERISTIC
/begin CHARACTERISTIC KL_TRA87 "Kennlinie Zeit Erste Rampe" CURVE 0x259908 kl_ui8_S6_S3 2540 UMR_MSEC__10_1_0_S6_S3 0 2540
 /begin AXIS_DESCR STD_AXIS zff_atsys._.iSignale._.obj.sig_m_t8 UMR_NM__8_1_M50_S6_S3 4 -400 1640 DEPOSIT ABSOLUTE MONOTONY MON_INCREASE /end AXIS_DESCR
/end CHARACTERISTIC
/begin CHARACTERISTIC KL_TRA87_EL "Kennlinie Zeit Erste Rampe" CURVE 0x259914 kl_ui8_S6_S3 2540 UMR_MSEC__10_1_0_S6_S3 0 2540
 /begin AXIS_DESCR STD_AXIS zff_atsys._.iSignale._.obj.sig_m_t8 UMR_NM__8_1_M50_S6_S3 4 -400 1640 DEPOSIT ABSOLUTE MONOTONY MON_INCREASE /end AXIS_DESCR
/end CHARACTERISTIC
/begin CHARACTERISTIC KL_PGRASYN87 "Schliessrampenradient" CURVE 0x259920 kl_si16_S6_S3 6553.4 UMR_BAR_SEC_1_10_0_S6_S3 -3276.7 3276.7
 /begin AXIS_DESCR STD_AXIS zff_atsys._.iSignale._.obj.sig_m_t UMR_NM__1_1_0_S6_S3 6 -400 1640 DEPOSIT ABSOLUTE MONOTONY MON_INCREASE /end AXIS_DESCR
/end CHARACTERISTIC
/begin CHARACTERISTIC KF_POFMTN87 "Kennfeld Fuelldruckoffset(n_t, m_t)" MAP 0x25993C kf_si16_S6_S3 12.75 UMR_BAR__1_1000_0_S6_S3 -6.4 6.35
 /begin AXIS_DESCR STD_AXIS zff_atsys._.iSignale._.obj.sig_n_t UMR_U_MIN_1_1_0_S6_S3 4 0 8160 DEPOSIT ABSOLUTE MONOTONY MON_INCREASE /end AXIS_DESCR
 /begin AXIS_DESCR STD_AXIS zff_atsys._.iSignale._.obj.sig_m_t UMR_NM__1_1_0_S6_S3 6 -400 1640 DEPOSIT ABSOLUTE MONOTONY MON_INCREASE /end AXIS_DESCR
/end CHARACTERISTIC
/begin CHARACTERISTIC KF_POFMTN87_EL "Kennfeld Fuelldruckoffset(n_t, m_t)" MAP 0x259988 kf_si16_S6_S3 12.75 UMR_BAR__1_1000_0_S6_S3 -6.4 6.35
 /begin AXIS_DESCR STD_AXIS zff_atsys._.iSignale._.obj.sig_n_t UMR_U_MIN_1_1_0_S6_S3 4 0 8160 DEPOSIT ABSOLUTE MONOTONY MON_INCREASE /end AXIS_DESCR
 /begin AXIS_DESCR STD_AXIS zff_atsys._.iSignale._.obj.sig_m_t UMR_NM__1_1_0_S6_S3 6 -400 1640 DEPOSIT ABSOLUTE MONOTONY MON_INCREASE /end AXIS_DESCR
/end CHARACTERISTIC
/begin CHARACTERISTIC KF_PKZU87 "Schaltdruck zuschaltende Kupplung" MAP 0x2599D4 kf_si16_S6_S3 12.75 UMR_BAR__1_1000_0_S6_S3 0 12.75
 /begin AXIS_DESCR STD_AXIS iSasZentr.iSchaltend.n_tkf UMR_U_MIN_32_1_0_S6_S3 8 0 8160 DEPOSIT ABSOLUTE MONOTONY MON_INCREASE /end AXIS_DESCR
 /begin AXIS_DESCR STD_AXIS zff_atsys._.iSignale._.obj.sig_m_t UMR_NM__1_1_0_S6_S3 8 -400 1640 DEPOSIT ABSOLUTE MONOTONY MON_INCREASE /end AXIS_DESCR
/end CHARACTERISTIC
/begin CHARACTERISTIC KF_PKZU87_EL "Schaltdruck zuschaltende Kupplung" MAP 0x259A7C kf_si16_S6_S3 12.75 UMR_BAR__1_1000_0_S6_S3 0 12.75
 /begin AXIS_DESCR STD_AXIS iSasZentr.iSchaltend.n_tkf UMR_U_MIN_32_1_0_S6_S3 8 0 8160 DEPOSIT ABSOLUTE MONOTONY MON_INCREASE /end AXIS_DESCR
 /begin AXIS_DESCR STD_AXIS zff_atsys._.iSignale._.obj.sig_m_t UMR_NM__1_1_0_S6_S3 8 -400 1640 DEPOSIT ABSOLUTE MONOTONY MON_INCREASE /end AXIS_DESCR
/end CHARACTERISTIC
/begin CHARACTERISTIC KF_POHINSYNKZU87 "Kennfeld Haltedruckoffset(n_tkf, m_t) bei Haltephase in Synchron" MAP 0x259B24 kf_si16_S6_S3 12.75 UMR_BAR__1_1000_0_S6_S3 -6.4 6.35
 /begin AXIS_DESCR STD_AXIS iSasZentr.iSchaltend.n_tkf UMR_U_MIN_32_1_0_S6_S3 4 0 8160 DEPOSIT ABSOLUTE MONOTONY MON_INCREASE /end AXIS_DESCR
 /begin AXIS_DESCR STD_AXIS zff_atsys._.iSignale._.obj.sig_m_t UMR_NM__1_1_0_S6_S3 4 -400 1640 DEPOSIT ABSOLUTE MONOTONY MON_INCREASE /end AXIS_DESCR
/end CHARACTERISTIC
/begin CHARACTERISTIC KL_TSYNCGHINSYNEKZU87 "Zeit fuer Ende Haltephase in Synchron KZU" CURVE 0x259B5C kl_ui8_S6_S3 2550 UMR_MSEC__10_1_M128_S6_S3 -1280 1270
 /begin AXIS_DESCR STD_AXIS zff_atsys._.iSignale._.obj.sig_c_getr UMR_GRADC__1_1_M40_S6_S3 4 -40 150 DEPOSIT ABSOLUTE MONOTONY MON_INCREASE /end AXIS_DESCR
/end CHARACTERISTIC
/begin CHARACTERISTIC F_PRASP21 "Druckfaktor waehrend Rampe auf Schaltdruck" VALUE 0x26E92F kw_ui8_S6_S3 1 UMR___1_100_0_S6_S3 0 1 /end CHARACTERISTIC
/begin CHARACTERISTIC F_TRASP21 "Zeitfaktor waehrend Rampe auf Schaltdruck" VALUE 0x26E930 kw_ui8_S6_S3 1 UMR___1_100_0_S6_S3 0 1 /end CHARACTERISTIC
/begin CHARACTERISTIC T_FSP21 "Fuellzeit" VALUE 0x26E931 kw_ui8_S6_S3 2540 UMR_MSEC__10_1_0_S6_S3 0 2540 /end CHARACTERISTIC
/begin CHARACTERISTIC KL_TRASP21 "Kennlinie Zeit Erste Rampe" CURVE 0x259B68 kl_ui8_S6_S3 2540 UMR_MSEC__10_1_0_S6_S3 0 2540
 /begin AXIS_DESCR STD_AXIS zff_atsys._.iSignale._.obj.sig_m_t8 UMR_NM__8_1_M50_S6_S3 4 -400 1640 DEPOSIT ABSOLUTE MONOTONY MON_INCREASE /end AXIS_DESCR
/end CHARACTERISTIC
/begin CHARACTERISTIC KL_PGRASYNSP21 "Schliessrampenradient" CURVE 0x259B74 kl_si16_S6_S3 6553.4 UMR_BAR_SEC_1_10_0_S6_S3 -3276.7 3276.7
 /begin AXIS_DESCR STD_AXIS zff_atsys._.iSignale._.obj.sig_m_t UMR_NM__1_1_0_S6_S3 6 -400 1640 DEPOSIT ABSOLUTE MONOTONY MON_INCREASE /end AXIS_DESCR
/end CHARACTERISTIC
/begin CHARACTERISTIC KF_POFMTNSP21 "Kennfeld Fuelldruckoffset(n_t, m_t)" MAP 0x259B90 kf_si16_S6_S3 12.75 UMR_BAR__1_1000_0_S6_S3 -6.4 6.35
 /begin AXIS_DESCR STD_AXIS zff_atsys._.iSignale._.obj.sig_n_t UMR_U_MIN_1_1_0_S6_S3 4 0 8160 DEPOSIT ABSOLUTE MONOTONY MON_INCREASE /end AXIS_DESCR
 /begin AXIS_DESCR STD_AXIS zff_atsys._.iSignale._.obj.sig_m_t UMR_NM__1_1_0_S6_S3 6 -400 1640 DEPOSIT ABSOLUTE MONOTONY MON_INCREASE /end AXIS_DESCR
/end CHARACTERISTIC
/begin CHARACTERISTIC KF_PKZUSP21 "Schaltdruck zuschaltende Kupplung" MAP 0x259BDC kf_si16_S6_S3 12.75 UMR_BAR__1_1000_0_S6_S3 0 12.75
 /begin AXIS_DESCR STD_AXIS iSasZentr.iSchaltend.n_tkf UMR_U_MIN_32_1_0_S6_S3 8 0 8160 DEPOSIT ABSOLUTE MONOTONY MON_INCREASE /end AXIS_DESCR
 /begin AXIS_DESCR STD_AXIS zff_atsys._.iSignale._.obj.sig_m_t UMR_NM__1_1_0_S6_S3 8 -400 1640 DEPOSIT ABSOLUTE MONOTONY MON_INCREASE /end AXIS_DESCR
/end CHARACTERISTIC
/begin CHARACTERISTIC KF_POHINSYNKZUSP21 "Kennfeld Haltedruckoffset(n_tkf, m_t) bei Haltephase in Synchron" MAP 0x259C84 kf_si16_S6_S3 12.75 UMR_BAR__1_1000_0_S6_S3 -6.4 6.35
 /begin AXIS_DESCR STD_AXIS iSasZentr.iSchaltend.n_tkf UMR_U_MIN_32_1_0_S6_S3 4 0 8160 DEPOSIT ABSOLUTE MONOTONY MON_INCREASE /end AXIS_DESCR
 /begin AXIS_DESCR STD_AXIS zff_atsys._.iSignale._.obj.sig_m_t UMR_NM__1_1_0_S6_S3 4 -400 1640 DEPOSIT ABSOLUTE MONOTONY MON_INCREASE /end AXIS_DESCR
/end CHARACTERISTIC
/begin CHARACTERISTIC KL_TSYNCGHINSYNEKZUSP21 "Zeit fuer Ende Haltephase in Synchron KZU" CURVE 0x259CBC kl_ui8_S6_S3 2550 UMR_MSEC__10_1_M128_S6_S3 -1280 1270
 /begin AXIS_DESCR STD_AXIS zff_atsys._.iSignale._.obj.sig_c_getr UMR_GRADC__1_1_M40_S6_S3 4 -40 150 DEPOSIT ABSOLUTE MONOTONY MON_INCREASE /end AXIS_DESCR
/end CHARACTERISTIC
/begin CHARACTERISTIC F_PRASP32 "Druckfaktor waehrend Rampe auf Schaltdruck" VALUE 0x26E932 kw_ui8_S6_S3 1 UMR___1_100_0_S6_S3 0 1 /end CHARACTERISTIC
/begin CHARACTERISTIC F_TRASP32 "Zeitfaktor waehrend Rampe auf Schaltdruck" VALUE 0x26E933 kw_ui8_S6_S3 1 UMR___1_100_0_S6_S3 0 1 /end CHARACTERISTIC
/begin CHARACTERISTIC T_FSP32 "Fuellzeit" VALUE 0x26E934 kw_ui8_S6_S3 2540 UMR_MSEC__10_1_0_S6_S3 0 2540 /end CHARACTERISTIC
/begin CHARACTERISTIC KL_TRASP32 "Kennlinie Zeit Erste Rampe" CURVE 0x259CC8 kl_ui8_S6_S3 2540 UMR_MSEC__10_1_0_S6_S3 0 2540
 /begin AXIS_DESCR STD_AXIS zff_atsys._.iSignale._.obj.sig_m_t8 UMR_NM__8_1_M50_S6_S3 4 -400 1640 DEPOSIT ABSOLUTE MONOTONY MON_INCREASE /end AXIS_DESCR
/end CHARACTERISTIC
/begin CHARACTERISTIC KL_PGRASYNSP32 "Schliessrampenradient" CURVE 0x259CD4 kl_si16_S6_S3 6553.4 UMR_BAR_SEC_1_10_0_S6_S3 -3276.7 3276.7
 /begin AXIS_DESCR STD_AXIS zff_atsys._.iSignale._.obj.sig_m_t UMR_NM__1_1_0_S6_S3 6 -400 1640 DEPOSIT ABSOLUTE MONOTONY MON_INCREASE /end AXIS_DESCR
/end CHARACTERISTIC
/begin CHARACTERISTIC KF_POFMTNSP32 "Kennfeld Fuelldruckoffset(n_t, m_t)" MAP 0x259CF0 kf_si16_S6_S3 12.75 UMR_BAR__1_1000_0_S6_S3 -6.4 6.35
 /begin AXIS_DESCR STD_AXIS zff_atsys._.iSignale._.obj.sig_n_t UMR_U_MIN_1_1_0_S6_S3 4 0 8160 DEPOSIT ABSOLUTE MONOTONY MON_INCREASE /end AXIS_DESCR
 /begin AXIS_DESCR STD_AXIS zff_atsys._.iSignale._.obj.sig_m_t UMR_NM__1_1_0_S6_S3 6 -400 1640 DEPOSIT ABSOLUTE MONOTONY MON_INCREASE /end AXIS_DESCR
/end CHARACTERISTIC
/begin CHARACTERISTIC KF_PKZUSP32 "Schaltdruck zuschaltende Kupplung" MAP 0x259D3C kf_si16_S6_S3 12.75 UMR_BAR__1_1000_0_S6_S3 0 12.75
 /begin AXIS_DESCR STD_AXIS iSasZentr.iSchaltend.n_tkf UMR_U_MIN_32_1_0_S6_S3 8 0 8160 DEPOSIT ABSOLUTE MONOTONY MON_INCREASE /end AXIS_DESCR
 /begin AXIS_DESCR STD_AXIS zff_atsys._.iSignale._.obj.sig_m_t UMR_NM__1_1_0_S6_S3 8 -400 1640 DEPOSIT ABSOLUTE MONOTONY MON_INCREASE /end AXIS_DESCR
/end CHARACTERISTIC
/begin CHARACTERISTIC KF_POHINSYNKZUSP32 "Kennfeld Haltedruckoffset(n_tkf, m_t) bei Haltephase in Synchron" MAP 0x259DE4 kf_si16_S6_S3 12.75 UMR_BAR__1_1000_0_S6_S3 -6.4 6.35
 /begin AXIS_DESCR STD_AXIS iSasZentr.iSchaltend.n_tkf UMR_U_MIN_32_1_0_S6_S3 4 0 8160 DEPOSIT ABSOLUTE MONOTONY MON_INCREASE /end AXIS_DESCR
 /begin AXIS_DESCR STD_AXIS zff_atsys._.iSignale._.obj.sig_m_t UMR_NM__1_1_0_S6_S3 4 -400 1640 DEPOSIT ABSOLUTE MONOTONY MON_INCREASE /end AXIS_DESCR
/end CHARACTERISTIC
/begin CHARACTERISTIC KL_TSYNCGHINSYNEKZUSP32 "Zeit fuer Ende Haltephase in Synchron KZU" CURVE 0x259E1C kl_ui8_S6_S3 2550 UMR_MSEC__10_1_M128_S6_S3 -1280 1270
 /begin AXIS_DESCR STD_AXIS zff_atsys._.iSignale._.obj.sig_c_getr UMR_GRADC__1_1_M40_S6_S3 4 -40 150 DEPOSIT ABSOLUTE MONOTONY MON_INCREASE /end AXIS_DESCR
/end CHARACTERISTIC
/begin CHARACTERISTIC F_PRASP43 "Druckfaktor waehrend Rampe auf Schaltdruck" VALUE 0x26E935 kw_ui8_S6_S3 1 UMR___1_100_0_S6_S3 0 1 /end CHARACTERISTIC
/begin CHARACTERISTIC F_TRASP43 "Zeitfaktor waehrend Rampe auf Schaltdruck" VALUE 0x26E936 kw_ui8_S6_S3 1 UMR___1_100_0_S6_S3 0 1 /end CHARACTERISTIC
/begin CHARACTERISTIC T_FSP43 "Fuellzeit" VALUE 0x26E937 kw_ui8_S6_S3 2540 UMR_MSEC__10_1_0_S6_S3 0 2540 /end CHARACTERISTIC
/begin CHARACTERISTIC KL_TRASP43 "Kennlinie Zeit Erste Rampe" CURVE 0x259E28 kl_ui8_S6_S3 2540 UMR_MSEC__10_1_0_S6_S3 0 2540
 /begin AXIS_DESCR STD_AXIS zff_atsys._.iSignale._.obj.sig_m_t8 UMR_NM__8_1_M50_S6_S3 4 -400 1640 DEPOSIT ABSOLUTE MONOTONY MON_INCREASE /end AXIS_DESCR
/end CHARACTERISTIC
/begin CHARACTERISTIC KL_PGRASYNSP43 "Schliessrampenradient" CURVE 0x259E34 kl_si16_S6_S3 6553.4 UMR_BAR_SEC_1_10_0_S6_S3 -3276.7 3276.7
 /begin AXIS_DESCR STD_AXIS zff_atsys._.iSignale._.obj.sig_m_t UMR_NM__1_1_0_S6_S3 6 -400 1640 DEPOSIT ABSOLUTE MONOTONY MON_INCREASE /end AXIS_DESCR
/end CHARACTERISTIC
/begin CHARACTERISTIC KF_POFMTNSP43 "Kennfeld Fuelldruckoffset(n_t, m_t)" MAP 0x259E50 kf_si16_S6_S3 12.75 UMR_BAR__1_1000_0_S6_S3 -6.4 6.35
 /begin AXIS_DESCR STD_AXIS zff_atsys._.iSignale._.obj.sig_n_t UMR_U_MIN_1_1_0_S6_S3 4 0 8160 DEPOSIT ABSOLUTE MONOTONY MON_INCREASE /end AXIS_DESCR
 /begin AXIS_DESCR STD_AXIS zff_atsys._.iSignale._.obj.sig_m_t UMR_NM__1_1_0_S6_S3 6 -400 1640 DEPOSIT ABSOLUTE MONOTONY MON_INCREASE /end AXIS_DESCR
/end CHARACTERISTIC
/begin CHARACTERISTIC KF_PKZUSP43 "Schaltdruck zuschaltende Kupplung" MAP 0x259E9C kf_si16_S6_S3 12.75 UMR_BAR__1_1000_0_S6_S3 0 12.75
 /begin AXIS_DESCR STD_AXIS iSasZentr.iSchaltend.n_tkf UMR_U_MIN_32_1_0_S6_S3 8 0 8160 DEPOSIT ABSOLUTE MONOTONY MON_INCREASE /end AXIS_DESCR
 /begin AXIS_DESCR STD_AXIS zff_atsys._.iSignale._.obj.sig_m_t UMR_NM__1_1_0_S6_S3 8 -400 1640 DEPOSIT ABSOLUTE MONOTONY MON_INCREASE /end AXIS_DESCR
/end CHARACTERISTIC
/begin CHARACTERISTIC KF_POHINSYNKZUSP43 "Kennfeld Haltedruckoffset(n_tkf, m_t) bei Haltephase in Synchron" MAP 0x259F44 kf_si16_S6_S3 12.75 UMR_BAR__1_1000_0_S6_S3 -6.4 6.35
 /begin AXIS_DESCR STD_AXIS iSasZentr.iSchaltend.n_tkf UMR_U_MIN_32_1_0_S6_S3 4 0 8160 DEPOSIT ABSOLUTE MONOTONY MON_INCREASE /end AXIS_DESCR
 /begin AXIS_DESCR STD_AXIS zff_atsys._.iSignale._.obj.sig_m_t UMR_NM__1_1_0_S6_S3 4 -400 1640 DEPOSIT ABSOLUTE MONOTONY MON_INCREASE /end AXIS_DESCR
/end CHARACTERISTIC
/begin CHARACTERISTIC KL_TSYNCGHINSYNEKZUSP43 "Zeit fuer Ende Haltephase in Synchron KZU" CURVE 0x259F7C kl_ui8_S6_S3 2550 UMR_MSEC__10_1_M128_S6_S3 -1280 1270
 /begin AXIS_DESCR STD_AXIS zff_atsys._.iSignale._.obj.sig_c_getr UMR_GRADC__1_1_M40_S6_S3 4 -40 150 DEPOSIT ABSOLUTE MONOTONY MON_INCREASE /end AXIS_DESCR
/end CHARACTERISTIC
/begin CHARACTERISTIC F_PRASP54 "Druckfaktor waehrend Rampe auf Schaltdruck" VALUE 0x26E938 kw_ui8_S6_S3 1 UMR___1_100_0_S6_S3 0 1 /end CHARACTERISTIC
/begin CHARACTERISTIC F_TRASP54 "Zeitfaktor waehrend Rampe auf Schaltdruck" VALUE 0x26E939 kw_ui8_S6_S3 1 UMR___1_100_0_S6_S3 0 1 /end CHARACTERISTIC
/begin CHARACTERISTIC T_FSP54 "Fuellzeit" VALUE 0x26E93A kw_ui8_S6_S3 2540 UMR_MSEC__10_1_0_S6_S3 0 2540 /end CHARACTERISTIC
/begin CHARACTERISTIC KL_TRASP54 "Kennlinie Zeit Erste Rampe" CURVE 0x259F88 kl_ui8_S6_S3 2540 UMR_MSEC__10_1_0_S6_S3 0 2540
 /begin AXIS_DESCR STD_AXIS zff_atsys._.iSignale._.obj.sig_m_t8 UMR_NM__8_1_M50_S6_S3 4 -400 1640 DEPOSIT ABSOLUTE MONOTONY MON_INCREASE /end AXIS_DESCR
/end CHARACTERISTIC
/begin CHARACTERISTIC KL_PGRASYNSP54 "Schliessrampenradient" CURVE 0x259F94 kl_si16_S6_S3 6553.4 UMR_BAR_SEC_1_10_0_S6_S3 -3276.7 3276.7
 /begin AXIS_DESCR STD_AXIS zff_atsys._.iSignale._.obj.sig_m_t UMR_NM__1_1_0_S6_S3 6 -400 1640 DEPOSIT ABSOLUTE MONOTONY MON_INCREASE /end AXIS_DESCR
/end CHARACTERISTIC
/begin CHARACTERISTIC KF_POFMTNSP54 "Kennfeld Fuelldruckoffset(n_t, m_t)" MAP 0x259FB0 kf_si16_S6_S3 12.75 UMR_BAR__1_1000_0_S6_S3 -6.4 6.35
 /begin AXIS_DESCR STD_AXIS zff_atsys._.iSignale._.obj.sig_n_t UMR_U_MIN_1_1_0_S6_S3 4 0 8160 DEPOSIT ABSOLUTE MONOTONY MON_INCREASE /end AXIS_DESCR
 /begin AXIS_DESCR STD_AXIS zff_atsys._.iSignale._.obj.sig_m_t UMR_NM__1_1_0_S6_S3 6 -400 1640 DEPOSIT ABSOLUTE MONOTONY MON_INCREASE /end AXIS_DESCR
/end CHARACTERISTIC
/begin CHARACTERISTIC KF_PKZUSP54 "Schaltdruck zuschaltende Kupplung" MAP 0x259FFC kf_si16_S6_S3 12.75 UMR_BAR__1_1000_0_S6_S3 0 12.75
 /begin AXIS_DESCR STD_AXIS iSasZentr.iSchaltend.n_tkf UMR_U_MIN_32_1_0_S6_S3 8 0 8160 DEPOSIT ABSOLUTE MONOTONY MON_INCREASE /end AXIS_DESCR
 /begin AXIS_DESCR STD_AXIS zff_atsys._.iSignale._.obj.sig_m_t UMR_NM__1_1_0_S6_S3 8 -400 1640 DEPOSIT ABSOLUTE MONOTONY MON_INCREASE /end AXIS_DESCR
/end CHARACTERISTIC
/begin CHARACTERISTIC KF_POHINSYNKZUSP54 "Kennfeld Haltedruckoffset(n_tkf, m_t) bei Haltephase in Synchron" MAP 0x25A0A4 kf_si16_S6_S3 12.75 UMR_BAR__1_1000_0_S6_S3 -6.4 6.35
 /begin AXIS_DESCR STD_AXIS iSasZentr.iSchaltend.n_tkf UMR_U_MIN_32_1_0_S6_S3 4 0 8160 DEPOSIT ABSOLUTE MONOTONY MON_INCREASE /end AXIS_DESCR
 /begin AXIS_DESCR STD_AXIS zff_atsys._.iSignale._.obj.sig_m_t UMR_NM__1_1_0_S6_S3 4 -400 1640 DEPOSIT ABSOLUTE MONOTONY MON_INCREASE /end AXIS_DESCR
/end CHARACTERISTIC
/begin CHARACTERISTIC KL_TSYNCGHINSYNEKZUSP54 "Zeit fuer Ende Haltephase in Synchron KZU" CURVE 0x25A0DC kl_ui8_S6_S3 2550 UMR_MSEC__10_1_M128_S6_S3 -1280 1270
 /begin AXIS_DESCR STD_AXIS zff_atsys._.iSignale._.obj.sig_c_getr UMR_GRADC__1_1_M40_S6_S3 4 -40 150 DEPOSIT ABSOLUTE MONOTONY MON_INCREASE /end AXIS_DESCR
/end CHARACTERISTIC
/begin CHARACTERISTIC F_PRASP65 "Druckfaktor waehrend Rampe auf Schaltdruck" VALUE 0x26E93B kw_ui8_S6_S3 1 UMR___1_100_0_S6_S3 0 1 /end CHARACTERISTIC
/begin CHARACTERISTIC F_TRASP65 "Zeitfaktor waehrend Rampe auf Schaltdruck" VALUE 0x26E93C kw_ui8_S6_S3 1 UMR___1_100_0_S6_S3 0 1 /end CHARACTERISTIC
/begin CHARACTERISTIC T_FSP65 "Fuellzeit" VALUE 0x26E93D kw_ui8_S6_S3 2540 UMR_MSEC__10_1_0_S6_S3 0 2540 /end CHARACTERISTIC
/begin CHARACTERISTIC KL_TRASP65 "Kennlinie Zeit Erste Rampe" CURVE 0x25A0E8 kl_ui8_S6_S3 2540 UMR_MSEC__10_1_0_S6_S3 0 2540
 /begin AXIS_DESCR STD_AXIS zff_atsys._.iSignale._.obj.sig_m_t8 UMR_NM__8_1_M50_S6_S3 4 -400 1640 DEPOSIT ABSOLUTE MONOTONY MON_INCREASE /end AXIS_DESCR
/end CHARACTERISTIC
/begin CHARACTERISTIC KL_PGRASYNSP65 "Schliessrampenradient" CURVE 0x25A0F4 kl_si16_S6_S3 6553.4 UMR_BAR_SEC_1_10_0_S6_S3 -3276.7 3276.7
 /begin AXIS_DESCR STD_AXIS zff_atsys._.iSignale._.obj.sig_m_t UMR_NM__1_1_0_S6_S3 6 -400 1640 DEPOSIT ABSOLUTE MONOTONY MON_INCREASE /end AXIS_DESCR
/end CHARACTERISTIC
/begin CHARACTERISTIC KF_POFMTNSP65 "Kennfeld Fuelldruckoffset(n_t, m_t)" MAP 0x25A110 kf_si16_S6_S3 12.75 UMR_BAR__1_1000_0_S6_S3 -6.4 6.35
 /begin AXIS_DESCR STD_AXIS zff_atsys._.iSignale._.obj.sig_n_t UMR_U_MIN_1_1_0_S6_S3 4 0 8160 DEPOSIT ABSOLUTE MONOTONY MON_INCREASE /end AXIS_DESCR
 /begin AXIS_DESCR STD_AXIS zff_atsys._.iSignale._.obj.sig_m_t UMR_NM__1_1_0_S6_S3 6 -400 1640 DEPOSIT ABSOLUTE MONOTONY MON_INCREASE /end AXIS_DESCR
/end CHARACTERISTIC
/begin CHARACTERISTIC KF_PKZUSP65 "Schaltdruck zuschaltende Kupplung" MAP 0x25A15C kf_si16_S6_S3 12.75 UMR_BAR__1_1000_0_S6_S3 0 12.75
 /begin AXIS_DESCR STD_AXIS iSasZentr.iSchaltend.n_tkf UMR_U_MIN_32_1_0_S6_S3 8 0 8160 DEPOSIT ABSOLUTE MONOTONY MON_INCREASE /end AXIS_DESCR
 /begin AXIS_DESCR STD_AXIS zff_atsys._.iSignale._.obj.sig_m_t UMR_NM__1_1_0_S6_S3 8 -400 1640 DEPOSIT ABSOLUTE MONOTONY MON_INCREASE /end AXIS_DESCR
/end CHARACTERISTIC
/begin CHARACTERISTIC KF_POHINSYNKZUSP65 "Kennfeld Haltedruckoffset(n_tkf, m_t) bei Haltephase in Synchron" MAP 0x25A204 kf_si16_S6_S3 12.75 UMR_BAR__1_1000_0_S6_S3 -6.4 6.35
 /begin AXIS_DESCR STD_AXIS iSasZentr.iSchaltend.n_tkf UMR_U_MIN_32_1_0_S6_S3 4 0 8160 DEPOSIT ABSOLUTE MONOTONY MON_INCREASE /end AXIS_DESCR
 /begin AXIS_DESCR STD_AXIS zff_atsys._.iSignale._.obj.sig_m_t UMR_NM__1_1_0_S6_S3 4 -400 1640 DEPOSIT ABSOLUTE MONOTONY MON_INCREASE /end AXIS_DESCR
/end CHARACTERISTIC
/begin CHARACTERISTIC KL_TSYNCGHINSYNEKZUSP65 "Zeit fuer Ende Haltephase in Synchron KZU" CURVE 0x25A23C kl_ui8_S6_S3 2550 UMR_MSEC__10_1_M128_S6_S3 -1280 1270
 /begin AXIS_DESCR STD_AXIS zff_atsys._.iSignale._.obj.sig_c_getr UMR_GRADC__1_1_M40_S6_S3 4 -40 150 DEPOSIT ABSOLUTE MONOTONY MON_INCREASE /end AXIS_DESCR
/end CHARACTERISTIC
/begin CHARACTERISTIC F_PRASP76 "Druckfaktor waehrend Rampe auf Schaltdruck" VALUE 0x26E93E kw_ui8_S6_S3 1 UMR___1_100_0_S6_S3 0 1 /end CHARACTERISTIC
/begin CHARACTERISTIC F_TRASP76 "Zeitfaktor waehrend Rampe auf Schaltdruck" VALUE 0x26E93F kw_ui8_S6_S3 1 UMR___1_100_0_S6_S3 0 1 /end CHARACTERISTIC
/begin CHARACTERISTIC T_FSP76 "Fuellzeit" VALUE 0x26E940 kw_ui8_S6_S3 2540 UMR_MSEC__10_1_0_S6_S3 0 2540 /end CHARACTERISTIC
/begin CHARACTERISTIC KL_TRASP76 "Kennlinie Zeit Erste Rampe" CURVE 0x25A248 kl_ui8_S6_S3 2540 UMR_MSEC__10_1_0_S6_S3 0 2540
 /begin AXIS_DESCR STD_AXIS zff_atsys._.iSignale._.obj.sig_m_t8 UMR_NM__8_1_M50_S6_S3 4 -400 1640 DEPOSIT ABSOLUTE MONOTONY MON_INCREASE /end AXIS_DESCR
/end CHARACTERISTIC
/begin CHARACTERISTIC KL_PGRASYNSP76 "Schliessrampenradient" CURVE 0x25A254 kl_si16_S6_S3 6553.4 UMR_BAR_SEC_1_10_0_S6_S3 -3276.7 3276.7
 /begin AXIS_DESCR STD_AXIS zff_atsys._.iSignale._.obj.sig_m_t UMR_NM__1_1_0_S6_S3 6 -400 1640 DEPOSIT ABSOLUTE MONOTONY MON_INCREASE /end AXIS_DESCR
/end CHARACTERISTIC
/begin CHARACTERISTIC KF_POFMTNSP76 "Kennfeld Fuelldruckoffset(n_t, m_t)" MAP 0x25A270 kf_si16_S6_S3 12.75 UMR_BAR__1_1000_0_S6_S3 -6.4 6.35
 /begin AXIS_DESCR STD_AXIS zff_atsys._.iSignale._.obj.sig_n_t UMR_U_MIN_1_1_0_S6_S3 4 0 8160 DEPOSIT ABSOLUTE MONOTONY MON_INCREASE /end AXIS_DESCR
 /begin AXIS_DESCR STD_AXIS zff_atsys._.iSignale._.obj.sig_m_t UMR_NM__1_1_0_S6_S3 6 -400 1640 DEPOSIT ABSOLUTE MONOTONY MON_INCREASE /end AXIS_DESCR
/end CHARACTERISTIC
/begin CHARACTERISTIC KF_PKZUSP76 "Schaltdruck zuschaltende Kupplung" MAP 0x25A2BC kf_si16_S6_S3 12.75 UMR_BAR__1_1000_0_S6_S3 0 12.75
 /begin AXIS_DESCR STD_AXIS iSasZentr.iSchaltend.n_tkf UMR_U_MIN_32_1_0_S6_S3 8 0 8160 DEPOSIT ABSOLUTE MONOTONY MON_INCREASE /end AXIS_DESCR
 /begin AXIS_DESCR STD_AXIS zff_atsys._.iSignale._.obj.sig_m_t UMR_NM__1_1_0_S6_S3 8 -400 1640 DEPOSIT ABSOLUTE MONOTONY MON_INCREASE /end AXIS_DESCR
/end CHARACTERISTIC
/begin CHARACTERISTIC KF_POHINSYNKZUSP76 "Kennfeld Haltedruckoffset(n_tkf, m_t) bei Haltephase in Synchron" MAP 0x25A364 kf_si16_S6_S3 12.75 UMR_BAR__1_1000_0_S6_S3 -6.4 6.35
 /begin AXIS_DESCR STD_AXIS iSasZentr.iSchaltend.n_tkf UMR_U_MIN_32_1_0_S6_S3 4 0 8160 DEPOSIT ABSOLUTE MONOTONY MON_INCREASE /end AXIS_DESCR
 /begin AXIS_DESCR STD_AXIS zff_atsys._.iSignale._.obj.sig_m_t UMR_NM__1_1_0_S6_S3 4 -400 1640 DEPOSIT ABSOLUTE MONOTONY MON_INCREASE /end AXIS_DESCR
/end CHARACTERISTIC
/begin CHARACTERISTIC KL_TSYNCGHINSYNEKZUSP76 "Zeit fuer Ende Haltephase in Synchron KZU" CURVE 0x25A39C kl_ui8_S6_S3 2550 UMR_MSEC__10_1_M128_S6_S3 -1280 1270
 /begin AXIS_DESCR STD_AXIS zff_atsys._.iSignale._.obj.sig_c_getr UMR_GRADC__1_1_M40_S6_S3 4 -40 150 DEPOSIT ABSOLUTE MONOTONY MON_INCREASE /end AXIS_DESCR
/end CHARACTERISTIC
/begin CHARACTERISTIC F_PRASP87 "Druckfaktor waehrend Rampe auf Schaltdruck" VALUE 0x26E941 kw_ui8_S6_S3 1 UMR___1_100_0_S6_S3 0 1 /end CHARACTERISTIC
/begin CHARACTERISTIC F_TRASP87 "Zeitfaktor waehrend Rampe auf Schaltdruck" VALUE 0x26E942 kw_ui8_S6_S3 1 UMR___1_100_0_S6_S3 0 1 /end CHARACTERISTIC
/begin CHARACTERISTIC T_FSP87 "Fuellzeit" VALUE 0x26E943 kw_ui8_S6_S3 2540 UMR_MSEC__10_1_0_S6_S3 0 2540 /end CHARACTERISTIC
/begin CHARACTERISTIC KL_TRASP87 "Kennlinie Zeit Erste Rampe" CURVE 0x25A3A8 kl_ui8_S6_S3 2540 UMR_MSEC__10_1_0_S6_S3 0 2540
 /begin AXIS_DESCR STD_AXIS zff_atsys._.iSignale._.obj.sig_m_t8 UMR_NM__8_1_M50_S6_S3 4 -400 1640 DEPOSIT ABSOLUTE MONOTONY MON_INCREASE /end AXIS_DESCR
/end CHARACTERISTIC
/begin CHARACTERISTIC KL_PGRASYNSP87 "Schliessrampenradient" CURVE 0x25A3B4 kl_si16_S6_S3 6553.4 UMR_BAR_SEC_1_10_0_S6_S3 -3276.7 3276.7
 /begin AXIS_DESCR STD_AXIS zff_atsys._.iSignale._.obj.sig_m_t UMR_NM__1_1_0_S6_S3 6 -400 1640 DEPOSIT ABSOLUTE MONOTONY MON_INCREASE /end AXIS_DESCR
/end CHARACTERISTIC
/begin CHARACTERISTIC KF_POFMTNSP87 "Kennfeld Fuelldruckoffset(n_t, m_t)" MAP 0x25A3D0 kf_si16_S6_S3 12.75 UMR_BAR__1_1000_0_S6_S3 -6.4 6.35
 /begin AXIS_DESCR STD_AXIS zff_atsys._.iSignale._.obj.sig_n_t UMR_U_MIN_1_1_0_S6_S3 4 0 8160 DEPOSIT ABSOLUTE MONOTONY MON_INCREASE /end AXIS_DESCR
 /begin AXIS_DESCR STD_AXIS zff_atsys._.iSignale._.obj.sig_m_t UMR_NM__1_1_0_S6_S3 6 -400 1640 DEPOSIT ABSOLUTE MONOTONY MON_INCREASE /end AXIS_DESCR
/end CHARACTERISTIC
/begin CHARACTERISTIC KF_PKZUSP87 "Schaltdruck zuschaltende Kupplung" MAP 0x25A41C kf_si16_S6_S3 12.75 UMR_BAR__1_1000_0_S6_S3 0 12.75
 /begin AXIS_DESCR STD_AXIS iSasZentr.iSchaltend.n_tkf UMR_U_MIN_32_1_0_S6_S3 8 0 8160 DEPOSIT ABSOLUTE MONOTONY MON_INCREASE /end AXIS_DESCR
 /begin AXIS_DESCR STD_AXIS zff_atsys._.iSignale._.obj.sig_m_t UMR_NM__1_1_0_S6_S3 8 -400 1640 DEPOSIT ABSOLUTE MONOTONY MON_INCREASE /end AXIS_DESCR
/end CHARACTERISTIC
/begin CHARACTERISTIC KF_POHINSYNKZUSP87 "Kennfeld Haltedruckoffset(n_tkf, m_t) bei Haltephase in Synchron" MAP 0x25A4C4 kf_si16_S6_S3 12.75 UMR_BAR__1_1000_0_S6_S3 -6.4 6.35
 /begin AXIS_DESCR STD_AXIS iSasZentr.iSchaltend.n_tkf UMR_U_MIN_32_1_0_S6_S3 4 0 8160 DEPOSIT ABSOLUTE MONOTONY MON_INCREASE /end AXIS_DESCR
 /begin AXIS_DESCR STD_AXIS zff_atsys._.iSignale._.obj.sig_m_t UMR_NM__1_1_0_S6_S3 4 -400 1640 DEPOSIT ABSOLUTE MONOTONY MON_INCREASE /end AXIS_DESCR
/end CHARACTERISTIC
/begin CHARACTERISTIC KL_TSYNCGHINSYNEKZUSP87 "Zeit fuer Ende Haltephase in Synchron KZU" CURVE 0x25A4FC kl_ui8_S6_S3 2550 UMR_MSEC__10_1_M128_S6_S3 -1280 1270
 /begin AXIS_DESCR STD_AXIS zff_atsys._.iSignale._.obj.sig_c_getr UMR_GRADC__1_1_M40_S6_S3 4 -40 150 DEPOSIT ABSOLUTE MONOTONY MON_INCREASE /end AXIS_DESCR
/end CHARACTERISTIC
/begin CHARACTERISTIC F_PRASP31 "Druckfaktor waehrend Rampe auf Schaltdruck" VALUE 0x26E944 kw_ui8_S6_S3 1 UMR___1_100_0_S6_S3 0 1 /end CHARACTERISTIC
/begin CHARACTERISTIC F_TRASP31 "Zeitfaktor waehrend Rampe auf Schaltdruck" VALUE 0x26E945 kw_ui8_S6_S3 1 UMR___1_100_0_S6_S3 0 1 /end CHARACTERISTIC
/begin CHARACTERISTIC T_FSP31 "Fuellzeit" VALUE 0x26E946 kw_ui8_S6_S3 2540 UMR_MSEC__10_1_0_S6_S3 0 2540 /end CHARACTERISTIC
/begin CHARACTERISTIC KL_TRASP31 "Kennlinie Zeit Erste Rampe" CURVE 0x25A508 kl_ui8_S6_S3 2540 UMR_MSEC__10_1_0_S6_S3 0 2540
 /begin AXIS_DESCR STD_AXIS zff_atsys._.iSignale._.obj.sig_m_t8 UMR_NM__8_1_M50_S6_S3 4 -400 1640 DEPOSIT ABSOLUTE MONOTONY MON_INCREASE /end AXIS_DESCR
/end CHARACTERISTIC
/begin CHARACTERISTIC KL_PGRASYNSP31 "Schliessrampenradient" CURVE 0x25A514 kl_si16_S6_S3 6553.4 UMR_BAR_SEC_1_10_0_S6_S3 -3276.7 3276.7
 /begin AXIS_DESCR STD_AXIS zff_atsys._.iSignale._.obj.sig_m_t UMR_NM__1_1_0_S6_S3 6 -400 1640 DEPOSIT ABSOLUTE MONOTONY MON_INCREASE /end AXIS_DESCR
/end CHARACTERISTIC
/begin CHARACTERISTIC KF_POFMTNSP31 "Kennfeld Fuelldruckoffset(n_t, m_t)" MAP 0x25A530 kf_si16_S6_S3 12.75 UMR_BAR__1_1000_0_S6_S3 -6.4 6.35
 /begin AXIS_DESCR STD_AXIS zff_atsys._.iSignale._.obj.sig_n_t UMR_U_MIN_1_1_0_S6_S3 4 0 8160 DEPOSIT ABSOLUTE MONOTONY MON_INCREASE /end AXIS_DESCR
 /begin AXIS_DESCR STD_AXIS zff_atsys._.iSignale._.obj.sig_m_t UMR_NM__1_1_0_S6_S3 6 -400 1640 DEPOSIT ABSOLUTE MONOTONY MON_INCREASE /end AXIS_DESCR
/end CHARACTERISTIC
/begin CHARACTERISTIC KF_PKZUSP31 "Schaltdruck zuschaltende Kupplung" MAP 0x25A57C kf_si16_S6_S3 12.75 UMR_BAR__1_1000_0_S6_S3 0 12.75
 /begin AXIS_DESCR STD_AXIS iSasZentr.iSchaltend.n_tkf UMR_U_MIN_32_1_0_S6_S3 8 0 8160 DEPOSIT ABSOLUTE MONOTONY MON_INCREASE /end AXIS_DESCR
 /begin AXIS_DESCR STD_AXIS zff_atsys._.iSignale._.obj.sig_m_t UMR_NM__1_1_0_S6_S3 8 -400 1640 DEPOSIT ABSOLUTE MONOTONY MON_INCREASE /end AXIS_DESCR
/end CHARACTERISTIC
/begin CHARACTERISTIC KF_POHINSYNKZUSP31 "Kennfeld Haltedruckoffset(n_tkf, m_t) bei Haltephase in Synchron" MAP 0x25A624 kf_si16_S6_S3 12.75 UMR_BAR__1_1000_0_S6_S3 -6.4 6.35
 /begin AXIS_DESCR STD_AXIS iSasZentr.iSchaltend.n_tkf UMR_U_MIN_32_1_0_S6_S3 4 0 8160 DEPOSIT ABSOLUTE MONOTONY MON_INCREASE /end AXIS_DESCR
 /begin AXIS_DESCR STD_AXIS zff_atsys._.iSignale._.obj.sig_m_t UMR_NM__1_1_0_S6_S3 4 -400 1640 DEPOSIT ABSOLUTE MONOTONY MON_INCREASE /end AXIS_DESCR
/end CHARACTERISTIC
/begin CHARACTERISTIC KL_TSYNCGHINSYNEKZUSP31 "Zeit fuer Ende Haltephase in Synchron KZU" CURVE 0x25A65C kl_ui8_S6_S3 2550 UMR_MSEC__10_1_M128_S6_S3 -1280 1270
 /begin AXIS_DESCR STD_AXIS zff_atsys._.iSignale._.obj.sig_c_getr UMR_GRADC__1_1_M40_S6_S3 4 -40 150 DEPOSIT ABSOLUTE MONOTONY MON_INCREASE /end AXIS_DESCR
/end CHARACTERISTIC
/begin CHARACTERISTIC F_PRASP42 "Druckfaktor waehrend Rampe auf Schaltdruck" VALUE 0x26E947 kw_ui8_S6_S3 1 UMR___1_100_0_S6_S3 0 1 /end CHARACTERISTIC
/begin CHARACTERISTIC F_TRASP42 "Zeitfaktor waehrend Rampe auf Schaltdruck" VALUE 0x26E948 kw_ui8_S6_S3 1 UMR___1_100_0_S6_S3 0 1 /end CHARACTERISTIC
/begin CHARACTERISTIC T_FSP42 "Fuellzeit" VALUE 0x26E949 kw_ui8_S6_S3 2540 UMR_MSEC__10_1_0_S6_S3 0 2540 /end CHARACTERISTIC
/begin CHARACTERISTIC T_FSP42_EL "Fuellzeit" VALUE 0x26E94A kw_ui8_S6_S3 2540 UMR_MSEC__10_1_0_S6_S3 0 2540 /end CHARACTERISTIC
/begin CHARACTERISTIC KL_TRASP42 "Kennlinie Zeit Erste Rampe" CURVE 0x25A668 kl_ui8_S6_S3 2540 UMR_MSEC__10_1_0_S6_S3 0 2540
 /begin AXIS_DESCR STD_AXIS zff_atsys._.iSignale._.obj.sig_m_t8 UMR_NM__8_1_M50_S6_S3 4 -400 1640 DEPOSIT ABSOLUTE MONOTONY MON_INCREASE /end AXIS_DESCR
/end CHARACTERISTIC
/begin CHARACTERISTIC KL_TRASP42_EL "Kennlinie Zeit Erste Rampe" CURVE 0x25A674 kl_ui8_S6_S3 2540 UMR_MSEC__10_1_0_S6_S3 0 2540
 /begin AXIS_DESCR STD_AXIS zff_atsys._.iSignale._.obj.sig_m_t8 UMR_NM__8_1_M50_S6_S3 4 -400 1640 DEPOSIT ABSOLUTE MONOTONY MON_INCREASE /end AXIS_DESCR
/end CHARACTERISTIC
/begin CHARACTERISTIC KL_PGRASYNSP42 "Schliessrampenradient" CURVE 0x25A680 kl_si16_S6_S3 6553.4 UMR_BAR_SEC_1_10_0_S6_S3 -3276.7 3276.7
 /begin AXIS_DESCR STD_AXIS zff_atsys._.iSignale._.obj.sig_m_t UMR_NM__1_1_0_S6_S3 6 -400 1640 DEPOSIT ABSOLUTE MONOTONY MON_INCREASE /end AXIS_DESCR
/end CHARACTERISTIC
/begin CHARACTERISTIC KF_POFMTNSP42 "Kennfeld Fuelldruckoffset(n_t, m_t)" MAP 0x25A69C kf_si16_S6_S3 12.75 UMR_BAR__1_1000_0_S6_S3 -6.4 6.35
 /begin AXIS_DESCR STD_AXIS zff_atsys._.iSignale._.obj.sig_n_t UMR_U_MIN_1_1_0_S6_S3 4 0 8160 DEPOSIT ABSOLUTE MONOTONY MON_INCREASE /end AXIS_DESCR
 /begin AXIS_DESCR STD_AXIS zff_atsys._.iSignale._.obj.sig_m_t UMR_NM__1_1_0_S6_S3 6 -400 1640 DEPOSIT ABSOLUTE MONOTONY MON_INCREASE /end AXIS_DESCR
/end CHARACTERISTIC
/begin CHARACTERISTIC KF_POFMTNSP42_EL "Kennfeld Fuelldruckoffset(n_t, m_t)" MAP 0x25A6E8 kf_si16_S6_S3 12.75 UMR_BAR__1_1000_0_S6_S3 -6.4 6.35
 /begin AXIS_DESCR STD_AXIS zff_atsys._.iSignale._.obj.sig_n_t UMR_U_MIN_1_1_0_S6_S3 4 0 8160 DEPOSIT ABSOLUTE MONOTONY MON_INCREASE /end AXIS_DESCR
 /begin AXIS_DESCR STD_AXIS zff_atsys._.iSignale._.obj.sig_m_t UMR_NM__1_1_0_S6_S3 6 -400 1640 DEPOSIT ABSOLUTE MONOTONY MON_INCREASE /end AXIS_DESCR
/end CHARACTERISTIC
/begin CHARACTERISTIC KF_PKZUSP42 "Schaltdruck zuschaltende Kupplung" MAP 0x25A734 kf_si16_S6_S3 12.75 UMR_BAR__1_1000_0_S6_S3 0 12.75
 /begin AXIS_DESCR STD_AXIS iSasZentr.iSchaltend.n_tkf UMR_U_MIN_32_1_0_S6_S3 8 0 8160 DEPOSIT ABSOLUTE MONOTONY MON_INCREASE /end AXIS_DESCR
 /begin AXIS_DESCR STD_AXIS zff_atsys._.iSignale._.obj.sig_m_t UMR_NM__1_1_0_S6_S3 8 -400 1640 DEPOSIT ABSOLUTE MONOTONY MON_INCREASE /end AXIS_DESCR
/end CHARACTERISTIC
/begin CHARACTERISTIC KF_PKZUSP42_EL "Schaltdruck zuschaltende Kupplung" MAP 0x25A7DC kf_si16_S6_S3 12.75 UMR_BAR__1_1000_0_S6_S3 0 12.75
 /begin AXIS_DESCR STD_AXIS iSasZentr.iSchaltend.n_tkf UMR_U_MIN_32_1_0_S6_S3 8 0 8160 DEPOSIT ABSOLUTE MONOTONY MON_INCREASE /end AXIS_DESCR
 /begin AXIS_DESCR STD_AXIS zff_atsys._.iSignale._.obj.sig_m_t UMR_NM__1_1_0_S6_S3 8 -400 1640 DEPOSIT ABSOLUTE MONOTONY MON_INCREASE /end AXIS_DESCR
/end CHARACTERISTIC
/begin CHARACTERISTIC KF_POHINSYNKZUSP42 "Kennfeld Haltedruckoffset(n_tkf, m_t) bei Haltephase in Synchron" MAP 0x25A884 kf_si16_S6_S3 12.75 UMR_BAR__1_1000_0_S6_S3 -6.4 6.35
 /begin AXIS_DESCR STD_AXIS iSasZentr.iSchaltend.n_tkf UMR_U_MIN_32_1_0_S6_S3 4 0 8160 DEPOSIT ABSOLUTE MONOTONY MON_INCREASE /end AXIS_DESCR
 /begin AXIS_DESCR STD_AXIS zff_atsys._.iSignale._.obj.sig_m_t UMR_NM__1_1_0_S6_S3 4 -400 1640 DEPOSIT ABSOLUTE MONOTONY MON_INCREASE /end AXIS_DESCR
/end CHARACTERISTIC
/begin CHARACTERISTIC KL_TSYNCGHINSYNEKZUSP42 "Zeit fuer Ende Haltephase in Synchron KZU" CURVE 0x25A8BC kl_ui8_S6_S3 2550 UMR_MSEC__10_1_M128_S6_S3 -1280 1270
 /begin AXIS_DESCR STD_AXIS zff_atsys._.iSignale._.obj.sig_c_getr UMR_GRADC__1_1_M40_S6_S3 4 -40 150 DEPOSIT ABSOLUTE MONOTONY MON_INCREASE /end AXIS_DESCR
/end CHARACTERISTIC
/begin CHARACTERISTIC F_PRASP51 "Druckfaktor waehrend Rampe auf Schaltdruck" VALUE 0x26E94B kw_ui8_S6_S3 1 UMR___1_100_0_S6_S3 0 1 /end CHARACTERISTIC
/begin CHARACTERISTIC F_TRASP51 "Zeitfaktor waehrend Rampe auf Schaltdruck" VALUE 0x26E94C kw_ui8_S6_S3 1 UMR___1_100_0_S6_S3 0 1 /end CHARACTERISTIC
/begin CHARACTERISTIC T_FSP51 "Fuellzeit" VALUE 0x26E94D kw_ui8_S6_S3 2540 UMR_MSEC__10_1_0_S6_S3 0 2540 /end CHARACTERISTIC
/begin CHARACTERISTIC KL_TRASP51 "Kennlinie Zeit Erste Rampe" CURVE 0x25A8C8 kl_ui8_S6_S3 2540 UMR_MSEC__10_1_0_S6_S3 0 2540
 /begin AXIS_DESCR STD_AXIS zff_atsys._.iSignale._.obj.sig_m_t8 UMR_NM__8_1_M50_S6_S3 4 -400 1640 DEPOSIT ABSOLUTE MONOTONY MON_INCREASE /end AXIS_DESCR
/end CHARACTERISTIC
/begin CHARACTERISTIC KL_PGRASYNSP51 "Schliessrampenradient" CURVE 0x25A8D4 kl_si16_S6_S3 6553.4 UMR_BAR_SEC_1_10_0_S6_S3 -3276.7 3276.7
 /begin AXIS_DESCR STD_AXIS zff_atsys._.iSignale._.obj.sig_m_t UMR_NM__1_1_0_S6_S3 6 -400 1640 DEPOSIT ABSOLUTE MONOTONY MON_INCREASE /end AXIS_DESCR
/end CHARACTERISTIC
/begin CHARACTERISTIC KF_POFMTNSP51 "Kennfeld Fuelldruckoffset(n_t, m_t)" MAP 0x25A8F0 kf_si16_S6_S3 12.75 UMR_BAR__1_1000_0_S6_S3 -6.4 6.35
 /begin AXIS_DESCR STD_AXIS zff_atsys._.iSignale._.obj.sig_n_t UMR_U_MIN_1_1_0_S6_S3 4 0 8160 DEPOSIT ABSOLUTE MONOTONY MON_INCREASE /end AXIS_DESCR
 /begin AXIS_DESCR STD_AXIS zff_atsys._.iSignale._.obj.sig_m_t UMR_NM__1_1_0_S6_S3 6 -400 1640 DEPOSIT ABSOLUTE MONOTONY MON_INCREASE /end AXIS_DESCR
/end CHARACTERISTIC
/begin CHARACTERISTIC KF_PKZUSP51 "Schaltdruck zuschaltende Kupplung" MAP 0x25A93C kf_si16_S6_S3 12.75 UMR_BAR__1_1000_0_S6_S3 0 12.75
 /begin AXIS_DESCR STD_AXIS iSasZentr.iSchaltend.n_tkf UMR_U_MIN_32_1_0_S6_S3 8 0 8160 DEPOSIT ABSOLUTE MONOTONY MON_INCREASE /end AXIS_DESCR
 /begin AXIS_DESCR STD_AXIS zff_atsys._.iSignale._.obj.sig_m_t UMR_NM__1_1_0_S6_S3 8 -400 1640 DEPOSIT ABSOLUTE MONOTONY MON_INCREASE /end AXIS_DESCR
/end CHARACTERISTIC
/begin CHARACTERISTIC KF_POHINSYNKZUSP51 "Kennfeld Haltedruckoffset(n_tkf, m_t) bei Haltephase in Synchron" MAP 0x25A9E4 kf_si16_S6_S3 12.75 UMR_BAR__1_1000_0_S6_S3 -6.4 6.35
 /begin AXIS_DESCR STD_AXIS iSasZentr.iSchaltend.n_tkf UMR_U_MIN_32_1_0_S6_S3 4 0 8160 DEPOSIT ABSOLUTE MONOTONY MON_INCREASE /end AXIS_DESCR
 /begin AXIS_DESCR STD_AXIS zff_atsys._.iSignale._.obj.sig_m_t UMR_NM__1_1_0_S6_S3 4 -400 1640 DEPOSIT ABSOLUTE MONOTONY MON_INCREASE /end AXIS_DESCR
/end CHARACTERISTIC
/begin CHARACTERISTIC KL_TSYNCGHINSYNEKZUSP51 "Zeit fuer Ende Haltephase in Synchron KZU" CURVE 0x25AA1C kl_ui8_S6_S3 2550 UMR_MSEC__10_1_M128_S6_S3 -1280 1270
 /begin AXIS_DESCR STD_AXIS zff_atsys._.iSignale._.obj.sig_c_getr UMR_GRADC__1_1_M40_S6_S3 4 -40 150 DEPOSIT ABSOLUTE MONOTONY MON_INCREASE /end AXIS_DESCR
/end CHARACTERISTIC
/begin CHARACTERISTIC F_PRASP53 "Druckfaktor waehrend Rampe auf Schaltdruck" VALUE 0x26E94E kw_ui8_S6_S3 1 UMR___1_100_0_S6_S3 0 1 /end CHARACTERISTIC
/begin CHARACTERISTIC F_TRASP53 "Zeitfaktor waehrend Rampe auf Schaltdruck" VALUE 0x26E94F kw_ui8_S6_S3 1 UMR___1_100_0_S6_S3 0 1 /end CHARACTERISTIC
/begin CHARACTERISTIC T_FSP53 "Fuellzeit" VALUE 0x26E950 kw_ui8_S6_S3 2540 UMR_MSEC__10_1_0_S6_S3 0 2540 /end CHARACTERISTIC
/begin CHARACTERISTIC T_FSP53_EL "Fuellzeit" VALUE 0x26E951 kw_ui8_S6_S3 2540 UMR_MSEC__10_1_0_S6_S3 0 2540 /end CHARACTERISTIC
/begin CHARACTERISTIC KL_TRASP53 "Kennlinie Zeit Erste Rampe" CURVE 0x25AA28 kl_ui8_S6_S3 2540 UMR_MSEC__10_1_0_S6_S3 0 2540
 /begin AXIS_DESCR STD_AXIS zff_atsys._.iSignale._.obj.sig_m_t8 UMR_NM__8_1_M50_S6_S3 4 -400 1640 DEPOSIT ABSOLUTE MONOTONY MON_INCREASE /end AXIS_DESCR
/end CHARACTERISTIC
/begin CHARACTERISTIC KL_TRASP53_EL "Kennlinie Zeit Erste Rampe" CURVE 0x25AA34 kl_ui8_S6_S3 2540 UMR_MSEC__10_1_0_S6_S3 0 2540
 /begin AXIS_DESCR STD_AXIS zff_atsys._.iSignale._.obj.sig_m_t8 UMR_NM__8_1_M50_S6_S3 4 -400 1640 DEPOSIT ABSOLUTE MONOTONY MON_INCREASE /end AXIS_DESCR
/end CHARACTERISTIC
/begin CHARACTERISTIC KL_PGRASYNSP53 "Schliessrampenradient" CURVE 0x25AA40 kl_si16_S6_S3 6553.4 UMR_BAR_SEC_1_10_0_S6_S3 -3276.7 3276.7
 /begin AXIS_DESCR STD_AXIS zff_atsys._.iSignale._.obj.sig_m_t UMR_NM__1_1_0_S6_S3 6 -400 1640 DEPOSIT ABSOLUTE MONOTONY MON_INCREASE /end AXIS_DESCR
/end CHARACTERISTIC
/begin CHARACTERISTIC KF_POFMTNSP53 "Kennfeld Fuelldruckoffset(n_t, m_t)" MAP 0x25AA5C kf_si16_S6_S3 12.75 UMR_BAR__1_1000_0_S6_S3 -6.4 6.35
 /begin AXIS_DESCR STD_AXIS zff_atsys._.iSignale._.obj.sig_n_t UMR_U_MIN_1_1_0_S6_S3 4 0 8160 DEPOSIT ABSOLUTE MONOTONY MON_INCREASE /end AXIS_DESCR
 /begin AXIS_DESCR STD_AXIS zff_atsys._.iSignale._.obj.sig_m_t UMR_NM__1_1_0_S6_S3 6 -400 1640 DEPOSIT ABSOLUTE MONOTONY MON_INCREASE /end AXIS_DESCR
/end CHARACTERISTIC
/begin CHARACTERISTIC KF_POFMTNSP53_EL "Kennfeld Fuelldruckoffset(n_t, m_t)" MAP 0x25AAA8 kf_si16_S6_S3 12.75 UMR_BAR__1_1000_0_S6_S3 -6.4 6.35
 /begin AXIS_DESCR STD_AXIS zff_atsys._.iSignale._.obj.sig_n_t UMR_U_MIN_1_1_0_S6_S3 4 0 8160 DEPOSIT ABSOLUTE MONOTONY MON_INCREASE /end AXIS_DESCR
 /begin AXIS_DESCR STD_AXIS zff_atsys._.iSignale._.obj.sig_m_t UMR_NM__1_1_0_S6_S3 6 -400 1640 DEPOSIT ABSOLUTE MONOTONY MON_INCREASE /end AXIS_DESCR
/end CHARACTERISTIC
/begin CHARACTERISTIC KF_PKZUSP53 "Schaltdruck zuschaltende Kupplung" MAP 0x25AAF4 kf_si16_S6_S3 12.75 UMR_BAR__1_1000_0_S6_S3 0 12.75
 /begin AXIS_DESCR STD_AXIS iSasZentr.iSchaltend.n_tkf UMR_U_MIN_32_1_0_S6_S3 8 0 8160 DEPOSIT ABSOLUTE MONOTONY MON_INCREASE /end AXIS_DESCR
 /begin AXIS_DESCR STD_AXIS zff_atsys._.iSignale._.obj.sig_m_t UMR_NM__1_1_0_S6_S3 8 -400 1640 DEPOSIT ABSOLUTE MONOTONY MON_INCREASE /end AXIS_DESCR
/end CHARACTERISTIC
/begin CHARACTERISTIC KF_PKZUSP53_EL "Schaltdruck zuschaltende Kupplung" MAP 0x25AB9C kf_si16_S6_S3 12.75 UMR_BAR__1_1000_0_S6_S3 0 12.75
 /begin AXIS_DESCR STD_AXIS iSasZentr.iSchaltend.n_tkf UMR_U_MIN_32_1_0_S6_S3 8 0 8160 DEPOSIT ABSOLUTE MONOTONY MON_INCREASE /end AXIS_DESCR
 /begin AXIS_DESCR STD_AXIS zff_atsys._.iSignale._.obj.sig_m_t UMR_NM__1_1_0_S6_S3 8 -400 1640 DEPOSIT ABSOLUTE MONOTONY MON_INCREASE /end AXIS_DESCR
/end CHARACTERISTIC
/begin CHARACTERISTIC KF_POHINSYNKZUSP53 "Kennfeld Haltedruckoffset(n_tkf, m_t) bei Haltephase in Synchron" MAP 0x25AC44 kf_si16_S6_S3 12.75 UMR_BAR__1_1000_0_S6_S3 -6.4 6.35
 /begin AXIS_DESCR STD_AXIS iSasZentr.iSchaltend.n_tkf UMR_U_MIN_32_1_0_S6_S3 4 0 8160 DEPOSIT ABSOLUTE MONOTONY MON_INCREASE /end AXIS_DESCR
 /begin AXIS_DESCR STD_AXIS zff_atsys._.iSignale._.obj.sig_m_t UMR_NM__1_1_0_S6_S3 4 -400 1640 DEPOSIT ABSOLUTE MONOTONY MON_INCREASE /end AXIS_DESCR
/end CHARACTERISTIC
/begin CHARACTERISTIC KL_TSYNCGHINSYNEKZUSP53 "Zeit fuer Ende Haltephase in Synchron KZU" CURVE 0x25AC7C kl_ui8_S6_S3 2550 UMR_MSEC__10_1_M128_S6_S3 -1280 1270
 /begin AXIS_DESCR STD_AXIS zff_atsys._.iSignale._.obj.sig_c_getr UMR_GRADC__1_1_M40_S6_S3 4 -40 150 DEPOSIT ABSOLUTE MONOTONY MON_INCREASE /end AXIS_DESCR
/end CHARACTERISTIC
/begin CHARACTERISTIC F_PRASP63 "Druckfaktor waehrend Rampe auf Schaltdruck" VALUE 0x26E952 kw_ui8_S6_S3 1 UMR___1_100_0_S6_S3 0 1 /end CHARACTERISTIC
/begin CHARACTERISTIC F_TRASP63 "Zeitfaktor waehrend Rampe auf Schaltdruck" VALUE 0x26E953 kw_ui8_S6_S3 1 UMR___1_100_0_S6_S3 0 1 /end CHARACTERISTIC
/begin CHARACTERISTIC T_FSP63 "Fuellzeit" VALUE 0x26E954 kw_ui8_S6_S3 2540 UMR_MSEC__10_1_0_S6_S3 0 2540 /end CHARACTERISTIC
/begin CHARACTERISTIC T_FSP63_EL "Fuellzeit" VALUE 0x26E955 kw_ui8_S6_S3 2540 UMR_MSEC__10_1_0_S6_S3 0 2540 /end CHARACTERISTIC
/begin CHARACTERISTIC KL_TRASP63 "Kennlinie Zeit Erste Rampe" CURVE 0x25AC88 kl_ui8_S6_S3 2540 UMR_MSEC__10_1_0_S6_S3 0 2540
 /begin AXIS_DESCR STD_AXIS zff_atsys._.iSignale._.obj.sig_m_t8 UMR_NM__8_1_M50_S6_S3 4 -400 1640 DEPOSIT ABSOLUTE MONOTONY MON_INCREASE /end AXIS_DESCR
/end CHARACTERISTIC
/begin CHARACTERISTIC KL_TRASP63_EL "Kennlinie Zeit Erste Rampe" CURVE 0x25AC94 kl_ui8_S6_S3 2540 UMR_MSEC__10_1_0_S6_S3 0 2540
 /begin AXIS_DESCR STD_AXIS zff_atsys._.iSignale._.obj.sig_m_t8 UMR_NM__8_1_M50_S6_S3 4 -400 1640 DEPOSIT ABSOLUTE MONOTONY MON_INCREASE /end AXIS_DESCR
/end CHARACTERISTIC
/begin CHARACTERISTIC KL_PGRASYNSP63 "Schliessrampenradient" CURVE 0x25ACA0 kl_si16_S6_S3 6553.4 UMR_BAR_SEC_1_10_0_S6_S3 -3276.7 3276.7
 /begin AXIS_DESCR STD_AXIS zff_atsys._.iSignale._.obj.sig_m_t UMR_NM__1_1_0_S6_S3 6 -400 1640 DEPOSIT ABSOLUTE MONOTONY MON_INCREASE /end AXIS_DESCR
/end CHARACTERISTIC
/begin CHARACTERISTIC KF_POFMTNSP63 "Kennfeld Fuelldruckoffset(n_t, m_t)" MAP 0x25ACBC kf_si16_S6_S3 12.75 UMR_BAR__1_1000_0_S6_S3 -6.4 6.35
 /begin AXIS_DESCR STD_AXIS zff_atsys._.iSignale._.obj.sig_n_t UMR_U_MIN_1_1_0_S6_S3 4 0 8160 DEPOSIT ABSOLUTE MONOTONY MON_INCREASE /end AXIS_DESCR
 /begin AXIS_DESCR STD_AXIS zff_atsys._.iSignale._.obj.sig_m_t UMR_NM__1_1_0_S6_S3 6 -400 1640 DEPOSIT ABSOLUTE MONOTONY MON_INCREASE /end AXIS_DESCR
/end CHARACTERISTIC
/begin CHARACTERISTIC KF_POFMTNSP63_EL "Kennfeld Fuelldruckoffset(n_t, m_t)" MAP 0x25AD08 kf_si16_S6_S3 12.75 UMR_BAR__1_1000_0_S6_S3 -6.4 6.35
 /begin AXIS_DESCR STD_AXIS zff_atsys._.iSignale._.obj.sig_n_t UMR_U_MIN_1_1_0_S6_S3 4 0 8160 DEPOSIT ABSOLUTE MONOTONY MON_INCREASE /end AXIS_DESCR
 /begin AXIS_DESCR STD_AXIS zff_atsys._.iSignale._.obj.sig_m_t UMR_NM__1_1_0_S6_S3 6 -400 1640 DEPOSIT ABSOLUTE MONOTONY MON_INCREASE /end AXIS_DESCR
/end CHARACTERISTIC
/begin CHARACTERISTIC KF_PKZUSP63 "Schaltdruck zuschaltende Kupplung" MAP 0x25AD54 kf_si16_S6_S3 12.75 UMR_BAR__1_1000_0_S6_S3 0 12.75
 /begin AXIS_DESCR STD_AXIS iSasZentr.iSchaltend.n_tkf UMR_U_MIN_32_1_0_S6_S3 8 0 8160 DEPOSIT ABSOLUTE MONOTONY MON_INCREASE /end AXIS_DESCR
 /begin AXIS_DESCR STD_AXIS zff_atsys._.iSignale._.obj.sig_m_t UMR_NM__1_1_0_S6_S3 8 -400 1640 DEPOSIT ABSOLUTE MONOTONY MON_INCREASE /end AXIS_DESCR
/end CHARACTERISTIC
/begin CHARACTERISTIC KF_PKZUSP63_EL "Schaltdruck zuschaltende Kupplung" MAP 0x25ADFC kf_si16_S6_S3 12.75 UMR_BAR__1_1000_0_S6_S3 0 12.75
 /begin AXIS_DESCR STD_AXIS iSasZentr.iSchaltend.n_tkf UMR_U_MIN_32_1_0_S6_S3 8 0 8160 DEPOSIT ABSOLUTE MONOTONY MON_INCREASE /end AXIS_DESCR
 /begin AXIS_DESCR STD_AXIS zff_atsys._.iSignale._.obj.sig_m_t UMR_NM__1_1_0_S6_S3 8 -400 1640 DEPOSIT ABSOLUTE MONOTONY MON_INCREASE /end AXIS_DESCR
/end CHARACTERISTIC
/begin CHARACTERISTIC KF_POHINSYNKZUSP63 "Kennfeld Haltedruckoffset(n_tkf, m_t) bei Haltephase in Synchron" MAP 0x25AEA4 kf_si16_S6_S3 12.75 UMR_BAR__1_1000_0_S6_S3 -6.4 6.35
 /begin AXIS_DESCR STD_AXIS iSasZentr.iSchaltend.n_tkf UMR_U_MIN_32_1_0_S6_S3 4 0 8160 DEPOSIT ABSOLUTE MONOTONY MON_INCREASE /end AXIS_DESCR
 /begin AXIS_DESCR STD_AXIS zff_atsys._.iSignale._.obj.sig_m_t UMR_NM__1_1_0_S6_S3 4 -400 1640 DEPOSIT ABSOLUTE MONOTONY MON_INCREASE /end AXIS_DESCR
/end CHARACTERISTIC
/begin CHARACTERISTIC KL_TSYNCGHINSYNEKZUSP63 "Zeit fuer Ende Haltephase in Synchron KZU" CURVE 0x25AEDC kl_ui8_S6_S3 2550 UMR_MSEC__10_1_M128_S6_S3 -1280 1270
 /begin AXIS_DESCR STD_AXIS zff_atsys._.iSignale._.obj.sig_c_getr UMR_GRADC__1_1_M40_S6_S3 4 -40 150 DEPOSIT ABSOLUTE MONOTONY MON_INCREASE /end AXIS_DESCR
/end CHARACTERISTIC
/begin CHARACTERISTIC F_PRASP64 "Druckfaktor waehrend Rampe auf Schaltdruck" VALUE 0x26E956 kw_ui8_S6_S3 1 UMR___1_100_0_S6_S3 0 1 /end CHARACTERISTIC
/begin CHARACTERISTIC F_TRASP64 "Zeitfaktor waehrend Rampe auf Schaltdruck" VALUE 0x26E957 kw_ui8_S6_S3 1 UMR___1_100_0_S6_S3 0 1 /end CHARACTERISTIC
/begin CHARACTERISTIC T_FSP64 "Fuellzeit" VALUE 0x26E958 kw_ui8_S6_S3 2540 UMR_MSEC__10_1_0_S6_S3 0 2540 /end CHARACTERISTIC
/begin CHARACTERISTIC T_FSP64_EL "Fuellzeit" VALUE 0x26E959 kw_ui8_S6_S3 2540 UMR_MSEC__10_1_0_S6_S3 0 2540 /end CHARACTERISTIC
/begin CHARACTERISTIC KL_TRASP64 "Kennlinie Zeit Erste Rampe" CURVE 0x25AEE8 kl_ui8_S6_S3 2540 UMR_MSEC__10_1_0_S6_S3 0 2540
 /begin AXIS_DESCR STD_AXIS zff_atsys._.iSignale._.obj.sig_m_t8 UMR_NM__8_1_M50_S6_S3 4 -400 1640 DEPOSIT ABSOLUTE MONOTONY MON_INCREASE /end AXIS_DESCR
/end CHARACTERISTIC
/begin CHARACTERISTIC KL_TRASP64_EL "Kennlinie Zeit Erste Rampe" CURVE 0x25AEF4 kl_ui8_S6_S3 2540 UMR_MSEC__10_1_0_S6_S3 0 2540
 /begin AXIS_DESCR STD_AXIS zff_atsys._.iSignale._.obj.sig_m_t8 UMR_NM__8_1_M50_S6_S3 4 -400 1640 DEPOSIT ABSOLUTE MONOTONY MON_INCREASE /end AXIS_DESCR
/end CHARACTERISTIC
/begin CHARACTERISTIC KL_PGRASYNSP64 "Schliessrampenradient" CURVE 0x25AF00 kl_si16_S6_S3 6553.4 UMR_BAR_SEC_1_10_0_S6_S3 -3276.7 3276.7
 /begin AXIS_DESCR STD_AXIS zff_atsys._.iSignale._.obj.sig_m_t UMR_NM__1_1_0_S6_S3 6 -400 1640 DEPOSIT ABSOLUTE MONOTONY MON_INCREASE /end AXIS_DESCR
/end CHARACTERISTIC
/begin CHARACTERISTIC KF_POFMTNSP64 "Kennfeld Fuelldruckoffset(n_t, m_t)" MAP 0x25AF1C kf_si16_S6_S3 12.75 UMR_BAR__1_1000_0_S6_S3 -6.4 6.35
 /begin AXIS_DESCR STD_AXIS zff_atsys._.iSignale._.obj.sig_n_t UMR_U_MIN_1_1_0_S6_S3 4 0 8160 DEPOSIT ABSOLUTE MONOTONY MON_INCREASE /end AXIS_DESCR
 /begin AXIS_DESCR STD_AXIS zff_atsys._.iSignale._.obj.sig_m_t UMR_NM__1_1_0_S6_S3 6 -400 1640 DEPOSIT ABSOLUTE MONOTONY MON_INCREASE /end AXIS_DESCR
/end CHARACTERISTIC
/begin CHARACTERISTIC KF_POFMTNSP64_EL "Kennfeld Fuelldruckoffset(n_t, m_t)" MAP 0x25AF68 kf_si16_S6_S3 12.75 UMR_BAR__1_1000_0_S6_S3 -6.4 6.35
 /begin AXIS_DESCR STD_AXIS zff_atsys._.iSignale._.obj.sig_n_t UMR_U_MIN_1_1_0_S6_S3 4 0 8160 DEPOSIT ABSOLUTE MONOTONY MON_INCREASE /end AXIS_DESCR
 /begin AXIS_DESCR STD_AXIS zff_atsys._.iSignale._.obj.sig_m_t UMR_NM__1_1_0_S6_S3 6 -400 1640 DEPOSIT ABSOLUTE MONOTONY MON_INCREASE /end AXIS_DESCR
/end CHARACTERISTIC
/begin CHARACTERISTIC KF_PKZUSP64 "Schaltdruck zuschaltende Kupplung" MAP 0x25AFB4 kf_si16_S6_S3 12.75 UMR_BAR__1_1000_0_S6_S3 0 12.75
 /begin AXIS_DESCR STD_AXIS iSasZentr.iSchaltend.n_tkf UMR_U_MIN_32_1_0_S6_S3 8 0 8160 DEPOSIT ABSOLUTE MONOTONY MON_INCREASE /end AXIS_DESCR
 /begin AXIS_DESCR STD_AXIS zff_atsys._.iSignale._.obj.sig_m_t UMR_NM__1_1_0_S6_S3 8 -400 1640 DEPOSIT ABSOLUTE MONOTONY MON_INCREASE /end AXIS_DESCR
/end CHARACTERISTIC
/begin CHARACTERISTIC KF_PKZUSP64_EL "Schaltdruck zuschaltende Kupplung" MAP 0x25B05C kf_si16_S6_S3 12.75 UMR_BAR__1_1000_0_S6_S3 0 12.75
 /begin AXIS_DESCR STD_AXIS iSasZentr.iSchaltend.n_tkf UMR_U_MIN_32_1_0_S6_S3 8 0 8160 DEPOSIT ABSOLUTE MONOTONY MON_INCREASE /end AXIS_DESCR
 /begin AXIS_DESCR STD_AXIS zff_atsys._.iSignale._.obj.sig_m_t UMR_NM__1_1_0_S6_S3 8 -400 1640 DEPOSIT ABSOLUTE MONOTONY MON_INCREASE /end AXIS_DESCR
/end CHARACTERISTIC
/begin CHARACTERISTIC KF_POHINSYNKZUSP64 "Kennfeld Haltedruckoffset(n_tkf, m_t) bei Haltephase in Synchron" MAP 0x25B104 kf_si16_S6_S3 12.75 UMR_BAR__1_1000_0_S6_S3 -6.4 6.35
 /begin AXIS_DESCR STD_AXIS iSasZentr.iSchaltend.n_tkf UMR_U_MIN_32_1_0_S6_S3 4 0 8160 DEPOSIT ABSOLUTE MONOTONY MON_INCREASE /end AXIS_DESCR
 /begin AXIS_DESCR STD_AXIS zff_atsys._.iSignale._.obj.sig_m_t UMR_NM__1_1_0_S6_S3 4 -400 1640 DEPOSIT ABSOLUTE MONOTONY MON_INCREASE /end AXIS_DESCR
/end CHARACTERISTIC
/begin CHARACTERISTIC KL_TSYNCGHINSYNEKZUSP64 "Zeit fuer Ende Haltephase in Synchron KZU" CURVE 0x25B13C kl_ui8_S6_S3 2550 UMR_MSEC__10_1_M128_S6_S3 -1280 1270
 /begin AXIS_DESCR STD_AXIS zff_atsys._.iSignale._.obj.sig_c_getr UMR_GRADC__1_1_M40_S6_S3 4 -40 150 DEPOSIT ABSOLUTE MONOTONY MON_INCREASE /end AXIS_DESCR
/end CHARACTERISTIC
/begin CHARACTERISTIC F_PRASP71 "Druckfaktor waehrend Rampe auf Schaltdruck" VALUE 0x26E95A kw_ui8_S6_S3 1 UMR___1_100_0_S6_S3 0 1 /end CHARACTERISTIC
/begin CHARACTERISTIC F_TRASP71 "Zeitfaktor waehrend Rampe auf Schaltdruck" VALUE 0x26E95B kw_ui8_S6_S3 1 UMR___1_100_0_S6_S3 0 1 /end CHARACTERISTIC
/begin CHARACTERISTIC T_FSP71 "Fuellzeit" VALUE 0x26E95C kw_ui8_S6_S3 2540 UMR_MSEC__10_1_0_S6_S3 0 2540 /end CHARACTERISTIC
/begin CHARACTERISTIC KL_TRASP71 "Kennlinie Zeit Erste Rampe" CURVE 0x25B148 kl_ui8_S6_S3 2540 UMR_MSEC__10_1_0_S6_S3 0 2540
 /begin AXIS_DESCR STD_AXIS zff_atsys._.iSignale._.obj.sig_m_t8 UMR_NM__8_1_M50_S6_S3 4 -400 1640 DEPOSIT ABSOLUTE MONOTONY MON_INCREASE /end AXIS_DESCR
/end CHARACTERISTIC
/begin CHARACTERISTIC KL_PGRASYNSP71 "Schliessrampenradient" CURVE 0x25B154 kl_si16_S6_S3 6553.4 UMR_BAR_SEC_1_10_0_S6_S3 -3276.7 3276.7
 /begin AXIS_DESCR STD_AXIS zff_atsys._.iSignale._.obj.sig_m_t UMR_NM__1_1_0_S6_S3 6 -400 1640 DEPOSIT ABSOLUTE MONOTONY MON_INCREASE /end AXIS_DESCR
/end CHARACTERISTIC
/begin CHARACTERISTIC KF_POFMTNSP71 "Kennfeld Fuelldruckoffset(n_t, m_t)" MAP 0x25B170 kf_si16_S6_S3 12.75 UMR_BAR__1_1000_0_S6_S3 -6.4 6.35
 /begin AXIS_DESCR STD_AXIS zff_atsys._.iSignale._.obj.sig_n_t UMR_U_MIN_1_1_0_S6_S3 4 0 8160 DEPOSIT ABSOLUTE MONOTONY MON_INCREASE /end AXIS_DESCR
 /begin AXIS_DESCR STD_AXIS zff_atsys._.iSignale._.obj.sig_m_t UMR_NM__1_1_0_S6_S3 6 -400 1640 DEPOSIT ABSOLUTE MONOTONY MON_INCREASE /end AXIS_DESCR
/end CHARACTERISTIC
/begin CHARACTERISTIC KF_PKZUSP71 "Schaltdruck zuschaltende Kupplung" MAP 0x25B1BC kf_si16_S6_S3 12.75 UMR_BAR__1_1000_0_S6_S3 0 12.75
 /begin AXIS_DESCR STD_AXIS iSasZentr.iSchaltend.n_tkf UMR_U_MIN_32_1_0_S6_S3 8 0 8160 DEPOSIT ABSOLUTE MONOTONY MON_INCREASE /end AXIS_DESCR
 /begin AXIS_DESCR STD_AXIS zff_atsys._.iSignale._.obj.sig_m_t UMR_NM__1_1_0_S6_S3 8 -400 1640 DEPOSIT ABSOLUTE MONOTONY MON_INCREASE /end AXIS_DESCR
/end CHARACTERISTIC
/begin CHARACTERISTIC KF_POHINSYNKZUSP71 "Kennfeld Haltedruckoffset(n_tkf, m_t) bei Haltephase in Synchron" MAP 0x25B264 kf_si16_S6_S3 12.75 UMR_BAR__1_1000_0_S6_S3 -6.4 6.35
 /begin AXIS_DESCR STD_AXIS iSasZentr.iSchaltend.n_tkf UMR_U_MIN_32_1_0_S6_S3 4 0 8160 DEPOSIT ABSOLUTE MONOTONY MON_INCREASE /end AXIS_DESCR
 /begin AXIS_DESCR STD_AXIS zff_atsys._.iSignale._.obj.sig_m_t UMR_NM__1_1_0_S6_S3 4 -400 1640 DEPOSIT ABSOLUTE MONOTONY MON_INCREASE /end AXIS_DESCR
/end CHARACTERISTIC
/begin CHARACTERISTIC KL_TSYNCGHINSYNEKZUSP71 "Zeit fuer Ende Haltephase in Synchron KZU" CURVE 0x25B29C kl_ui8_S6_S3 2550 UMR_MSEC__10_1_M128_S6_S3 -1280 1270
 /begin AXIS_DESCR STD_AXIS zff_atsys._.iSignale._.obj.sig_c_getr UMR_GRADC__1_1_M40_S6_S3 4 -40 150 DEPOSIT ABSOLUTE MONOTONY MON_INCREASE /end AXIS_DESCR
/end CHARACTERISTIC
/begin CHARACTERISTIC F_PRASP75 "Druckfaktor waehrend Rampe auf Schaltdruck" VALUE 0x26E95D kw_ui8_S6_S3 1 UMR___1_100_0_S6_S3 0 1 /end CHARACTERISTIC
/begin CHARACTERISTIC F_TRASP75 "Zeitfaktor waehrend Rampe auf Schaltdruck" VALUE 0x26E95E kw_ui8_S6_S3 1 UMR___1_100_0_S6_S3 0 1 /end CHARACTERISTIC
/begin CHARACTERISTIC T_FSP75 "Fuellzeit" VALUE 0x26E95F kw_ui8_S6_S3 2540 UMR_MSEC__10_1_0_S6_S3 0 2540 /end CHARACTERISTIC
/begin CHARACTERISTIC T_FSP75_EL "Fuellzeit" VALUE 0x26E960 kw_ui8_S6_S3 2540 UMR_MSEC__10_1_0_S6_S3 0 2540 /end CHARACTERISTIC
/begin CHARACTERISTIC KL_TRASP75 "Kennlinie Zeit Erste Rampe" CURVE 0x25B2A8 kl_ui8_S6_S3 2540 UMR_MSEC__10_1_0_S6_S3 0 2540
 /begin AXIS_DESCR STD_AXIS zff_atsys._.iSignale._.obj.sig_m_t8 UMR_NM__8_1_M50_S6_S3 4 -400 1640 DEPOSIT ABSOLUTE MONOTONY MON_INCREASE /end AXIS_DESCR
/end CHARACTERISTIC
/begin CHARACTERISTIC KL_TRASP75_EL "Kennlinie Zeit Erste Rampe" CURVE 0x25B2B4 kl_ui8_S6_S3 2540 UMR_MSEC__10_1_0_S6_S3 0 2540
 /begin AXIS_DESCR STD_AXIS zff_atsys._.iSignale._.obj.sig_m_t8 UMR_NM__8_1_M50_S6_S3 4 -400 1640 DEPOSIT ABSOLUTE MONOTONY MON_INCREASE /end AXIS_DESCR
/end CHARACTERISTIC
/begin CHARACTERISTIC KL_PGRASYNSP75 "Schliessrampenradient" CURVE 0x25B2C0 kl_si16_S6_S3 6553.4 UMR_BAR_SEC_1_10_0_S6_S3 -3276.7 3276.7
 /begin AXIS_DESCR STD_AXIS zff_atsys._.iSignale._.obj.sig_m_t UMR_NM__1_1_0_S6_S3 6 -400 1640 DEPOSIT ABSOLUTE MONOTONY MON_INCREASE /end AXIS_DESCR
/end CHARACTERISTIC
/begin CHARACTERISTIC KF_POFMTNSP75 "Kennfeld Fuelldruckoffset(n_t, m_t)" MAP 0x25B2DC kf_si16_S6_S3 12.75 UMR_BAR__1_1000_0_S6_S3 -6.4 6.35
 /begin AXIS_DESCR STD_AXIS zff_atsys._.iSignale._.obj.sig_n_t UMR_U_MIN_1_1_0_S6_S3 4 0 8160 DEPOSIT ABSOLUTE MONOTONY MON_INCREASE /end AXIS_DESCR
 /begin AXIS_DESCR STD_AXIS zff_atsys._.iSignale._.obj.sig_m_t UMR_NM__1_1_0_S6_S3 6 -400 1640 DEPOSIT ABSOLUTE MONOTONY MON_INCREASE /end AXIS_DESCR
/end CHARACTERISTIC
/begin CHARACTERISTIC KF_POFMTNSP75_EL "Kennfeld Fuelldruckoffset(n_t, m_t)" MAP 0x25B328 kf_si16_S6_S3 12.75 UMR_BAR__1_1000_0_S6_S3 -6.4 6.35
 /begin AXIS_DESCR STD_AXIS zff_atsys._.iSignale._.obj.sig_n_t UMR_U_MIN_1_1_0_S6_S3 4 0 8160 DEPOSIT ABSOLUTE MONOTONY MON_INCREASE /end AXIS_DESCR
 /begin AXIS_DESCR STD_AXIS zff_atsys._.iSignale._.obj.sig_m_t UMR_NM__1_1_0_S6_S3 6 -400 1640 DEPOSIT ABSOLUTE MONOTONY MON_INCREASE /end AXIS_DESCR
/end CHARACTERISTIC
/begin CHARACTERISTIC KF_PKZUSP75 "Schaltdruck zuschaltende Kupplung" MAP 0x25B374 kf_si16_S6_S3 12.75 UMR_BAR__1_1000_0_S6_S3 0 12.75
 /begin AXIS_DESCR STD_AXIS iSasZentr.iSchaltend.n_tkf UMR_U_MIN_32_1_0_S6_S3 8 0 8160 DEPOSIT ABSOLUTE MONOTONY MON_INCREASE /end AXIS_DESCR
 /begin AXIS_DESCR STD_AXIS zff_atsys._.iSignale._.obj.sig_m_t UMR_NM__1_1_0_S6_S3 8 -400 1640 DEPOSIT ABSOLUTE MONOTONY MON_INCREASE /end AXIS_DESCR
/end CHARACTERISTIC
/begin CHARACTERISTIC KF_PKZUSP75_EL "Schaltdruck zuschaltende Kupplung" MAP 0x25B41C kf_si16_S6_S3 12.75 UMR_BAR__1_1000_0_S6_S3 0 12.75
 /begin AXIS_DESCR STD_AXIS iSasZentr.iSchaltend.n_tkf UMR_U_MIN_32_1_0_S6_S3 8 0 8160 DEPOSIT ABSOLUTE MONOTONY MON_INCREASE /end AXIS_DESCR
 /begin AXIS_DESCR STD_AXIS zff_atsys._.iSignale._.obj.sig_m_t UMR_NM__1_1_0_S6_S3 8 -400 1640 DEPOSIT ABSOLUTE MONOTONY MON_INCREASE /end AXIS_DESCR
/end CHARACTERISTIC
/begin CHARACTERISTIC KF_POHINSYNKZUSP75 "Kennfeld Haltedruckoffset(n_tkf, m_t) bei Haltephase in Synchron" MAP 0x25B4C4 kf_si16_S6_S3 12.75 UMR_BAR__1_1000_0_S6_S3 -6.4 6.35
 /begin AXIS_DESCR STD_AXIS iSasZentr.iSchaltend.n_tkf UMR_U_MIN_32_1_0_S6_S3 4 0 8160 DEPOSIT ABSOLUTE MONOTONY MON_INCREASE /end AXIS_DESCR
 /begin AXIS_DESCR STD_AXIS zff_atsys._.iSignale._.obj.sig_m_t UMR_NM__1_1_0_S6_S3 4 -400 1640 DEPOSIT ABSOLUTE MONOTONY MON_INCREASE /end AXIS_DESCR
/end CHARACTERISTIC
/begin CHARACTERISTIC KL_TSYNCGHINSYNEKZUSP75 "Zeit fuer Ende Haltephase in Synchron KZU" CURVE 0x25B4FC kl_ui8_S6_S3 2550 UMR_MSEC__10_1_M128_S6_S3 -1280 1270
 /begin AXIS_DESCR STD_AXIS zff_atsys._.iSignale._.obj.sig_c_getr UMR_GRADC__1_1_M40_S6_S3 4 -40 150 DEPOSIT ABSOLUTE MONOTONY MON_INCREASE /end AXIS_DESCR
/end CHARACTERISTIC
/begin CHARACTERISTIC F_PRASP82 "Druckfaktor waehrend Rampe auf Schaltdruck" VALUE 0x26E961 kw_ui8_S6_S3 1 UMR___1_100_0_S6_S3 0 1 /end CHARACTERISTIC
/begin CHARACTERISTIC F_TRASP82 "Zeitfaktor waehrend Rampe auf Schaltdruck" VALUE 0x26E962 kw_ui8_S6_S3 1 UMR___1_100_0_S6_S3 0 1 /end CHARACTERISTIC
/begin CHARACTERISTIC T_FSP82 "Fuellzeit" VALUE 0x26E963 kw_ui8_S6_S3 2540 UMR_MSEC__10_1_0_S6_S3 0 2540 /end CHARACTERISTIC
/begin CHARACTERISTIC T_FSP82_EL "Fuellzeit" VALUE 0x26E964 kw_ui8_S6_S3 2540 UMR_MSEC__10_1_0_S6_S3 0 2540 /end CHARACTERISTIC
/begin CHARACTERISTIC KL_TRASP82 "Kennlinie Zeit Erste Rampe" CURVE 0x25B508 kl_ui8_S6_S3 2540 UMR_MSEC__10_1_0_S6_S3 0 2540
 /begin AXIS_DESCR STD_AXIS zff_atsys._.iSignale._.obj.sig_m_t8 UMR_NM__8_1_M50_S6_S3 4 -400 1640 DEPOSIT ABSOLUTE MONOTONY MON_INCREASE /end AXIS_DESCR
/end CHARACTERISTIC
/begin CHARACTERISTIC KL_TRASP82_EL "Kennlinie Zeit Erste Rampe" CURVE 0x25B514 kl_ui8_S6_S3 2540 UMR_MSEC__10_1_0_S6_S3 0 2540
 /begin AXIS_DESCR STD_AXIS zff_atsys._.iSignale._.obj.sig_m_t8 UMR_NM__8_1_M50_S6_S3 4 -400 1640 DEPOSIT ABSOLUTE MONOTONY MON_INCREASE /end AXIS_DESCR
/end CHARACTERISTIC
/begin CHARACTERISTIC KL_PGRASYNSP82 "Schliessrampenradient" CURVE 0x25B520 kl_si16_S6_S3 6553.4 UMR_BAR_SEC_1_10_0_S6_S3 -3276.7 3276.7
 /begin AXIS_DESCR STD_AXIS zff_atsys._.iSignale._.obj.sig_m_t UMR_NM__1_1_0_S6_S3 6 -400 1640 DEPOSIT ABSOLUTE MONOTONY MON_INCREASE /end AXIS_DESCR
/end CHARACTERISTIC
/begin CHARACTERISTIC KF_POFMTNSP82 "Kennfeld Fuelldruckoffset(n_t, m_t)" MAP 0x25B53C kf_si16_S6_S3 12.75 UMR_BAR__1_1000_0_S6_S3 -6.4 6.35
 /begin AXIS_DESCR STD_AXIS zff_atsys._.iSignale._.obj.sig_n_t UMR_U_MIN_1_1_0_S6_S3 4 0 8160 DEPOSIT ABSOLUTE MONOTONY MON_INCREASE /end AXIS_DESCR
 /begin AXIS_DESCR STD_AXIS zff_atsys._.iSignale._.obj.sig_m_t UMR_NM__1_1_0_S6_S3 6 -400 1640 DEPOSIT ABSOLUTE MONOTONY MON_INCREASE /end AXIS_DESCR
/end CHARACTERISTIC
/begin CHARACTERISTIC KF_POFMTNSP82_EL "Kennfeld Fuelldruckoffset(n_t, m_t)" MAP 0x25B588 kf_si16_S6_S3 12.75 UMR_BAR__1_1000_0_S6_S3 -6.4 6.35
 /begin AXIS_DESCR STD_AXIS zff_atsys._.iSignale._.obj.sig_n_t UMR_U_MIN_1_1_0_S6_S3 4 0 8160 DEPOSIT ABSOLUTE MONOTONY MON_INCREASE /end AXIS_DESCR
 /begin AXIS_DESCR STD_AXIS zff_atsys._.iSignale._.obj.sig_m_t UMR_NM__1_1_0_S6_S3 6 -400 1640 DEPOSIT ABSOLUTE MONOTONY MON_INCREASE /end AXIS_DESCR
/end CHARACTERISTIC
/begin CHARACTERISTIC KF_PKZUSP82 "Schaltdruck zuschaltende Kupplung" MAP 0x25B5D4 kf_si16_S6_S3 12.75 UMR_BAR__1_1000_0_S6_S3 0 12.75
 /begin AXIS_DESCR STD_AXIS iSasZentr.iSchaltend.n_tkf UMR_U_MIN_32_1_0_S6_S3 8 0 8160 DEPOSIT ABSOLUTE MONOTONY MON_INCREASE /end AXIS_DESCR
 /begin AXIS_DESCR STD_AXIS zff_atsys._.iSignale._.obj.sig_m_t UMR_NM__1_1_0_S6_S3 8 -400 1640 DEPOSIT ABSOLUTE MONOTONY MON_INCREASE /end AXIS_DESCR
/end CHARACTERISTIC
/begin CHARACTERISTIC KF_PKZUSP82_EL "Schaltdruck zuschaltende Kupplung" MAP 0x25B67C kf_si16_S6_S3 12.75 UMR_BAR__1_1000_0_S6_S3 0 12.75
 /begin AXIS_DESCR STD_AXIS iSasZentr.iSchaltend.n_tkf UMR_U_MIN_32_1_0_S6_S3 8 0 8160 DEPOSIT ABSOLUTE MONOTONY MON_INCREASE /end AXIS_DESCR
 /begin AXIS_DESCR STD_AXIS zff_atsys._.iSignale._.obj.sig_m_t UMR_NM__1_1_0_S6_S3 8 -400 1640 DEPOSIT ABSOLUTE MONOTONY MON_INCREASE /end AXIS_DESCR
/end CHARACTERISTIC
/begin CHARACTERISTIC KF_POHINSYNKZUSP82 "Kennfeld Haltedruckoffset(n_tkf, m_t) bei Haltephase in Synchron" MAP 0x25B724 kf_si16_S6_S3 12.75 UMR_BAR__1_1000_0_S6_S3 -6.4 6.35
 /begin AXIS_DESCR STD_AXIS iSasZentr.iSchaltend.n_tkf UMR_U_MIN_32_1_0_S6_S3 4 0 8160 DEPOSIT ABSOLUTE MONOTONY MON_INCREASE /end AXIS_DESCR
 /begin AXIS_DESCR STD_AXIS zff_atsys._.iSignale._.obj.sig_m_t UMR_NM__1_1_0_S6_S3 4 -400 1640 DEPOSIT ABSOLUTE MONOTONY MON_INCREASE /end AXIS_DESCR
/end CHARACTERISTIC
/begin CHARACTERISTIC KL_TSYNCGHINSYNEKZUSP82 "Zeit fuer Ende Haltephase in Synchron KZU" CURVE 0x25B75C kl_ui8_S6_S3 2550 UMR_MSEC__10_1_M128_S6_S3 -1280 1270
 /begin AXIS_DESCR STD_AXIS zff_atsys._.iSignale._.obj.sig_c_getr UMR_GRADC__1_1_M40_S6_S3 4 -40 150 DEPOSIT ABSOLUTE MONOTONY MON_INCREASE /end AXIS_DESCR
/end CHARACTERISTIC
/begin CHARACTERISTIC F_PRASP84 "Druckfaktor waehrend Rampe auf Schaltdruck" VALUE 0x26E965 kw_ui8_S6_S3 1 UMR___1_100_0_S6_S3 0 1 /end CHARACTERISTIC
/begin CHARACTERISTIC F_TRASP84 "Zeitfaktor waehrend Rampe auf Schaltdruck" VALUE 0x26E966 kw_ui8_S6_S3 1 UMR___1_100_0_S6_S3 0 1 /end CHARACTERISTIC
/begin CHARACTERISTIC T_FSP84 "Fuellzeit" VALUE 0x26E967 kw_ui8_S6_S3 2540 UMR_MSEC__10_1_0_S6_S3 0 2540 /end CHARACTERISTIC
/begin CHARACTERISTIC T_FSP84_EL "Fuellzeit" VALUE 0x26E968 kw_ui8_S6_S3 2540 UMR_MSEC__10_1_0_S6_S3 0 2540 /end CHARACTERISTIC
/begin CHARACTERISTIC KL_TRASP84 "Kennlinie Zeit Erste Rampe" CURVE 0x25B768 kl_ui8_S6_S3 2540 UMR_MSEC__10_1_0_S6_S3 0 2540
 /begin AXIS_DESCR STD_AXIS zff_atsys._.iSignale._.obj.sig_m_t8 UMR_NM__8_1_M50_S6_S3 4 -400 1640 DEPOSIT ABSOLUTE MONOTONY MON_INCREASE /end AXIS_DESCR
/end CHARACTERISTIC
/begin CHARACTERISTIC KL_TRASP84_EL "Kennlinie Zeit Erste Rampe" CURVE 0x25B774 kl_ui8_S6_S3 2540 UMR_MSEC__10_1_0_S6_S3 0 2540
 /begin AXIS_DESCR STD_AXIS zff_atsys._.iSignale._.obj.sig_m_t8 UMR_NM__8_1_M50_S6_S3 4 -400 1640 DEPOSIT ABSOLUTE MONOTONY MON_INCREASE /end AXIS_DESCR
/end CHARACTERISTIC
/begin CHARACTERISTIC KL_PGRASYNSP84 "Schliessrampenradient" CURVE 0x25B780 kl_si16_S6_S3 6553.4 UMR_BAR_SEC_1_10_0_S6_S3 -3276.7 3276.7
 /begin AXIS_DESCR STD_AXIS zff_atsys._.iSignale._.obj.sig_m_t UMR_NM__1_1_0_S6_S3 6 -400 1640 DEPOSIT ABSOLUTE MONOTONY MON_INCREASE /end AXIS_DESCR
/end CHARACTERISTIC
/begin CHARACTERISTIC KF_POFMTNSP84 "Kennfeld Fuelldruckoffset(n_t, m_t)" MAP 0x25B79C kf_si16_S6_S3 12.75 UMR_BAR__1_1000_0_S6_S3 -6.4 6.35
 /begin AXIS_DESCR STD_AXIS zff_atsys._.iSignale._.obj.sig_n_t UMR_U_MIN_1_1_0_S6_S3 4 0 8160 DEPOSIT ABSOLUTE MONOTONY MON_INCREASE /end AXIS_DESCR
 /begin AXIS_DESCR STD_AXIS zff_atsys._.iSignale._.obj.sig_m_t UMR_NM__1_1_0_S6_S3 6 -400 1640 DEPOSIT ABSOLUTE MONOTONY MON_INCREASE /end AXIS_DESCR
/end CHARACTERISTIC
/begin CHARACTERISTIC KF_POFMTNSP84_EL "Kennfeld Fuelldruckoffset(n_t, m_t)" MAP 0x25B7E8 kf_si16_S6_S3 12.75 UMR_BAR__1_1000_0_S6_S3 -6.4 6.35
 /begin AXIS_DESCR STD_AXIS zff_atsys._.iSignale._.obj.sig_n_t UMR_U_MIN_1_1_0_S6_S3 4 0 8160 DEPOSIT ABSOLUTE MONOTONY MON_INCREASE /end AXIS_DESCR
 /begin AXIS_DESCR STD_AXIS zff_atsys._.iSignale._.obj.sig_m_t UMR_NM__1_1_0_S6_S3 6 -400 1640 DEPOSIT ABSOLUTE MONOTONY MON_INCREASE /end AXIS_DESCR
/end CHARACTERISTIC
/begin CHARACTERISTIC KF_PKZUSP84 "Schaltdruck zuschaltende Kupplung" MAP 0x25B834 kf_si16_S6_S3 12.75 UMR_BAR__1_1000_0_S6_S3 0 12.75
 /begin AXIS_DESCR STD_AXIS iSasZentr.iSchaltend.n_tkf UMR_U_MIN_32_1_0_S6_S3 8 0 8160 DEPOSIT ABSOLUTE MONOTONY MON_INCREASE /end AXIS_DESCR
 /begin AXIS_DESCR STD_AXIS zff_atsys._.iSignale._.obj.sig_m_t UMR_NM__1_1_0_S6_S3 8 -400 1640 DEPOSIT ABSOLUTE MONOTONY MON_INCREASE /end AXIS_DESCR
/end CHARACTERISTIC
/begin CHARACTERISTIC KF_PKZUSP84_EL "Schaltdruck zuschaltende Kupplung" MAP 0x25B8DC kf_si16_S6_S3 12.75 UMR_BAR__1_1000_0_S6_S3 0 12.75
 /begin AXIS_DESCR STD_AXIS iSasZentr.iSchaltend.n_tkf UMR_U_MIN_32_1_0_S6_S3 8 0 8160 DEPOSIT ABSOLUTE MONOTONY MON_INCREASE /end AXIS_DESCR
 /begin AXIS_DESCR STD_AXIS zff_atsys._.iSignale._.obj.sig_m_t UMR_NM__1_1_0_S6_S3 8 -400 1640 DEPOSIT ABSOLUTE MONOTONY MON_INCREASE /end AXIS_DESCR
/end CHARACTERISTIC
/begin CHARACTERISTIC KF_POHINSYNKZUSP84 "Kennfeld Haltedruckoffset(n_tkf, m_t) bei Haltephase in Synchron" MAP 0x25B984 kf_si16_S6_S3 12.75 UMR_BAR__1_1000_0_S6_S3 -6.4 6.35
 /begin AXIS_DESCR STD_AXIS iSasZentr.iSchaltend.n_tkf UMR_U_MIN_32_1_0_S6_S3 4 0 8160 DEPOSIT ABSOLUTE MONOTONY MON_INCREASE /end AXIS_DESCR
 /begin AXIS_DESCR STD_AXIS zff_atsys._.iSignale._.obj.sig_m_t UMR_NM__1_1_0_S6_S3 4 -400 1640 DEPOSIT ABSOLUTE MONOTONY MON_INCREASE /end AXIS_DESCR
/end CHARACTERISTIC
/begin CHARACTERISTIC KL_TSYNCGHINSYNEKZUSP84 "Zeit fuer Ende Haltephase in Synchron KZU" CURVE 0x25B9BC kl_ui8_S6_S3 2550 UMR_MSEC__10_1_M128_S6_S3 -1280 1270
 /begin AXIS_DESCR STD_AXIS zff_atsys._.iSignale._.obj.sig_c_getr UMR_GRADC__1_1_M40_S6_S3 4 -40 150 DEPOSIT ABSOLUTE MONOTONY MON_INCREASE /end AXIS_DESCR
/end CHARACTERISTIC
/begin CHARACTERISTIC F_PRASP86 "Druckfaktor waehrend Rampe auf Schaltdruck" VALUE 0x26E969 kw_ui8_S6_S3 1 UMR___1_100_0_S6_S3 0 1 /end CHARACTERISTIC
/begin CHARACTERISTIC F_TRASP86 "Zeitfaktor waehrend Rampe auf Schaltdruck" VALUE 0x26E96A kw_ui8_S6_S3 1 UMR___1_100_0_S6_S3 0 1 /end CHARACTERISTIC
/begin CHARACTERISTIC T_FSP86 "Fuellzeit" VALUE 0x26E96B kw_ui8_S6_S3 2540 UMR_MSEC__10_1_0_S6_S3 0 2540 /end CHARACTERISTIC
/begin CHARACTERISTIC T_FSP86_EL "Fuellzeit" VALUE 0x26E96C kw_ui8_S6_S3 2540 UMR_MSEC__10_1_0_S6_S3 0 2540 /end CHARACTERISTIC
/begin CHARACTERISTIC KL_TRASP86 "Kennlinie Zeit Erste Rampe" CURVE 0x25B9C8 kl_ui8_S6_S3 2540 UMR_MSEC__10_1_0_S6_S3 0 2540
 /begin AXIS_DESCR STD_AXIS zff_atsys._.iSignale._.obj.sig_m_t8 UMR_NM__8_1_M50_S6_S3 4 -400 1640 DEPOSIT ABSOLUTE MONOTONY MON_INCREASE /end AXIS_DESCR
/end CHARACTERISTIC
/begin CHARACTERISTIC KL_TRASP86_EL "Kennlinie Zeit Erste Rampe" CURVE 0x25B9D4 kl_ui8_S6_S3 2540 UMR_MSEC__10_1_0_S6_S3 0 2540
 /begin AXIS_DESCR STD_AXIS zff_atsys._.iSignale._.obj.sig_m_t8 UMR_NM__8_1_M50_S6_S3 4 -400 1640 DEPOSIT ABSOLUTE MONOTONY MON_INCREASE /end AXIS_DESCR
/end CHARACTERISTIC
/begin CHARACTERISTIC KL_PGRASYNSP86 "Schliessrampenradient" CURVE 0x25B9E0 kl_si16_S6_S3 6553.4 UMR_BAR_SEC_1_10_0_S6_S3 -3276.7 3276.7
 /begin AXIS_DESCR STD_AXIS zff_atsys._.iSignale._.obj.sig_m_t UMR_NM__1_1_0_S6_S3 6 -400 1640 DEPOSIT ABSOLUTE MONOTONY MON_INCREASE /end AXIS_DESCR
/end CHARACTERISTIC
/begin CHARACTERISTIC KF_POFMTNSP86 "Kennfeld Fuelldruckoffset(n_t, m_t)" MAP 0x25B9FC kf_si16_S6_S3 12.75 UMR_BAR__1_1000_0_S6_S3 -6.4 6.35
 /begin AXIS_DESCR STD_AXIS zff_atsys._.iSignale._.obj.sig_n_t UMR_U_MIN_1_1_0_S6_S3 4 0 8160 DEPOSIT ABSOLUTE MONOTONY MON_INCREASE /end AXIS_DESCR
 /begin AXIS_DESCR STD_AXIS zff_atsys._.iSignale._.obj.sig_m_t UMR_NM__1_1_0_S6_S3 6 -400 1640 DEPOSIT ABSOLUTE MONOTONY MON_INCREASE /end AXIS_DESCR
/end CHARACTERISTIC
/begin CHARACTERISTIC KF_POFMTNSP86_EL "Kennfeld Fuelldruckoffset(n_t, m_t)" MAP 0x25BA48 kf_si16_S6_S3 12.75 UMR_BAR__1_1000_0_S6_S3 -6.4 6.35
 /begin AXIS_DESCR STD_AXIS zff_atsys._.iSignale._.obj.sig_n_t UMR_U_MIN_1_1_0_S6_S3 4 0 8160 DEPOSIT ABSOLUTE MONOTONY MON_INCREASE /end AXIS_DESCR
 /begin AXIS_DESCR STD_AXIS zff_atsys._.iSignale._.obj.sig_m_t UMR_NM__1_1_0_S6_S3 6 -400 1640 DEPOSIT ABSOLUTE MONOTONY MON_INCREASE /end AXIS_DESCR
/end CHARACTERISTIC
/begin CHARACTERISTIC KF_PKZUSP86 "Schaltdruck zuschaltende Kupplung" MAP 0x25BA94 kf_si16_S6_S3 12.75 UMR_BAR__1_1000_0_S6_S3 0 12.75
 /begin AXIS_DESCR STD_AXIS iSasZentr.iSchaltend.n_tkf UMR_U_MIN_32_1_0_S6_S3 8 0 8160 DEPOSIT ABSOLUTE MONOTONY MON_INCREASE /end AXIS_DESCR
 /begin AXIS_DESCR STD_AXIS zff_atsys._.iSignale._.obj.sig_m_t UMR_NM__1_1_0_S6_S3 8 -400 1640 DEPOSIT ABSOLUTE MONOTONY MON_INCREASE /end AXIS_DESCR
/end CHARACTERISTIC
/begin CHARACTERISTIC KF_PKZUSP86_EL "Schaltdruck zuschaltende Kupplung" MAP 0x25BB3C kf_si16_S6_S3 12.75 UMR_BAR__1_1000_0_S6_S3 0 12.75
 /begin AXIS_DESCR STD_AXIS iSasZentr.iSchaltend.n_tkf UMR_U_MIN_32_1_0_S6_S3 8 0 8160 DEPOSIT ABSOLUTE MONOTONY MON_INCREASE /end AXIS_DESCR
 /begin AXIS_DESCR STD_AXIS zff_atsys._.iSignale._.obj.sig_m_t UMR_NM__1_1_0_S6_S3 8 -400 1640 DEPOSIT ABSOLUTE MONOTONY MON_INCREASE /end AXIS_DESCR
/end CHARACTERISTIC
/begin CHARACTERISTIC KF_POHINSYNKZUSP86 "Kennfeld Haltedruckoffset(n_tkf, m_t) bei Haltephase in Synchron" MAP 0x25BBE4 kf_si16_S6_S3 12.75 UMR_BAR__1_1000_0_S6_S3 -6.4 6.35
 /begin AXIS_DESCR STD_AXIS iSasZentr.iSchaltend.n_tkf UMR_U_MIN_32_1_0_S6_S3 4 0 8160 DEPOSIT ABSOLUTE MONOTONY MON_INCREASE /end AXIS_DESCR
 /begin AXIS_DESCR STD_AXIS zff_atsys._.iSignale._.obj.sig_m_t UMR_NM__1_1_0_S6_S3 4 -400 1640 DEPOSIT ABSOLUTE MONOTONY MON_INCREASE /end AXIS_DESCR
/end CHARACTERISTIC
/begin CHARACTERISTIC KL_TSYNCGHINSYNEKZUSP86 "Zeit fuer Ende Haltephase in Synchron KZU" CURVE 0x25BC1C kl_ui8_S6_S3 2550 UMR_MSEC__10_1_M128_S6_S3 -1280 1270
 /begin AXIS_DESCR STD_AXIS zff_atsys._.iSignale._.obj.sig_c_getr UMR_GRADC__1_1_M40_S6_S3 4 -40 150 DEPOSIT ABSOLUTE MONOTONY MON_INCREASE /end AXIS_DESCR
/end CHARACTERISTIC
/begin CHARACTERISTIC F_PRASPORT21 "Druckfaktor waehrend Rampe auf Schaltdruck" VALUE 0x26E96D kw_ui8_S6_S3 1 UMR___1_100_0_S6_S3 0 1 /end CHARACTERISTIC
/begin CHARACTERISTIC F_TRASPORT21 "Zeitfaktor waehrend Rampe auf Schaltdruck" VALUE 0x26E96E kw_ui8_S6_S3 1 UMR___1_100_0_S6_S3 0 1 /end CHARACTERISTIC
/begin CHARACTERISTIC T_FSPORT21 "Fuellzeit" VALUE 0x26E96F kw_ui8_S6_S3 2540 UMR_MSEC__10_1_0_S6_S3 0 2540 /end CHARACTERISTIC
/begin CHARACTERISTIC KL_TRASPORT21 "Kennlinie Zeit Erste Rampe" CURVE 0x25BC28 kl_ui8_S6_S3 2540 UMR_MSEC__10_1_0_S6_S3 0 2540
 /begin AXIS_DESCR STD_AXIS zff_atsys._.iSignale._.obj.sig_m_t8 UMR_NM__8_1_M50_S6_S3 4 -400 1640 DEPOSIT ABSOLUTE MONOTONY MON_INCREASE /end AXIS_DESCR
/end CHARACTERISTIC
/begin CHARACTERISTIC KL_PGRASYNSPORT21 "Schliessrampenradient" CURVE 0x25BC34 kl_si16_S6_S3 6553.4 UMR_BAR_SEC_1_10_0_S6_S3 -3276.7 3276.7
 /begin AXIS_DESCR STD_AXIS zff_atsys._.iSignale._.obj.sig_m_t UMR_NM__1_1_0_S6_S3 6 -400 1640 DEPOSIT ABSOLUTE MONOTONY MON_INCREASE /end AXIS_DESCR
/end CHARACTERISTIC
/begin CHARACTERISTIC KF_POFMTNSPORT21 "Kennfeld Fuelldruckoffset(n_t, m_t)" MAP 0x25BC50 kf_si16_S6_S3 12.75 UMR_BAR__1_1000_0_S6_S3 -6.4 6.35
 /begin AXIS_DESCR STD_AXIS zff_atsys._.iSignale._.obj.sig_n_t UMR_U_MIN_1_1_0_S6_S3 4 0 8160 DEPOSIT ABSOLUTE MONOTONY MON_INCREASE /end AXIS_DESCR
 /begin AXIS_DESCR STD_AXIS zff_atsys._.iSignale._.obj.sig_m_t UMR_NM__1_1_0_S6_S3 6 -400 1640 DEPOSIT ABSOLUTE MONOTONY MON_INCREASE /end AXIS_DESCR
/end CHARACTERISTIC
/begin CHARACTERISTIC KF_PKZUSPORT21 "Schaltdruck zuschaltende Kupplung" MAP 0x25BC9C kf_si16_S6_S3 12.75 UMR_BAR__1_1000_0_S6_S3 0 12.75
 /begin AXIS_DESCR STD_AXIS iSasZentr.iSchaltend.n_tkf UMR_U_MIN_32_1_0_S6_S3 8 0 8160 DEPOSIT ABSOLUTE MONOTONY MON_INCREASE /end AXIS_DESCR
 /begin AXIS_DESCR STD_AXIS zff_atsys._.iSignale._.obj.sig_m_t UMR_NM__1_1_0_S6_S3 8 -400 1640 DEPOSIT ABSOLUTE MONOTONY MON_INCREASE /end AXIS_DESCR
/end CHARACTERISTIC
/begin CHARACTERISTIC KF_POHINSYNKZUSPORT21 "Kennfeld Haltedruckoffset(n_tkf, m_t) bei Haltephase in Synchron" MAP 0x25BD44 kf_si16_S6_S3 12.75 UMR_BAR__1_1000_0_S6_S3 -6.4 6.35
 /begin AXIS_DESCR STD_AXIS iSasZentr.iSchaltend.n_tkf UMR_U_MIN_32_1_0_S6_S3 4 0 8160 DEPOSIT ABSOLUTE MONOTONY MON_INCREASE /end AXIS_DESCR
 /begin AXIS_DESCR STD_AXIS zff_atsys._.iSignale._.obj.sig_m_t UMR_NM__1_1_0_S6_S3 4 -400 1640 DEPOSIT ABSOLUTE MONOTONY MON_INCREASE /end AXIS_DESCR
/end CHARACTERISTIC
/begin CHARACTERISTIC KL_TSYNCGHINSYNEKZUSPORT21 "Zeit fuer Ende Haltephase in Synchron KZU" CURVE 0x25BD7C kl_ui8_S6_S3 2550 UMR_MSEC__10_1_M128_S6_S3 -1280 1270
 /begin AXIS_DESCR STD_AXIS zff_atsys._.iSignale._.obj.sig_c_getr UMR_GRADC__1_1_M40_S6_S3 4 -40 150 DEPOSIT ABSOLUTE MONOTONY MON_INCREASE /end AXIS_DESCR
/end CHARACTERISTIC
/begin CHARACTERISTIC F_PRASPORT32 "Druckfaktor waehrend Rampe auf Schaltdruck" VALUE 0x26E970 kw_ui8_S6_S3 1 UMR___1_100_0_S6_S3 0 1 /end CHARACTERISTIC
/begin CHARACTERISTIC F_TRASPORT32 "Zeitfaktor waehrend Rampe auf Schaltdruck" VALUE 0x26E971 kw_ui8_S6_S3 1 UMR___1_100_0_S6_S3 0 1 /end CHARACTERISTIC
/begin CHARACTERISTIC T_FSPORT32 "Fuellzeit" VALUE 0x26E972 kw_ui8_S6_S3 2540 UMR_MSEC__10_1_0_S6_S3 0 2540 /end CHARACTERISTIC
/begin CHARACTERISTIC KL_TRASPORT32 "Kennlinie Zeit Erste Rampe" CURVE 0x25BD88 kl_ui8_S6_S3 2540 UMR_MSEC__10_1_0_S6_S3 0 2540
 /begin AXIS_DESCR STD_AXIS zff_atsys._.iSignale._.obj.sig_m_t8 UMR_NM__8_1_M50_S6_S3 4 -400 1640 DEPOSIT ABSOLUTE MONOTONY MON_INCREASE /end AXIS_DESCR
/end CHARACTERISTIC
/begin CHARACTERISTIC KL_PGRASYNSPORT32 "Schliessrampenradient" CURVE 0x25BD94 kl_si16_S6_S3 6553.4 UMR_BAR_SEC_1_10_0_S6_S3 -3276.7 3276.7
 /begin AXIS_DESCR STD_AXIS zff_atsys._.iSignale._.obj.sig_m_t UMR_NM__1_1_0_S6_S3 6 -400 1640 DEPOSIT ABSOLUTE MONOTONY MON_INCREASE /end AXIS_DESCR
/end CHARACTERISTIC
/begin CHARACTERISTIC KF_POFMTNSPORT32 "Kennfeld Fuelldruckoffset(n_t, m_t)" MAP 0x25BDB0 kf_si16_S6_S3 12.75 UMR_BAR__1_1000_0_S6_S3 -6.4 6.35
 /begin AXIS_DESCR STD_AXIS zff_atsys._.iSignale._.obj.sig_n_t UMR_U_MIN_1_1_0_S6_S3 4 0 8160 DEPOSIT ABSOLUTE MONOTONY MON_INCREASE /end AXIS_DESCR
 /begin AXIS_DESCR STD_AXIS zff_atsys._.iSignale._.obj.sig_m_t UMR_NM__1_1_0_S6_S3 6 -400 1640 DEPOSIT ABSOLUTE MONOTONY MON_INCREASE /end AXIS_DESCR
/end CHARACTERISTIC
/begin CHARACTERISTIC KF_PKZUSPORT32 "Schaltdruck zuschaltende Kupplung" MAP 0x25BDFC kf_si16_S6_S3 12.75 UMR_BAR__1_1000_0_S6_S3 0 12.75
 /begin AXIS_DESCR STD_AXIS iSasZentr.iSchaltend.n_tkf UMR_U_MIN_32_1_0_S6_S3 8 0 8160 DEPOSIT ABSOLUTE MONOTONY MON_INCREASE /end AXIS_DESCR
 /begin AXIS_DESCR STD_AXIS zff_atsys._.iSignale._.obj.sig_m_t UMR_NM__1_1_0_S6_S3 8 -400 1640 DEPOSIT ABSOLUTE MONOTONY MON_INCREASE /end AXIS_DESCR
/end CHARACTERISTIC
/begin CHARACTERISTIC KF_POHINSYNKZUSPORT32 "Kennfeld Haltedruckoffset(n_tkf, m_t) bei Haltephase in Synchron" MAP 0x25BEA4 kf_si16_S6_S3 12.75 UMR_BAR__1_1000_0_S6_S3 -6.4 6.35
 /begin AXIS_DESCR STD_AXIS iSasZentr.iSchaltend.n_tkf UMR_U_MIN_32_1_0_S6_S3 4 0 8160 DEPOSIT ABSOLUTE MONOTONY MON_INCREASE /end AXIS_DESCR
 /begin AXIS_DESCR STD_AXIS zff_atsys._.iSignale._.obj.sig_m_t UMR_NM__1_1_0_S6_S3 4 -400 1640 DEPOSIT ABSOLUTE MONOTONY MON_INCREASE /end AXIS_DESCR
/end CHARACTERISTIC
/begin CHARACTERISTIC KL_TSYNCGHINSYNEKZUSPORT32 "Zeit fuer Ende Haltephase in Synchron KZU" CURVE 0x25BEDC kl_ui8_S6_S3 2550 UMR_MSEC__10_1_M128_S6_S3 -1280 1270
 /begin AXIS_DESCR STD_AXIS zff_atsys._.iSignale._.obj.sig_c_getr UMR_GRADC__1_1_M40_S6_S3 4 -40 150 DEPOSIT ABSOLUTE MONOTONY MON_INCREASE /end AXIS_DESCR
/end CHARACTERISTIC
/begin CHARACTERISTIC F_PRASPORT43 "Druckfaktor waehrend Rampe auf Schaltdruck" VALUE 0x26E973 kw_ui8_S6_S3 1 UMR___1_100_0_S6_S3 0 1 /end CHARACTERISTIC
/begin CHARACTERISTIC F_TRASPORT43 "Zeitfaktor waehrend Rampe auf Schaltdruck" VALUE 0x26E974 kw_ui8_S6_S3 1 UMR___1_100_0_S6_S3 0 1 /end CHARACTERISTIC
/begin CHARACTERISTIC T_FSPORT43 "Fuellzeit" VALUE 0x26E975 kw_ui8_S6_S3 2540 UMR_MSEC__10_1_0_S6_S3 0 2540 /end CHARACTERISTIC
/begin CHARACTERISTIC KL_TRASPORT43 "Kennlinie Zeit Erste Rampe" CURVE 0x25BEE8 kl_ui8_S6_S3 2540 UMR_MSEC__10_1_0_S6_S3 0 2540
 /begin AXIS_DESCR STD_AXIS zff_atsys._.iSignale._.obj.sig_m_t8 UMR_NM__8_1_M50_S6_S3 4 -400 1640 DEPOSIT ABSOLUTE MONOTONY MON_INCREASE /end AXIS_DESCR
/end CHARACTERISTIC
/begin CHARACTERISTIC KL_PGRASYNSPORT43 "Schliessrampenradient" CURVE 0x25BEF4 kl_si16_S6_S3 6553.4 UMR_BAR_SEC_1_10_0_S6_S3 -3276.7 3276.7
 /begin AXIS_DESCR STD_AXIS zff_atsys._.iSignale._.obj.sig_m_t UMR_NM__1_1_0_S6_S3 6 -400 1640 DEPOSIT ABSOLUTE MONOTONY MON_INCREASE /end AXIS_DESCR
/end CHARACTERISTIC
/begin CHARACTERISTIC KF_POFMTNSPORT43 "Kennfeld Fuelldruckoffset(n_t, m_t)" MAP 0x25BF10 kf_si16_S6_S3 12.75 UMR_BAR__1_1000_0_S6_S3 -6.4 6.35
 /begin AXIS_DESCR STD_AXIS zff_atsys._.iSignale._.obj.sig_n_t UMR_U_MIN_1_1_0_S6_S3 4 0 8160 DEPOSIT ABSOLUTE MONOTONY MON_INCREASE /end AXIS_DESCR
 /begin AXIS_DESCR STD_AXIS zff_atsys._.iSignale._.obj.sig_m_t UMR_NM__1_1_0_S6_S3 6 -400 1640 DEPOSIT ABSOLUTE MONOTONY MON_INCREASE /end AXIS_DESCR
/end CHARACTERISTIC
/begin CHARACTERISTIC KF_PKZUSPORT43 "Schaltdruck zuschaltende Kupplung" MAP 0x25BF5C kf_si16_S6_S3 12.75 UMR_BAR__1_1000_0_S6_S3 0 12.75
 /begin AXIS_DESCR STD_AXIS iSasZentr.iSchaltend.n_tkf UMR_U_MIN_32_1_0_S6_S3 8 0 8160 DEPOSIT ABSOLUTE MONOTONY MON_INCREASE /end AXIS_DESCR
 /begin AXIS_DESCR STD_AXIS zff_atsys._.iSignale._.obj.sig_m_t UMR_NM__1_1_0_S6_S3 8 -400 1640 DEPOSIT ABSOLUTE MONOTONY MON_INCREASE /end AXIS_DESCR
/end CHARACTERISTIC
/begin CHARACTERISTIC KF_POHINSYNKZUSPORT43 "Kennfeld Haltedruckoffset(n_tkf, m_t) bei Haltephase in Synchron" MAP 0x25C004 kf_si16_S6_S3 12.75 UMR_BAR__1_1000_0_S6_S3 -6.4 6.35
 /begin AXIS_DESCR STD_AXIS iSasZentr.iSchaltend.n_tkf UMR_U_MIN_32_1_0_S6_S3 4 0 8160 DEPOSIT ABSOLUTE MONOTONY MON_INCREASE /end AXIS_DESCR
 /begin AXIS_DESCR STD_AXIS zff_atsys._.iSignale._.obj.sig_m_t UMR_NM__1_1_0_S6_S3 4 -400 1640 DEPOSIT ABSOLUTE MONOTONY MON_INCREASE /end AXIS_DESCR
/end CHARACTERISTIC
/begin CHARACTERISTIC KL_TSYNCGHINSYNEKZUSPORT43 "Zeit fuer Ende Haltephase in Synchron KZU" CURVE 0x25C03C kl_ui8_S6_S3 2550 UMR_MSEC__10_1_M128_S6_S3 -1280 1270
 /begin AXIS_DESCR STD_AXIS zff_atsys._.iSignale._.obj.sig_c_getr UMR_GRADC__1_1_M40_S6_S3 4 -40 150 DEPOSIT ABSOLUTE MONOTONY MON_INCREASE /end AXIS_DESCR
/end CHARACTERISTIC
/begin CHARACTERISTIC F_PRASPORT54 "Druckfaktor waehrend Rampe auf Schaltdruck" VALUE 0x26E976 kw_ui8_S6_S3 1 UMR___1_100_0_S6_S3 0 1 /end CHARACTERISTIC
/begin CHARACTERISTIC F_TRASPORT54 "Zeitfaktor waehrend Rampe auf Schaltdruck" VALUE 0x26E977 kw_ui8_S6_S3 1 UMR___1_100_0_S6_S3 0 1 /end CHARACTERISTIC
/begin CHARACTERISTIC T_FSPORT54 "Fuellzeit" VALUE 0x26E978 kw_ui8_S6_S3 2540 UMR_MSEC__10_1_0_S6_S3 0 2540 /end CHARACTERISTIC
/begin CHARACTERISTIC KL_TRASPORT54 "Kennlinie Zeit Erste Rampe" CURVE 0x25C048 kl_ui8_S6_S3 2540 UMR_MSEC__10_1_0_S6_S3 0 2540
 /begin AXIS_DESCR STD_AXIS zff_atsys._.iSignale._.obj.sig_m_t8 UMR_NM__8_1_M50_S6_S3 4 -400 1640 DEPOSIT ABSOLUTE MONOTONY MON_INCREASE /end AXIS_DESCR
/end CHARACTERISTIC
/begin CHARACTERISTIC KL_PGRASYNSPORT54 "Schliessrampenradient" CURVE 0x25C054 kl_si16_S6_S3 6553.4 UMR_BAR_SEC_1_10_0_S6_S3 -3276.7 3276.7
 /begin AXIS_DESCR STD_AXIS zff_atsys._.iSignale._.obj.sig_m_t UMR_NM__1_1_0_S6_S3 6 -400 1640 DEPOSIT ABSOLUTE MONOTONY MON_INCREASE /end AXIS_DESCR
/end CHARACTERISTIC
/begin CHARACTERISTIC KF_POFMTNSPORT54 "Kennfeld Fuelldruckoffset(n_t, m_t)" MAP 0x25C070 kf_si16_S6_S3 12.75 UMR_BAR__1_1000_0_S6_S3 -6.4 6.35
 /begin AXIS_DESCR STD_AXIS zff_atsys._.iSignale._.obj.sig_n_t UMR_U_MIN_1_1_0_S6_S3 4 0 8160 DEPOSIT ABSOLUTE MONOTONY MON_INCREASE /end AXIS_DESCR
 /begin AXIS_DESCR STD_AXIS zff_atsys._.iSignale._.obj.sig_m_t UMR_NM__1_1_0_S6_S3 6 -400 1640 DEPOSIT ABSOLUTE MONOTONY MON_INCREASE /end AXIS_DESCR
/end CHARACTERISTIC
/begin CHARACTERISTIC KF_PKZUSPORT54 "Schaltdruck zuschaltende Kupplung" MAP 0x25C0BC kf_si16_S6_S3 12.75 UMR_BAR__1_1000_0_S6_S3 0 12.75
 /begin AXIS_DESCR STD_AXIS iSasZentr.iSchaltend.n_tkf UMR_U_MIN_32_1_0_S6_S3 8 0 8160 DEPOSIT ABSOLUTE MONOTONY MON_INCREASE /end AXIS_DESCR
 /begin AXIS_DESCR STD_AXIS zff_atsys._.iSignale._.obj.sig_m_t UMR_NM__1_1_0_S6_S3 8 -400 1640 DEPOSIT ABSOLUTE MONOTONY MON_INCREASE /end AXIS_DESCR
/end CHARACTERISTIC
/begin CHARACTERISTIC KF_POHINSYNKZUSPORT54 "Kennfeld Haltedruckoffset(n_tkf, m_t) bei Haltephase in Synchron" MAP 0x25C164 kf_si16_S6_S3 12.75 UMR_BAR__1_1000_0_S6_S3 -6.4 6.35
 /begin AXIS_DESCR STD_AXIS iSasZentr.iSchaltend.n_tkf UMR_U_MIN_32_1_0_S6_S3 4 0 8160 DEPOSIT ABSOLUTE MONOTONY MON_INCREASE /end AXIS_DESCR
 /begin AXIS_DESCR STD_AXIS zff_atsys._.iSignale._.obj.sig_m_t UMR_NM__1_1_0_S6_S3 4 -400 1640 DEPOSIT ABSOLUTE MONOTONY MON_INCREASE /end AXIS_DESCR
/end CHARACTERISTIC
/begin CHARACTERISTIC KL_TSYNCGHINSYNEKZUSPORT54 "Zeit fuer Ende Haltephase in Synchron KZU" CURVE 0x25C19C kl_ui8_S6_S3 2550 UMR_MSEC__10_1_M128_S6_S3 -1280 1270
 /begin AXIS_DESCR STD_AXIS zff_atsys._.iSignale._.obj.sig_c_getr UMR_GRADC__1_1_M40_S6_S3 4 -40 150 DEPOSIT ABSOLUTE MONOTONY MON_INCREASE /end AXIS_DESCR
/end CHARACTERISTIC
/begin CHARACTERISTIC F_PRASPORT65 "Druckfaktor waehrend Rampe auf Schaltdruck" VALUE 0x26E979 kw_ui8_S6_S3 1 UMR___1_100_0_S6_S3 0 1 /end CHARACTERISTIC
/begin CHARACTERISTIC F_TRASPORT65 "Zeitfaktor waehrend Rampe auf Schaltdruck" VALUE 0x26E97A kw_ui8_S6_S3 1 UMR___1_100_0_S6_S3 0 1 /end CHARACTERISTIC
/begin CHARACTERISTIC T_FSPORT65 "Fuellzeit" VALUE 0x26E97B kw_ui8_S6_S3 2540 UMR_MSEC__10_1_0_S6_S3 0 2540 /end CHARACTERISTIC
/begin CHARACTERISTIC KL_TRASPORT65 "Kennlinie Zeit Erste Rampe" CURVE 0x25C1A8 kl_ui8_S6_S3 2540 UMR_MSEC__10_1_0_S6_S3 0 2540
 /begin AXIS_DESCR STD_AXIS zff_atsys._.iSignale._.obj.sig_m_t8 UMR_NM__8_1_M50_S6_S3 4 -400 1640 DEPOSIT ABSOLUTE MONOTONY MON_INCREASE /end AXIS_DESCR
/end CHARACTERISTIC
/begin CHARACTERISTIC KL_PGRASYNSPORT65 "Schliessrampenradient" CURVE 0x25C1B4 kl_si16_S6_S3 6553.4 UMR_BAR_SEC_1_10_0_S6_S3 -3276.7 3276.7
 /begin AXIS_DESCR STD_AXIS zff_atsys._.iSignale._.obj.sig_m_t UMR_NM__1_1_0_S6_S3 6 -400 1640 DEPOSIT ABSOLUTE MONOTONY MON_INCREASE /end AXIS_DESCR
/end CHARACTERISTIC
/begin CHARACTERISTIC KF_POFMTNSPORT65 "Kennfeld Fuelldruckoffset(n_t, m_t)" MAP 0x25C1D0 kf_si16_S6_S3 12.75 UMR_BAR__1_1000_0_S6_S3 -6.4 6.35
 /begin AXIS_DESCR STD_AXIS zff_atsys._.iSignale._.obj.sig_n_t UMR_U_MIN_1_1_0_S6_S3 4 0 8160 DEPOSIT ABSOLUTE MONOTONY MON_INCREASE /end AXIS_DESCR
 /begin AXIS_DESCR STD_AXIS zff_atsys._.iSignale._.obj.sig_m_t UMR_NM__1_1_0_S6_S3 6 -400 1640 DEPOSIT ABSOLUTE MONOTONY MON_INCREASE /end AXIS_DESCR
/end CHARACTERISTIC
/begin CHARACTERISTIC KF_PKZUSPORT65 "Schaltdruck zuschaltende Kupplung" MAP 0x25C21C kf_si16_S6_S3 12.75 UMR_BAR__1_1000_0_S6_S3 0 12.75
 /begin AXIS_DESCR STD_AXIS iSasZentr.iSchaltend.n_tkf UMR_U_MIN_32_1_0_S6_S3 8 0 8160 DEPOSIT ABSOLUTE MONOTONY MON_INCREASE /end AXIS_DESCR
 /begin AXIS_DESCR STD_AXIS zff_atsys._.iSignale._.obj.sig_m_t UMR_NM__1_1_0_S6_S3 8 -400 1640 DEPOSIT ABSOLUTE MONOTONY MON_INCREASE /end AXIS_DESCR
/end CHARACTERISTIC
/begin CHARACTERISTIC KF_POHINSYNKZUSPORT65 "Kennfeld Haltedruckoffset(n_tkf, m_t) bei Haltephase in Synchron" MAP 0x25C2C4 kf_si16_S6_S3 12.75 UMR_BAR__1_1000_0_S6_S3 -6.4 6.35
 /begin AXIS_DESCR STD_AXIS iSasZentr.iSchaltend.n_tkf UMR_U_MIN_32_1_0_S6_S3 4 0 8160 DEPOSIT ABSOLUTE MONOTONY MON_INCREASE /end AXIS_DESCR
 /begin AXIS_DESCR STD_AXIS zff_atsys._.iSignale._.obj.sig_m_t UMR_NM__1_1_0_S6_S3 4 -400 1640 DEPOSIT ABSOLUTE MONOTONY MON_INCREASE /end AXIS_DESCR
/end CHARACTERISTIC
/begin CHARACTERISTIC KL_TSYNCGHINSYNEKZUSPORT65 "Zeit fuer Ende Haltephase in Synchron KZU" CURVE 0x25C2FC kl_ui8_S6_S3 2550 UMR_MSEC__10_1_M128_S6_S3 -1280 1270
 /begin AXIS_DESCR STD_AXIS zff_atsys._.iSignale._.obj.sig_c_getr UMR_GRADC__1_1_M40_S6_S3 4 -40 150 DEPOSIT ABSOLUTE MONOTONY MON_INCREASE /end AXIS_DESCR
/end CHARACTERISTIC
/begin CHARACTERISTIC F_PRASPORT76 "Druckfaktor waehrend Rampe auf Schaltdruck" VALUE 0x26E97C kw_ui8_S6_S3 1 UMR___1_100_0_S6_S3 0 1 /end CHARACTERISTIC
/begin CHARACTERISTIC F_TRASPORT76 "Zeitfaktor waehrend Rampe auf Schaltdruck" VALUE 0x26E97D kw_ui8_S6_S3 1 UMR___1_100_0_S6_S3 0 1 /end CHARACTERISTIC
/begin CHARACTERISTIC T_FSPORT76 "Fuellzeit" VALUE 0x26E97E kw_ui8_S6_S3 2540 UMR_MSEC__10_1_0_S6_S3 0 2540 /end CHARACTERISTIC
/begin CHARACTERISTIC KL_TRASPORT76 "Kennlinie Zeit Erste Rampe" CURVE 0x25C308 kl_ui8_S6_S3 2540 UMR_MSEC__10_1_0_S6_S3 0 2540
 /begin AXIS_DESCR STD_AXIS zff_atsys._.iSignale._.obj.sig_m_t8 UMR_NM__8_1_M50_S6_S3 4 -400 1640 DEPOSIT ABSOLUTE MONOTONY MON_INCREASE /end AXIS_DESCR
/end CHARACTERISTIC
/begin CHARACTERISTIC KL_PGRASYNSPORT76 "Schliessrampenradient" CURVE 0x25C314 kl_si16_S6_S3 6553.4 UMR_BAR_SEC_1_10_0_S6_S3 -3276.7 3276.7
 /begin AXIS_DESCR STD_AXIS zff_atsys._.iSignale._.obj.sig_m_t UMR_NM__1_1_0_S6_S3 6 -400 1640 DEPOSIT ABSOLUTE MONOTONY MON_INCREASE /end AXIS_DESCR
/end CHARACTERISTIC
/begin CHARACTERISTIC KF_POFMTNSPORT76 "Kennfeld Fuelldruckoffset(n_t, m_t)" MAP 0x25C330 kf_si16_S6_S3 12.75 UMR_BAR__1_1000_0_S6_S3 -6.4 6.35
 /begin AXIS_DESCR STD_AXIS zff_atsys._.iSignale._.obj.sig_n_t UMR_U_MIN_1_1_0_S6_S3 4 0 8160 DEPOSIT ABSOLUTE MONOTONY MON_INCREASE /end AXIS_DESCR
 /begin AXIS_DESCR STD_AXIS zff_atsys._.iSignale._.obj.sig_m_t UMR_NM__1_1_0_S6_S3 6 -400 1640 DEPOSIT ABSOLUTE MONOTONY MON_INCREASE /end AXIS_DESCR
/end CHARACTERISTIC
/begin CHARACTERISTIC KF_PKZUSPORT76 "Schaltdruck zuschaltende Kupplung" MAP 0x25C37C kf_si16_S6_S3 12.75 UMR_BAR__1_1000_0_S6_S3 0 12.75
 /begin AXIS_DESCR STD_AXIS iSasZentr.iSchaltend.n_tkf UMR_U_MIN_32_1_0_S6_S3 8 0 8160 DEPOSIT ABSOLUTE MONOTONY MON_INCREASE /end AXIS_DESCR
 /begin AXIS_DESCR STD_AXIS zff_atsys._.iSignale._.obj.sig_m_t UMR_NM__1_1_0_S6_S3 8 -400 1640 DEPOSIT ABSOLUTE MONOTONY MON_INCREASE /end AXIS_DESCR
/end CHARACTERISTIC
/begin CHARACTERISTIC KF_POHINSYNKZUSPORT76 "Kennfeld Haltedruckoffset(n_tkf, m_t) bei Haltephase in Synchron" MAP 0x25C424 kf_si16_S6_S3 12.75 UMR_BAR__1_1000_0_S6_S3 -6.4 6.35
 /begin AXIS_DESCR STD_AXIS iSasZentr.iSchaltend.n_tkf UMR_U_MIN_32_1_0_S6_S3 4 0 8160 DEPOSIT ABSOLUTE MONOTONY MON_INCREASE /end AXIS_DESCR
 /begin AXIS_DESCR STD_AXIS zff_atsys._.iSignale._.obj.sig_m_t UMR_NM__1_1_0_S6_S3 4 -400 1640 DEPOSIT ABSOLUTE MONOTONY MON_INCREASE /end AXIS_DESCR
/end CHARACTERISTIC
/begin CHARACTERISTIC KL_TSYNCGHINSYNEKZUSPORT76 "Zeit fuer Ende Haltephase in Synchron KZU" CURVE 0x25C45C kl_ui8_S6_S3 2550 UMR_MSEC__10_1_M128_S6_S3 -1280 1270
 /begin AXIS_DESCR STD_AXIS zff_atsys._.iSignale._.obj.sig_c_getr UMR_GRADC__1_1_M40_S6_S3 4 -40 150 DEPOSIT ABSOLUTE MONOTONY MON_INCREASE /end AXIS_DESCR
/end CHARACTERISTIC
/begin CHARACTERISTIC F_PRASPORT87 "Druckfaktor waehrend Rampe auf Schaltdruck" VALUE 0x26E97F kw_ui8_S6_S3 1 UMR___1_100_0_S6_S3 0 1 /end CHARACTERISTIC
/begin CHARACTERISTIC F_TRASPORT87 "Zeitfaktor waehrend Rampe auf Schaltdruck" VALUE 0x26E980 kw_ui8_S6_S3 1 UMR___1_100_0_S6_S3 0 1 /end CHARACTERISTIC
/begin CHARACTERISTIC T_FSPORT87 "Fuellzeit" VALUE 0x26E981 kw_ui8_S6_S3 2540 UMR_MSEC__10_1_0_S6_S3 0 2540 /end CHARACTERISTIC
/begin CHARACTERISTIC KL_TRASPORT87 "Kennlinie Zeit Erste Rampe" CURVE 0x25C468 kl_ui8_S6_S3 2540 UMR_MSEC__10_1_0_S6_S3 0 2540
 /begin AXIS_DESCR STD_AXIS zff_atsys._.iSignale._.obj.sig_m_t8 UMR_NM__8_1_M50_S6_S3 4 -400 1640 DEPOSIT ABSOLUTE MONOTONY MON_INCREASE /end AXIS_DESCR
/end CHARACTERISTIC
/begin CHARACTERISTIC KL_PGRASYNSPORT87 "Schliessrampenradient" CURVE 0x25C474 kl_si16_S6_S3 6553.4 UMR_BAR_SEC_1_10_0_S6_S3 -3276.7 3276.7
 /begin AXIS_DESCR STD_AXIS zff_atsys._.iSignale._.obj.sig_m_t UMR_NM__1_1_0_S6_S3 6 -400 1640 DEPOSIT ABSOLUTE MONOTONY MON_INCREASE /end AXIS_DESCR
/end CHARACTERISTIC
/begin CHARACTERISTIC KF_POFMTNSPORT87 "Kennfeld Fuelldruckoffset(n_t, m_t)" MAP 0x25C490 kf_si16_S6_S3 12.75 UMR_BAR__1_1000_0_S6_S3 -6.4 6.35
 /begin AXIS_DESCR STD_AXIS zff_atsys._.iSignale._.obj.sig_n_t UMR_U_MIN_1_1_0_S6_S3 4 0 8160 DEPOSIT ABSOLUTE MONOTONY MON_INCREASE /end AXIS_DESCR
 /begin AXIS_DESCR STD_AXIS zff_atsys._.iSignale._.obj.sig_m_t UMR_NM__1_1_0_S6_S3 6 -400 1640 DEPOSIT ABSOLUTE MONOTONY MON_INCREASE /end AXIS_DESCR
/end CHARACTERISTIC
/begin CHARACTERISTIC KF_PKZUSPORT87 "Schaltdruck zuschaltende Kupplung" MAP 0x25C4DC kf_si16_S6_S3 12.75 UMR_BAR__1_1000_0_S6_S3 0 12.75
 /begin AXIS_DESCR STD_AXIS iSasZentr.iSchaltend.n_tkf UMR_U_MIN_32_1_0_S6_S3 8 0 8160 DEPOSIT ABSOLUTE MONOTONY MON_INCREASE /end AXIS_DESCR
 /begin AXIS_DESCR STD_AXIS zff_atsys._.iSignale._.obj.sig_m_t UMR_NM__1_1_0_S6_S3 8 -400 1640 DEPOSIT ABSOLUTE MONOTONY MON_INCREASE /end AXIS_DESCR
/end CHARACTERISTIC
/begin CHARACTERISTIC KF_POHINSYNKZUSPORT87 "Kennfeld Haltedruckoffset(n_tkf, m_t) bei Haltephase in Synchron" MAP 0x25C584 kf_si16_S6_S3 12.75 UMR_BAR__1_1000_0_S6_S3 -6.4 6.35
 /begin AXIS_DESCR STD_AXIS iSasZentr.iSchaltend.n_tkf UMR_U_MIN_32_1_0_S6_S3 4 0 8160 DEPOSIT ABSOLUTE MONOTONY MON_INCREASE /end AXIS_DESCR
 /begin AXIS_DESCR STD_AXIS zff_atsys._.iSignale._.obj.sig_m_t UMR_NM__1_1_0_S6_S3 4 -400 1640 DEPOSIT ABSOLUTE MONOTONY MON_INCREASE /end AXIS_DESCR
/end CHARACTERISTIC
/begin CHARACTERISTIC KL_TSYNCGHINSYNEKZUSPORT87 "Zeit fuer Ende Haltephase in Synchron KZU" CURVE 0x25C5BC kl_ui8_S6_S3 2550 UMR_MSEC__10_1_M128_S6_S3 -1280 1270
 /begin AXIS_DESCR STD_AXIS zff_atsys._.iSignale._.obj.sig_c_getr UMR_GRADC__1_1_M40_S6_S3 4 -40 150 DEPOSIT ABSOLUTE MONOTONY MON_INCREASE /end AXIS_DESCR
/end CHARACTERISTIC
/begin CHARACTERISTIC F_PRASPORT31 "Druckfaktor waehrend Rampe auf Schaltdruck" VALUE 0x26E982 kw_ui8_S6_S3 1 UMR___1_100_0_S6_S3 0 1 /end CHARACTERISTIC
/begin CHARACTERISTIC F_TRASPORT31 "Zeitfaktor waehrend Rampe auf Schaltdruck" VALUE 0x26E983 kw_ui8_S6_S3 1 UMR___1_100_0_S6_S3 0 1 /end CHARACTERISTIC
/begin CHARACTERISTIC T_FSPORT31 "Fuellzeit" VALUE 0x26E984 kw_ui8_S6_S3 2540 UMR_MSEC__10_1_0_S6_S3 0 2540 /end CHARACTERISTIC
/begin CHARACTERISTIC KL_TRASPORT31 "Kennlinie Zeit Erste Rampe" CURVE 0x25C5C8 kl_ui8_S6_S3 2540 UMR_MSEC__10_1_0_S6_S3 0 2540
 /begin AXIS_DESCR STD_AXIS zff_atsys._.iSignale._.obj.sig_m_t8 UMR_NM__8_1_M50_S6_S3 4 -400 1640 DEPOSIT ABSOLUTE MONOTONY MON_INCREASE /end AXIS_DESCR
/end CHARACTERISTIC
/begin CHARACTERISTIC KL_PGRASYNSPORT31 "Schliessrampenradient" CURVE 0x25C5D4 kl_si16_S6_S3 6553.4 UMR_BAR_SEC_1_10_0_S6_S3 -3276.7 3276.7
 /begin AXIS_DESCR STD_AXIS zff_atsys._.iSignale._.obj.sig_m_t UMR_NM__1_1_0_S6_S3 6 -400 1640 DEPOSIT ABSOLUTE MONOTONY MON_INCREASE /end AXIS_DESCR
/end CHARACTERISTIC
/begin CHARACTERISTIC KF_POFMTNSPORT31 "Kennfeld Fuelldruckoffset(n_t, m_t)" MAP 0x25C5F0 kf_si16_S6_S3 12.75 UMR_BAR__1_1000_0_S6_S3 -6.4 6.35
 /begin AXIS_DESCR STD_AXIS zff_atsys._.iSignale._.obj.sig_n_t UMR_U_MIN_1_1_0_S6_S3 4 0 8160 DEPOSIT ABSOLUTE MONOTONY MON_INCREASE /end AXIS_DESCR
 /begin AXIS_DESCR STD_AXIS zff_atsys._.iSignale._.obj.sig_m_t UMR_NM__1_1_0_S6_S3 6 -400 1640 DEPOSIT ABSOLUTE MONOTONY MON_INCREASE /end AXIS_DESCR
/end CHARACTERISTIC
/begin CHARACTERISTIC KF_PKZUSPORT31 "Schaltdruck zuschaltende Kupplung" MAP 0x25C63C kf_si16_S6_S3 12.75 UMR_BAR__1_1000_0_S6_S3 0 12.75
 /begin AXIS_DESCR STD_AXIS iSasZentr.iSchaltend.n_tkf UMR_U_MIN_32_1_0_S6_S3 8 0 8160 DEPOSIT ABSOLUTE MONOTONY MON_INCREASE /end AXIS_DESCR
 /begin AXIS_DESCR STD_AXIS zff_atsys._.iSignale._.obj.sig_m_t UMR_NM__1_1_0_S6_S3 8 -400 1640 DEPOSIT ABSOLUTE MONOTONY MON_INCREASE /end AXIS_DESCR
/end CHARACTERISTIC
/begin CHARACTERISTIC KF_POHINSYNKZUSPORT31 "Kennfeld Haltedruckoffset(n_tkf, m_t) bei Haltephase in Synchron" MAP 0x25C6E4 kf_si16_S6_S3 12.75 UMR_BAR__1_1000_0_S6_S3 -6.4 6.35
 /begin AXIS_DESCR STD_AXIS iSasZentr.iSchaltend.n_tkf UMR_U_MIN_32_1_0_S6_S3 4 0 8160 DEPOSIT ABSOLUTE MONOTONY MON_INCREASE /end AXIS_DESCR
 /begin AXIS_DESCR STD_AXIS zff_atsys._.iSignale._.obj.sig_m_t UMR_NM__1_1_0_S6_S3 4 -400 1640 DEPOSIT ABSOLUTE MONOTONY MON_INCREASE /end AXIS_DESCR
/end CHARACTERISTIC
/begin CHARACTERISTIC KL_TSYNCGHINSYNEKZUSPORT31 "Zeit fuer Ende Haltephase in Synchron KZU" CURVE 0x25C71C kl_ui8_S6_S3 2550 UMR_MSEC__10_1_M128_S6_S3 -1280 1270
 /begin AXIS_DESCR STD_AXIS zff_atsys._.iSignale._.obj.sig_c_getr UMR_GRADC__1_1_M40_S6_S3 4 -40 150 DEPOSIT ABSOLUTE MONOTONY MON_INCREASE /end AXIS_DESCR
/end CHARACTERISTIC
/begin CHARACTERISTIC F_PRASPORT42 "Druckfaktor waehrend Rampe auf Schaltdruck" VALUE 0x26E985 kw_ui8_S6_S3 1 UMR___1_100_0_S6_S3 0 1 /end CHARACTERISTIC
/begin CHARACTERISTIC F_TRASPORT42 "Zeitfaktor waehrend Rampe auf Schaltdruck" VALUE 0x26E986 kw_ui8_S6_S3 1 UMR___1_100_0_S6_S3 0 1 /end CHARACTERISTIC
/begin CHARACTERISTIC T_FSPORT42 "Fuellzeit" VALUE 0x26E987 kw_ui8_S6_S3 2540 UMR_MSEC__10_1_0_S6_S3 0 2540 /end CHARACTERISTIC
/begin CHARACTERISTIC KL_TRASPORT42 "Kennlinie Zeit Erste Rampe" CURVE 0x25C728 kl_ui8_S6_S3 2540 UMR_MSEC__10_1_0_S6_S3 0 2540
 /begin AXIS_DESCR STD_AXIS zff_atsys._.iSignale._.obj.sig_m_t8 UMR_NM__8_1_M50_S6_S3 4 -400 1640 DEPOSIT ABSOLUTE MONOTONY MON_INCREASE /end AXIS_DESCR
/end CHARACTERISTIC
/begin CHARACTERISTIC KL_PGRASYNSPORT42 "Schliessrampenradient" CURVE 0x25C734 kl_si16_S6_S3 6553.4 UMR_BAR_SEC_1_10_0_S6_S3 -3276.7 3276.7
 /begin AXIS_DESCR STD_AXIS zff_atsys._.iSignale._.obj.sig_m_t UMR_NM__1_1_0_S6_S3 6 -400 1640 DEPOSIT ABSOLUTE MONOTONY MON_INCREASE /end AXIS_DESCR
/end CHARACTERISTIC
/begin CHARACTERISTIC KF_POFMTNSPORT42 "Kennfeld Fuelldruckoffset(n_t, m_t)" MAP 0x25C750 kf_si16_S6_S3 12.75 UMR_BAR__1_1000_0_S6_S3 -6.4 6.35
 /begin AXIS_DESCR STD_AXIS zff_atsys._.iSignale._.obj.sig_n_t UMR_U_MIN_1_1_0_S6_S3 4 0 8160 DEPOSIT ABSOLUTE MONOTONY MON_INCREASE /end AXIS_DESCR
 /begin AXIS_DESCR STD_AXIS zff_atsys._.iSignale._.obj.sig_m_t UMR_NM__1_1_0_S6_S3 6 -400 1640 DEPOSIT ABSOLUTE MONOTONY MON_INCREASE /end AXIS_DESCR
/end CHARACTERISTIC
/begin CHARACTERISTIC KF_PKZUSPORT42 "Schaltdruck zuschaltende Kupplung" MAP 0x25C79C kf_si16_S6_S3 12.75 UMR_BAR__1_1000_0_S6_S3 0 12.75
 /begin AXIS_DESCR STD_AXIS iSasZentr.iSchaltend.n_tkf UMR_U_MIN_32_1_0_S6_S3 8 0 8160 DEPOSIT ABSOLUTE MONOTONY MON_INCREASE /end AXIS_DESCR
 /begin AXIS_DESCR STD_AXIS zff_atsys._.iSignale._.obj.sig_m_t UMR_NM__1_1_0_S6_S3 8 -400 1640 DEPOSIT ABSOLUTE MONOTONY MON_INCREASE /end AXIS_DESCR
/end CHARACTERISTIC
/begin CHARACTERISTIC KF_POHINSYNKZUSPORT42 "Kennfeld Haltedruckoffset(n_tkf, m_t) bei Haltephase in Synchron" MAP 0x25C844 kf_si16_S6_S3 12.75 UMR_BAR__1_1000_0_S6_S3 -6.4 6.35
 /begin AXIS_DESCR STD_AXIS iSasZentr.iSchaltend.n_tkf UMR_U_MIN_32_1_0_S6_S3 4 0 8160 DEPOSIT ABSOLUTE MONOTONY MON_INCREASE /end AXIS_DESCR
 /begin AXIS_DESCR STD_AXIS zff_atsys._.iSignale._.obj.sig_m_t UMR_NM__1_1_0_S6_S3 4 -400 1640 DEPOSIT ABSOLUTE MONOTONY MON_INCREASE /end AXIS_DESCR
/end CHARACTERISTIC
/begin CHARACTERISTIC KL_TSYNCGHINSYNEKZUSPORT42 "Zeit fuer Ende Haltephase in Synchron KZU" CURVE 0x25C87C kl_ui8_S6_S3 2550 UMR_MSEC__10_1_M128_S6_S3 -1280 1270
 /begin AXIS_DESCR STD_AXIS zff_atsys._.iSignale._.obj.sig_c_getr UMR_GRADC__1_1_M40_S6_S3 4 -40 150 DEPOSIT ABSOLUTE MONOTONY MON_INCREASE /end AXIS_DESCR
/end CHARACTERISTIC
/begin CHARACTERISTIC F_PRASPORT51 "Druckfaktor waehrend Rampe auf Schaltdruck" VALUE 0x26E988 kw_ui8_S6_S3 1 UMR___1_100_0_S6_S3 0 1 /end CHARACTERISTIC
/begin CHARACTERISTIC F_TRASPORT51 "Zeitfaktor waehrend Rampe auf Schaltdruck" VALUE 0x26E989 kw_ui8_S6_S3 1 UMR___1_100_0_S6_S3 0 1 /end CHARACTERISTIC
/begin CHARACTERISTIC T_FSPORT51 "Fuellzeit" VALUE 0x26E98A kw_ui8_S6_S3 2540 UMR_MSEC__10_1_0_S6_S3 0 2540 /end CHARACTERISTIC
/begin CHARACTERISTIC KL_TRASPORT51 "Kennlinie Zeit Erste Rampe" CURVE 0x25C888 kl_ui8_S6_S3 2540 UMR_MSEC__10_1_0_S6_S3 0 2540
 /begin AXIS_DESCR STD_AXIS zff_atsys._.iSignale._.obj.sig_m_t8 UMR_NM__8_1_M50_S6_S3 4 -400 1640 DEPOSIT ABSOLUTE MONOTONY MON_INCREASE /end AXIS_DESCR
/end CHARACTERISTIC
/begin CHARACTERISTIC KL_PGRASYNSPORT51 "Schliessrampenradient" CURVE 0x25C894 kl_si16_S6_S3 6553.4 UMR_BAR_SEC_1_10_0_S6_S3 -3276.7 3276.7
 /begin AXIS_DESCR STD_AXIS zff_atsys._.iSignale._.obj.sig_m_t UMR_NM__1_1_0_S6_S3 6 -400 1640 DEPOSIT ABSOLUTE MONOTONY MON_INCREASE /end AXIS_DESCR
/end CHARACTERISTIC
/begin CHARACTERISTIC KF_POFMTNSPORT51 "Kennfeld Fuelldruckoffset(n_t, m_t)" MAP 0x25C8B0 kf_si16_S6_S3 12.75 UMR_BAR__1_1000_0_S6_S3 -6.4 6.35
 /begin AXIS_DESCR STD_AXIS zff_atsys._.iSignale._.obj.sig_n_t UMR_U_MIN_1_1_0_S6_S3 4 0 8160 DEPOSIT ABSOLUTE MONOTONY MON_INCREASE /end AXIS_DESCR
 /begin AXIS_DESCR STD_AXIS zff_atsys._.iSignale._.obj.sig_m_t UMR_NM__1_1_0_S6_S3 6 -400 1640 DEPOSIT ABSOLUTE MONOTONY MON_INCREASE /end AXIS_DESCR
/end CHARACTERISTIC
/begin CHARACTERISTIC KF_PKZUSPORT51 "Schaltdruck zuschaltende Kupplung" MAP 0x25C8FC kf_si16_S6_S3 12.75 UMR_BAR__1_1000_0_S6_S3 0 12.75
 /begin AXIS_DESCR STD_AXIS iSasZentr.iSchaltend.n_tkf UMR_U_MIN_32_1_0_S6_S3 8 0 8160 DEPOSIT ABSOLUTE MONOTONY MON_INCREASE /end AXIS_DESCR
 /begin AXIS_DESCR STD_AXIS zff_atsys._.iSignale._.obj.sig_m_t UMR_NM__1_1_0_S6_S3 8 -400 1640 DEPOSIT ABSOLUTE MONOTONY MON_INCREASE /end AXIS_DESCR
/end CHARACTERISTIC
/begin CHARACTERISTIC KF_POHINSYNKZUSPORT51 "Kennfeld Haltedruckoffset(n_tkf, m_t) bei Haltephase in Synchron" MAP 0x25C9A4 kf_si16_S6_S3 12.75 UMR_BAR__1_1000_0_S6_S3 -6.4 6.35
 /begin AXIS_DESCR STD_AXIS iSasZentr.iSchaltend.n_tkf UMR_U_MIN_32_1_0_S6_S3 4 0 8160 DEPOSIT ABSOLUTE MONOTONY MON_INCREASE /end AXIS_DESCR
 /begin AXIS_DESCR STD_AXIS zff_atsys._.iSignale._.obj.sig_m_t UMR_NM__1_1_0_S6_S3 4 -400 1640 DEPOSIT ABSOLUTE MONOTONY MON_INCREASE /end AXIS_DESCR
/end CHARACTERISTIC
/begin CHARACTERISTIC KL_TSYNCGHINSYNEKZUSPORT51 "Zeit fuer Ende Haltephase in Synchron KZU" CURVE 0x25C9DC kl_ui8_S6_S3 2550 UMR_MSEC__10_1_M128_S6_S3 -1280 1270
 /begin AXIS_DESCR STD_AXIS zff_atsys._.iSignale._.obj.sig_c_getr UMR_GRADC__1_1_M40_S6_S3 4 -40 150 DEPOSIT ABSOLUTE MONOTONY MON_INCREASE /end AXIS_DESCR
/end CHARACTERISTIC
/begin CHARACTERISTIC F_PRASPORT53 "Druckfaktor waehrend Rampe auf Schaltdruck" VALUE 0x26E98B kw_ui8_S6_S3 1 UMR___1_100_0_S6_S3 0 1 /end CHARACTERISTIC
/begin CHARACTERISTIC F_TRASPORT53 "Zeitfaktor waehrend Rampe auf Schaltdruck" VALUE 0x26E98C kw_ui8_S6_S3 1 UMR___1_100_0_S6_S3 0 1 /end CHARACTERISTIC
/begin CHARACTERISTIC T_FSPORT53 "Fuellzeit" VALUE 0x26E98D kw_ui8_S6_S3 2540 UMR_MSEC__10_1_0_S6_S3 0 2540 /end CHARACTERISTIC
/begin CHARACTERISTIC KL_TRASPORT53 "Kennlinie Zeit Erste Rampe" CURVE 0x25C9E8 kl_ui8_S6_S3 2540 UMR_MSEC__10_1_0_S6_S3 0 2540
 /begin AXIS_DESCR STD_AXIS zff_atsys._.iSignale._.obj.sig_m_t8 UMR_NM__8_1_M50_S6_S3 4 -400 1640 DEPOSIT ABSOLUTE MONOTONY MON_INCREASE /end AXIS_DESCR
/end CHARACTERISTIC
/begin CHARACTERISTIC KL_PGRASYNSPORT53 "Schliessrampenradient" CURVE 0x25C9F4 kl_si16_S6_S3 6553.4 UMR_BAR_SEC_1_10_0_S6_S3 -3276.7 3276.7
 /begin AXIS_DESCR STD_AXIS zff_atsys._.iSignale._.obj.sig_m_t UMR_NM__1_1_0_S6_S3 6 -400 1640 DEPOSIT ABSOLUTE MONOTONY MON_INCREASE /end AXIS_DESCR
/end CHARACTERISTIC
/begin CHARACTERISTIC KF_POFMTNSPORT53 "Kennfeld Fuelldruckoffset(n_t, m_t)" MAP 0x25CA10 kf_si16_S6_S3 12.75 UMR_BAR__1_1000_0_S6_S3 -6.4 6.35
 /begin AXIS_DESCR STD_AXIS zff_atsys._.iSignale._.obj.sig_n_t UMR_U_MIN_1_1_0_S6_S3 4 0 8160 DEPOSIT ABSOLUTE MONOTONY MON_INCREASE /end AXIS_DESCR
 /begin AXIS_DESCR STD_AXIS zff_atsys._.iSignale._.obj.sig_m_t UMR_NM__1_1_0_S6_S3 6 -400 1640 DEPOSIT ABSOLUTE MONOTONY MON_INCREASE /end AXIS_DESCR
/end CHARACTERISTIC
/begin CHARACTERISTIC KF_PKZUSPORT53 "Schaltdruck zuschaltende Kupplung" MAP 0x25CA5C kf_si16_S6_S3 12.75 UMR_BAR__1_1000_0_S6_S3 0 12.75
 /begin AXIS_DESCR STD_AXIS iSasZentr.iSchaltend.n_tkf UMR_U_MIN_32_1_0_S6_S3 8 0 8160 DEPOSIT ABSOLUTE MONOTONY MON_INCREASE /end AXIS_DESCR
 /begin AXIS_DESCR STD_AXIS zff_atsys._.iSignale._.obj.sig_m_t UMR_NM__1_1_0_S6_S3 8 -400 1640 DEPOSIT ABSOLUTE MONOTONY MON_INCREASE /end AXIS_DESCR
/end CHARACTERISTIC
/begin CHARACTERISTIC KF_POHINSYNKZUSPORT53 "Kennfeld Haltedruckoffset(n_tkf, m_t) bei Haltephase in Synchron" MAP 0x25CB04 kf_si16_S6_S3 12.75 UMR_BAR__1_1000_0_S6_S3 -6.4 6.35
 /begin AXIS_DESCR STD_AXIS iSasZentr.iSchaltend.n_tkf UMR_U_MIN_32_1_0_S6_S3 4 0 8160 DEPOSIT ABSOLUTE MONOTONY MON_INCREASE /end AXIS_DESCR
 /begin AXIS_DESCR STD_AXIS zff_atsys._.iSignale._.obj.sig_m_t UMR_NM__1_1_0_S6_S3 4 -400 1640 DEPOSIT ABSOLUTE MONOTONY MON_INCREASE /end AXIS_DESCR
/end CHARACTERISTIC
/begin CHARACTERISTIC KL_TSYNCGHINSYNEKZUSPORT53 "Zeit fuer Ende Haltephase in Synchron KZU" CURVE 0x25CB3C kl_ui8_S6_S3 2550 UMR_MSEC__10_1_M128_S6_S3 -1280 1270
 /begin AXIS_DESCR STD_AXIS zff_atsys._.iSignale._.obj.sig_c_getr UMR_GRADC__1_1_M40_S6_S3 4 -40 150 DEPOSIT ABSOLUTE MONOTONY MON_INCREASE /end AXIS_DESCR
/end CHARACTERISTIC
/begin CHARACTERISTIC F_PRASPORT63 "Druckfaktor waehrend Rampe auf Schaltdruck" VALUE 0x26E98E kw_ui8_S6_S3 1 UMR___1_100_0_S6_S3 0 1 /end CHARACTERISTIC
/begin CHARACTERISTIC F_TRASPORT63 "Zeitfaktor waehrend Rampe auf Schaltdruck" VALUE 0x26E98F kw_ui8_S6_S3 1 UMR___1_100_0_S6_S3 0 1 /end CHARACTERISTIC
/begin CHARACTERISTIC T_FSPORT63 "Fuellzeit" VALUE 0x26E990 kw_ui8_S6_S3 2540 UMR_MSEC__10_1_0_S6_S3 0 2540 /end CHARACTERISTIC
/begin CHARACTERISTIC KL_TRASPORT63 "Kennlinie Zeit Erste Rampe" CURVE 0x25CB48 kl_ui8_S6_S3 2540 UMR_MSEC__10_1_0_S6_S3 0 2540
 /begin AXIS_DESCR STD_AXIS zff_atsys._.iSignale._.obj.sig_m_t8 UMR_NM__8_1_M50_S6_S3 4 -400 1640 DEPOSIT ABSOLUTE MONOTONY MON_INCREASE /end AXIS_DESCR
/end CHARACTERISTIC
/begin CHARACTERISTIC KL_PGRASYNSPORT63 "Schliessrampenradient" CURVE 0x25CB54 kl_si16_S6_S3 6553.4 UMR_BAR_SEC_1_10_0_S6_S3 -3276.7 3276.7
 /begin AXIS_DESCR STD_AXIS zff_atsys._.iSignale._.obj.sig_m_t UMR_NM__1_1_0_S6_S3 6 -400 1640 DEPOSIT ABSOLUTE MONOTONY MON_INCREASE /end AXIS_DESCR
/end CHARACTERISTIC
/begin CHARACTERISTIC KF_POFMTNSPORT63 "Kennfeld Fuelldruckoffset(n_t, m_t)" MAP 0x25CB70 kf_si16_S6_S3 12.75 UMR_BAR__1_1000_0_S6_S3 -6.4 6.35
 /begin AXIS_DESCR STD_AXIS zff_atsys._.iSignale._.obj.sig_n_t UMR_U_MIN_1_1_0_S6_S3 4 0 8160 DEPOSIT ABSOLUTE MONOTONY MON_INCREASE /end AXIS_DESCR
 /begin AXIS_DESCR STD_AXIS zff_atsys._.iSignale._.obj.sig_m_t UMR_NM__1_1_0_S6_S3 6 -400 1640 DEPOSIT ABSOLUTE MONOTONY MON_INCREASE /end AXIS_DESCR
/end CHARACTERISTIC
/begin CHARACTERISTIC KF_PKZUSPORT63 "Schaltdruck zuschaltende Kupplung" MAP 0x25CBBC kf_si16_S6_S3 12.75 UMR_BAR__1_1000_0_S6_S3 0 12.75
 /begin AXIS_DESCR STD_AXIS iSasZentr.iSchaltend.n_tkf UMR_U_MIN_32_1_0_S6_S3 8 0 8160 DEPOSIT ABSOLUTE MONOTONY MON_INCREASE /end AXIS_DESCR
 /begin AXIS_DESCR STD_AXIS zff_atsys._.iSignale._.obj.sig_m_t UMR_NM__1_1_0_S6_S3 8 -400 1640 DEPOSIT ABSOLUTE MONOTONY MON_INCREASE /end AXIS_DESCR
/end CHARACTERISTIC
/begin CHARACTERISTIC KF_POHINSYNKZUSPORT63 "Kennfeld Haltedruckoffset(n_tkf, m_t) bei Haltephase in Synchron" MAP 0x25CC64 kf_si16_S6_S3 12.75 UMR_BAR__1_1000_0_S6_S3 -6.4 6.35
 /begin AXIS_DESCR STD_AXIS iSasZentr.iSchaltend.n_tkf UMR_U_MIN_32_1_0_S6_S3 4 0 8160 DEPOSIT ABSOLUTE MONOTONY MON_INCREASE /end AXIS_DESCR
 /begin AXIS_DESCR STD_AXIS zff_atsys._.iSignale._.obj.sig_m_t UMR_NM__1_1_0_S6_S3 4 -400 1640 DEPOSIT ABSOLUTE MONOTONY MON_INCREASE /end AXIS_DESCR
/end CHARACTERISTIC
/begin CHARACTERISTIC KL_TSYNCGHINSYNEKZUSPORT63 "Zeit fuer Ende Haltephase in Synchron KZU" CURVE 0x25CC9C kl_ui8_S6_S3 2550 UMR_MSEC__10_1_M128_S6_S3 -1280 1270
 /begin AXIS_DESCR STD_AXIS zff_atsys._.iSignale._.obj.sig_c_getr UMR_GRADC__1_1_M40_S6_S3 4 -40 150 DEPOSIT ABSOLUTE MONOTONY MON_INCREASE /end AXIS_DESCR
/end CHARACTERISTIC
/begin CHARACTERISTIC F_PRASPORT64 "Druckfaktor waehrend Rampe auf Schaltdruck" VALUE 0x26E991 kw_ui8_S6_S3 1 UMR___1_100_0_S6_S3 0 1 /end CHARACTERISTIC
/begin CHARACTERISTIC F_TRASPORT64 "Zeitfaktor waehrend Rampe auf Schaltdruck" VALUE 0x26E992 kw_ui8_S6_S3 1 UMR___1_100_0_S6_S3 0 1 /end CHARACTERISTIC
/begin CHARACTERISTIC T_FSPORT64 "Fuellzeit" VALUE 0x26E993 kw_ui8_S6_S3 2540 UMR_MSEC__10_1_0_S6_S3 0 2540 /end CHARACTERISTIC
/begin CHARACTERISTIC KL_TRASPORT64 "Kennlinie Zeit Erste Rampe" CURVE 0x25CCA8 kl_ui8_S6_S3 2540 UMR_MSEC__10_1_0_S6_S3 0 2540
 /begin AXIS_DESCR STD_AXIS zff_atsys._.iSignale._.obj.sig_m_t8 UMR_NM__8_1_M50_S6_S3 4 -400 1640 DEPOSIT ABSOLUTE MONOTONY MON_INCREASE /end AXIS_DESCR
/end CHARACTERISTIC
/begin CHARACTERISTIC KL_PGRASYNSPORT64 "Schliessrampenradient" CURVE 0x25CCB4 kl_si16_S6_S3 6553.4 UMR_BAR_SEC_1_10_0_S6_S3 -3276.7 3276.7
 /begin AXIS_DESCR STD_AXIS zff_atsys._.iSignale._.obj.sig_m_t UMR_NM__1_1_0_S6_S3 6 -400 1640 DEPOSIT ABSOLUTE MONOTONY MON_INCREASE /end AXIS_DESCR
/end CHARACTERISTIC
/begin CHARACTERISTIC KF_POFMTNSPORT64 "Kennfeld Fuelldruckoffset(n_t, m_t)" MAP 0x25CCD0 kf_si16_S6_S3 12.75 UMR_BAR__1_1000_0_S6_S3 -6.4 6.35
 /begin AXIS_DESCR STD_AXIS zff_atsys._.iSignale._.obj.sig_n_t UMR_U_MIN_1_1_0_S6_S3 4 0 8160 DEPOSIT ABSOLUTE MONOTONY MON_INCREASE /end AXIS_DESCR
 /begin AXIS_DESCR STD_AXIS zff_atsys._.iSignale._.obj.sig_m_t UMR_NM__1_1_0_S6_S3 6 -400 1640 DEPOSIT ABSOLUTE MONOTONY MON_INCREASE /end AXIS_DESCR
/end CHARACTERISTIC
/begin CHARACTERISTIC KF_PKZUSPORT64 "Schaltdruck zuschaltende Kupplung" MAP 0x25CD1C kf_si16_S6_S3 12.75 UMR_BAR__1_1000_0_S6_S3 0 12.75
 /begin AXIS_DESCR STD_AXIS iSasZentr.iSchaltend.n_tkf UMR_U_MIN_32_1_0_S6_S3 8 0 8160 DEPOSIT ABSOLUTE MONOTONY MON_INCREASE /end AXIS_DESCR
 /begin AXIS_DESCR STD_AXIS zff_atsys._.iSignale._.obj.sig_m_t UMR_NM__1_1_0_S6_S3 8 -400 1640 DEPOSIT ABSOLUTE MONOTONY MON_INCREASE /end AXIS_DESCR
/end CHARACTERISTIC
/begin CHARACTERISTIC KF_POHINSYNKZUSPORT64 "Kennfeld Haltedruckoffset(n_tkf, m_t) bei Haltephase in Synchron" MAP 0x25CDC4 kf_si16_S6_S3 12.75 UMR_BAR__1_1000_0_S6_S3 -6.4 6.35
 /begin AXIS_DESCR STD_AXIS iSasZentr.iSchaltend.n_tkf UMR_U_MIN_32_1_0_S6_S3 4 0 8160 DEPOSIT ABSOLUTE MONOTONY MON_INCREASE /end AXIS_DESCR
 /begin AXIS_DESCR STD_AXIS zff_atsys._.iSignale._.obj.sig_m_t UMR_NM__1_1_0_S6_S3 4 -400 1640 DEPOSIT ABSOLUTE MONOTONY MON_INCREASE /end AXIS_DESCR
/end CHARACTERISTIC
/begin CHARACTERISTIC KL_TSYNCGHINSYNEKZUSPORT64 "Zeit fuer Ende Haltephase in Synchron KZU" CURVE 0x25CDFC kl_ui8_S6_S3 2550 UMR_MSEC__10_1_M128_S6_S3 -1280 1270
 /begin AXIS_DESCR STD_AXIS zff_atsys._.iSignale._.obj.sig_c_getr UMR_GRADC__1_1_M40_S6_S3 4 -40 150 DEPOSIT ABSOLUTE MONOTONY MON_INCREASE /end AXIS_DESCR
/end CHARACTERISTIC
/begin CHARACTERISTIC F_PRASPORT71 "Druckfaktor waehrend Rampe auf Schaltdruck" VALUE 0x26E994 kw_ui8_S6_S3 1 UMR___1_100_0_S6_S3 0 1 /end CHARACTERISTIC
/begin CHARACTERISTIC F_TRASPORT71 "Zeitfaktor waehrend Rampe auf Schaltdruck" VALUE 0x26E995 kw_ui8_S6_S3 1 UMR___1_100_0_S6_S3 0 1 /end CHARACTERISTIC
/begin CHARACTERISTIC T_FSPORT71 "Fuellzeit" VALUE 0x26E996 kw_ui8_S6_S3 2540 UMR_MSEC__10_1_0_S6_S3 0 2540 /end CHARACTERISTIC
/begin CHARACTERISTIC KL_TRASPORT71 "Kennlinie Zeit Erste Rampe" CURVE 0x25CE08 kl_ui8_S6_S3 2540 UMR_MSEC__10_1_0_S6_S3 0 2540
 /begin AXIS_DESCR STD_AXIS zff_atsys._.iSignale._.obj.sig_m_t8 UMR_NM__8_1_M50_S6_S3 4 -400 1640 DEPOSIT ABSOLUTE MONOTONY MON_INCREASE /end AXIS_DESCR
/end CHARACTERISTIC
/begin CHARACTERISTIC KL_PGRASYNSPORT71 "Schliessrampenradient" CURVE 0x25CE14 kl_si16_S6_S3 6553.4 UMR_BAR_SEC_1_10_0_S6_S3 -3276.7 3276.7
 /begin AXIS_DESCR STD_AXIS zff_atsys._.iSignale._.obj.sig_m_t UMR_NM__1_1_0_S6_S3 6 -400 1640 DEPOSIT ABSOLUTE MONOTONY MON_INCREASE /end AXIS_DESCR
/end CHARACTERISTIC
/begin CHARACTERISTIC KF_POFMTNSPORT71 "Kennfeld Fuelldruckoffset(n_t, m_t)" MAP 0x25CE30 kf_si16_S6_S3 12.75 UMR_BAR__1_1000_0_S6_S3 -6.4 6.35
 /begin AXIS_DESCR STD_AXIS zff_atsys._.iSignale._.obj.sig_n_t UMR_U_MIN_1_1_0_S6_S3 4 0 8160 DEPOSIT ABSOLUTE MONOTONY MON_INCREASE /end AXIS_DESCR
 /begin AXIS_DESCR STD_AXIS zff_atsys._.iSignale._.obj.sig_m_t UMR_NM__1_1_0_S6_S3 6 -400 1640 DEPOSIT ABSOLUTE MONOTONY MON_INCREASE /end AXIS_DESCR
/end CHARACTERISTIC
/begin CHARACTERISTIC KF_PKZUSPORT71 "Schaltdruck zuschaltende Kupplung" MAP 0x25CE7C kf_si16_S6_S3 12.75 UMR_BAR__1_1000_0_S6_S3 0 12.75
 /begin AXIS_DESCR STD_AXIS iSasZentr.iSchaltend.n_tkf UMR_U_MIN_32_1_0_S6_S3 8 0 8160 DEPOSIT ABSOLUTE MONOTONY MON_INCREASE /end AXIS_DESCR
 /begin AXIS_DESCR STD_AXIS zff_atsys._.iSignale._.obj.sig_m_t UMR_NM__1_1_0_S6_S3 8 -400 1640 DEPOSIT ABSOLUTE MONOTONY MON_INCREASE /end AXIS_DESCR
/end CHARACTERISTIC
/begin CHARACTERISTIC KF_POHINSYNKZUSPORT71 "Kennfeld Haltedruckoffset(n_tkf, m_t) bei Haltephase in Synchron" MAP 0x25CF24 kf_si16_S6_S3 12.75 UMR_BAR__1_1000_0_S6_S3 -6.4 6.35
 /begin AXIS_DESCR STD_AXIS iSasZentr.iSchaltend.n_tkf UMR_U_MIN_32_1_0_S6_S3 4 0 8160 DEPOSIT ABSOLUTE MONOTONY MON_INCREASE /end AXIS_DESCR
 /begin AXIS_DESCR STD_AXIS zff_atsys._.iSignale._.obj.sig_m_t UMR_NM__1_1_0_S6_S3 4 -400 1640 DEPOSIT ABSOLUTE MONOTONY MON_INCREASE /end AXIS_DESCR
/end CHARACTERISTIC
/begin CHARACTERISTIC KL_TSYNCGHINSYNEKZUSPORT71 "Zeit fuer Ende Haltephase in Synchron KZU" CURVE 0x25CF5C kl_ui8_S6_S3 2550 UMR_MSEC__10_1_M128_S6_S3 -1280 1270
 /begin AXIS_DESCR STD_AXIS zff_atsys._.iSignale._.obj.sig_c_getr UMR_GRADC__1_1_M40_S6_S3 4 -40 150 DEPOSIT ABSOLUTE MONOTONY MON_INCREASE /end AXIS_DESCR
/end CHARACTERISTIC
/begin CHARACTERISTIC F_PRASPORT75 "Druckfaktor waehrend Rampe auf Schaltdruck" VALUE 0x26E997 kw_ui8_S6_S3 1 UMR___1_100_0_S6_S3 0 1 /end CHARACTERISTIC
/begin CHARACTERISTIC F_TRASPORT75 "Zeitfaktor waehrend Rampe auf Schaltdruck" VALUE 0x26E998 kw_ui8_S6_S3 1 UMR___1_100_0_S6_S3 0 1 /end CHARACTERISTIC
/begin CHARACTERISTIC T_FSPORT75 "Fuellzeit" VALUE 0x26E999 kw_ui8_S6_S3 2540 UMR_MSEC__10_1_0_S6_S3 0 2540 /end CHARACTERISTIC
/begin CHARACTERISTIC KL_TRASPORT75 "Kennlinie Zeit Erste Rampe" CURVE 0x25CF68 kl_ui8_S6_S3 2540 UMR_MSEC__10_1_0_S6_S3 0 2540
 /begin AXIS_DESCR STD_AXIS zff_atsys._.iSignale._.obj.sig_m_t8 UMR_NM__8_1_M50_S6_S3 4 -400 1640 DEPOSIT ABSOLUTE MONOTONY MON_INCREASE /end AXIS_DESCR
/end CHARACTERISTIC
/begin CHARACTERISTIC KL_PGRASYNSPORT75 "Schliessrampenradient" CURVE 0x25CF74 kl_si16_S6_S3 6553.4 UMR_BAR_SEC_1_10_0_S6_S3 -3276.7 3276.7
 /begin AXIS_DESCR STD_AXIS zff_atsys._.iSignale._.obj.sig_m_t UMR_NM__1_1_0_S6_S3 6 -400 1640 DEPOSIT ABSOLUTE MONOTONY MON_INCREASE /end AXIS_DESCR
/end CHARACTERISTIC
/begin CHARACTERISTIC KF_POFMTNSPORT75 "Kennfeld Fuelldruckoffset(n_t, m_t)" MAP 0x25CF90 kf_si16_S6_S3 12.75 UMR_BAR__1_1000_0_S6_S3 -6.4 6.35
 /begin AXIS_DESCR STD_AXIS zff_atsys._.iSignale._.obj.sig_n_t UMR_U_MIN_1_1_0_S6_S3 4 0 8160 DEPOSIT ABSOLUTE MONOTONY MON_INCREASE /end AXIS_DESCR
 /begin AXIS_DESCR STD_AXIS zff_atsys._.iSignale._.obj.sig_m_t UMR_NM__1_1_0_S6_S3 6 -400 1640 DEPOSIT ABSOLUTE MONOTONY MON_INCREASE /end AXIS_DESCR
/end CHARACTERISTIC
/begin CHARACTERISTIC KF_PKZUSPORT75 "Schaltdruck zuschaltende Kupplung" MAP 0x25CFDC kf_si16_S6_S3 12.75 UMR_BAR__1_1000_0_S6_S3 0 12.75
 /begin AXIS_DESCR STD_AXIS iSasZentr.iSchaltend.n_tkf UMR_U_MIN_32_1_0_S6_S3 8 0 8160 DEPOSIT ABSOLUTE MONOTONY MON_INCREASE /end AXIS_DESCR
 /begin AXIS_DESCR STD_AXIS zff_atsys._.iSignale._.obj.sig_m_t UMR_NM__1_1_0_S6_S3 8 -400 1640 DEPOSIT ABSOLUTE MONOTONY MON_INCREASE /end AXIS_DESCR
/end CHARACTERISTIC
/begin CHARACTERISTIC KF_POHINSYNKZUSPORT75 "Kennfeld Haltedruckoffset(n_tkf, m_t) bei Haltephase in Synchron" MAP 0x25D084 kf_si16_S6_S3 12.75 UMR_BAR__1_1000_0_S6_S3 -6.4 6.35
 /begin AXIS_DESCR STD_AXIS iSasZentr.iSchaltend.n_tkf UMR_U_MIN_32_1_0_S6_S3 4 0 8160 DEPOSIT ABSOLUTE MONOTONY MON_INCREASE /end AXIS_DESCR
 /begin AXIS_DESCR STD_AXIS zff_atsys._.iSignale._.obj.sig_m_t UMR_NM__1_1_0_S6_S3 4 -400 1640 DEPOSIT ABSOLUTE MONOTONY MON_INCREASE /end AXIS_DESCR
/end CHARACTERISTIC
/begin CHARACTERISTIC KL_TSYNCGHINSYNEKZUSPORT75 "Zeit fuer Ende Haltephase in Synchron KZU" CURVE 0x25D0BC kl_ui8_S6_S3 2550 UMR_MSEC__10_1_M128_S6_S3 -1280 1270
 /begin AXIS_DESCR STD_AXIS zff_atsys._.iSignale._.obj.sig_c_getr UMR_GRADC__1_1_M40_S6_S3 4 -40 150 DEPOSIT ABSOLUTE MONOTONY MON_INCREASE /end AXIS_DESCR
/end CHARACTERISTIC
/begin CHARACTERISTIC F_PRASPORT82 "Druckfaktor waehrend Rampe auf Schaltdruck" VALUE 0x26E99A kw_ui8_S6_S3 1 UMR___1_100_0_S6_S3 0 1 /end CHARACTERISTIC
/begin CHARACTERISTIC F_TRASPORT82 "Zeitfaktor waehrend Rampe auf Schaltdruck" VALUE 0x26E99B kw_ui8_S6_S3 1 UMR___1_100_0_S6_S3 0 1 /end CHARACTERISTIC
/begin CHARACTERISTIC T_FSPORT82 "Fuellzeit" VALUE 0x26E99C kw_ui8_S6_S3 2540 UMR_MSEC__10_1_0_S6_S3 0 2540 /end CHARACTERISTIC
/begin CHARACTERISTIC KL_TRASPORT82 "Kennlinie Zeit Erste Rampe" CURVE 0x25D0C8 kl_ui8_S6_S3 2540 UMR_MSEC__10_1_0_S6_S3 0 2540
 /begin AXIS_DESCR STD_AXIS zff_atsys._.iSignale._.obj.sig_m_t8 UMR_NM__8_1_M50_S6_S3 4 -400 1640 DEPOSIT ABSOLUTE MONOTONY MON_INCREASE /end AXIS_DESCR
/end CHARACTERISTIC
/begin CHARACTERISTIC KL_PGRASYNSPORT82 "Schliessrampenradient" CURVE 0x25D0D4 kl_si16_S6_S3 6553.4 UMR_BAR_SEC_1_10_0_S6_S3 -3276.7 3276.7
 /begin AXIS_DESCR STD_AXIS zff_atsys._.iSignale._.obj.sig_m_t UMR_NM__1_1_0_S6_S3 6 -400 1640 DEPOSIT ABSOLUTE MONOTONY MON_INCREASE /end AXIS_DESCR
/end CHARACTERISTIC
/begin CHARACTERISTIC KF_POFMTNSPORT82 "Kennfeld Fuelldruckoffset(n_t, m_t)" MAP 0x25D0F0 kf_si16_S6_S3 12.75 UMR_BAR__1_1000_0_S6_S3 -6.4 6.35
 /begin AXIS_DESCR STD_AXIS zff_atsys._.iSignale._.obj.sig_n_t UMR_U_MIN_1_1_0_S6_S3 4 0 8160 DEPOSIT ABSOLUTE MONOTONY MON_INCREASE /end AXIS_DESCR
 /begin AXIS_DESCR STD_AXIS zff_atsys._.iSignale._.obj.sig_m_t UMR_NM__1_1_0_S6_S3 6 -400 1640 DEPOSIT ABSOLUTE MONOTONY MON_INCREASE /end AXIS_DESCR
/end CHARACTERISTIC
/begin CHARACTERISTIC KF_PKZUSPORT82 "Schaltdruck zuschaltende Kupplung" MAP 0x25D13C kf_si16_S6_S3 12.75 UMR_BAR__1_1000_0_S6_S3 0 12.75
 /begin AXIS_DESCR STD_AXIS iSasZentr.iSchaltend.n_tkf UMR_U_MIN_32_1_0_S6_S3 8 0 8160 DEPOSIT ABSOLUTE MONOTONY MON_INCREASE /end AXIS_DESCR
 /begin AXIS_DESCR STD_AXIS zff_atsys._.iSignale._.obj.sig_m_t UMR_NM__1_1_0_S6_S3 8 -400 1640 DEPOSIT ABSOLUTE MONOTONY MON_INCREASE /end AXIS_DESCR
/end CHARACTERISTIC
/begin CHARACTERISTIC KF_POHINSYNKZUSPORT82 "Kennfeld Haltedruckoffset(n_tkf, m_t) bei Haltephase in Synchron" MAP 0x25D1E4 kf_si16_S6_S3 12.75 UMR_BAR__1_1000_0_S6_S3 -6.4 6.35
 /begin AXIS_DESCR STD_AXIS iSasZentr.iSchaltend.n_tkf UMR_U_MIN_32_1_0_S6_S3 4 0 8160 DEPOSIT ABSOLUTE MONOTONY MON_INCREASE /end AXIS_DESCR
 /begin AXIS_DESCR STD_AXIS zff_atsys._.iSignale._.obj.sig_m_t UMR_NM__1_1_0_S6_S3 4 -400 1640 DEPOSIT ABSOLUTE MONOTONY MON_INCREASE /end AXIS_DESCR
/end CHARACTERISTIC
/begin CHARACTERISTIC KL_TSYNCGHINSYNEKZUSPORT82 "Zeit fuer Ende Haltephase in Synchron KZU" CURVE 0x25D21C kl_ui8_S6_S3 2550 UMR_MSEC__10_1_M128_S6_S3 -1280 1270
 /begin AXIS_DESCR STD_AXIS zff_atsys._.iSignale._.obj.sig_c_getr UMR_GRADC__1_1_M40_S6_S3 4 -40 150 DEPOSIT ABSOLUTE MONOTONY MON_INCREASE /end AXIS_DESCR
/end CHARACTERISTIC
/begin CHARACTERISTIC F_PRASPORT84 "Druckfaktor waehrend Rampe auf Schaltdruck" VALUE 0x26E99D kw_ui8_S6_S3 1 UMR___1_100_0_S6_S3 0 1 /end CHARACTERISTIC
/begin CHARACTERISTIC F_TRASPORT84 "Zeitfaktor waehrend Rampe auf Schaltdruck" VALUE 0x26E99E kw_ui8_S6_S3 1 UMR___1_100_0_S6_S3 0 1 /end CHARACTERISTIC
/begin CHARACTERISTIC T_FSPORT84 "Fuellzeit" VALUE 0x26E99F kw_ui8_S6_S3 2540 UMR_MSEC__10_1_0_S6_S3 0 2540 /end CHARACTERISTIC
/begin CHARACTERISTIC KL_TRASPORT84 "Kennlinie Zeit Erste Rampe" CURVE 0x25D228 kl_ui8_S6_S3 2540 UMR_MSEC__10_1_0_S6_S3 0 2540
 /begin AXIS_DESCR STD_AXIS zff_atsys._.iSignale._.obj.sig_m_t8 UMR_NM__8_1_M50_S6_S3 4 -400 1640 DEPOSIT ABSOLUTE MONOTONY MON_INCREASE /end AXIS_DESCR
/end CHARACTERISTIC
/begin CHARACTERISTIC KL_PGRASYNSPORT84 "Schliessrampenradient" CURVE 0x25D234 kl_si16_S6_S3 6553.4 UMR_BAR_SEC_1_10_0_S6_S3 -3276.7 3276.7
 /begin AXIS_DESCR STD_AXIS zff_atsys._.iSignale._.obj.sig_m_t UMR_NM__1_1_0_S6_S3 6 -400 1640 DEPOSIT ABSOLUTE MONOTONY MON_INCREASE /end AXIS_DESCR
/end CHARACTERISTIC
/begin CHARACTERISTIC KF_POFMTNSPORT84 "Kennfeld Fuelldruckoffset(n_t, m_t)" MAP 0x25D250 kf_si16_S6_S3 12.75 UMR_BAR__1_1000_0_S6_S3 -6.4 6.35
 /begin AXIS_DESCR STD_AXIS zff_atsys._.iSignale._.obj.sig_n_t UMR_U_MIN_1_1_0_S6_S3 4 0 8160 DEPOSIT ABSOLUTE MONOTONY MON_INCREASE /end AXIS_DESCR
 /begin AXIS_DESCR STD_AXIS zff_atsys._.iSignale._.obj.sig_m_t UMR_NM__1_1_0_S6_S3 6 -400 1640 DEPOSIT ABSOLUTE MONOTONY MON_INCREASE /end AXIS_DESCR
/end CHARACTERISTIC
/begin CHARACTERISTIC KF_PKZUSPORT84 "Schaltdruck zuschaltende Kupplung" MAP 0x25D29C kf_si16_S6_S3 12.75 UMR_BAR__1_1000_0_S6_S3 0 12.75
 /begin AXIS_DESCR STD_AXIS iSasZentr.iSchaltend.n_tkf UMR_U_MIN_32_1_0_S6_S3 8 0 8160 DEPOSIT ABSOLUTE MONOTONY MON_INCREASE /end AXIS_DESCR
 /begin AXIS_DESCR STD_AXIS zff_atsys._.iSignale._.obj.sig_m_t UMR_NM__1_1_0_S6_S3 8 -400 1640 DEPOSIT ABSOLUTE MONOTONY MON_INCREASE /end AXIS_DESCR
/end CHARACTERISTIC
/begin CHARACTERISTIC KF_POHINSYNKZUSPORT84 "Kennfeld Haltedruckoffset(n_tkf, m_t) bei Haltephase in Synchron" MAP 0x25D344 kf_si16_S6_S3 12.75 UMR_BAR__1_1000_0_S6_S3 -6.4 6.35
 /begin AXIS_DESCR STD_AXIS iSasZentr.iSchaltend.n_tkf UMR_U_MIN_32_1_0_S6_S3 4 0 8160 DEPOSIT ABSOLUTE MONOTONY MON_INCREASE /end AXIS_DESCR
 /begin AXIS_DESCR STD_AXIS zff_atsys._.iSignale._.obj.sig_m_t UMR_NM__1_1_0_S6_S3 4 -400 1640 DEPOSIT ABSOLUTE MONOTONY MON_INCREASE /end AXIS_DESCR
/end CHARACTERISTIC
/begin CHARACTERISTIC KL_TSYNCGHINSYNEKZUSPORT84 "Zeit fuer Ende Haltephase in Synchron KZU" CURVE 0x25D37C kl_ui8_S6_S3 2550 UMR_MSEC__10_1_M128_S6_S3 -1280 1270
 /begin AXIS_DESCR STD_AXIS zff_atsys._.iSignale._.obj.sig_c_getr UMR_GRADC__1_1_M40_S6_S3 4 -40 150 DEPOSIT ABSOLUTE MONOTONY MON_INCREASE /end AXIS_DESCR
/end CHARACTERISTIC
/begin CHARACTERISTIC F_PRASPORT86 "Druckfaktor waehrend Rampe auf Schaltdruck" VALUE 0x26E9A0 kw_ui8_S6_S3 1 UMR___1_100_0_S6_S3 0 1 /end CHARACTERISTIC
/begin CHARACTERISTIC F_TRASPORT86 "Zeitfaktor waehrend Rampe auf Schaltdruck" VALUE 0x26E9A1 kw_ui8_S6_S3 1 UMR___1_100_0_S6_S3 0 1 /end CHARACTERISTIC
/begin CHARACTERISTIC T_FSPORT86 "Fuellzeit" VALUE 0x26E9A2 kw_ui8_S6_S3 2540 UMR_MSEC__10_1_0_S6_S3 0 2540 /end CHARACTERISTIC
/begin CHARACTERISTIC KL_TRASPORT86 "Kennlinie Zeit Erste Rampe" CURVE 0x25D388 kl_ui8_S6_S3 2540 UMR_MSEC__10_1_0_S6_S3 0 2540
 /begin AXIS_DESCR STD_AXIS zff_atsys._.iSignale._.obj.sig_m_t8 UMR_NM__8_1_M50_S6_S3 4 -400 1640 DEPOSIT ABSOLUTE MONOTONY MON_INCREASE /end AXIS_DESCR
/end CHARACTERISTIC
/begin CHARACTERISTIC KL_PGRASYNSPORT86 "Schliessrampenradient" CURVE 0x25D394 kl_si16_S6_S3 6553.4 UMR_BAR_SEC_1_10_0_S6_S3 -3276.7 3276.7
 /begin AXIS_DESCR STD_AXIS zff_atsys._.iSignale._.obj.sig_m_t UMR_NM__1_1_0_S6_S3 6 -400 1640 DEPOSIT ABSOLUTE MONOTONY MON_INCREASE /end AXIS_DESCR
/end CHARACTERISTIC
/begin CHARACTERISTIC KF_POFMTNSPORT86 "Kennfeld Fuelldruckoffset(n_t, m_t)" MAP 0x25D3B0 kf_si16_S6_S3 12.75 UMR_BAR__1_1000_0_S6_S3 -6.4 6.35
 /begin AXIS_DESCR STD_AXIS zff_atsys._.iSignale._.obj.sig_n_t UMR_U_MIN_1_1_0_S6_S3 4 0 8160 DEPOSIT ABSOLUTE MONOTONY MON_INCREASE /end AXIS_DESCR
 /begin AXIS_DESCR STD_AXIS zff_atsys._.iSignale._.obj.sig_m_t UMR_NM__1_1_0_S6_S3 6 -400 1640 DEPOSIT ABSOLUTE MONOTONY MON_INCREASE /end AXIS_DESCR
/end CHARACTERISTIC
/begin CHARACTERISTIC KF_PKZUSPORT86 "Schaltdruck zuschaltende Kupplung" MAP 0x25D3FC kf_si16_S6_S3 12.75 UMR_BAR__1_1000_0_S6_S3 0 12.75
 /begin AXIS_DESCR STD_AXIS iSasZentr.iSchaltend.n_tkf UMR_U_MIN_32_1_0_S6_S3 8 0 8160 DEPOSIT ABSOLUTE MONOTONY MON_INCREASE /end AXIS_DESCR
 /begin AXIS_DESCR STD_AXIS zff_atsys._.iSignale._.obj.sig_m_t UMR_NM__1_1_0_S6_S3 8 -400 1640 DEPOSIT ABSOLUTE MONOTONY MON_INCREASE /end AXIS_DESCR
/end CHARACTERISTIC
/begin CHARACTERISTIC KF_POHINSYNKZUSPORT86 "Kennfeld Haltedruckoffset(n_tkf, m_t) bei Haltephase in Synchron" MAP 0x25D4A4 kf_si16_S6_S3 12.75 UMR_BAR__1_1000_0_S6_S3 -6.4 6.35
 /begin AXIS_DESCR STD_AXIS iSasZentr.iSchaltend.n_tkf UMR_U_MIN_32_1_0_S6_S3 4 0 8160 DEPOSIT ABSOLUTE MONOTONY MON_INCREASE /end AXIS_DESCR
 /begin AXIS_DESCR STD_AXIS zff_atsys._.iSignale._.obj.sig_m_t UMR_NM__1_1_0_S6_S3 4 -400 1640 DEPOSIT ABSOLUTE MONOTONY MON_INCREASE /end AXIS_DESCR
/end CHARACTERISTIC
/begin CHARACTERISTIC KL_TSYNCGHINSYNEKZUSPORT86 "Zeit fuer Ende Haltephase in Synchron KZU" CURVE 0x25D4DC kl_ui8_S6_S3 2550 UMR_MSEC__10_1_M128_S6_S3 -1280 1270
 /begin AXIS_DESCR STD_AXIS zff_atsys._.iSignale._.obj.sig_c_getr UMR_GRADC__1_1_M40_S6_S3 4 -40 150 DEPOSIT ABSOLUTE MONOTONY MON_INCREASE /end AXIS_DESCR
/end CHARACTERISTIC
/begin CHARACTERISTIC KL_TSYNMTKZUSFVFOLNACHMRS21 "Zeit vor sync. Start Schnellfuellung vorb. KZU" CURVE 0x24C624 kl_si16_S6_S3 5000 UMR_MSEC__10_1_0_S6_S3 -5000 0
 /begin AXIS_DESCR STD_AXIS zff_atsys._.iSignale._.obj.sig_m_t UMR_NM__1_1_0_S6_S3 4 -400 1640 DEPOSIT ABSOLUTE MONOTONY MON_INCREASE /end AXIS_DESCR
/end CHARACTERISTIC
/begin CHARACTERISTIC KL_TSYNMTTRAKZUVFOLNACHMRS21 "Zeit vor sync. Ende Fuellausgleich vorb. KZU" CURVE 0x24C638 kl_ui8_S6_S3 1280 UMR_MSEC__10_1_M128_S6_S3 -1280 0
 /begin AXIS_DESCR STD_AXIS zff_atsys._.iSignale._.obj.sig_m_t8 UMR_NM__8_1_M50_S6_S3 4 -400 1640 DEPOSIT ABSOLUTE MONOTONY MON_INCREASE /end AXIS_DESCR
/end CHARACTERISTIC
/begin CHARACTERISTIC KL_TSYNMTKZUSFVFOLNACHMRS32 "Zeit vor sync. Start Schnellfuellung vorb. KZU" CURVE 0x24C644 kl_si16_S6_S3 5000 UMR_MSEC__10_1_0_S6_S3 -5000 0
 /begin AXIS_DESCR STD_AXIS zff_atsys._.iSignale._.obj.sig_m_t UMR_NM__1_1_0_S6_S3 4 -400 1640 DEPOSIT ABSOLUTE MONOTONY MON_INCREASE /end AXIS_DESCR
/end CHARACTERISTIC
/begin CHARACTERISTIC KL_TSYNMTTRAKZUVFOLNACHMRS32 "Zeit vor sync. Ende Fuellausgleich vorb. KZU" CURVE 0x24C658 kl_ui8_S6_S3 1280 UMR_MSEC__10_1_M128_S6_S3 -1280 0
 /begin AXIS_DESCR STD_AXIS zff_atsys._.iSignale._.obj.sig_m_t8 UMR_NM__8_1_M50_S6_S3 4 -400 1640 DEPOSIT ABSOLUTE MONOTONY MON_INCREASE /end AXIS_DESCR
/end CHARACTERISTIC
/begin CHARACTERISTIC KL_TSYNMTKZUSFVFOLNACHMRS43 "Zeit vor sync. Start Schnellfuellung vorb. KZU" CURVE 0x24C664 kl_si16_S6_S3 5000 UMR_MSEC__10_1_0_S6_S3 -5000 0
 /begin AXIS_DESCR STD_AXIS zff_atsys._.iSignale._.obj.sig_m_t UMR_NM__1_1_0_S6_S3 4 -400 1640 DEPOSIT ABSOLUTE MONOTONY MON_INCREASE /end AXIS_DESCR
/end CHARACTERISTIC
/begin CHARACTERISTIC KL_TSYNMTTRAKZUVFOLNACHMRS43 "Zeit vor sync. Ende Fuellausgleich vorb. KZU" CURVE 0x24C678 kl_ui8_S6_S3 1280 UMR_MSEC__10_1_M128_S6_S3 -1280 0
 /begin AXIS_DESCR STD_AXIS zff_atsys._.iSignale._.obj.sig_m_t8 UMR_NM__8_1_M50_S6_S3 4 -400 1640 DEPOSIT ABSOLUTE MONOTONY MON_INCREASE /end AXIS_DESCR
/end CHARACTERISTIC
/begin CHARACTERISTIC KL_TSYNMTKZUSFVFOLNACHMRS54 "Zeit vor sync. Start Schnellfuellung vorb. KZU" CURVE 0x24C684 kl_si16_S6_S3 5000 UMR_MSEC__10_1_0_S6_S3 -5000 0
 /begin AXIS_DESCR STD_AXIS zff_atsys._.iSignale._.obj.sig_m_t UMR_NM__1_1_0_S6_S3 4 -400 1640 DEPOSIT ABSOLUTE MONOTONY MON_INCREASE /end AXIS_DESCR
/end CHARACTERISTIC
/begin CHARACTERISTIC KL_TSYNMTTRAKZUVFOLNACHMRS54 "Zeit vor sync. Ende Fuellausgleich vorb. KZU" CURVE 0x24C698 kl_ui8_S6_S3 1280 UMR_MSEC__10_1_M128_S6_S3 -1280 0
 /begin AXIS_DESCR STD_AXIS zff_atsys._.iSignale._.obj.sig_m_t8 UMR_NM__8_1_M50_S6_S3 4 -400 1640 DEPOSIT ABSOLUTE MONOTONY MON_INCREASE /end AXIS_DESCR
/end CHARACTERISTIC
/begin CHARACTERISTIC KL_TSYNMTKZUSFVFOLNACHMRS65 "Zeit vor sync. Start Schnellfuellung vorb. KZU" CURVE 0x24C6A4 kl_si16_S6_S3 5000 UMR_MSEC__10_1_0_S6_S3 -5000 0
 /begin AXIS_DESCR STD_AXIS zff_atsys._.iSignale._.obj.sig_m_t UMR_NM__1_1_0_S6_S3 4 -400 1640 DEPOSIT ABSOLUTE MONOTONY MON_INCREASE /end AXIS_DESCR
/end CHARACTERISTIC
/begin CHARACTERISTIC KL_TSYNMTTRAKZUVFOLNACHMRS65 "Zeit vor sync. Ende Fuellausgleich vorb. KZU" CURVE 0x24C6B8 kl_ui8_S6_S3 1280 UMR_MSEC__10_1_M128_S6_S3 -1280 0
 /begin AXIS_DESCR STD_AXIS zff_atsys._.iSignale._.obj.sig_m_t8 UMR_NM__8_1_M50_S6_S3 4 -400 1640 DEPOSIT ABSOLUTE MONOTONY MON_INCREASE /end AXIS_DESCR
/end CHARACTERISTIC
/begin CHARACTERISTIC KL_TSYNMTKZUSFVFOLNACHMRS76 "Zeit vor sync. Start Schnellfuellung vorb. KZU" CURVE 0x24C6C4 kl_si16_S6_S3 5000 UMR_MSEC__10_1_0_S6_S3 -5000 0
 /begin AXIS_DESCR STD_AXIS zff_atsys._.iSignale._.obj.sig_m_t UMR_NM__1_1_0_S6_S3 4 -400 1640 DEPOSIT ABSOLUTE MONOTONY MON_INCREASE /end AXIS_DESCR
/end CHARACTERISTIC
/begin CHARACTERISTIC KL_TSYNMTTRAKZUVFOLNACHMRS76 "Zeit vor sync. Ende Fuellausgleich vorb. KZU" CURVE 0x24C6D8 kl_ui8_S6_S3 1280 UMR_MSEC__10_1_M128_S6_S3 -1280 0
 /begin AXIS_DESCR STD_AXIS zff_atsys._.iSignale._.obj.sig_m_t8 UMR_NM__8_1_M50_S6_S3 4 -400 1640 DEPOSIT ABSOLUTE MONOTONY MON_INCREASE /end AXIS_DESCR
/end CHARACTERISTIC
/begin CHARACTERISTIC KL_TSYNMTKZUSFVFOLNACHMRS87 "Zeit vor sync. Start Schnellfuellung vorb. KZU" CURVE 0x24C6E4 kl_si16_S6_S3 5000 UMR_MSEC__10_1_0_S6_S3 -5000 0
 /begin AXIS_DESCR STD_AXIS zff_atsys._.iSignale._.obj.sig_m_t UMR_NM__1_1_0_S6_S3 4 -400 1640 DEPOSIT ABSOLUTE MONOTONY MON_INCREASE /end AXIS_DESCR
/end CHARACTERISTIC
/begin CHARACTERISTIC KL_TSYNMTTRAKZUVFOLNACHMRS87 "Zeit vor sync. Ende Fuellausgleich vorb. KZU" CURVE 0x24C6F8 kl_ui8_S6_S3 1280 UMR_MSEC__10_1_M128_S6_S3 -1280 0
 /begin AXIS_DESCR STD_AXIS zff_atsys._.iSignale._.obj.sig_m_t8 UMR_NM__8_1_M50_S6_S3 4 -400 1640 DEPOSIT ABSOLUTE MONOTONY MON_INCREASE /end AXIS_DESCR
/end CHARACTERISTIC
/begin CHARACTERISTIC T_RAABV21 "Zeit Rampe auf Schaltdruck" VALUE 0x26E7D0 kw_ui8_S6_S3 2540 UMR_MSEC__10_1_0_S6_S3 0 2540 /end CHARACTERISTIC
/begin CHARACTERISTIC T_RAABVFOLNACHMRS21 "Zeit Rampe auf Schaltdruck" VALUE 0x26E7D1 kw_ui8_S6_S3 2540 UMR_MSEC__10_1_0_S6_S3 0 2540 /end CHARACTERISTIC
/begin CHARACTERISTIC KL_POKABV21 "Druckoffset Folgeschaltung in Abhaengigkeit von m_t" CURVE 0x2499E4 kl_si16_S6_S3 12 UMR_BAR__1_1000_0_S6_S3 -6 6
 /begin AXIS_DESCR STD_AXIS zff_atsys._.iSignale._.obj.sig_m_t UMR_NM__1_1_0_S6_S3 4 -400 1640 DEPOSIT ABSOLUTE MONOTONY MON_INCREASE /end AXIS_DESCR
/end CHARACTERISTIC
/begin CHARACTERISTIC KL_POKABVFOLNACHMRS21 "Druckoffset Folgeschaltung nach MRS in Abhaengigkeit von m_t" CURVE 0x2499F8 kl_si16_S6_S3 12 UMR_BAR__1_1000_0_S6_S3 -6 6
 /begin AXIS_DESCR STD_AXIS zff_atsys._.iSignale._.obj.sig_m_t UMR_NM__1_1_0_S6_S3 4 -400 1640 DEPOSIT ABSOLUTE MONOTONY MON_INCREASE /end AXIS_DESCR
/end CHARACTERISTIC
/begin CHARACTERISTIC KF_TSYNMTNTKABVFOLNACHMRS21 "Zeit vor sync. Ende Haltephase vorb. KAB" MAP 0x249A0C kf_si16_S6_S3 5000 UMR_MSEC__10_1_0_S6_S3 -5000 0
 /begin AXIS_DESCR STD_AXIS zff_atsys._.iSignale._.obj.sig_m_t UMR_NM__1_1_0_S6_S3 4 -400 1640 DEPOSIT ABSOLUTE MONOTONY MON_INCREASE /end AXIS_DESCR
 /begin AXIS_DESCR STD_AXIS zff_atsys._.iSignale._.obj.sig_n_t UMR_U_MIN_1_1_0_S6_S3 6 0 8160 DEPOSIT ABSOLUTE MONOTONY MON_INCREASE /end AXIS_DESCR
/end CHARACTERISTIC
/begin CHARACTERISTIC KL_PGOKABFOLNACHRS21 "Druckgradient in Abhaengigkeit von m_t fuer Folgeschaltung" CURVE 0x249A58 kl_si16_S6_S3 200 UMR_BAR_SEC_1_10_0_S6_S3 -100 100
 /begin AXIS_DESCR STD_AXIS zff_atsys._.iSignale._.obj.sig_m_t UMR_NM__1_1_0_S6_S3 6 -400 1640 DEPOSIT ABSOLUTE MONOTONY MON_INCREASE /end AXIS_DESCR
/end CHARACTERISTIC
/begin CHARACTERISTIC KL_PGRASYNKABFOLNACHRS21 "Druckgradient Wegschalten KAB fuer Folgeschaltung" CURVE 0x249A74 kl_si16_S6_S3 100 UMR_BAR_SEC_1_10_0_S6_S3 -100 0
 /begin AXIS_DESCR STD_AXIS zff_atsys._.iSignale._.obj.sig_m_t UMR_NM__1_1_0_S6_S3 6 -400 1640 DEPOSIT ABSOLUTE MONOTONY MON_INCREASE /end AXIS_DESCR
/end CHARACTERISTIC
/begin CHARACTERISTIC TO_TSYNHINSYNS21 "Zeitoffset nach Synchron für Dauer Haltephase in Syn. KAB" VALUE 0x26E7D2 kw_ui8_S6_S3 2540 UMR_MSEC__10_1_0_S6_S3 0 2540 /end CHARACTERISTIC
/begin CHARACTERISTIC KL_POKABNGAB21 "Druckoffset in Abhaengigkeit von ng_ab" CURVE 0x249A90 kl_si16_S6_S3 12 UMR_BAR__1_1000_0_S6_S3 -6 6
 /begin AXIS_DESCR STD_AXIS iItfInput.ng_ab UMR_U_MINSEC_1_1_0_S6_S3 4 -5000 1000 DEPOSIT ABSOLUTE MONOTONY MON_INCREASE /end AXIS_DESCR
/end CHARACTERISTIC
/begin CHARACTERISTIC T_SYNKABWS21 "Zeit vor sync. Ende Schaltdruck KAB bei Weiterschaltung" VALUE 0x26E7D3 kw_ui8_S6_S3 1280 UMR_MSEC__10_1_M128_S6_S3 -1280 0 /end CHARACTERISTIC
/begin CHARACTERISTIC KL_FPOCGHINSYNKAB21 "Temperaturabhängige Gewichtung des Haltedruckoffsets" CURVE 0x249AA4 kl_ui8_S6_S3 1 UMR___1_100_0_S6_S3 0 1
 /begin AXIS_DESCR STD_AXIS zff_atsys._.iSignale._.obj.sig_c_getr UMR_GRADC__1_1_M40_S6_S3 4 -40 150 DEPOSIT ABSOLUTE MONOTONY MON_INCREASE /end AXIS_DESCR
/end CHARACTERISTIC
/begin CHARACTERISTIC KL_TOHKABCG21 "Zeit Offset Haltephase" CURVE 0x249AB0 kl_ui8_S6_S3 1270 UMR_MSEC__10_1_0_S6_S3 0 1270
 /begin AXIS_DESCR STD_AXIS zff_atsys._.iSignale._.obj.sig_c_getr UMR_GRADC__1_1_M40_S6_S3 4 -40 190 DEPOSIT ABSOLUTE MONOTONY MON_INCREASE /end AXIS_DESCR
/end CHARACTERISTIC
/begin CHARACTERISTIC KL_PGRASYNKAB21 "Druckgradient Wegschalten abschaltende Kupplung" CURVE 0x249ABC kl_si16_S6_S3 100 UMR_BAR_SEC_1_10_0_S6_S3 -100 0
 /begin AXIS_DESCR STD_AXIS zff_atsys._.iSignale._.obj.sig_m_t UMR_NM__1_1_0_S6_S3 6 -400 1640 DEPOSIT ABSOLUTE MONOTONY MON_INCREASE /end AXIS_DESCR
/end CHARACTERISTIC
/begin CHARACTERISTIC KL_PGRASYNKABWS21 "Druckgradient Wegschalten abschaltende Kupplung bei Weiterschaltung" CURVE 0x249AD8 kl_si16_S6_S3 100 UMR_BAR_SEC_1_10_0_S6_S3 -100 0
 /begin AXIS_DESCR STD_AXIS zff_atsys._.iSignale._.obj.sig_m_t UMR_NM__1_1_0_S6_S3 6 -400 1640 DEPOSIT ABSOLUTE MONOTONY MON_INCREASE /end AXIS_DESCR
/end CHARACTERISTIC
/begin CHARACTERISTIC KF_POKABMTCG21 "Schaltdruckoffset" MAP 0x249AF4 kf_si16_S6_S3 12.75 UMR_BAR__1_1000_0_S6_S3 -6.4 6.35
 /begin AXIS_DESCR STD_AXIS zff_atsys._.iSignale._.obj.sig_m_t UMR_NM__1_1_0_S6_S3 5 -400 1640 DEPOSIT ABSOLUTE MONOTONY MON_INCREASE /end AXIS_DESCR
 /begin AXIS_DESCR STD_AXIS zff_atsys._.iSignale._.obj.sig_c_getr UMR_GRADC__1_1_M40_S6_S3 10 -40 150 DEPOSIT ABSOLUTE MONOTONY MON_INCREASE /end AXIS_DESCR
/end CHARACTERISTIC
/begin CHARACTERISTIC KL_POKABMDMOTSOLL21 "Schaltdruckoffset in Abhaengigkeit von md_motsoll_sas" CURVE 0x249B80 kl_si16_S6_S3 12.75 UMR_BAR__1_1000_0_S6_S3 -6.4 6.35
 /begin AXIS_DESCR STD_AXIS NO_INPUT_QUANTITY UMR_NM__1_1_0_S6_S3 6 -2000 2000 DEPOSIT ABSOLUTE MONOTONY MON_INCREASE /end AXIS_DESCR
/end CHARACTERISTIC
/begin CHARACTERISTIC KF_TVKABMTNMOTRS21 "Verzögerungszeit abschaltende Kupplung bei RS" MAP 0x249B9C kf_ui8_S6_S3 2000 UMR_MSEC__10_1_0_S6_S3 0 2000
 /begin AXIS_DESCR STD_AXIS zff_atsys._.iSignale._.obj.sig_m_t8 UMR_NM__8_1_M50_S6_S3 4 -400 1640 DEPOSIT ABSOLUTE MONOTONY MON_INCREASE /end AXIS_DESCR
 /begin AXIS_DESCR STD_AXIS zff_atsys._.iSignale._.obj.sig_n_mot8 UMR_U_MIN_32_1_0_S6_S3 4 0 8160 DEPOSIT ABSOLUTE MONOTONY MON_INCREASE /end AXIS_DESCR
/end CHARACTERISTIC
/begin CHARACTERISTIC T_RAABV32 "Zeit Rampe auf Schaltdruck" VALUE 0x26E7D4 kw_ui8_S6_S3 2540 UMR_MSEC__10_1_0_S6_S3 0 2540 /end CHARACTERISTIC
/begin CHARACTERISTIC T_RAABVFOLNACHMRS32 "Zeit Rampe auf Schaltdruck" VALUE 0x26E7D5 kw_ui8_S6_S3 2540 UMR_MSEC__10_1_0_S6_S3 0 2540 /end CHARACTERISTIC
/begin CHARACTERISTIC KL_POKABV32 "Druckoffset Folgeschaltung in Abhaengigkeit von m_t" CURVE 0x249BBC kl_si16_S6_S3 12 UMR_BAR__1_1000_0_S6_S3 -6 6
 /begin AXIS_DESCR STD_AXIS zff_atsys._.iSignale._.obj.sig_m_t UMR_NM__1_1_0_S6_S3 4 -400 1640 DEPOSIT ABSOLUTE MONOTONY MON_INCREASE /end AXIS_DESCR
/end CHARACTERISTIC
/begin CHARACTERISTIC KL_POKABVFOLNACHMRS32 "Druckoffset Folgeschaltung nach MRS in Abhaengigkeit von m_t" CURVE 0x249BD0 kl_si16_S6_S3 12 UMR_BAR__1_1000_0_S6_S3 -6 6
 /begin AXIS_DESCR STD_AXIS zff_atsys._.iSignale._.obj.sig_m_t UMR_NM__1_1_0_S6_S3 4 -400 1640 DEPOSIT ABSOLUTE MONOTONY MON_INCREASE /end AXIS_DESCR
/end CHARACTERISTIC
/begin CHARACTERISTIC KF_TSYNMTNTKABVFOLNACHMRS32 "Zeit vor sync. Ende Haltephase vorb. KAB" MAP 0x249BE4 kf_si16_S6_S3 5000 UMR_MSEC__10_1_0_S6_S3 -5000 0
 /begin AXIS_DESCR STD_AXIS zff_atsys._.iSignale._.obj.sig_m_t UMR_NM__1_1_0_S6_S3 4 -400 1640 DEPOSIT ABSOLUTE MONOTONY MON_INCREASE /end AXIS_DESCR
 /begin AXIS_DESCR STD_AXIS zff_atsys._.iSignale._.obj.sig_n_t UMR_U_MIN_1_1_0_S6_S3 6 0 8160 DEPOSIT ABSOLUTE MONOTONY MON_INCREASE /end AXIS_DESCR
/end CHARACTERISTIC
/begin CHARACTERISTIC KL_PGOKABFOLNACHRS32 "Druckgradient in Abhaengigkeit von m_t fuer Folgeschaltung" CURVE 0x249C30 kl_si16_S6_S3 200 UMR_BAR_SEC_1_10_0_S6_S3 -100 100
 /begin AXIS_DESCR STD_AXIS zff_atsys._.iSignale._.obj.sig_m_t UMR_NM__1_1_0_S6_S3 6 -400 1640 DEPOSIT ABSOLUTE MONOTONY MON_INCREASE /end AXIS_DESCR
/end CHARACTERISTIC
/begin CHARACTERISTIC KL_PGRASYNKABFOLNACHRS32 "Druckgradient Wegschalten KAB fuer Folgeschaltung" CURVE 0x249C4C kl_si16_S6_S3 100 UMR_BAR_SEC_1_10_0_S6_S3 -100 0
 /begin AXIS_DESCR STD_AXIS zff_atsys._.iSignale._.obj.sig_m_t UMR_NM__1_1_0_S6_S3 6 -400 1640 DEPOSIT ABSOLUTE MONOTONY MON_INCREASE /end AXIS_DESCR
/end CHARACTERISTIC
/begin CHARACTERISTIC TO_TSYNHINSYNS32 "Zeitoffset nach Synchron für Dauer Haltephase in Syn. KAB" VALUE 0x26E7D6 kw_ui8_S6_S3 2540 UMR_MSEC__10_1_0_S6_S3 0 2540 /end CHARACTERISTIC
/begin CHARACTERISTIC KL_POKABNGAB32 "Druckoffset in Abhaengigkeit von ng_ab" CURVE 0x249C68 kl_si16_S6_S3 12 UMR_BAR__1_1000_0_S6_S3 -6 6
 /begin AXIS_DESCR STD_AXIS iItfInput.ng_ab UMR_U_MINSEC_1_1_0_S6_S3 4 -5000 1000 DEPOSIT ABSOLUTE MONOTONY MON_INCREASE /end AXIS_DESCR
/end CHARACTERISTIC
/begin CHARACTERISTIC T_SYNKABWS32 "Zeit vor sync. Ende Schaltdruck KAB bei Weiterschaltung" VALUE 0x26E7D7 kw_ui8_S6_S3 1280 UMR_MSEC__10_1_M128_S6_S3 -1280 0 /end CHARACTERISTIC
/begin CHARACTERISTIC KL_FPOCGHINSYNKAB32 "Temperaturabhängige Gewichtung des Haltedruckoffsets" CURVE 0x249C7C kl_ui8_S6_S3 1 UMR___1_100_0_S6_S3 0 1
 /begin AXIS_DESCR STD_AXIS zff_atsys._.iSignale._.obj.sig_c_getr UMR_GRADC__1_1_M40_S6_S3 4 -40 150 DEPOSIT ABSOLUTE MONOTONY MON_INCREASE /end AXIS_DESCR
/end CHARACTERISTIC
/begin CHARACTERISTIC KL_TOHKABCG32 "Zeit Offset Haltephase" CURVE 0x249C88 kl_ui8_S6_S3 1270 UMR_MSEC__10_1_0_S6_S3 0 1270
 /begin AXIS_DESCR STD_AXIS zff_atsys._.iSignale._.obj.sig_c_getr UMR_GRADC__1_1_M40_S6_S3 4 -40 190 DEPOSIT ABSOLUTE MONOTONY MON_INCREASE /end AXIS_DESCR
/end CHARACTERISTIC
/begin CHARACTERISTIC KL_PGRASYNKAB32 "Druckgradient Wegschalten abschaltende Kupplung" CURVE 0x249C94 kl_si16_S6_S3 100 UMR_BAR_SEC_1_10_0_S6_S3 -100 0
 /begin AXIS_DESCR STD_AXIS zff_atsys._.iSignale._.obj.sig_m_t UMR_NM__1_1_0_S6_S3 6 -400 1640 DEPOSIT ABSOLUTE MONOTONY MON_INCREASE /end AXIS_DESCR
/end CHARACTERISTIC
/begin CHARACTERISTIC KL_PGRASYNKABWS32 "Druckgradient Wegschalten abschaltende Kupplung bei Weiterschaltung" CURVE 0x249CB0 kl_si16_S6_S3 100 UMR_BAR_SEC_1_10_0_S6_S3 -100 0
 /begin AXIS_DESCR STD_AXIS zff_atsys._.iSignale._.obj.sig_m_t UMR_NM__1_1_0_S6_S3 6 -400 1640 DEPOSIT ABSOLUTE MONOTONY MON_INCREASE /end AXIS_DESCR
/end CHARACTERISTIC
/begin CHARACTERISTIC KF_POKABMTCG32 "Schaltdruckoffset" MAP 0x249CCC kf_si16_S6_S3 12.75 UMR_BAR__1_1000_0_S6_S3 -6.4 6.35
 /begin AXIS_DESCR STD_AXIS zff_atsys._.iSignale._.obj.sig_m_t UMR_NM__1_1_0_S6_S3 5 -400 1640 DEPOSIT ABSOLUTE MONOTONY MON_INCREASE /end AXIS_DESCR
 /begin AXIS_DESCR STD_AXIS zff_atsys._.iSignale._.obj.sig_c_getr UMR_GRADC__1_1_M40_S6_S3 10 -40 150 DEPOSIT ABSOLUTE MONOTONY MON_INCREASE /end AXIS_DESCR
/end CHARACTERISTIC
/begin CHARACTERISTIC KL_POKABMDMOTSOLL32 "Schaltdruckoffset in Abhaengigkeit von md_motsoll_sas" CURVE 0x249D58 kl_si16_S6_S3 12.75 UMR_BAR__1_1000_0_S6_S3 -6.4 6.35
 /begin AXIS_DESCR STD_AXIS NO_INPUT_QUANTITY UMR_NM__1_1_0_S6_S3 6 -2000 2000 DEPOSIT ABSOLUTE MONOTONY MON_INCREASE /end AXIS_DESCR
/end CHARACTERISTIC
/begin CHARACTERISTIC KF_TVKABMTNMOTRS32 "Verzögerungszeit abschaltende Kupplung bei RS" MAP 0x249D74 kf_ui8_S6_S3 2000 UMR_MSEC__10_1_0_S6_S3 0 2000
 /begin AXIS_DESCR STD_AXIS zff_atsys._.iSignale._.obj.sig_m_t8 UMR_NM__8_1_M50_S6_S3 4 -400 1640 DEPOSIT ABSOLUTE MONOTONY MON_INCREASE /end AXIS_DESCR
 /begin AXIS_DESCR STD_AXIS zff_atsys._.iSignale._.obj.sig_n_mot8 UMR_U_MIN_32_1_0_S6_S3 4 0 8160 DEPOSIT ABSOLUTE MONOTONY MON_INCREASE /end AXIS_DESCR
/end CHARACTERISTIC
/begin CHARACTERISTIC T_RAABV43 "Zeit Rampe auf Schaltdruck" VALUE 0x26E7D8 kw_ui8_S6_S3 2540 UMR_MSEC__10_1_0_S6_S3 0 2540 /end CHARACTERISTIC
/begin CHARACTERISTIC KL_POKABV43 "Druckoffset Folgeschaltung in Abhaengigkeit von m_t" CURVE 0x249D94 kl_si16_S6_S3 12 UMR_BAR__1_1000_0_S6_S3 -6 6
 /begin AXIS_DESCR STD_AXIS zff_atsys._.iSignale._.obj.sig_m_t UMR_NM__1_1_0_S6_S3 4 -400 1640 DEPOSIT ABSOLUTE MONOTONY MON_INCREASE /end AXIS_DESCR
/end CHARACTERISTIC
/begin CHARACTERISTIC KL_POKABVFOLNACHMRS43 "Druckoffset Folgeschaltung nach MRS in Abhaengigkeit von m_t" CURVE 0x249DA8 kl_si16_S6_S3 12 UMR_BAR__1_1000_0_S6_S3 -6 6
 /begin AXIS_DESCR STD_AXIS zff_atsys._.iSignale._.obj.sig_m_t UMR_NM__1_1_0_S6_S3 4 -400 1640 DEPOSIT ABSOLUTE MONOTONY MON_INCREASE /end AXIS_DESCR
/end CHARACTERISTIC
/begin CHARACTERISTIC KL_PGOKABFOLNACHRS43 "Druckgradient in Abhaengigkeit von m_t fuer Folgeschaltung" CURVE 0x249DBC kl_si16_S6_S3 200 UMR_BAR_SEC_1_10_0_S6_S3 -100 100
 /begin AXIS_DESCR STD_AXIS zff_atsys._.iSignale._.obj.sig_m_t UMR_NM__1_1_0_S6_S3 6 -400 1640 DEPOSIT ABSOLUTE MONOTONY MON_INCREASE /end AXIS_DESCR
/end CHARACTERISTIC
/begin CHARACTERISTIC KL_PGRASYNKABFOLNACHRS43 "Druckgradient Wegschalten KAB fuer Folgeschaltung" CURVE 0x249DD8 kl_si16_S6_S3 100 UMR_BAR_SEC_1_10_0_S6_S3 -100 0
 /begin AXIS_DESCR STD_AXIS zff_atsys._.iSignale._.obj.sig_m_t UMR_NM__1_1_0_S6_S3 6 -400 1640 DEPOSIT ABSOLUTE MONOTONY MON_INCREASE /end AXIS_DESCR
/end CHARACTERISTIC
/begin CHARACTERISTIC TO_TSYNHINSYNS43 "Zeitoffset nach Synchron für Dauer Haltephase in Syn. KAB" VALUE 0x26E7D9 kw_ui8_S6_S3 2540 UMR_MSEC__10_1_0_S6_S3 0 2540 /end CHARACTERISTIC
/begin CHARACTERISTIC KL_POKABNGAB43 "Druckoffset in Abhaengigkeit von ng_ab" CURVE 0x249DF4 kl_si16_S6_S3 12 UMR_BAR__1_1000_0_S6_S3 -6 6
 /begin AXIS_DESCR STD_AXIS iItfInput.ng_ab UMR_U_MINSEC_1_1_0_S6_S3 4 -5000 1000 DEPOSIT ABSOLUTE MONOTONY MON_INCREASE /end AXIS_DESCR
/end CHARACTERISTIC
/begin CHARACTERISTIC T_SYNKABWS43 "Zeit vor sync. Ende Schaltdruck KAB bei Weiterschaltung" VALUE 0x26E7DA kw_ui8_S6_S3 1280 UMR_MSEC__10_1_M128_S6_S3 -1280 0 /end CHARACTERISTIC
/begin CHARACTERISTIC KL_FPOCGHINSYNKAB43 "Temperaturabhängige Gewichtung des Haltedruckoffsets" CURVE 0x249E08 kl_ui8_S6_S3 1 UMR___1_100_0_S6_S3 0 1
 /begin AXIS_DESCR STD_AXIS zff_atsys._.iSignale._.obj.sig_c_getr UMR_GRADC__1_1_M40_S6_S3 4 -40 150 DEPOSIT ABSOLUTE MONOTONY MON_INCREASE /end AXIS_DESCR
/end CHARACTERISTIC
/begin CHARACTERISTIC KL_TOHKABCG43 "Zeit Offset Haltephase" CURVE 0x249E14 kl_ui8_S6_S3 1270 UMR_MSEC__10_1_0_S6_S3 0 1270
 /begin AXIS_DESCR STD_AXIS zff_atsys._.iSignale._.obj.sig_c_getr UMR_GRADC__1_1_M40_S6_S3 4 -40 190 DEPOSIT ABSOLUTE MONOTONY MON_INCREASE /end AXIS_DESCR
/end CHARACTERISTIC
/begin CHARACTERISTIC KL_PGRASYNKAB43 "Druckgradient Wegschalten abschaltende Kupplung" CURVE 0x249E20 kl_si16_S6_S3 100 UMR_BAR_SEC_1_10_0_S6_S3 -100 0
 /begin AXIS_DESCR STD_AXIS zff_atsys._.iSignale._.obj.sig_m_t UMR_NM__1_1_0_S6_S3 6 -400 1640 DEPOSIT ABSOLUTE MONOTONY MON_INCREASE /end AXIS_DESCR
/end CHARACTERISTIC
/begin CHARACTERISTIC KL_PGRASYNKABWS43 "Druckgradient Wegschalten abschaltende Kupplung bei Weiterschaltung" CURVE 0x249E3C kl_si16_S6_S3 100 UMR_BAR_SEC_1_10_0_S6_S3 -100 0
 /begin AXIS_DESCR STD_AXIS zff_atsys._.iSignale._.obj.sig_m_t UMR_NM__1_1_0_S6_S3 6 -400 1640 DEPOSIT ABSOLUTE MONOTONY MON_INCREASE /end AXIS_DESCR
/end CHARACTERISTIC
/begin CHARACTERISTIC KF_POKABMTCG43 "Schaltdruckoffset" MAP 0x249E58 kf_si16_S6_S3 12.75 UMR_BAR__1_1000_0_S6_S3 -6.4 6.35
 /begin AXIS_DESCR STD_AXIS zff_atsys._.iSignale._.obj.sig_m_t UMR_NM__1_1_0_S6_S3 5 -400 1640 DEPOSIT ABSOLUTE MONOTONY MON_INCREASE /end AXIS_DESCR
 /begin AXIS_DESCR STD_AXIS zff_atsys._.iSignale._.obj.sig_c_getr UMR_GRADC__1_1_M40_S6_S3 10 -40 150 DEPOSIT ABSOLUTE MONOTONY MON_INCREASE /end AXIS_DESCR
/end CHARACTERISTIC
/begin CHARACTERISTIC KL_POKABMDMOTSOLL43 "Schaltdruckoffset in Abhaengigkeit von md_motsoll_sas" CURVE 0x249EE4 kl_si16_S6_S3 12.75 UMR_BAR__1_1000_0_S6_S3 -6.4 6.35
 /begin AXIS_DESCR STD_AXIS NO_INPUT_QUANTITY UMR_NM__1_1_0_S6_S3 6 -2000 2000 DEPOSIT ABSOLUTE MONOTONY MON_INCREASE /end AXIS_DESCR
/end CHARACTERISTIC
/begin CHARACTERISTIC KF_TVKABMTNMOTRS43 "Verzögerungszeit abschaltende Kupplung bei RS" MAP 0x249F00 kf_ui8_S6_S3 2000 UMR_MSEC__10_1_0_S6_S3 0 2000
 /begin AXIS_DESCR STD_AXIS zff_atsys._.iSignale._.obj.sig_m_t8 UMR_NM__8_1_M50_S6_S3 4 -400 1640 DEPOSIT ABSOLUTE MONOTONY MON_INCREASE /end AXIS_DESCR
 /begin AXIS_DESCR STD_AXIS zff_atsys._.iSignale._.obj.sig_n_mot8 UMR_U_MIN_32_1_0_S6_S3 4 0 8160 DEPOSIT ABSOLUTE MONOTONY MON_INCREASE /end AXIS_DESCR
/end CHARACTERISTIC
/begin CHARACTERISTIC T_RAABV54 "Zeit Rampe auf Schaltdruck" VALUE 0x26E7DB kw_ui8_S6_S3 2540 UMR_MSEC__10_1_0_S6_S3 0 2540 /end CHARACTERISTIC
/begin CHARACTERISTIC T_RAABVFOLNACHMRS54 "Zeit Rampe auf Schaltdruck" VALUE 0x26E7DC kw_ui8_S6_S3 2540 UMR_MSEC__10_1_0_S6_S3 0 2540 /end CHARACTERISTIC
/begin CHARACTERISTIC KL_POKABV54 "Druckoffset Folgeschaltung in Abhaengigkeit von m_t" CURVE 0x249F20 kl_si16_S6_S3 12 UMR_BAR__1_1000_0_S6_S3 -6 6
 /begin AXIS_DESCR STD_AXIS zff_atsys._.iSignale._.obj.sig_m_t UMR_NM__1_1_0_S6_S3 4 -400 1640 DEPOSIT ABSOLUTE MONOTONY MON_INCREASE /end AXIS_DESCR
/end CHARACTERISTIC
/begin CHARACTERISTIC KL_POKABVFOLNACHMRS54 "Druckoffset Folgeschaltung nach MRS in Abhaengigkeit von m_t" CURVE 0x249F34 kl_si16_S6_S3 12 UMR_BAR__1_1000_0_S6_S3 -6 6
 /begin AXIS_DESCR STD_AXIS zff_atsys._.iSignale._.obj.sig_m_t UMR_NM__1_1_0_S6_S3 4 -400 1640 DEPOSIT ABSOLUTE MONOTONY MON_INCREASE /end AXIS_DESCR
/end CHARACTERISTIC
/begin CHARACTERISTIC KF_TSYNMTNTKABVFOLNACHMRS54 "Zeit vor sync. Ende Haltephase vorb. KAB" MAP 0x249F48 kf_si16_S6_S3 5000 UMR_MSEC__10_1_0_S6_S3 -5000 0
 /begin AXIS_DESCR STD_AXIS zff_atsys._.iSignale._.obj.sig_m_t UMR_NM__1_1_0_S6_S3 4 -400 1640 DEPOSIT ABSOLUTE MONOTONY MON_INCREASE /end AXIS_DESCR
 /begin AXIS_DESCR STD_AXIS zff_atsys._.iSignale._.obj.sig_n_t UMR_U_MIN_1_1_0_S6_S3 6 0 8160 DEPOSIT ABSOLUTE MONOTONY MON_INCREASE /end AXIS_DESCR
/end CHARACTERISTIC
/begin CHARACTERISTIC KL_PGOKABFOLNACHRS54 "Druckgradient in Abhaengigkeit von m_t fuer Folgeschaltung" CURVE 0x249F94 kl_si16_S6_S3 200 UMR_BAR_SEC_1_10_0_S6_S3 -100 100
 /begin AXIS_DESCR STD_AXIS zff_atsys._.iSignale._.obj.sig_m_t UMR_NM__1_1_0_S6_S3 6 -400 1640 DEPOSIT ABSOLUTE MONOTONY MON_INCREASE /end AXIS_DESCR
/end CHARACTERISTIC
/begin CHARACTERISTIC KL_PGRASYNKABFOLNACHRS54 "Druckgradient Wegschalten KAB fuer Folgeschaltung" CURVE 0x249FB0 kl_si16_S6_S3 100 UMR_BAR_SEC_1_10_0_S6_S3 -100 0
 /begin AXIS_DESCR STD_AXIS zff_atsys._.iSignale._.obj.sig_m_t UMR_NM__1_1_0_S6_S3 6 -400 1640 DEPOSIT ABSOLUTE MONOTONY MON_INCREASE /end AXIS_DESCR
/end CHARACTERISTIC
/begin CHARACTERISTIC TO_TSYNHINSYNS54 "Zeitoffset nach Synchron für Dauer Haltephase in Syn. KAB" VALUE 0x26E7DD kw_ui8_S6_S3 2540 UMR_MSEC__10_1_0_S6_S3 0 2540 /end CHARACTERISTIC
/begin CHARACTERISTIC KL_POKABNGAB54 "Druckoffset in Abhaengigkeit von ng_ab" CURVE 0x249FCC kl_si16_S6_S3 12 UMR_BAR__1_1000_0_S6_S3 -6 6
 /begin AXIS_DESCR STD_AXIS iItfInput.ng_ab UMR_U_MINSEC_1_1_0_S6_S3 4 -5000 1000 DEPOSIT ABSOLUTE MONOTONY MON_INCREASE /end AXIS_DESCR
/end CHARACTERISTIC
/begin CHARACTERISTIC T_SYNKABWS54 "Zeit vor sync. Ende Schaltdruck KAB bei Weiterschaltung" VALUE 0x26E7DE kw_ui8_S6_S3 1280 UMR_MSEC__10_1_M128_S6_S3 -1280 0 /end CHARACTERISTIC
/begin CHARACTERISTIC KL_FPOCGHINSYNKAB54 "Temperaturabhängige Gewichtung des Haltedruckoffsets" CURVE 0x249FE0 kl_ui8_S6_S3 1 UMR___1_100_0_S6_S3 0 1
 /begin AXIS_DESCR STD_AXIS zff_atsys._.iSignale._.obj.sig_c_getr UMR_GRADC__1_1_M40_S6_S3 4 -40 150 DEPOSIT ABSOLUTE MONOTONY MON_INCREASE /end AXIS_DESCR
/end CHARACTERISTIC
/begin CHARACTERISTIC KL_TOHKABCG54 "Zeit Offset Haltephase" CURVE 0x249FEC kl_ui8_S6_S3 1270 UMR_MSEC__10_1_0_S6_S3 0 1270
 /begin AXIS_DESCR STD_AXIS zff_atsys._.iSignale._.obj.sig_c_getr UMR_GRADC__1_1_M40_S6_S3 4 -40 190 DEPOSIT ABSOLUTE MONOTONY MON_INCREASE /end AXIS_DESCR
/end CHARACTERISTIC
/begin CHARACTERISTIC KL_PGRASYNKAB54 "Druckgradient Wegschalten abschaltende Kupplung" CURVE 0x249FF8 kl_si16_S6_S3 100 UMR_BAR_SEC_1_10_0_S6_S3 -100 0
 /begin AXIS_DESCR STD_AXIS zff_atsys._.iSignale._.obj.sig_m_t UMR_NM__1_1_0_S6_S3 6 -400 1640 DEPOSIT ABSOLUTE MONOTONY MON_INCREASE /end AXIS_DESCR
/end CHARACTERISTIC
/begin CHARACTERISTIC KL_PGRASYNKABWS54 "Druckgradient Wegschalten abschaltende Kupplung bei Weiterschaltung" CURVE 0x24A014 kl_si16_S6_S3 100 UMR_BAR_SEC_1_10_0_S6_S3 -100 0
 /begin AXIS_DESCR STD_AXIS zff_atsys._.iSignale._.obj.sig_m_t UMR_NM__1_1_0_S6_S3 6 -400 1640 DEPOSIT ABSOLUTE MONOTONY MON_INCREASE /end AXIS_DESCR
/end CHARACTERISTIC
/begin CHARACTERISTIC KF_POKABMTCG54 "Schaltdruckoffset" MAP 0x24A030 kf_si16_S6_S3 12.75 UMR_BAR__1_1000_0_S6_S3 -6.4 6.35
 /begin AXIS_DESCR STD_AXIS zff_atsys._.iSignale._.obj.sig_m_t UMR_NM__1_1_0_S6_S3 5 -400 1640 DEPOSIT ABSOLUTE MONOTONY MON_INCREASE /end AXIS_DESCR
 /begin AXIS_DESCR STD_AXIS zff_atsys._.iSignale._.obj.sig_c_getr UMR_GRADC__1_1_M40_S6_S3 10 -40 150 DEPOSIT ABSOLUTE MONOTONY MON_INCREASE /end AXIS_DESCR
/end CHARACTERISTIC
/begin CHARACTERISTIC KL_POKABMDMOTSOLL54 "Schaltdruckoffset in Abhaengigkeit von md_motsoll_sas" CURVE 0x24A0BC kl_si16_S6_S3 12.75 UMR_BAR__1_1000_0_S6_S3 -6.4 6.35
 /begin AXIS_DESCR STD_AXIS NO_INPUT_QUANTITY UMR_NM__1_1_0_S6_S3 6 -2000 2000 DEPOSIT ABSOLUTE MONOTONY MON_INCREASE /end AXIS_DESCR
/end CHARACTERISTIC
/begin CHARACTERISTIC KF_TVKABMTNMOTRS54 "Verzögerungszeit abschaltende Kupplung bei RS" MAP 0x24A0D8 kf_ui8_S6_S3 2000 UMR_MSEC__10_1_0_S6_S3 0 2000
 /begin AXIS_DESCR STD_AXIS zff_atsys._.iSignale._.obj.sig_m_t8 UMR_NM__8_1_M50_S6_S3 4 -400 1640 DEPOSIT ABSOLUTE MONOTONY MON_INCREASE /end AXIS_DESCR
 /begin AXIS_DESCR STD_AXIS zff_atsys._.iSignale._.obj.sig_n_mot8 UMR_U_MIN_32_1_0_S6_S3 4 0 8160 DEPOSIT ABSOLUTE MONOTONY MON_INCREASE /end AXIS_DESCR
/end CHARACTERISTIC
/begin CHARACTERISTIC T_RAABV65 "Zeit Rampe auf Schaltdruck" VALUE 0x26E7DF kw_ui8_S6_S3 2540 UMR_MSEC__10_1_0_S6_S3 0 2540 /end CHARACTERISTIC
/begin CHARACTERISTIC T_RAABVFOLNACHMRS65 "Zeit Rampe auf Schaltdruck" VALUE 0x26E7E0 kw_ui8_S6_S3 2540 UMR_MSEC__10_1_0_S6_S3 0 2540 /end CHARACTERISTIC
/begin CHARACTERISTIC KL_POKABV65 "Druckoffset Folgeschaltung in Abhaengigkeit von m_t" CURVE 0x24A0F8 kl_si16_S6_S3 12 UMR_BAR__1_1000_0_S6_S3 -6 6
 /begin AXIS_DESCR STD_AXIS zff_atsys._.iSignale._.obj.sig_m_t UMR_NM__1_1_0_S6_S3 4 -400 1640 DEPOSIT ABSOLUTE MONOTONY MON_INCREASE /end AXIS_DESCR
/end CHARACTERISTIC
/begin CHARACTERISTIC KL_POKABVFOLNACHMRS65 "Druckoffset Folgeschaltung nach MRS in Abhaengigkeit von m_t" CURVE 0x24A10C kl_si16_S6_S3 12 UMR_BAR__1_1000_0_S6_S3 -6 6
 /begin AXIS_DESCR STD_AXIS zff_atsys._.iSignale._.obj.sig_m_t UMR_NM__1_1_0_S6_S3 4 -400 1640 DEPOSIT ABSOLUTE MONOTONY MON_INCREASE /end AXIS_DESCR
/end CHARACTERISTIC
/begin CHARACTERISTIC KF_TSYNMTNTKABVFOLNACHMRS65 "Zeit vor sync. Ende Haltephase vorb. KAB" MAP 0x24A120 kf_si16_S6_S3 5000 UMR_MSEC__10_1_0_S6_S3 -5000 0
 /begin AXIS_DESCR STD_AXIS zff_atsys._.iSignale._.obj.sig_m_t UMR_NM__1_1_0_S6_S3 4 -400 1640 DEPOSIT ABSOLUTE MONOTONY MON_INCREASE /end AXIS_DESCR
 /begin AXIS_DESCR STD_AXIS zff_atsys._.iSignale._.obj.sig_n_t UMR_U_MIN_1_1_0_S6_S3 6 0 8160 DEPOSIT ABSOLUTE MONOTONY MON_INCREASE /end AXIS_DESCR
/end CHARACTERISTIC
/begin CHARACTERISTIC KL_PGOKABFOLNACHRS65 "Druckgradient in Abhaengigkeit von m_t fuer Folgeschaltung" CURVE 0x24A16C kl_si16_S6_S3 200 UMR_BAR_SEC_1_10_0_S6_S3 -100 100
 /begin AXIS_DESCR STD_AXIS zff_atsys._.iSignale._.obj.sig_m_t UMR_NM__1_1_0_S6_S3 6 -400 1640 DEPOSIT ABSOLUTE MONOTONY MON_INCREASE /end AXIS_DESCR
/end CHARACTERISTIC
/begin CHARACTERISTIC KL_PGRASYNKABFOLNACHRS65 "Druckgradient Wegschalten KAB fuer Folgeschaltung" CURVE 0x24A188 kl_si16_S6_S3 100 UMR_BAR_SEC_1_10_0_S6_S3 -100 0
 /begin AXIS_DESCR STD_AXIS zff_atsys._.iSignale._.obj.sig_m_t UMR_NM__1_1_0_S6_S3 6 -400 1640 DEPOSIT ABSOLUTE MONOTONY MON_INCREASE /end AXIS_DESCR
/end CHARACTERISTIC
/begin CHARACTERISTIC TO_TSYNHINSYNS65 "Zeitoffset nach Synchron für Dauer Haltephase in Syn. KAB" VALUE 0x26E7E1 kw_ui8_S6_S3 2540 UMR_MSEC__10_1_0_S6_S3 0 2540 /end CHARACTERISTIC
/begin CHARACTERISTIC KL_POKABNGAB65 "Druckoffset in Abhaengigkeit von ng_ab" CURVE 0x24A1A4 kl_si16_S6_S3 12 UMR_BAR__1_1000_0_S6_S3 -6 6
 /begin AXIS_DESCR STD_AXIS iItfInput.ng_ab UMR_U_MINSEC_1_1_0_S6_S3 4 -5000 1000 DEPOSIT ABSOLUTE MONOTONY MON_INCREASE /end AXIS_DESCR
/end CHARACTERISTIC
/begin CHARACTERISTIC T_SYNKABWS65 "Zeit vor sync. Ende Schaltdruck KAB bei Weiterschaltung" VALUE 0x26E7E2 kw_ui8_S6_S3 1280 UMR_MSEC__10_1_M128_S6_S3 -1280 0 /end CHARACTERISTIC
/begin CHARACTERISTIC KL_FPOCGHINSYNKAB65 "Temperaturabhängige Gewichtung des Haltedruckoffsets" CURVE 0x24A1B8 kl_ui8_S6_S3 1 UMR___1_100_0_S6_S3 0 1
 /begin AXIS_DESCR STD_AXIS zff_atsys._.iSignale._.obj.sig_c_getr UMR_GRADC__1_1_M40_S6_S3 4 -40 150 DEPOSIT ABSOLUTE MONOTONY MON_INCREASE /end AXIS_DESCR
/end CHARACTERISTIC
/begin CHARACTERISTIC KL_TOHKABCG65 "Zeit Offset Haltephase" CURVE 0x24A1C4 kl_ui8_S6_S3 1270 UMR_MSEC__10_1_0_S6_S3 0 1270
 /begin AXIS_DESCR STD_AXIS zff_atsys._.iSignale._.obj.sig_c_getr UMR_GRADC__1_1_M40_S6_S3 4 -40 190 DEPOSIT ABSOLUTE MONOTONY MON_INCREASE /end AXIS_DESCR
/end CHARACTERISTIC
/begin CHARACTERISTIC KL_PGRASYNKAB65 "Druckgradient Wegschalten abschaltende Kupplung" CURVE 0x24A1D0 kl_si16_S6_S3 100 UMR_BAR_SEC_1_10_0_S6_S3 -100 0
 /begin AXIS_DESCR STD_AXIS zff_atsys._.iSignale._.obj.sig_m_t UMR_NM__1_1_0_S6_S3 6 -400 1640 DEPOSIT ABSOLUTE MONOTONY MON_INCREASE /end AXIS_DESCR
/end CHARACTERISTIC
/begin CHARACTERISTIC KL_PGRASYNKABWS65 "Druckgradient Wegschalten abschaltende Kupplung bei Weiterschaltung" CURVE 0x24A1EC kl_si16_S6_S3 100 UMR_BAR_SEC_1_10_0_S6_S3 -100 0
 /begin AXIS_DESCR STD_AXIS zff_atsys._.iSignale._.obj.sig_m_t UMR_NM__1_1_0_S6_S3 6 -400 1640 DEPOSIT ABSOLUTE MONOTONY MON_INCREASE /end AXIS_DESCR
/end CHARACTERISTIC
/begin CHARACTERISTIC KF_POKABMTCG65 "Schaltdruckoffset" MAP 0x24A208 kf_si16_S6_S3 12.75 UMR_BAR__1_1000_0_S6_S3 -6.4 6.35
 /begin AXIS_DESCR STD_AXIS zff_atsys._.iSignale._.obj.sig_m_t UMR_NM__1_1_0_S6_S3 5 -400 1640 DEPOSIT ABSOLUTE MONOTONY MON_INCREASE /end AXIS_DESCR
 /begin AXIS_DESCR STD_AXIS zff_atsys._.iSignale._.obj.sig_c_getr UMR_GRADC__1_1_M40_S6_S3 10 -40 150 DEPOSIT ABSOLUTE MONOTONY MON_INCREASE /end AXIS_DESCR
/end CHARACTERISTIC
/begin CHARACTERISTIC KL_POKABMDMOTSOLL65 "Schaltdruckoffset in Abhaengigkeit von md_motsoll_sas" CURVE 0x24A294 kl_si16_S6_S3 12.75 UMR_BAR__1_1000_0_S6_S3 -6.4 6.35
 /begin AXIS_DESCR STD_AXIS NO_INPUT_QUANTITY UMR_NM__1_1_0_S6_S3 6 -2000 2000 DEPOSIT ABSOLUTE MONOTONY MON_INCREASE /end AXIS_DESCR
/end CHARACTERISTIC
/begin CHARACTERISTIC KF_TVKABMTNMOTRS65 "Verzögerungszeit abschaltende Kupplung bei RS" MAP 0x24A2B0 kf_ui8_S6_S3 2000 UMR_MSEC__10_1_0_S6_S3 0 2000
 /begin AXIS_DESCR STD_AXIS zff_atsys._.iSignale._.obj.sig_m_t8 UMR_NM__8_1_M50_S6_S3 4 -400 1640 DEPOSIT ABSOLUTE MONOTONY MON_INCREASE /end AXIS_DESCR
 /begin AXIS_DESCR STD_AXIS zff_atsys._.iSignale._.obj.sig_n_mot8 UMR_U_MIN_32_1_0_S6_S3 4 0 8160 DEPOSIT ABSOLUTE MONOTONY MON_INCREASE /end AXIS_DESCR
/end CHARACTERISTIC
/begin CHARACTERISTIC T_RAABV76 "Zeit Rampe auf Schaltdruck" VALUE 0x26E7E3 kw_ui8_S6_S3 2540 UMR_MSEC__10_1_0_S6_S3 0 2540 /end CHARACTERISTIC
/begin CHARACTERISTIC T_RAABVFOLNACHMRS76 "Zeit Rampe auf Schaltdruck" VALUE 0x26E7E4 kw_ui8_S6_S3 2540 UMR_MSEC__10_1_0_S6_S3 0 2540 /end CHARACTERISTIC
/begin CHARACTERISTIC KL_POKABV76 "Druckoffset Folgeschaltung in Abhaengigkeit von m_t" CURVE 0x24A2D0 kl_si16_S6_S3 12 UMR_BAR__1_1000_0_S6_S3 -6 6
 /begin AXIS_DESCR STD_AXIS zff_atsys._.iSignale._.obj.sig_m_t UMR_NM__1_1_0_S6_S3 4 -400 1640 DEPOSIT ABSOLUTE MONOTONY MON_INCREASE /end AXIS_DESCR
/end CHARACTERISTIC
/begin CHARACTERISTIC KL_POKABVFOLNACHMRS76 "Druckoffset Folgeschaltung nach MRS in Abhaengigkeit von m_t" CURVE 0x24A2E4 kl_si16_S6_S3 12 UMR_BAR__1_1000_0_S6_S3 -6 6
 /begin AXIS_DESCR STD_AXIS zff_atsys._.iSignale._.obj.sig_m_t UMR_NM__1_1_0_S6_S3 4 -400 1640 DEPOSIT ABSOLUTE MONOTONY MON_INCREASE /end AXIS_DESCR
/end CHARACTERISTIC
/begin CHARACTERISTIC KF_TSYNMTNTKABVFOLNACHMRS76 "Zeit vor sync. Ende Haltephase vorb. KAB" MAP 0x24A2F8 kf_si16_S6_S3 5000 UMR_MSEC__10_1_0_S6_S3 -5000 0
 /begin AXIS_DESCR STD_AXIS zff_atsys._.iSignale._.obj.sig_m_t UMR_NM__1_1_0_S6_S3 4 -400 1640 DEPOSIT ABSOLUTE MONOTONY MON_INCREASE /end AXIS_DESCR
 /begin AXIS_DESCR STD_AXIS zff_atsys._.iSignale._.obj.sig_n_t UMR_U_MIN_1_1_0_S6_S3 6 0 8160 DEPOSIT ABSOLUTE MONOTONY MON_INCREASE /end AXIS_DESCR
/end CHARACTERISTIC
/begin CHARACTERISTIC KL_PGOKABFOLNACHRS76 "Druckgradient in Abhaengigkeit von m_t fuer Folgeschaltung" CURVE 0x24A344 kl_si16_S6_S3 200 UMR_BAR_SEC_1_10_0_S6_S3 -100 100
 /begin AXIS_DESCR STD_AXIS zff_atsys._.iSignale._.obj.sig_m_t UMR_NM__1_1_0_S6_S3 6 -400 1640 DEPOSIT ABSOLUTE MONOTONY MON_INCREASE /end AXIS_DESCR
/end CHARACTERISTIC
/begin CHARACTERISTIC KL_PGRASYNKABFOLNACHRS76 "Druckgradient Wegschalten KAB fuer Folgeschaltung" CURVE 0x24A360 kl_si16_S6_S3 100 UMR_BAR_SEC_1_10_0_S6_S3 -100 0
 /begin AXIS_DESCR STD_AXIS zff_atsys._.iSignale._.obj.sig_m_t UMR_NM__1_1_0_S6_S3 6 -400 1640 DEPOSIT ABSOLUTE MONOTONY MON_INCREASE /end AXIS_DESCR
/end CHARACTERISTIC
/begin CHARACTERISTIC TO_TSYNHINSYNS76 "Zeitoffset nach Synchron für Dauer Haltephase in Syn. KAB" VALUE 0x26E7E5 kw_ui8_S6_S3 2540 UMR_MSEC__10_1_0_S6_S3 0 2540 /end CHARACTERISTIC
/begin CHARACTERISTIC KL_POKABNGAB76 "Druckoffset in Abhaengigkeit von ng_ab" CURVE 0x24A37C kl_si16_S6_S3 12 UMR_BAR__1_1000_0_S6_S3 -6 6
 /begin AXIS_DESCR STD_AXIS iItfInput.ng_ab UMR_U_MINSEC_1_1_0_S6_S3 4 -5000 1000 DEPOSIT ABSOLUTE MONOTONY MON_INCREASE /end AXIS_DESCR
/end CHARACTERISTIC
/begin CHARACTERISTIC T_SYNKABWS76 "Zeit vor sync. Ende Schaltdruck KAB bei Weiterschaltung" VALUE 0x26E7E6 kw_ui8_S6_S3 1280 UMR_MSEC__10_1_M128_S6_S3 -1280 0 /end CHARACTERISTIC
/begin CHARACTERISTIC KL_FPOCGHINSYNKAB76 "Temperaturabhängige Gewichtung des Haltedruckoffsets" CURVE 0x24A390 kl_ui8_S6_S3 1 UMR___1_100_0_S6_S3 0 1
 /begin AXIS_DESCR STD_AXIS zff_atsys._.iSignale._.obj.sig_c_getr UMR_GRADC__1_1_M40_S6_S3 4 -40 150 DEPOSIT ABSOLUTE MONOTONY MON_INCREASE /end AXIS_DESCR
/end CHARACTERISTIC
/begin CHARACTERISTIC KL_TOHKABCG76 "Zeit Offset Haltephase" CURVE 0x24A39C kl_ui8_S6_S3 1270 UMR_MSEC__10_1_0_S6_S3 0 1270
 /begin AXIS_DESCR STD_AXIS zff_atsys._.iSignale._.obj.sig_c_getr UMR_GRADC__1_1_M40_S6_S3 4 -40 190 DEPOSIT ABSOLUTE MONOTONY MON_INCREASE /end AXIS_DESCR
/end CHARACTERISTIC
/begin CHARACTERISTIC KL_PGRASYNKAB76 "Druckgradient Wegschalten abschaltende Kupplung" CURVE 0x24A3A8 kl_si16_S6_S3 100 UMR_BAR_SEC_1_10_0_S6_S3 -100 0
 /begin AXIS_DESCR STD_AXIS zff_atsys._.iSignale._.obj.sig_m_t UMR_NM__1_1_0_S6_S3 6 -400 1640 DEPOSIT ABSOLUTE MONOTONY MON_INCREASE /end AXIS_DESCR
/end CHARACTERISTIC
/begin CHARACTERISTIC KL_PGRASYNKABWS76 "Druckgradient Wegschalten abschaltende Kupplung bei Weiterschaltung" CURVE 0x24A3C4 kl_si16_S6_S3 100 UMR_BAR_SEC_1_10_0_S6_S3 -100 0
 /begin AXIS_DESCR STD_AXIS zff_atsys._.iSignale._.obj.sig_m_t UMR_NM__1_1_0_S6_S3 6 -400 1640 DEPOSIT ABSOLUTE MONOTONY MON_INCREASE /end AXIS_DESCR
/end CHARACTERISTIC
/begin CHARACTERISTIC KF_POKABMTCG76 "Schaltdruckoffset" MAP 0x24A3E0 kf_si16_S6_S3 12.75 UMR_BAR__1_1000_0_S6_S3 -6.4 6.35
 /begin AXIS_DESCR STD_AXIS zff_atsys._.iSignale._.obj.sig_m_t UMR_NM__1_1_0_S6_S3 5 -400 1640 DEPOSIT ABSOLUTE MONOTONY MON_INCREASE /end AXIS_DESCR
 /begin AXIS_DESCR STD_AXIS zff_atsys._.iSignale._.obj.sig_c_getr UMR_GRADC__1_1_M40_S6_S3 10 -40 150 DEPOSIT ABSOLUTE MONOTONY MON_INCREASE /end AXIS_DESCR
/end CHARACTERISTIC
/begin CHARACTERISTIC KL_POKABMDMOTSOLL76 "Schaltdruckoffset in Abhaengigkeit von md_motsoll_sas" CURVE 0x24A46C kl_si16_S6_S3 12.75 UMR_BAR__1_1000_0_S6_S3 -6.4 6.35
 /begin AXIS_DESCR STD_AXIS NO_INPUT_QUANTITY UMR_NM__1_1_0_S6_S3 6 -2000 2000 DEPOSIT ABSOLUTE MONOTONY MON_INCREASE /end AXIS_DESCR
/end CHARACTERISTIC
/begin CHARACTERISTIC KF_TVKABMTNMOTRS76 "Verzögerungszeit abschaltende Kupplung bei RS" MAP 0x24A488 kf_ui8_S6_S3 2000 UMR_MSEC__10_1_0_S6_S3 0 2000
 /begin AXIS_DESCR STD_AXIS zff_atsys._.iSignale._.obj.sig_m_t8 UMR_NM__8_1_M50_S6_S3 4 -400 1640 DEPOSIT ABSOLUTE MONOTONY MON_INCREASE /end AXIS_DESCR
 /begin AXIS_DESCR STD_AXIS zff_atsys._.iSignale._.obj.sig_n_mot8 UMR_U_MIN_32_1_0_S6_S3 4 0 8160 DEPOSIT ABSOLUTE MONOTONY MON_INCREASE /end AXIS_DESCR
/end CHARACTERISTIC
/begin CHARACTERISTIC T_RAABV87 "Zeit Rampe auf Schaltdruck" VALUE 0x26E7E7 kw_ui8_S6_S3 2540 UMR_MSEC__10_1_0_S6_S3 0 2540 /end CHARACTERISTIC
/begin CHARACTERISTIC T_RAABVFOLNACHMRS87 "Zeit Rampe auf Schaltdruck" VALUE 0x26E7E8 kw_ui8_S6_S3 2540 UMR_MSEC__10_1_0_S6_S3 0 2540 /end CHARACTERISTIC
/begin CHARACTERISTIC KL_POKABV87 "Druckoffset Folgeschaltung in Abhaengigkeit von m_t" CURVE 0x24A4A8 kl_si16_S6_S3 12 UMR_BAR__1_1000_0_S6_S3 -6 6
 /begin AXIS_DESCR STD_AXIS zff_atsys._.iSignale._.obj.sig_m_t UMR_NM__1_1_0_S6_S3 4 -400 1640 DEPOSIT ABSOLUTE MONOTONY MON_INCREASE /end AXIS_DESCR
/end CHARACTERISTIC
/begin CHARACTERISTIC KL_POKABVFOLNACHMRS87 "Druckoffset Folgeschaltung nach MRS in Abhaengigkeit von m_t" CURVE 0x24A4BC kl_si16_S6_S3 12 UMR_BAR__1_1000_0_S6_S3 -6 6
 /begin AXIS_DESCR STD_AXIS zff_atsys._.iSignale._.obj.sig_m_t UMR_NM__1_1_0_S6_S3 4 -400 1640 DEPOSIT ABSOLUTE MONOTONY MON_INCREASE /end AXIS_DESCR
/end CHARACTERISTIC
/begin CHARACTERISTIC KF_TSYNMTNTKABVFOLNACHMRS87 "Zeit vor sync. Ende Haltephase vorb. KAB" MAP 0x24A4D0 kf_si16_S6_S3 5000 UMR_MSEC__10_1_0_S6_S3 -5000 0
 /begin AXIS_DESCR STD_AXIS zff_atsys._.iSignale._.obj.sig_m_t UMR_NM__1_1_0_S6_S3 4 -400 1640 DEPOSIT ABSOLUTE MONOTONY MON_INCREASE /end AXIS_DESCR
 /begin AXIS_DESCR STD_AXIS zff_atsys._.iSignale._.obj.sig_n_t UMR_U_MIN_1_1_0_S6_S3 6 0 8160 DEPOSIT ABSOLUTE MONOTONY MON_INCREASE /end AXIS_DESCR
/end CHARACTERISTIC
/begin CHARACTERISTIC KL_PGOKABFOLNACHRS87 "Druckgradient in Abhaengigkeit von m_t fuer Folgeschaltung" CURVE 0x24A51C kl_si16_S6_S3 200 UMR_BAR_SEC_1_10_0_S6_S3 -100 100
 /begin AXIS_DESCR STD_AXIS zff_atsys._.iSignale._.obj.sig_m_t UMR_NM__1_1_0_S6_S3 6 -400 1640 DEPOSIT ABSOLUTE MONOTONY MON_INCREASE /end AXIS_DESCR
/end CHARACTERISTIC
/begin CHARACTERISTIC KL_PGRASYNKABFOLNACHRS87 "Druckgradient Wegschalten KAB fuer Folgeschaltung" CURVE 0x24A538 kl_si16_S6_S3 100 UMR_BAR_SEC_1_10_0_S6_S3 -100 0
 /begin AXIS_DESCR STD_AXIS zff_atsys._.iSignale._.obj.sig_m_t UMR_NM__1_1_0_S6_S3 6 -400 1640 DEPOSIT ABSOLUTE MONOTONY MON_INCREASE /end AXIS_DESCR
/end CHARACTERISTIC
/begin CHARACTERISTIC TO_TSYNHINSYNS87 "Zeitoffset nach Synchron für Dauer Haltephase in Syn. KAB" VALUE 0x26E7E9 kw_ui8_S6_S3 2540 UMR_MSEC__10_1_0_S6_S3 0 2540 /end CHARACTERISTIC
/begin CHARACTERISTIC KL_POKABNGAB87 "Druckoffset in Abhaengigkeit von ng_ab" CURVE 0x24A554 kl_si16_S6_S3 12 UMR_BAR__1_1000_0_S6_S3 -6 6
 /begin AXIS_DESCR STD_AXIS iItfInput.ng_ab UMR_U_MINSEC_1_1_0_S6_S3 4 -5000 1000 DEPOSIT ABSOLUTE MONOTONY MON_INCREASE /end AXIS_DESCR
/end CHARACTERISTIC
/begin CHARACTERISTIC T_SYNKABWS87 "Zeit vor sync. Ende Schaltdruck KAB bei Weiterschaltung" VALUE 0x26E7EA kw_ui8_S6_S3 1280 UMR_MSEC__10_1_M128_S6_S3 -1280 0 /end CHARACTERISTIC
/begin CHARACTERISTIC KL_FPOCGHINSYNKAB87 "Temperaturabhängige Gewichtung des Haltedruckoffsets" CURVE 0x24A568 kl_ui8_S6_S3 1 UMR___1_100_0_S6_S3 0 1
 /begin AXIS_DESCR STD_AXIS zff_atsys._.iSignale._.obj.sig_c_getr UMR_GRADC__1_1_M40_S6_S3 4 -40 150 DEPOSIT ABSOLUTE MONOTONY MON_INCREASE /end AXIS_DESCR
/end CHARACTERISTIC
/begin CHARACTERISTIC KL_TOHKABCG87 "Zeit Offset Haltephase" CURVE 0x24A574 kl_ui8_S6_S3 1270 UMR_MSEC__10_1_0_S6_S3 0 1270
 /begin AXIS_DESCR STD_AXIS zff_atsys._.iSignale._.obj.sig_c_getr UMR_GRADC__1_1_M40_S6_S3 4 -40 190 DEPOSIT ABSOLUTE MONOTONY MON_INCREASE /end AXIS_DESCR
/end CHARACTERISTIC
/begin CHARACTERISTIC KL_PGRASYNKAB87 "Druckgradient Wegschalten abschaltende Kupplung" CURVE 0x24A580 kl_si16_S6_S3 100 UMR_BAR_SEC_1_10_0_S6_S3 -100 0
 /begin AXIS_DESCR STD_AXIS zff_atsys._.iSignale._.obj.sig_m_t UMR_NM__1_1_0_S6_S3 6 -400 1640 DEPOSIT ABSOLUTE MONOTONY MON_INCREASE /end AXIS_DESCR
/end CHARACTERISTIC
/begin CHARACTERISTIC KL_PGRASYNKABWS87 "Druckgradient Wegschalten abschaltende Kupplung bei Weiterschaltung" CURVE 0x24A59C kl_si16_S6_S3 100 UMR_BAR_SEC_1_10_0_S6_S3 -100 0
 /begin AXIS_DESCR STD_AXIS zff_atsys._.iSignale._.obj.sig_m_t UMR_NM__1_1_0_S6_S3 6 -400 1640 DEPOSIT ABSOLUTE MONOTONY MON_INCREASE /end AXIS_DESCR
/end CHARACTERISTIC
/begin CHARACTERISTIC KF_POKABMTCG87 "Schaltdruckoffset" MAP 0x24A5B8 kf_si16_S6_S3 12.75 UMR_BAR__1_1000_0_S6_S3 -6.4 6.35
 /begin AXIS_DESCR STD_AXIS zff_atsys._.iSignale._.obj.sig_m_t UMR_NM__1_1_0_S6_S3 5 -400 1640 DEPOSIT ABSOLUTE MONOTONY MON_INCREASE /end AXIS_DESCR
 /begin AXIS_DESCR STD_AXIS zff_atsys._.iSignale._.obj.sig_c_getr UMR_GRADC__1_1_M40_S6_S3 10 -40 150 DEPOSIT ABSOLUTE MONOTONY MON_INCREASE /end AXIS_DESCR
/end CHARACTERISTIC
/begin CHARACTERISTIC KL_POKABMDMOTSOLL87 "Schaltdruckoffset in Abhaengigkeit von md_motsoll_sas" CURVE 0x24A644 kl_si16_S6_S3 12.75 UMR_BAR__1_1000_0_S6_S3 -6.4 6.35
 /begin AXIS_DESCR STD_AXIS NO_INPUT_QUANTITY UMR_NM__1_1_0_S6_S3 6 -2000 2000 DEPOSIT ABSOLUTE MONOTONY MON_INCREASE /end AXIS_DESCR
/end CHARACTERISTIC
/begin CHARACTERISTIC KF_TVKABMTNMOTRS87 "Verzögerungszeit abschaltende Kupplung bei RS" MAP 0x24A660 kf_ui8_S6_S3 2000 UMR_MSEC__10_1_0_S6_S3 0 2000
 /begin AXIS_DESCR STD_AXIS zff_atsys._.iSignale._.obj.sig_m_t8 UMR_NM__8_1_M50_S6_S3 4 -400 1640 DEPOSIT ABSOLUTE MONOTONY MON_INCREASE /end AXIS_DESCR
 /begin AXIS_DESCR STD_AXIS zff_atsys._.iSignale._.obj.sig_n_mot8 UMR_U_MIN_32_1_0_S6_S3 4 0 8160 DEPOSIT ABSOLUTE MONOTONY MON_INCREASE /end AXIS_DESCR
/end CHARACTERISTIC
/begin CHARACTERISTIC T_RAABVSP31 "Zeit Rampe auf Schaltdruck" VALUE 0x26E7EB kw_ui8_S6_S3 2540 UMR_MSEC__10_1_0_S6_S3 0 2540 /end CHARACTERISTIC
/begin CHARACTERISTIC T_RAABVFOLNACHMRSSP31 "Zeit Rampe auf Schaltdruck" VALUE 0x26E7EC kw_ui8_S6_S3 2540 UMR_MSEC__10_1_0_S6_S3 0 2540 /end CHARACTERISTIC
/begin CHARACTERISTIC KL_POKABVSP31 "Druckoffset Folgeschaltung in Abhaengigkeit von m_t" CURVE 0x24A680 kl_si16_S6_S3 12 UMR_BAR__1_1000_0_S6_S3 -6 6
 /begin AXIS_DESCR STD_AXIS zff_atsys._.iSignale._.obj.sig_m_t UMR_NM__1_1_0_S6_S3 4 -400 1640 DEPOSIT ABSOLUTE MONOTONY MON_INCREASE /end AXIS_DESCR
/end CHARACTERISTIC
/begin CHARACTERISTIC KL_POKABVFOLNACHMRSSP31 "Druckoffset Folgeschaltung nach MRS in Abhaengigkeit von m_t" CURVE 0x24A694 kl_si16_S6_S3 12 UMR_BAR__1_1000_0_S6_S3 -6 6
 /begin AXIS_DESCR STD_AXIS zff_atsys._.iSignale._.obj.sig_m_t UMR_NM__1_1_0_S6_S3 4 -400 1640 DEPOSIT ABSOLUTE MONOTONY MON_INCREASE /end AXIS_DESCR
/end CHARACTERISTIC
/begin CHARACTERISTIC KF_TSYNMTNTKABVFOLNACHMRSSP31 "Zeit vor sync. Ende Haltephase vorb. KAB" MAP 0x24A6A8 kf_si16_S6_S3 5000 UMR_MSEC__10_1_0_S6_S3 -5000 0
 /begin AXIS_DESCR STD_AXIS zff_atsys._.iSignale._.obj.sig_m_t UMR_NM__1_1_0_S6_S3 4 -400 1640 DEPOSIT ABSOLUTE MONOTONY MON_INCREASE /end AXIS_DESCR
 /begin AXIS_DESCR STD_AXIS zff_atsys._.iSignale._.obj.sig_n_t UMR_U_MIN_1_1_0_S6_S3 6 0 8160 DEPOSIT ABSOLUTE MONOTONY MON_INCREASE /end AXIS_DESCR
/end CHARACTERISTIC
/begin CHARACTERISTIC KL_PGOKABFOLNACHRSSP31 "Druckgradient in Abhaengigkeit von m_t fuer Folgeschaltung" CURVE 0x24A6F4 kl_si16_S6_S3 200 UMR_BAR_SEC_1_10_0_S6_S3 -100 100
 /begin AXIS_DESCR STD_AXIS zff_atsys._.iSignale._.obj.sig_m_t UMR_NM__1_1_0_S6_S3 6 -400 1640 DEPOSIT ABSOLUTE MONOTONY MON_INCREASE /end AXIS_DESCR
/end CHARACTERISTIC
/begin CHARACTERISTIC KL_PGRASYNKABFOLNACHRSSP31 "Druckgradient Wegschalten KAB fuer Folgeschaltung" CURVE 0x24A710 kl_si16_S6_S3 100 UMR_BAR_SEC_1_10_0_S6_S3 -100 0
 /begin AXIS_DESCR STD_AXIS zff_atsys._.iSignale._.obj.sig_m_t UMR_NM__1_1_0_S6_S3 6 -400 1640 DEPOSIT ABSOLUTE MONOTONY MON_INCREASE /end AXIS_DESCR
/end CHARACTERISTIC
/begin CHARACTERISTIC KF_PKABFOLSP31 "Schaltdruck ab.Kupplung fuer MRS Folgeschaltung" MAP 0x24A72C kf_si16_S6_S3 12.75 UMR_BAR__1_1000_0_S6_S3 0 12.75
 /begin AXIS_DESCR STD_AXIS NO_INPUT_QUANTITY UMR_U_MIN_32_1_0_S6_S3 8 0 8160 DEPOSIT ABSOLUTE MONOTONY MON_INCREASE /end AXIS_DESCR
 /begin AXIS_DESCR STD_AXIS zff_atsys._.iSignale._.obj.sig_m_t UMR_NM__1_1_0_S6_S3 10 -400 1640 DEPOSIT ABSOLUTE MONOTONY MON_INCREASE /end AXIS_DESCR
/end CHARACTERISTIC
/begin CHARACTERISTIC TO_TSYNHINSYNSSP31 "Zeitoffset nach Synchron für Dauer Haltephase in Syn. KAB" VALUE 0x26E7ED kw_ui8_S6_S3 2540 UMR_MSEC__10_1_0_S6_S3 0 2540 /end CHARACTERISTIC
/begin CHARACTERISTIC KL_POKABNGABSP31 "Druckoffset in Abhaengigkeit von ng_ab" CURVE 0x24A7F8 kl_si16_S6_S3 12 UMR_BAR__1_1000_0_S6_S3 -6 6
 /begin AXIS_DESCR STD_AXIS iItfInput.ng_ab UMR_U_MINSEC_1_1_0_S6_S3 4 -5000 1000 DEPOSIT ABSOLUTE MONOTONY MON_INCREASE /end AXIS_DESCR
/end CHARACTERISTIC
/begin CHARACTERISTIC T_SYNKABWSSP31 "Zeit vor sync. Ende Schaltdruck KAB bei Weiterschaltung" VALUE 0x26E7EE kw_ui8_S6_S3 1280 UMR_MSEC__10_1_M128_S6_S3 -1280 0 /end CHARACTERISTIC
/begin CHARACTERISTIC KL_FPOCGHINSYNKABSP31 "Temperaturabhängige Gewichtung des Haltedruckoffsets" CURVE 0x24A80C kl_ui8_S6_S3 1 UMR___1_100_0_S6_S3 0 1
 /begin AXIS_DESCR STD_AXIS zff_atsys._.iSignale._.obj.sig_c_getr UMR_GRADC__1_1_M40_S6_S3 4 -40 150 DEPOSIT ABSOLUTE MONOTONY MON_INCREASE /end AXIS_DESCR
/end CHARACTERISTIC
/begin CHARACTERISTIC KL_TOHKABCGSP31 "Zeit Offset Haltephase" CURVE 0x24A818 kl_ui8_S6_S3 1270 UMR_MSEC__10_1_0_S6_S3 0 1270
 /begin AXIS_DESCR STD_AXIS zff_atsys._.iSignale._.obj.sig_c_getr UMR_GRADC__1_1_M40_S6_S3 4 -40 190 DEPOSIT ABSOLUTE MONOTONY MON_INCREASE /end AXIS_DESCR
/end CHARACTERISTIC
/begin CHARACTERISTIC KL_PGRASYNKABSP31 "Druckgradient Wegschalten abschaltende Kupplung" CURVE 0x24A824 kl_si16_S6_S3 100 UMR_BAR_SEC_1_10_0_S6_S3 -100 0
 /begin AXIS_DESCR STD_AXIS zff_atsys._.iSignale._.obj.sig_m_t UMR_NM__1_1_0_S6_S3 6 -400 1640 DEPOSIT ABSOLUTE MONOTONY MON_INCREASE /end AXIS_DESCR
/end CHARACTERISTIC
/begin CHARACTERISTIC KL_PGRASYNKABWSSP31 "Druckgradient Wegschalten abschaltende Kupplung bei Weiterschaltung" CURVE 0x24A840 kl_si16_S6_S3 100 UMR_BAR_SEC_1_10_0_S6_S3 -100 0
 /begin AXIS_DESCR STD_AXIS zff_atsys._.iSignale._.obj.sig_m_t UMR_NM__1_1_0_S6_S3 6 -400 1640 DEPOSIT ABSOLUTE MONOTONY MON_INCREASE /end AXIS_DESCR
/end CHARACTERISTIC
/begin CHARACTERISTIC KF_POKABMTCGSP31 "Schaltdruckoffset" MAP 0x24A85C kf_si16_S6_S3 12.75 UMR_BAR__1_1000_0_S6_S3 -6.4 6.35
 /begin AXIS_DESCR STD_AXIS zff_atsys._.iSignale._.obj.sig_m_t UMR_NM__1_1_0_S6_S3 5 -400 1640 DEPOSIT ABSOLUTE MONOTONY MON_INCREASE /end AXIS_DESCR
 /begin AXIS_DESCR STD_AXIS zff_atsys._.iSignale._.obj.sig_c_getr UMR_GRADC__1_1_M40_S6_S3 10 -40 150 DEPOSIT ABSOLUTE MONOTONY MON_INCREASE /end AXIS_DESCR
/end CHARACTERISTIC
/begin CHARACTERISTIC KL_POKABMDMOTSOLLSP31 "Schaltdruckoffset in Abhaengigkeit von md_motsoll_sas" CURVE 0x24A8E8 kl_si16_S6_S3 12.75 UMR_BAR__1_1000_0_S6_S3 -6.4 6.35
 /begin AXIS_DESCR STD_AXIS NO_INPUT_QUANTITY UMR_NM__1_1_0_S6_S3 6 -2000 2000 DEPOSIT ABSOLUTE MONOTONY MON_INCREASE /end AXIS_DESCR
/end CHARACTERISTIC
/begin CHARACTERISTIC KF_TVKABMTNMOTRSSP31 "Verzögerungszeit abschaltende Kupplung bei RS" MAP 0x24A904 kf_ui8_S6_S3 2000 UMR_MSEC__10_1_0_S6_S3 0 2000
 /begin AXIS_DESCR STD_AXIS zff_atsys._.iSignale._.obj.sig_m_t8 UMR_NM__8_1_M50_S6_S3 4 -400 1640 DEPOSIT ABSOLUTE MONOTONY MON_INCREASE /end AXIS_DESCR
 /begin AXIS_DESCR STD_AXIS zff_atsys._.iSignale._.obj.sig_n_mot8 UMR_U_MIN_32_1_0_S6_S3 4 0 8160 DEPOSIT ABSOLUTE MONOTONY MON_INCREASE /end AXIS_DESCR
/end CHARACTERISTIC
/begin CHARACTERISTIC T_RAABVSP42 "Zeit Rampe auf Schaltdruck" VALUE 0x26E7EF kw_ui8_S6_S3 2540 UMR_MSEC__10_1_0_S6_S3 0 2540 /end CHARACTERISTIC
/begin CHARACTERISTIC T_RAABVFOLNACHMRSSP42 "Zeit Rampe auf Schaltdruck" VALUE 0x26E7F0 kw_ui8_S6_S3 2540 UMR_MSEC__10_1_0_S6_S3 0 2540 /end CHARACTERISTIC
/begin CHARACTERISTIC KL_POKABVSP42 "Druckoffset Folgeschaltung in Abhaengigkeit von m_t" CURVE 0x24A924 kl_si16_S6_S3 12 UMR_BAR__1_1000_0_S6_S3 -6 6
 /begin AXIS_DESCR STD_AXIS zff_atsys._.iSignale._.obj.sig_m_t UMR_NM__1_1_0_S6_S3 4 -400 1640 DEPOSIT ABSOLUTE MONOTONY MON_INCREASE /end AXIS_DESCR
/end CHARACTERISTIC
/begin CHARACTERISTIC KL_POKABVFOLNACHMRSSP42 "Druckoffset Folgeschaltung nach MRS in Abhaengigkeit von m_t" CURVE 0x24A938 kl_si16_S6_S3 12 UMR_BAR__1_1000_0_S6_S3 -6 6
 /begin AXIS_DESCR STD_AXIS zff_atsys._.iSignale._.obj.sig_m_t UMR_NM__1_1_0_S6_S3 4 -400 1640 DEPOSIT ABSOLUTE MONOTONY MON_INCREASE /end AXIS_DESCR
/end CHARACTERISTIC
/begin CHARACTERISTIC KF_TSYNMTNTKABVFOLNACHMRSSP42 "Zeit vor sync. Ende Haltephase vorb. KAB" MAP 0x24A94C kf_si16_S6_S3 5000 UMR_MSEC__10_1_0_S6_S3 -5000 0
 /begin AXIS_DESCR STD_AXIS zff_atsys._.iSignale._.obj.sig_m_t UMR_NM__1_1_0_S6_S3 4 -400 1640 DEPOSIT ABSOLUTE MONOTONY MON_INCREASE /end AXIS_DESCR
 /begin AXIS_DESCR STD_AXIS zff_atsys._.iSignale._.obj.sig_n_t UMR_U_MIN_1_1_0_S6_S3 6 0 8160 DEPOSIT ABSOLUTE MONOTONY MON_INCREASE /end AXIS_DESCR
/end CHARACTERISTIC
/begin CHARACTERISTIC KL_PGOKABFOLNACHRSSP42 "Druckgradient in Abhaengigkeit von m_t fuer Folgeschaltung" CURVE 0x24A998 kl_si16_S6_S3 200 UMR_BAR_SEC_1_10_0_S6_S3 -100 100
 /begin AXIS_DESCR STD_AXIS zff_atsys._.iSignale._.obj.sig_m_t UMR_NM__1_1_0_S6_S3 6 -400 1640 DEPOSIT ABSOLUTE MONOTONY MON_INCREASE /end AXIS_DESCR
/end CHARACTERISTIC
/begin CHARACTERISTIC KL_PGRASYNKABFOLNACHRSSP42 "Druckgradient Wegschalten KAB fuer Folgeschaltung" CURVE 0x24A9B4 kl_si16_S6_S3 100 UMR_BAR_SEC_1_10_0_S6_S3 -100 0
 /begin AXIS_DESCR STD_AXIS zff_atsys._.iSignale._.obj.sig_m_t UMR_NM__1_1_0_S6_S3 6 -400 1640 DEPOSIT ABSOLUTE MONOTONY MON_INCREASE /end AXIS_DESCR
/end CHARACTERISTIC
/begin CHARACTERISTIC KF_PKABFOLSP42 "Schaltdruck ab.Kupplung fuer MRS Folgeschaltung" MAP 0x24A9D0 kf_si16_S6_S3 12.75 UMR_BAR__1_1000_0_S6_S3 0 12.75
 /begin AXIS_DESCR STD_AXIS NO_INPUT_QUANTITY UMR_U_MIN_32_1_0_S6_S3 8 0 8160 DEPOSIT ABSOLUTE MONOTONY MON_INCREASE /end AXIS_DESCR
 /begin AXIS_DESCR STD_AXIS zff_atsys._.iSignale._.obj.sig_m_t UMR_NM__1_1_0_S6_S3 10 -400 1640 DEPOSIT ABSOLUTE MONOTONY MON_INCREASE /end AXIS_DESCR
/end CHARACTERISTIC
/begin CHARACTERISTIC TO_TSYNHINSYNSSP42 "Zeitoffset nach Synchron für Dauer Haltephase in Syn. KAB" VALUE 0x26E7F1 kw_ui8_S6_S3 2540 UMR_MSEC__10_1_0_S6_S3 0 2540 /end CHARACTERISTIC
/begin CHARACTERISTIC KL_POKABNGABSP42 "Druckoffset in Abhaengigkeit von ng_ab" CURVE 0x24AA9C kl_si16_S6_S3 12 UMR_BAR__1_1000_0_S6_S3 -6 6
 /begin AXIS_DESCR STD_AXIS iItfInput.ng_ab UMR_U_MINSEC_1_1_0_S6_S3 4 -5000 1000 DEPOSIT ABSOLUTE MONOTONY MON_INCREASE /end AXIS_DESCR
/end CHARACTERISTIC
/begin CHARACTERISTIC T_SYNKABWSSP42 "Zeit vor sync. Ende Schaltdruck KAB bei Weiterschaltung" VALUE 0x26E7F2 kw_ui8_S6_S3 1280 UMR_MSEC__10_1_M128_S6_S3 -1280 0 /end CHARACTERISTIC
/begin CHARACTERISTIC KL_FPOCGHINSYNKABSP42 "Temperaturabhängige Gewichtung des Haltedruckoffsets" CURVE 0x24AAB0 kl_ui8_S6_S3 1 UMR___1_100_0_S6_S3 0 1
 /begin AXIS_DESCR STD_AXIS zff_atsys._.iSignale._.obj.sig_c_getr UMR_GRADC__1_1_M40_S6_S3 4 -40 150 DEPOSIT ABSOLUTE MONOTONY MON_INCREASE /end AXIS_DESCR
/end CHARACTERISTIC
/begin CHARACTERISTIC KL_TOHKABCGSP42 "Zeit Offset Haltephase" CURVE 0x24AABC kl_ui8_S6_S3 1270 UMR_MSEC__10_1_0_S6_S3 0 1270
 /begin AXIS_DESCR STD_AXIS zff_atsys._.iSignale._.obj.sig_c_getr UMR_GRADC__1_1_M40_S6_S3 4 -40 190 DEPOSIT ABSOLUTE MONOTONY MON_INCREASE /end AXIS_DESCR
/end CHARACTERISTIC
/begin CHARACTERISTIC KL_PGRASYNKABSP42 "Druckgradient Wegschalten abschaltende Kupplung" CURVE 0x24AAC8 kl_si16_S6_S3 100 UMR_BAR_SEC_1_10_0_S6_S3 -100 0
 /begin AXIS_DESCR STD_AXIS zff_atsys._.iSignale._.obj.sig_m_t UMR_NM__1_1_0_S6_S3 6 -400 1640 DEPOSIT ABSOLUTE MONOTONY MON_INCREASE /end AXIS_DESCR
/end CHARACTERISTIC
/begin CHARACTERISTIC KL_PGRASYNKABWSSP42 "Druckgradient Wegschalten abschaltende Kupplung bei Weiterschaltung" CURVE 0x24AAE4 kl_si16_S6_S3 100 UMR_BAR_SEC_1_10_0_S6_S3 -100 0
 /begin AXIS_DESCR STD_AXIS zff_atsys._.iSignale._.obj.sig_m_t UMR_NM__1_1_0_S6_S3 6 -400 1640 DEPOSIT ABSOLUTE MONOTONY MON_INCREASE /end AXIS_DESCR
/end CHARACTERISTIC
/begin CHARACTERISTIC KF_POKABMTCGSP42 "Schaltdruckoffset" MAP 0x24AB00 kf_si16_S6_S3 12.75 UMR_BAR__1_1000_0_S6_S3 -6.4 6.35
 /begin AXIS_DESCR STD_AXIS zff_atsys._.iSignale._.obj.sig_m_t UMR_NM__1_1_0_S6_S3 5 -400 1640 DEPOSIT ABSOLUTE MONOTONY MON_INCREASE /end AXIS_DESCR
 /begin AXIS_DESCR STD_AXIS zff_atsys._.iSignale._.obj.sig_c_getr UMR_GRADC__1_1_M40_S6_S3 10 -40 150 DEPOSIT ABSOLUTE MONOTONY MON_INCREASE /end AXIS_DESCR
/end CHARACTERISTIC
/begin CHARACTERISTIC KL_POKABMDMOTSOLLSP42 "Schaltdruckoffset in Abhaengigkeit von md_motsoll_sas" CURVE 0x24AB8C kl_si16_S6_S3 12.75 UMR_BAR__1_1000_0_S6_S3 -6.4 6.35
 /begin AXIS_DESCR STD_AXIS NO_INPUT_QUANTITY UMR_NM__1_1_0_S6_S3 6 -2000 2000 DEPOSIT ABSOLUTE MONOTONY MON_INCREASE /end AXIS_DESCR
/end CHARACTERISTIC
/begin CHARACTERISTIC KF_TVKABMTNMOTRSSP42 "Verzögerungszeit abschaltende Kupplung bei RS" MAP 0x24ABA8 kf_ui8_S6_S3 2000 UMR_MSEC__10_1_0_S6_S3 0 2000
 /begin AXIS_DESCR STD_AXIS zff_atsys._.iSignale._.obj.sig_m_t8 UMR_NM__8_1_M50_S6_S3 4 -400 1640 DEPOSIT ABSOLUTE MONOTONY MON_INCREASE /end AXIS_DESCR
 /begin AXIS_DESCR STD_AXIS zff_atsys._.iSignale._.obj.sig_n_mot8 UMR_U_MIN_32_1_0_S6_S3 4 0 8160 DEPOSIT ABSOLUTE MONOTONY MON_INCREASE /end AXIS_DESCR
/end CHARACTERISTIC
/begin CHARACTERISTIC T_RAABVSP51 "Zeit Rampe auf Schaltdruck" VALUE 0x26E7F3 kw_ui8_S6_S3 2540 UMR_MSEC__10_1_0_S6_S3 0 2540 /end CHARACTERISTIC
/begin CHARACTERISTIC T_RAABVFOLNACHMRSSP51 "Zeit Rampe auf Schaltdruck" VALUE 0x26E7F4 kw_ui8_S6_S3 2540 UMR_MSEC__10_1_0_S6_S3 0 2540 /end CHARACTERISTIC
/begin CHARACTERISTIC KL_POKABVSP51 "Druckoffset Folgeschaltung in Abhaengigkeit von m_t" CURVE 0x24ABC8 kl_si16_S6_S3 12 UMR_BAR__1_1000_0_S6_S3 -6 6
 /begin AXIS_DESCR STD_AXIS zff_atsys._.iSignale._.obj.sig_m_t UMR_NM__1_1_0_S6_S3 4 -400 1640 DEPOSIT ABSOLUTE MONOTONY MON_INCREASE /end AXIS_DESCR
/end CHARACTERISTIC
/begin CHARACTERISTIC KL_POKABVFOLNACHMRSSP51 "Druckoffset Folgeschaltung nach MRS in Abhaengigkeit von m_t" CURVE 0x24ABDC kl_si16_S6_S3 12 UMR_BAR__1_1000_0_S6_S3 -6 6
 /begin AXIS_DESCR STD_AXIS zff_atsys._.iSignale._.obj.sig_m_t UMR_NM__1_1_0_S6_S3 4 -400 1640 DEPOSIT ABSOLUTE MONOTONY MON_INCREASE /end AXIS_DESCR
/end CHARACTERISTIC
/begin CHARACTERISTIC KF_TSYNMTNTKABVFOLNACHMRSSP51 "Zeit vor sync. Ende Haltephase vorb. KAB" MAP 0x24ABF0 kf_si16_S6_S3 5000 UMR_MSEC__10_1_0_S6_S3 -5000 0
 /begin AXIS_DESCR STD_AXIS zff_atsys._.iSignale._.obj.sig_m_t UMR_NM__1_1_0_S6_S3 4 -400 1640 DEPOSIT ABSOLUTE MONOTONY MON_INCREASE /end AXIS_DESCR
 /begin AXIS_DESCR STD_AXIS zff_atsys._.iSignale._.obj.sig_n_t UMR_U_MIN_1_1_0_S6_S3 6 0 8160 DEPOSIT ABSOLUTE MONOTONY MON_INCREASE /end AXIS_DESCR
/end CHARACTERISTIC
/begin CHARACTERISTIC KL_PGOKABFOLNACHRSSP51 "Druckgradient in Abhaengigkeit von m_t fuer Folgeschaltung" CURVE 0x24AC3C kl_si16_S6_S3 200 UMR_BAR_SEC_1_10_0_S6_S3 -100 100
 /begin AXIS_DESCR STD_AXIS zff_atsys._.iSignale._.obj.sig_m_t UMR_NM__1_1_0_S6_S3 6 -400 1640 DEPOSIT ABSOLUTE MONOTONY MON_INCREASE /end AXIS_DESCR
/end CHARACTERISTIC
/begin CHARACTERISTIC KL_PGRASYNKABFOLNACHRSSP51 "Druckgradient Wegschalten KAB fuer Folgeschaltung" CURVE 0x24AC58 kl_si16_S6_S3 100 UMR_BAR_SEC_1_10_0_S6_S3 -100 0
 /begin AXIS_DESCR STD_AXIS zff_atsys._.iSignale._.obj.sig_m_t UMR_NM__1_1_0_S6_S3 6 -400 1640 DEPOSIT ABSOLUTE MONOTONY MON_INCREASE /end AXIS_DESCR
/end CHARACTERISTIC
/begin CHARACTERISTIC KF_PKABFOLSP51 "Schaltdruck ab.Kupplung fuer MRS Folgeschaltung" MAP 0x24AC74 kf_si16_S6_S3 12.75 UMR_BAR__1_1000_0_S6_S3 0 12.75
 /begin AXIS_DESCR STD_AXIS NO_INPUT_QUANTITY UMR_U_MIN_32_1_0_S6_S3 8 0 8160 DEPOSIT ABSOLUTE MONOTONY MON_INCREASE /end AXIS_DESCR
 /begin AXIS_DESCR STD_AXIS zff_atsys._.iSignale._.obj.sig_m_t UMR_NM__1_1_0_S6_S3 10 -400 1640 DEPOSIT ABSOLUTE MONOTONY MON_INCREASE /end AXIS_DESCR
/end CHARACTERISTIC
/begin CHARACTERISTIC TO_TSYNHINSYNSSP51 "Zeitoffset nach Synchron für Dauer Haltephase in Syn. KAB" VALUE 0x26E7F5 kw_ui8_S6_S3 2540 UMR_MSEC__10_1_0_S6_S3 0 2540 /end CHARACTERISTIC
/begin CHARACTERISTIC KL_POKABNGABSP51 "Druckoffset in Abhaengigkeit von ng_ab" CURVE 0x24AD40 kl_si16_S6_S3 12 UMR_BAR__1_1000_0_S6_S3 -6 6
 /begin AXIS_DESCR STD_AXIS iItfInput.ng_ab UMR_U_MINSEC_1_1_0_S6_S3 4 -5000 1000 DEPOSIT ABSOLUTE MONOTONY MON_INCREASE /end AXIS_DESCR
/end CHARACTERISTIC
/begin CHARACTERISTIC T_SYNKABWSSP51 "Zeit vor sync. Ende Schaltdruck KAB bei Weiterschaltung" VALUE 0x26E7F6 kw_ui8_S6_S3 1280 UMR_MSEC__10_1_M128_S6_S3 -1280 0 /end CHARACTERISTIC
/begin CHARACTERISTIC KL_FPOCGHINSYNKABSP51 "Temperaturabhängige Gewichtung des Haltedruckoffsets" CURVE 0x24AD54 kl_ui8_S6_S3 1 UMR___1_100_0_S6_S3 0 1
 /begin AXIS_DESCR STD_AXIS zff_atsys._.iSignale._.obj.sig_c_getr UMR_GRADC__1_1_M40_S6_S3 4 -40 150 DEPOSIT ABSOLUTE MONOTONY MON_INCREASE /end AXIS_DESCR
/end CHARACTERISTIC
/begin CHARACTERISTIC KL_TOHKABCGSP51 "Zeit Offset Haltephase" CURVE 0x24AD60 kl_ui8_S6_S3 1270 UMR_MSEC__10_1_0_S6_S3 0 1270
 /begin AXIS_DESCR STD_AXIS zff_atsys._.iSignale._.obj.sig_c_getr UMR_GRADC__1_1_M40_S6_S3 4 -40 190 DEPOSIT ABSOLUTE MONOTONY MON_INCREASE /end AXIS_DESCR
/end CHARACTERISTIC
/begin CHARACTERISTIC KL_PGRASYNKABSP51 "Druckgradient Wegschalten abschaltende Kupplung" CURVE 0x24AD6C kl_si16_S6_S3 100 UMR_BAR_SEC_1_10_0_S6_S3 -100 0
 /begin AXIS_DESCR STD_AXIS zff_atsys._.iSignale._.obj.sig_m_t UMR_NM__1_1_0_S6_S3 6 -400 1640 DEPOSIT ABSOLUTE MONOTONY MON_INCREASE /end AXIS_DESCR
/end CHARACTERISTIC
/begin CHARACTERISTIC KL_PGRASYNKABWSSP51 "Druckgradient Wegschalten abschaltende Kupplung bei Weiterschaltung" CURVE 0x24AD88 kl_si16_S6_S3 100 UMR_BAR_SEC_1_10_0_S6_S3 -100 0
 /begin AXIS_DESCR STD_AXIS zff_atsys._.iSignale._.obj.sig_m_t UMR_NM__1_1_0_S6_S3 6 -400 1640 DEPOSIT ABSOLUTE MONOTONY MON_INCREASE /end AXIS_DESCR
/end CHARACTERISTIC
/begin CHARACTERISTIC KF_POKABMTCGSP51 "Schaltdruckoffset" MAP 0x24ADA4 kf_si16_S6_S3 12.75 UMR_BAR__1_1000_0_S6_S3 -6.4 6.35
 /begin AXIS_DESCR STD_AXIS zff_atsys._.iSignale._.obj.sig_m_t UMR_NM__1_1_0_S6_S3 5 -400 1640 DEPOSIT ABSOLUTE MONOTONY MON_INCREASE /end AXIS_DESCR
 /begin AXIS_DESCR STD_AXIS zff_atsys._.iSignale._.obj.sig_c_getr UMR_GRADC__1_1_M40_S6_S3 10 -40 150 DEPOSIT ABSOLUTE MONOTONY MON_INCREASE /end AXIS_DESCR
/end CHARACTERISTIC
/begin CHARACTERISTIC KL_POKABMDMOTSOLLSP51 "Schaltdruckoffset in Abhaengigkeit von md_motsoll_sas" CURVE 0x24AE30 kl_si16_S6_S3 12.75 UMR_BAR__1_1000_0_S6_S3 -6.4 6.35
 /begin AXIS_DESCR STD_AXIS NO_INPUT_QUANTITY UMR_NM__1_1_0_S6_S3 6 -2000 2000 DEPOSIT ABSOLUTE MONOTONY MON_INCREASE /end AXIS_DESCR
/end CHARACTERISTIC
/begin CHARACTERISTIC KF_TVKABMTNMOTRSSP51 "Verzögerungszeit abschaltende Kupplung bei RS" MAP 0x24AE4C kf_ui8_S6_S3 2000 UMR_MSEC__10_1_0_S6_S3 0 2000
 /begin AXIS_DESCR STD_AXIS zff_atsys._.iSignale._.obj.sig_m_t8 UMR_NM__8_1_M50_S6_S3 4 -400 1640 DEPOSIT ABSOLUTE MONOTONY MON_INCREASE /end AXIS_DESCR
 /begin AXIS_DESCR STD_AXIS zff_atsys._.iSignale._.obj.sig_n_mot8 UMR_U_MIN_32_1_0_S6_S3 4 0 8160 DEPOSIT ABSOLUTE MONOTONY MON_INCREASE /end AXIS_DESCR
/end CHARACTERISTIC
/begin COMPU_METHOD SAB_A_00478MPSS_M24_S2_S3 "int = ((phys * 10000) / 478) - (-512) m/s^2" RAT_FUNC "%5.3" "m/s^2" COEFFS 0 10000 244736 0 0 478 /end COMPU_METHOD
/begin COMPU_METHOD SAB_A_1MPSS10_M11_S2_S3 "int = ((phys * 10) / 1) - (-110) m/s^2" RAT_FUNC "%5.3" "m/s^2" COEFFS 0 10 110 0 0 1 /end COMPU_METHOD
/begin COMPU_METHOD SAB_A_9807MPSS1000000_M166719_S2_S3 "int = ((phys * 1.0E6) / 9807) - (-1700) m/s^2" RAT_FUNC "%5.3" "m/s^2" COEFFS 0 1000000 16671900 0 0 9807 /end COMPU_METHOD
/begin COMPU_METHOD SAB_A_1MPSS32_M16_S2_S3 "int = ((phys * 32) / 1) - (-512) m/s^2" RAT_FUNC "%5.3" "m/s^2" COEFFS 0 32 512 0 0 1 /end COMPU_METHOD
/begin COMPU_METHOD SAB_A_1MPSS200_M722_S2_S3 "int = ((phys * 200) / 1) - (-1444) m/s^2" RAT_FUNC "%5.3" "m/s^2" COEFFS 0 200 1444 0 0 1 /end COMPU_METHOD
/begin COMPU_METHOD SAB_A_5MPSS100_M10_S2_S3 "int = ((phys * 20) / 1) - (-200) m/s^2" RAT_FUNC "%5.3" "m/s^2" COEFFS 0 20 200 0 0 1 /end COMPU_METHOD
/begin COMPU_METHOD SAB_A_8MPSS100_1024M100_S2_S3 "int = ((phys * 100) / 8) - (-128) m/s^2" RAT_FUNC "%5.3" "m/s^2" COEFFS 0 100 1024 0 0 8 /end COMPU_METHOD
/begin COMPU_METHOD UMR___1_100_0_S6_S3 "int = ((phys * 100) / 1) - (0) [-]" RAT_FUNC "%4.2" "[-]" COEFFS 0 100 -0 0 0 1 /end COMPU_METHOD
/begin COMPU_METHOD UMR_NM__1_1_0_S6_S3 "int = ((phys * 1) / 1) - (0) [Nm]" RAT_FUNC "%2.0" "[Nm]" COEFFS 0 1 -0 0 0 1 /end COMPU_METHOD
/begin COMPU_METHOD UMR_NM__8_1_M50_S6_S3 "int = ((phys * 1) / 8) - (-50) [Nm]" RAT_FUNC "%2.0" "[Nm]" COEFFS 0 1 400 0 0 8 /end COMPU_METHOD
/begin COMPU_METHOD UMR_BAR__1_1000_0_S6_S3 "int = ((phys * 1000) / 1) - (0) [bar]" RAT_FUNC "%5.3" "[bar]" COEFFS 0 1000 -0 0 0 1 /end COMPU_METHOD
/begin COMPU_METHOD UMR_BAR_SEC_1_10_0_S6_S3 "int = ((phys * 10) / 1) - (0) [bar/s]" RAT_FUNC "%3.1" "[bar/s]" COEFFS 0 10 -0 0 0 1 /end COMPU_METHOD
/begin COMPU_METHOD UMR_U_MIN_1_1_0_S6_S3 "int = ((phys * 1) / 1) - (0) [U/min]" RAT_FUNC "%2.0" "[U/min]" COEFFS 0 1 -0 0 0 1 /end COMPU_METHOD
/begin COMPU_METHOD UMR_U_MIN_32_1_0_S6_S3 "int = ((phys * 1) / 32) - (0) [U/min]" RAT_FUNC "%2.0" "[U/min]" COEFFS 0 1 -0 0 0 32 /end COMPU_METHOD
/begin COMPU_METHOD UMR_U_MINSEC_1_1_0_S6_S3 "int = ((phys * 1) / 1) - (0) [U/(min*s)]" RAT_FUNC "%2.0" "[U/(min*s)]" COEFFS 0 1 -0 0 0 1 /end COMPU_METHOD
/begin COMPU_METHOD UMR_MSEC__10_1_0_S6_S3 "int = ((phys * 1) / 10) - (0) [ms]" RAT_FUNC "%2.0" "[ms]" COEFFS 0 1 -0 0 0 10 /end COMPU_METHOD
/begin COMPU_METHOD UMR_MSEC__10_1_M128_S6_S3 "int = ((phys * 1) / 10) - (-128) [ms]" RAT_FUNC "%2.0" "[ms]" COEFFS 0 1 1280 0 0 10 /end COMPU_METHOD
/begin COMPU_METHOD UMR_GRADC__1_1_M40_S6_S3 "int = ((phys * 1) / 1) - (-40) [°C]" RAT_FUNC "%2.0" "[°C]" COEFFS 0 1 40 0 0 1 /end COMPU_METHOD
/begin FUNCTION jSasKzuRSP187_Fktn "Applikationesgroessen Instanz jSasKzuRSP187"
 /begin DEF_CHARACTERISTIC F_PRA87 F_PRA87_EL F_TRA87 F_TRA87_EL KF_PKZU87 KF_PKZU87_EL KF_POFMTN87 KF_POFMTN87_EL KF_POHINSYNKZU87 KL_PGRASYN87 KL_TRA87 KL_TRA87_EL KL_TSYNCGHINSYNEKZU87 T_F87 T_F87_EL /end DEF_CHARACTERISTIC
/end FUNCTION
/begin FUNCTION jSasKzuRSP221_Fktn "Applikationesgroessen Instanz jSasKzuRSP221"
 /begin DEF_CHARACTERISTIC F_PRASP21 F_TRASP21 KF_PKZUSP21 KF_POFMTNSP21 KF_POHINSYNKZUSP21 KL_PGRASYNSP21 KL_TRASP21 KL_TSYNCGHINSYNEKZUSP21 T_FSP21 /end DEF_CHARACTERISTIC
/end FUNCTION
/begin FUNCTION jSasKzuRSP232_Fktn "Applikationesgroessen Instanz jSasKzuRSP232"
 /begin DEF_CHARACTERISTIC F_PRASP32 F_TRASP32 KF_PKZUSP32 KF_POFMTNSP32 KF_POHINSYNKZUSP32 KL_PGRASYNSP32 KL_TRASP32 KL_TSYNCGHINSYNEKZUSP32 T_FSP32 /end DEF_CHARACTERISTIC
/end FUNCTION
/begin FUNCTION jSasKzuRSP243_Fktn "Applikationesgroessen Instanz jSasKzuRSP243"
 /begin DEF_CHARACTERISTIC F_PRASP43 F_TRASP43 KF_PKZUSP43 KF_POFMTNSP43 KF_POHINSYNKZUSP43 KL_PGRASYNSP43 KL_TRASP43 KL_TSYNCGHINSYNEKZUSP43 T_FSP43 /end DEF_CHARACTERISTIC
/end FUNCTION
/begin FUNCTION jSasKzuRSP254_Fktn "Applikationesgroessen Instanz jSasKzuRSP254"
 /begin DEF_CHARACTERISTIC F_PRASP54 F_TRASP54 KF_PKZUSP54 KF_POFMTNSP54 KF_POHINSYNKZUSP54 KL_PGRASYNSP54 KL_TRASP54 KL_TSYNCGHINSYNEKZUSP54 T_FSP54 /end DEF_CHARACTERISTIC
/end FUNCTION
/begin FUNCTION jSasKzuRSP265_Fktn "Applikationesgroessen Instanz jSasKzuRSP265"
 /begin DEF_CHARACTERISTIC F_PRASP65 F_TRASP65 KF_PKZUSP65 KF_POFMTNSP65 KF_POHINSYNKZUSP65 KL_PGRASYNSP65 KL_TRASP65 KL_TSYNCGHINSYNEKZUSP65 T_FSP65 /end DEF_CHARACTERISTIC
/end FUNCTION
/begin FUNCTION jSasKzuRSP276_Fktn "Applikationesgroessen Instanz jSasKzuRSP276"
 /begin DEF_CHARACTERISTIC F_PRASP76 F_TRASP76 KF_PKZUSP76 KF_POFMTNSP76 KF_POHINSYNKZUSP76 KL_PGRASYNSP76 KL_TRASP76 KL_TSYNCGHINSYNEKZUSP76 T_FSP76 /end DEF_CHARACTERISTIC
/end FUNCTION
/begin FUNCTION jSasKzuRSP287_Fktn "Applikationesgroessen Instanz jSasKzuRSP287"
 /begin DEF_CHARACTERISTIC F_PRASP87 F_TRASP87 KF_PKZUSP87 KF_POFMTNSP87 KF_POHINSYNKZUSP87 KL_PGRASYNSP87 KL_TRASP87 KL_TSYNCGHINSYNEKZUSP87 T_FSP87 /end DEF_CHARACTERISTIC
/end FUNCTION
/begin FUNCTION jSasKzuRSP231_Fktn "Applikationesgroessen Instanz jSasKzuRSP231"
 /begin DEF_CHARACTERISTIC F_PRASP31 F_TRASP31 KF_PKZUSP31 KF_POFMTNSP31 KF_POHINSYNKZUSP31 KL_PGRASYNSP31 KL_TRASP31 KL_TSYNCGHINSYNEKZUSP31 T_FSP31 /end DEF_CHARACTERISTIC
/end FUNCTION
/begin FUNCTION jSasKzuRSP242_Fktn "Applikationesgroessen Instanz jSasKzuRSP242"
 /begin DEF_CHARACTERISTIC F_PRASP42 F_TRASP42 KF_PKZUSP42 KF_PKZUSP42_EL KF_POFMTNSP42 KF_POFMTNSP42_EL KF_POHINSYNKZUSP42 KL_PGRASYNSP42 KL_TRASP42 KL_TRASP42_EL KL_TSYNCGHINSYNEKZUSP42 T_FSP42 T_FSP42_EL /end DEF_CHARACTERISTIC
/end FUNCTION
/begin FUNCTION jSasKzuRSP251_Fktn "Applikationesgroessen Instanz jSasKzuRSP251"
 /begin DEF_CHARACTERISTIC F_PRASP51 F_TRASP51 KF_PKZUSP51 KF_POFMTNSP51 KF_POHINSYNKZUSP51 KL_PGRASYNSP51 KL_TRASP51 KL_TSYNCGHINSYNEKZUSP51 T_FSP51 /end DEF_CHARACTERISTIC
/end FUNCTION
/begin FUNCTION jSasKzuRSP253_Fktn "Applikationesgroessen Instanz jSasKzuRSP253"
 /begin DEF_CHARACTERISTIC F_PRASP53 F_TRASP53 KF_PKZUSP53 KF_PKZUSP53_EL KF_POFMTNSP53 KF_POFMTNSP53_EL KF_POHINSYNKZUSP53 KL_PGRASYNSP53 KL_TRASP53 KL_TRASP53_EL KL_TSYNCGHINSYNEKZUSP53 T_FSP53 T_FSP53_EL /end DEF_CHARACTERISTIC
/end FUNCTION
/begin FUNCTION jSasKzuRSP263_Fktn "Applikationesgroessen Instanz jSasKzuRSP263"
 /begin DEF_CHARACTERISTIC F_PRASP63 F_TRASP63 KF_PKZUSP63 KF_PKZUSP63_EL KF_POFMTNSP63 KF_POFMTNSP63_EL KF_POHINSYNKZUSP63 KL_PGRASYNSP63 KL_TRASP63 KL_TRASP63_EL KL_TSYNCGHINSYNEKZUSP63 T_FSP63 T_FSP63_EL /end DEF_CHARACTERISTIC
/end FUNCTION
/begin FUNCTION jSasKzuRSP264_Fktn "Applikationesgroessen Instanz jSasKzuRSP264"
 /begin DEF_CHARACTERISTIC F_PRASP64 F_TRASP64 KF_PKZUSP64 KF_PKZUSP64_EL KF_POFMTNSP64 KF_POFMTNSP64_EL KF_POHINSYNKZUSP64 KL_PGRASYNSP64 KL_TRASP64 KL_TRASP64_EL KL_TSYNCGHINSYNEKZUSP64 T_FSP64 T_FSP64_EL /end DEF_CHARACTERISTIC
/end FUNCTION
/begin FUNCTION jSasKzuRSP271_Fktn "Applikationesgroessen Instanz jSasKzuRSP271"
 /begin DEF_CHARACTERISTIC F_PRASP71 F_TRASP71 KF_PKZUSP71 KF_POFMTNSP71 KF_POHINSYNKZUSP71 KL_PGRASYNSP71 KL_TRASP71 KL_TSYNCGHINSYNEKZUSP71 T_FSP71 /end DEF_CHARACTERISTIC
/end FUNCTION
/begin FUNCTION jSasKzuRSP275_Fktn "Applikationesgroessen Instanz jSasKzuRSP275"
 /begin DEF_CHARACTERISTIC F_PRASP75 F_TRASP75 KF_PKZUSP75 KF_PKZUSP75_EL KF_POFMTNSP75 KF_POFMTNSP75_EL KF_POHINSYNKZUSP75 KL_PGRASYNSP75 KL_TRASP75 KL_TRASP75_EL KL_TSYNCGHINSYNEKZUSP75 T_FSP75 T_FSP75_EL /end DEF_CHARACTERISTIC
/end FUNCTION
/begin FUNCTION jSasKzuRSP282_Fktn "Applikationesgroessen Instanz jSasKzuRSP282"
 /begin DEF_CHARACTERISTIC F_PRASP82 F_TRASP82 KF_PKZUSP82 KF_PKZUSP82_EL KF_POFMTNSP82 KF_POFMTNSP82_EL KF_POHINSYNKZUSP82 KL_PGRASYNSP82 KL_TRASP82 KL_TRASP82_EL KL_TSYNCGHINSYNEKZUSP82 T_FSP82 T_FSP82_EL /end DEF_CHARACTERISTIC
/end FUNCTION
/begin FUNCTION jSasKzuRSP284_Fktn "Applikationesgroessen Instanz jSasKzuRSP284"
 /begin DEF_CHARACTERISTIC F_PRASP84 F_TRASP84 KF_PKZUSP84 KF_PKZUSP84_EL KF_POFMTNSP84 KF_POFMTNSP84_EL KF_POHINSYNKZUSP84 KL_PGRASYNSP84 KL_TRASP84 KL_TRASP84_EL KL_TSYNCGHINSYNEKZUSP84 T_FSP84 T_FSP84_EL /end DEF_CHARACTERISTIC
/end FUNCTION
/begin FUNCTION jSasKzuRSP286_Fktn "Applikationesgroessen Instanz jSasKzuRSP286"
 /begin DEF_CHARACTERISTIC F_PRASP86 F_TRASP86 KF_PKZUSP86 KF_PKZUSP86_EL KF_POFMTNSP86 KF_POFMTNSP86_EL KF_POHINSYNKZUSP86 KL_PGRASYNSP86 KL_TRASP86 KL_TRASP86_EL KL_TSYNCGHINSYNEKZUSP86 T_FSP86 T_FSP86_EL /end DEF_CHARACTERISTIC
/end FUNCTION
/begin FUNCTION jSasKzuRSP321_Fktn "Applikationesgroessen Instanz jSasKzuRSP321"
 /begin DEF_CHARACTERISTIC F_PRASPORT21 F_TRASPORT21 KF_PKZUSPORT21 KF_POFMTNSPORT21 KF_POHINSYNKZUSPORT21 KL_PGRASYNSPORT21 KL_TRASPORT21 KL_TSYNCGHINSYNEKZUSPORT21 T_FSPORT21 /end DEF_CHARACTERISTIC
/end FUNCTION
/begin FUNCTION jSasKzuRSP332_Fktn "Applikationesgroessen Instanz jSasKzuRSP332"
 /begin DEF_CHARACTERISTIC F_PRASPORT32 F_TRASPORT32 KF_PKZUSPORT32 KF_POFMTNSPORT32 KF_POHINSYNKZUSPORT32 KL_PGRASYNSPORT32 KL_TRASPORT32 KL_TSYNCGHINSYNEKZUSPORT32 T_FSPORT32 /end DEF_CHARACTERISTIC
/end FUNCTION
/begin FUNCTION jSasKzuRSP343_Fktn "Applikationesgroessen Instanz jSasKzuRSP343"
 /begin DEF_CHARACTERISTIC F_PRASPORT43 F_TRASPORT43 KF_PKZUSPORT43 KF_POFMTNSPORT43 KF_POHINSYNKZUSPORT43 KL_PGRASYNSPORT43 KL_TRASPORT43 KL_TSYNCGHINSYNEKZUSPORT43 T_FSPORT43 /end DEF_CHARACTERISTIC
/end FUNCTION
/begin FUNCTION jSasKzuRSP354_Fktn "Applikationesgroessen Instanz jSasKzuRSP354"
 /begin DEF_CHARACTERISTIC F_PRASPORT54 F_TRASPORT54 KF_PKZUSPORT54 KF_POFMTNSPORT54 KF_POHINSYNKZUSPORT54 KL_PGRASYNSPORT54 KL_TRASPORT54 KL_TSYNCGHINSYNEKZUSPORT54 T_FSPORT54 /end DEF_CHARACTERISTIC
/end FUNCTION
/begin FUNCTION jSasKzuRSP365_Fktn "Applikationesgroessen Instanz jSasKzuRSP365"
 /begin DEF_CHARACTERISTIC F_PRASPORT65 F_TRASPORT65 KF_PKZUSPORT65 KF_POFMTNSPORT65 KF_POHINSYNKZUSPORT65 KL_PGRASYNSPORT65 KL_TRASPORT65 KL_TSYNCGHINSYNEKZUSPORT65 T_FSPORT65 /end DEF_CHARACTERISTIC
/end FUNCTION
/begin FUNCTION jSasKzuRSP376_Fktn "Applikationesgroessen Instanz jSasKzuRSP376"
 /begin DEF_CHARACTERISTIC F_PRASPORT76 F_TRASPORT76 KF_PKZUSPORT76 KF_POFMTNSPORT76 KF_POHINSYNKZUSPORT76 KL_PGRASYNSPORT76 KL_TRASPORT76 KL_TSYNCGHINSYNEKZUSPORT76 T_FSPORT76 /end DEF_CHARACTERISTIC
/end FUNCTION
/begin FUNCTION jSasKzuRSP387_Fktn "Applikationesgroessen Instanz jSasKzuRSP387"
 /begin DEF_CHARACTERISTIC F_PRASPORT87 F_TRASPORT87 KF_PKZUSPORT87 KF_POFMTNSPORT87 KF_POHINSYNKZUSPORT87 KL_PGRASYNSPORT87 KL_TRASPORT87 KL_TSYNCGHINSYNEKZUSPORT87 T_FSPORT87 /end DEF_CHARACTERISTIC
/end FUNCTION
/begin FUNCTION jSasKzuRSP331_Fktn "Applikationesgroessen Instanz jSasKzuRSP331"
 /begin DEF_CHARACTERISTIC F_PRASPORT31 F_TRASPORT31 KF_PKZUSPORT31 KF_POFMTNSPORT31 KF_POHINSYNKZUSPORT31 KL_PGRASYNSPORT31 KL_TRASPORT31 KL_TSYNCGHINSYNEKZUSPORT31 T_FSPORT31 /end DEF_CHARACTERISTIC
/end FUNCTION
/begin FUNCTION jSasKzuRSP342_Fktn "Applikationesgroessen Instanz jSasKzuRSP342"
 /begin DEF_CHARACTERISTIC F_PRASPORT42 F_TRASPORT42 KF_PKZUSPORT42 KF_POFMTNSPORT42 KF_POHINSYNKZUSPORT42 KL_PGRASYNSPORT42 KL_TRASPORT42 KL_TSYNCGHINSYNEKZUSPORT42 T_FSPORT42 /end DEF_CHARACTERISTIC
/end FUNCTION
/begin FUNCTION jSasKzuRSP351_Fktn "Applikationesgroessen Instanz jSasKzuRSP351"
 /begin DEF_CHARACTERISTIC F_PRASPORT51 F_TRASPORT51 KF_PKZUSPORT51 KF_POFMTNSPORT51 KF_POHINSYNKZUSPORT51 KL_PGRASYNSPORT51 KL_TRASPORT51 KL_TSYNCGHINSYNEKZUSPORT51 T_FSPORT51 /end DEF_CHARACTERISTIC
/end FUNCTION
/begin FUNCTION jSasKzuRSP353_Fktn "Applikationesgroessen Instanz jSasKzuRSP353"
 /begin DEF_CHARACTERISTIC F_PRASPORT53 F_TRASPORT53 KF_PKZUSPORT53 KF_POFMTNSPORT53 KF_POHINSYNKZUSPORT53 KL_PGRASYNSPORT53 KL_TRASPORT53 KL_TSYNCGHINSYNEKZUSPORT53 T_FSPORT53 /end DEF_CHARACTERISTIC
/end FUNCTION
/begin FUNCTION jSasKzuRSP363_Fktn "Applikationesgroessen Instanz jSasKzuRSP363"
 /begin DEF_CHARACTERISTIC F_PRASPORT63 F_TRASPORT63 KF_PKZUSPORT63 KF_POFMTNSPORT63 KF_POHINSYNKZUSPORT63 KL_PGRASYNSPORT63 KL_TRASPORT63 KL_TSYNCGHINSYNEKZUSPORT63 T_FSPORT63 /end DEF_CHARACTERISTIC
/end FUNCTION
/begin FUNCTION jSasKzuRSP364_Fktn "Applikationesgroessen Instanz jSasKzuRSP364"
 /begin DEF_CHARACTERISTIC F_PRASPORT64 F_TRASPORT64 KF_PKZUSPORT64 KF_POFMTNSPORT64 KF_POHINSYNKZUSPORT64 KL_PGRASYNSPORT64 KL_TRASPORT64 KL_TSYNCGHINSYNEKZUSPORT64 T_FSPORT64 /end DEF_CHARACTERISTIC
/end FUNCTION
/begin FUNCTION jSasKzuRSP371_Fktn "Applikationesgroessen Instanz jSasKzuRSP371"
 /begin DEF_CHARACTERISTIC F_PRASPORT71 F_TRASPORT71 KF_PKZUSPORT71 KF_POFMTNSPORT71 KF_POHINSYNKZUSPORT71 KL_PGRASYNSPORT71 KL_TRASPORT71 KL_TSYNCGHINSYNEKZUSPORT71 T_FSPORT71 /end DEF_CHARACTERISTIC
/end FUNCTION
/begin FUNCTION jSasKzuRSP375_Fktn "Applikationesgroessen Instanz jSasKzuRSP375"
 /begin DEF_CHARACTERISTIC F_PRASPORT75 F_TRASPORT75 KF_PKZUSPORT75 KF_POFMTNSPORT75 KF_POHINSYNKZUSPORT75 KL_PGRASYNSPORT75 KL_TRASPORT75 KL_TSYNCGHINSYNEKZUSPORT75 T_FSPORT75 /end DEF_CHARACTERISTIC
/end FUNCTION
/begin FUNCTION jSasKzuRSP382_Fktn "Applikationesgroessen Instanz jSasKzuRSP382"
 /begin DEF_CHARACTERISTIC F_PRASPORT82 F_TRASPORT82 KF_PKZUSPORT82 KF_POFMTNSPORT82 KF_POHINSYNKZUSPORT82 KL_PGRASYNSPORT82 KL_TRASPORT82 KL_TSYNCGHINSYNEKZUSPORT82 T_FSPORT82 /end DEF_CHARACTERISTIC
/end FUNCTION
/begin FUNCTION jSasKzuRSP384_Fktn "Applikationesgroessen Instanz jSasKzuRSP384"
 /begin DEF_CHARACTERISTIC F_PRASPORT84 F_TRASPORT84 KF_PKZUSPORT84 KF_POFMTNSPORT84 KF_POHINSYNKZUSPORT84 KL_PGRASYNSPORT84 KL_TRASPORT84 KL_TSYNCGHINSYNEKZUSPORT84 T_FSPORT84 /end DEF_CHARACTERISTIC
/end FUNCTION
/begin FUNCTION jSasKzuRSP386_Fktn "Applikationesgroessen Instanz jSasKzuRSP386"
 /begin DEF_CHARACTERISTIC F_PRASPORT86 F_TRASPORT86 KF_PKZUSPORT86 KF_POFMTNSPORT86 KF_POHINSYNKZUSPORT86 KL_PGRASYNSPORT86 KL_TRASPORT86 KL_TSYNCGHINSYNEKZUSPORT86 T_FSPORT86 /end DEF_CHARACTERISTIC
/end FUNCTION
/begin FUNCTION dSasKzuERS_Fktn "Applikationesgroessen der Komponente dSasKzuERS"
 /begin SUB_FUNCTION jSasKzuERS21_Fktn jSasKzuERS32_Fktn jSasKzuERS43_Fktn jSasKzuERS54_Fktn jSasKzuERS65_Fktn jSasKzuERS76_Fktn jSasKzuERS87_Fktn /end SUB_FUNCTION
/end FUNCTION
/begin FUNCTION jSasKzuERS21_Fktn "Applikationesgroessen Instanz jSasKzuERS21" /begin DEF_CHARACTERISTIC KL_TSYNMTKZUSFVFOLNACHMRS21 KL_TSYNMTTRAKZUVFOLNACHMRS21 /end DEF_CHARACTERISTIC /end FUNCTION
/begin FUNCTION jSasKzuERS32_Fktn "Applikationesgroessen Instanz jSasKzuERS32" /begin DEF_CHARACTERISTIC KL_TSYNMTKZUSFVFOLNACHMRS32 KL_TSYNMTTRAKZUVFOLNACHMRS32 /end DEF_CHARACTERISTIC /end FUNCTION
/begin FUNCTION jSasKzuERS43_Fktn "Applikationesgroessen Instanz jSasKzuERS43" /begin DEF_CHARACTERISTIC KL_TSYNMTKZUSFVFOLNACHMRS43 KL_TSYNMTTRAKZUVFOLNACHMRS43 /end DEF_CHARACTERISTIC /end FUNCTION
/begin FUNCTION jSasKzuERS54_Fktn "Applikationesgroessen Instanz jSasKzuERS54" /begin DEF_CHARACTERISTIC KL_TSYNMTKZUSFVFOLNACHMRS54 KL_TSYNMTTRAKZUVFOLNACHMRS54 /end DEF_CHARACTERISTIC /end FUNCTION
/begin FUNCTION jSasKzuERS65_Fktn "Applikationesgroessen Instanz jSasKzuERS65" /begin DEF_CHARACTERISTIC KL_TSYNMTKZUSFVFOLNACHMRS65 KL_TSYNMTTRAKZUVFOLNACHMRS65 /end DEF_CHARACTERISTIC /end FUNCTION
/begin FUNCTION jSasKzuERS76_Fktn "Applikationesgroessen Instanz jSasKzuERS76" /begin DEF_CHARACTERISTIC KL_TSYNMTKZUSFVFOLNACHMRS76 KL_TSYNMTTRAKZUVFOLNACHMRS76 /end DEF_CHARACTERISTIC /end FUNCTION
/begin FUNCTION jSasKzuERS87_Fktn "Applikationesgroessen Instanz jSasKzuERS87" /begin DEF_CHARACTERISTIC KL_TSYNMTKZUSFVFOLNACHMRS87 KL_TSYNMTTRAKZUVFOLNACHMRS87 /end DEF_CHARACTERISTIC /end FUNCTION
/begin FUNCTION dSasKabRSS_Fktn "Applikationesgroessen der Komponente dSasKabRSS"
 /begin SUB_FUNCTION jSasKabRSS21_Fktn jSasKabRSS32_Fktn jSasKabRSS43_Fktn jSasKabRSS54_Fktn jSasKabRSS65_Fktn jSasKabRSS76_Fktn jSasKabRSS87_Fktn jSasKabRSS31_Fktn jSasKabRSS42_Fktn jSasKabRSS51_Fktn jSasKabRSS53_Fktn jSasKabRSS63_Fktn jSasKabRSS64_Fktn jSasKabRSS71_Fktn jSasKabRSS75_Fktn jSasKabRSS82_Fktn jSasKabRSS86_Fktn jSasKabRSS84_Fktn /end SUB_FUNCTION
/end FUNCTION
/begin FUNCTION jSasKabRSS21_Fktn "Applikationesgroessen Instanz jSasKabRSS21"
 /begin DEF_CHARACTERISTIC KF_POKABMTCG21 KF_TSYNMTNTKABVFOLNACHMRS21 KF_TVKABMTNMOTRS21 KL_FPOCGHINSYNKAB21 KL_PGOKABFOLNACHRS21 KL_PGRASYNKAB21 KL_PGRASYNKABFOLNACHRS21 KL_PGRASYNKABWS21 KL_POKABMDMOTSOLL21 KL_POKABNGAB21 KL_POKABV21 KL_POKABVFOLNACHMRS21 KL_TOHKABCG21 TO_TSYNHINSYNS21 T_RAABV21 T_RAABVFOLNACHMRS21 T_SYNKABWS21 /end DEF_CHARACTERISTIC
/end FUNCTION
/begin FUNCTION jSasKabRSS32_Fktn "Applikationesgroessen Instanz jSasKabRSS32"
 /begin DEF_CHARACTERISTIC KF_POKABMTCG32 KF_TSYNMTNTKABVFOLNACHMRS32 KF_TVKABMTNMOTRS32 KL_FPOCGHINSYNKAB32 KL_PGOKABFOLNACHRS32 KL_PGRASYNKAB32 KL_PGRASYNKABFOLNACHRS32 KL_PGRASYNKABWS32 KL_POKABMDMOTSOLL32 KL_POKABNGAB32 KL_POKABV32 KL_POKABVFOLNACHMRS32 KL_TOHKABCG32 TO_TSYNHINSYNS32 T_RAABV32 T_RAABVFOLNACHMRS32 T_SYNKABWS32 /end DEF_CHARACTERISTIC
/end FUNCTION
/begin FUNCTION jSasKabRSS43_Fktn "Applikationesgroessen Instanz jSasKabRSS43"
 /begin DEF_CHARACTERISTIC KF_POKABMTCG43 KF_TVKABMTNMOTRS43 KL_FPOCGHINSYNKAB43 KL_PGOKABFOLNACHRS43 KL_PGRASYNKAB43 KL_PGRASYNKABFOLNACHRS43 KL_PGRASYNKABWS43 KL_POKABMDMOTSOLL43 KL_POKABNGAB43 KL_POKABV43 KL_POKABVFOLNACHMRS43 KL_TOHKABCG43 TO_TSYNHINSYNS43 T_RAABV43 T_SYNKABWS43 /end DEF_CHARACTERISTIC
/end FUNCTION
/begin FUNCTION jSasKabRSS54_Fktn "Applikationesgroessen Instanz jSasKabRSS54"
 /begin DEF_CHARACTERISTIC KF_POKABMTCG54 KF_TSYNMTNTKABVFOLNACHMRS54 KF_TVKABMTNMOTRS54 KL_FPOCGHINSYNKAB54 KL_PGOKABFOLNACHRS54 KL_PGRASYNKAB54 KL_PGRASYNKABFOLNACHRS54 KL_PGRASYNKABWS54 KL_POKABMDMOTSOLL54 KL_POKABNGAB54 KL_POKABV54 KL_POKABVFOLNACHMRS54 KL_TOHKABCG54 TO_TSYNHINSYNS54 T_RAABV54 T_RAABVFOLNACHMRS54 T_SYNKABWS54 /end DEF_CHARACTERISTIC
/end FUNCTION
/begin FUNCTION jSasKabRSS65_Fktn "Applikationesgroessen Instanz jSasKabRSS65"
 /begin DEF_CHARACTERISTIC KF_POKABMTCG65 KF_TSYNMTNTKABVFOLNACHMRS65 KF_TVKABMTNMOTRS65 KL_FPOCGHINSYNKAB65 KL_PGOKABFOLNACHRS65 KL_PGRASYNKAB65 KL_PGRASYNKABFOLNACHRS65 KL_PGRASYNKABWS65 KL_POKABMDMOTSOLL65 KL_POKABNGAB65 KL_POKABV65 KL_POKABVFOLNACHMRS65 KL_TOHKABCG65 TO_TSYNHINSYNS65 T_RAABV65 T_RAABVFOLNACHMRS65 T_SYNKABWS65 /end DEF_CHARACTERISTIC
/end FUNCTION
/begin FUNCTION jSasKabRSS76_Fktn "Applikationesgroessen Instanz jSasKabRSS76"
 /begin DEF_CHARACTERISTIC KF_POKABMTCG76 KF_TSYNMTNTKABVFOLNACHMRS76 KF_TVKABMTNMOTRS76 KL_FPOCGHINSYNKAB76 KL_PGOKABFOLNACHRS76 KL_PGRASYNKAB76 KL_PGRASYNKABFOLNACHRS76 KL_PGRASYNKABWS76 KL_POKABMDMOTSOLL76 KL_POKABNGAB76 KL_POKABV76 KL_POKABVFOLNACHMRS76 KL_TOHKABCG76 TO_TSYNHINSYNS76 T_RAABV76 T_RAABVFOLNACHMRS76 T_SYNKABWS76 /end DEF_CHARACTERISTIC
/end FUNCTION
/begin FUNCTION jSasKabRSS87_Fktn "Applikationesgroessen Instanz jSasKabRSS87"
 /begin DEF_CHARACTERISTIC KF_POKABMTCG87 KF_TSYNMTNTKABVFOLNACHMRS87 KF_TVKABMTNMOTRS87 KL_FPOCGHINSYNKAB87 KL_PGOKABFOLNACHRS87 KL_PGRASYNKAB87 KL_PGRASYNKABFOLNACHRS87 KL_PGRASYNKABWS87 KL_POKABMDMOTSOLL87 KL_POKABNGAB87 KL_POKABV87 KL_POKABVFOLNACHMRS87 KL_TOHKABCG87 TO_TSYNHINSYNS87 T_RAABV87 T_RAABVFOLNACHMRS87 T_SYNKABWS87 /end DEF_CHARACTERISTIC
/end FUNCTION
/begin FUNCTION jSasKabRSS31_Fktn "Applikationesgroessen Instanz jSasKabRSS31"
 /begin DEF_CHARACTERISTIC KF_PKABFOLSP31 KF_POKABMTCGSP31 KF_TSYNMTNTKABVFOLNACHMRSSP31 KF_TVKABMTNMOTRSSP31 KL_FPOCGHINSYNKABSP31 KL_PGOKABFOLNACHRSSP31 KL_PGRASYNKABFOLNACHRSSP31 KL_PGRASYNKABSP31 KL_PGRASYNKABWSSP31 KL_POKABMDMOTSOLLSP31 KL_POKABNGABSP31 KL_POKABVFOLNACHMRSSP31 KL_POKABVSP31 KL_TOHKABCGSP31 TO_TSYNHINSYNSSP31 T_RAABVFOLNACHMRSSP31 T_RAABVSP31 T_SYNKABWSSP31 /end DEF_CHARACTERISTIC
/end FUNCTION
/begin FUNCTION jSasKabRSS42_Fktn "Applikationesgroessen Instanz jSasKabRSS42"
 /begin DEF_CHARACTERISTIC KF_PKABFOLSP42 KF_POKABMTCGSP42 KF_TSYNMTNTKABVFOLNACHMRSSP42 KF_TVKABMTNMOTRSSP42 KL_FPOCGHINSYNKABSP42 KL_PGOKABFOLNACHRSSP42 KL_PGRASYNKABFOLNACHRSSP42 KL_PGRASYNKABSP42 KL_PGRASYNKABWSSP42 KL_POKABMDMOTSOLLSP42 KL_POKABNGABSP42 KL_POKABVFOLNACHMRSSP42 KL_POKABVSP42 KL_TOHKABCGSP42 TO_TSYNHINSYNSSP42 T_RAABVFOLNACHMRSSP42 T_RAABVSP42 T_SYNKABWSSP42 /end DEF_CHARACTERISTIC
/end FUNCTION
/begin FUNCTION jSasKabRSS51_Fktn "Applikationesgroessen Instanz jSasKabRSS51"
 /begin DEF_CHARACTERISTIC KF_PKABFOLSP51 KF_POKABMTCGSP51 KF_TSYNMTNTKABVFOLNACHMRSSP51 KF_TVKABMTNMOTRSSP51 KL_FPOCGHINSYNKABSP51 KL_PGOKABFOLNACHRSSP51 KL_PGRASYNKABFOLNACHRSSP51 KL_PGRASYNKABSP51 KL_PGRASYNKABWSSP51 KL_POKABMDMOTSOLLSP51 KL_POKABNGABSP51 KL_POKABVFOLNACHMRSSP51 KL_POKABVSP51 KL_TOHKABCGSP51 TO_TSYNHINSYNSSP51 T_RAABVFOLNACHMRSSP51 T_RAABVSP51 T_SYNKABWSSP51 /end DEF_CHARACTERISTIC
/end FUNCTION
/begin RECORD_LAYOUT kw_ui8_S6_S3 FNC_VALUES 1 UBYTE COLUMN_DIR DIRECT /end RECORD_LAYOUT
/begin RECORD_LAYOUT kl_ui8_S6_S3 FNC_VALUES 3 UBYTE COLUMN_DIR DIRECT AXIS_PTS_X 2 UBYTE INDEX_INCR DIRECT NO_AXIS_PTS_X 1 ULONG /end RECORD_LAYOUT
/begin RECORD_LAYOUT kl_si16_S6_S3 FNC_VALUES 3 SWORD COLUMN_DIR DIRECT AXIS_PTS_X 2 SWORD INDEX_INCR DIRECT NO_AXIS_PTS_X 1 ULONG /end RECORD_LAYOUT
/begin RECORD_LAYOUT kf_ui8_S6_S3 FNC_VALUES 5 UBYTE ROW_DIR DIRECT AXIS_PTS_X 3 UBYTE INDEX_INCR DIRECT AXIS_PTS_Y 4 UBYTE INDEX_INCR DIRECT NO_AXIS_PTS_X 1 ULONG NO_AXIS_PTS_Y 2 ULONG /end RECORD_LAYOUT
/begin RECORD_LAYOUT kf_si16_S6_S3 FNC_VALUES 5 SWORD ROW_DIR DIRECT AXIS_PTS_X 3 SWORD INDEX_INCR DIRECT AXIS_PTS_Y 4 SWORD INDEX_INCR DIRECT NO_AXIS_PTS_X 1 ULONG NO_AXIS_PTS_Y 2 ULONG /end RECORD_LAYOUT
/end MODULE
/end PROJECT
