ASAP2_VERSION 1 51
/begin PROJECT _929_929 "Gen2_BMW_System_Supplier_Lib"
/begin HEADER "" VERSION "C_03_03" PROJECT_NO _929_929 /end HEADER
/begin MODULE DIM ""
/begin MOD_COMMON "" BYTE_ORDER MSB_FIRST ALIGNMENT_BYTE 1 ALIGNMENT_WORD 2 ALIGNMENT_LONG 4 ALIGNMENT_FLOAT32_IEEE 4 /end MOD_COMMON
/begin MEASUREMENT ZFEH_EepromData.di_obd_iumpr_gen_den "OBD monitoring conditions encountered counts (General Denominator)" UWORD EH_STANDARD_S5_S3 1 100 0 65535 DISPLAY_IDENTIFIER di_obd_iumpr_gen_den.ZFEH_EepromData ECU_ADDRESS 0xFFF832AC /end MEASUREMENT
/begin MEASUREMENT ZFEH_EepromData.di_obd_iumpr_ign_cycle "OBD ignition cycle counter (Number of engine starts)" UWORD EH_STANDARD_S5_S3 1 100 0 65535 DISPLAY_IDENTIFIER di_obd_iumpr_ign_cycle.ZFEH_EepromData ECU_ADDRESS 0xFFF832AE /end MEASUREMENT
/begin MEASUREMENT ZFEH_EepromData.di_obd_iumpr_numerator[0] "error code related numerator [index = KFC-1]" UWORD EH_STANDARD_S5_S3 1 100 0 65535 DISPLAY_IDENTIFIER di_obd_iumpr_numerator[0].ZFEH_EepromData ECU_ADDRESS 0xFFF832B2 /end MEASUREMENT
/begin MEASUREMENT ZFEH_EepromData.di_obd_iumpr_numerator[1] "error code related numerator [index = KFC-1]" UWORD EH_STANDARD_S5_S3 1 100 0 65535 DISPLAY_IDENTIFIER di_obd_iumpr_numerator[1].ZFEH_EepromData ECU_ADDRESS 0xFFF832B4 /end MEASUREMENT
/begin MEASUREMENT ZFEH_EepromData.di_obd_iumpr_numerator[2] "error code related numerator [index = KFC-1]" UWORD EH_STANDARD_S5_S3 1 100 0 65535 DISPLAY_IDENTIFIER di_obd_iumpr_numerator[2].ZFEH_EepromData ECU_ADDRESS 0xFFF832B6 /end MEASUREMENT
/begin MEASUREMENT ZFEH_EepromData.di_obd_iumpr_numerator[3] "error code related numerator [index = KFC-1]" UWORD EH_STANDARD_S5_S3 1 100 0 65535 DISPLAY_IDENTIFIER di_obd_iumpr_numerator[3].ZFEH_EepromData ECU_ADDRESS 0xFFF832B8 /end MEASUREMENT
/begin MEASUREMENT ZFEH_EepromData.di_obd_iumpr_numerator[4] "error code related numerator [index = KFC-1]" UWORD EH_STANDARD_S5_S3 1 100 0 65535 DISPLAY_IDENTIFIER di_obd_iumpr_numerator[4].ZFEH_EepromData ECU_ADDRESS 0xFFF832BA /end MEASUREMENT
/begin MEASUREMENT ZFEH_EepromData.di_obd_iumpr_numerator[5] "error code related numerator [index = KFC-1]" UWORD EH_STANDARD_S5_S3 1 100 0 65535 DISPLAY_IDENTIFIER di_obd_iumpr_numerator[5].ZFEH_EepromData ECU_ADDRESS 0xFFF832BC /end MEASUREMENT
/begin MEASUREMENT ZFEH_EepromData.di_obd_iumpr_numerator[10] "error code related numerator [index = KFC-1]" UWORD EH_STANDARD_S5_S3 1 100 0 65535 DISPLAY_IDENTIFIER di_obd_iumpr_numerator[10].ZFEH_EepromData ECU_ADDRESS 0xFFF832C6 /end MEASUREMENT
/begin MEASUREMENT ZFEH_EepromData.di_obd_iumpr_numerator[11] "error code related numerator [index = KFC-1]" UWORD EH_STANDARD_S5_S3 1 100 0 65535 DISPLAY_IDENTIFIER di_obd_iumpr_numerator[11].ZFEH_EepromData ECU_ADDRESS 0xFFF832C8 /end MEASUREMENT
/begin MEASUREMENT ZFEH_EepromData.di_obd_iumpr_numerator[12] "error code related numerator [index = KFC-1]" UWORD EH_STANDARD_S5_S3 1 100 0 65535 DISPLAY_IDENTIFIER di_obd_iumpr_numerator[12].ZFEH_EepromData ECU_ADDRESS 0xFFF832CA /end MEASUREMENT
/begin MEASUREMENT ZFEH_EepromData.di_obd_iumpr_numerator[13] "error code related numerator [index = KFC-1]" UWORD EH_STANDARD_S5_S3 1 100 0 65535 DISPLAY_IDENTIFIER di_obd_iumpr_numerator[13].ZFEH_EepromData ECU_ADDRESS 0xFFF832CC /end MEASUREMENT
/begin MEASUREMENT ZFEH_EepromData.di_obd_iumpr_numerator[14] "error code related numerator [index = KFC-1]" UWORD EH_STANDARD_S5_S3 1 100 0 65535 DISPLAY_IDENTIFIER di_obd_iumpr_numerator[14].ZFEH_EepromData ECU_ADDRESS 0xFFF832CE /end MEASUREMENT
/begin MEASUREMENT ZFEH_EepromData.di_obd_iumpr_numerator[15] "error code related numerator [index = KFC-1]" UWORD EH_STANDARD_S5_S3 1 100 0 65535 DISPLAY_IDENTIFIER di_obd_iumpr_numerator[15].ZFEH_EepromData ECU_ADDRESS 0xFFF832D0 /end MEASUREMENT
/begin MEASUREMENT ZFEH_EepromData.di_obd_iumpr_numerator[16] "error code related numerator [index = KFC-1]" UWORD EH_STANDARD_S5_S3 1 100 0 65535 DISPLAY_IDENTIFIER di_obd_iumpr_numerator[16].ZFEH_EepromData ECU_ADDRESS 0xFFF832D2 /end MEASUREMENT
/begin MEASUREMENT ZFEH_EepromData.di_obd_iumpr_numerator[17] "error code related numerator [index = KFC-1]" UWORD EH_STANDARD_S5_S3 1 100 0 65535 DISPLAY_IDENTIFIER di_obd_iumpr_numerator[17].ZFEH_EepromData ECU_ADDRESS 0xFFF832D4 /end MEASUREMENT
/begin MEASUREMENT ZFEH_EepromData.di_obd_iumpr_numerator[18] "error code related numerator [index = KFC-1]" UWORD EH_STANDARD_S5_S3 1 100 0 65535 DISPLAY_IDENTIFIER di_obd_iumpr_numerator[18].ZFEH_EepromData ECU_ADDRESS 0xFFF832D6 /end MEASUREMENT
/begin MEASUREMENT ZFEH_EepromData.di_obd_iumpr_numerator[19] "error code related numerator [index = KFC-1]" UWORD EH_STANDARD_S5_S3 1 100 0 65535 DISPLAY_IDENTIFIER di_obd_iumpr_numerator[19].ZFEH_EepromData ECU_ADDRESS 0xFFF832D8 /end MEASUREMENT
/begin MEASUREMENT ZFEH_EepromData.di_obd_iumpr_numerator[20] "error code related numerator [index = KFC-1]" UWORD EH_STANDARD_S5_S3 1 100 0 65535 DISPLAY_IDENTIFIER di_obd_iumpr_numerator[20].ZFEH_EepromData ECU_ADDRESS 0xFFF832DA /end MEASUREMENT
/begin MEASUREMENT ZFEH_EepromData.di_obd_iumpr_numerator[21] "error code related numerator [index = KFC-1]" UWORD EH_STANDARD_S5_S3 1 100 0 65535 DISPLAY_IDENTIFIER di_obd_iumpr_numerator[21].ZFEH_EepromData ECU_ADDRESS 0xFFF832DC /end MEASUREMENT
/begin MEASUREMENT ZFEH_EepromData.di_obd_iumpr_numerator[22] "error code related numerator [index = KFC-1]" UWORD EH_STANDARD_S5_S3 1 100 0 65535 DISPLAY_IDENTIFIER di_obd_iumpr_numerator[22].ZFEH_EepromData ECU_ADDRESS 0xFFF832DE /end MEASUREMENT
/begin MEASUREMENT ZFEH_EepromData.di_obd_iumpr_numerator[23] "error code related numerator [index = KFC-1]" UWORD EH_STANDARD_S5_S3 1 100 0 65535 DISPLAY_IDENTIFIER di_obd_iumpr_numerator[23].ZFEH_EepromData ECU_ADDRESS 0xFFF832E0 /end MEASUREMENT
/begin MEASUREMENT ZFEH_EepromData.di_obd_iumpr_numerator[24] "error code related numerator [index = KFC-1]" UWORD EH_STANDARD_S5_S3 1 100 0 65535 DISPLAY_IDENTIFIER di_obd_iumpr_numerator[24].ZFEH_EepromData ECU_ADDRESS 0xFFF832E2 /end MEASUREMENT
/begin MEASUREMENT ZFEH_EepromData.di_obd_iumpr_numerator[25] "error code related numerator [index = KFC-1]" UWORD EH_STANDARD_S5_S3 1 100 0 65535 DISPLAY_IDENTIFIER di_obd_iumpr_numerator[25].ZFEH_EepromData ECU_ADDRESS 0xFFF832E4 /end MEASUREMENT
/begin MEASUREMENT ZFEH_EepromData.di_obd_iumpr_numerator[26] "error code related numerator [index = KFC-1]" UWORD EH_STANDARD_S5_S3 1 100 0 65535 DISPLAY_IDENTIFIER di_obd_iumpr_numerator[26].ZFEH_EepromData ECU_ADDRESS 0xFFF832E6 /end MEASUREMENT
/begin MEASUREMENT ZFEH_EepromData.di_obd_iumpr_numerator[27] "error code related numerator [index = KFC-1]" UWORD EH_STANDARD_S5_S3 1 100 0 65535 DISPLAY_IDENTIFIER di_obd_iumpr_numerator[27].ZFEH_EepromData ECU_ADDRESS 0xFFF832E8 /end MEASUREMENT
/begin MEASUREMENT ZFEH_EepromData.di_obd_iumpr_numerator[28] "error code related numerator [index = KFC-1]" UWORD EH_STANDARD_S5_S3 1 100 0 65535 DISPLAY_IDENTIFIER di_obd_iumpr_numerator[28].ZFEH_EepromData ECU_ADDRESS 0xFFF832EA /end MEASUREMENT
/begin MEASUREMENT ZFEH_EepromData.di_obd_iumpr_numerator[29] "error code related numerator [index = KFC-1]" UWORD EH_STANDARD_S5_S3 1 100 0 65535 DISPLAY_IDENTIFIER di_obd_iumpr_numerator[29].ZFEH_EepromData ECU_ADDRESS 0xFFF832EC /end MEASUREMENT
/begin MEASUREMENT ZFEH_EepromData.di_obd_iumpr_numerator[30] "error code related numerator [index = KFC-1]" UWORD EH_STANDARD_S5_S3 1 100 0 65535 DISPLAY_IDENTIFIER di_obd_iumpr_numerator[30].ZFEH_EepromData ECU_ADDRESS 0xFFF832EE /end MEASUREMENT
/begin MEASUREMENT ZFEH_EepromData.di_obd_iumpr_numerator[31] "error code related numerator [index = KFC-1]" UWORD EH_STANDARD_S5_S3 1 100 0 65535 DISPLAY_IDENTIFIER di_obd_iumpr_numerator[31].ZFEH_EepromData ECU_ADDRESS 0xFFF832F0 /end MEASUREMENT
/begin MEASUREMENT ZFEH_EepromData.di_obd_iumpr_numerator[32] "error code related numerator [index = KFC-1]" UWORD EH_STANDARD_S5_S3 1 100 0 65535 DISPLAY_IDENTIFIER di_obd_iumpr_numerator[32].ZFEH_EepromData ECU_ADDRESS 0xFFF832F2 /end MEASUREMENT
/begin MEASUREMENT ZFEH_EepromData.di_obd_iumpr_numerator[33] "error code related numerator [index = KFC-1]" UWORD EH_STANDARD_S5_S3 1 100 0 65535 DISPLAY_IDENTIFIER di_obd_iumpr_numerator[33].ZFEH_EepromData ECU_ADDRESS 0xFFF832F4 /end MEASUREMENT
/begin MEASUREMENT ZFEH_EepromData.di_obd_iumpr_numerator[34] "error code related numerator [index = KFC-1]" UWORD EH_STANDARD_S5_S3 1 100 0 65535 DISPLAY_IDENTIFIER di_obd_iumpr_numerator[34].ZFEH_EepromData ECU_ADDRESS 0xFFF832F6 /end MEASUREMENT
/begin MEASUREMENT ZFEH_EepromData.di_obd_iumpr_numerator[35] "error code related numerator [index = KFC-1]" UWORD EH_STANDARD_S5_S3 1 100 0 65535 DISPLAY_IDENTIFIER di_obd_iumpr_numerator[35].ZFEH_EepromData ECU_ADDRESS 0xFFF832F8 /end MEASUREMENT
/begin MEASUREMENT ZFEH_EepromData.di_obd_iumpr_numerator[36] "error code related numerator [index = KFC-1]" UWORD EH_STANDARD_S5_S3 1 100 0 65535 DISPLAY_IDENTIFIER di_obd_iumpr_numerator[36].ZFEH_EepromData ECU_ADDRESS 0xFFF832FA /end MEASUREMENT
/begin MEASUREMENT ZFEH_EepromData.di_obd_iumpr_numerator[37] "error code related numerator [index = KFC-1]" UWORD EH_STANDARD_S5_S3 1 100 0 65535 DISPLAY_IDENTIFIER di_obd_iumpr_numerator[37].ZFEH_EepromData ECU_ADDRESS 0xFFF832FC /end MEASUREMENT
/begin MEASUREMENT ZFEH_EepromData.di_obd_iumpr_numerator[38] "error code related numerator [index = KFC-1]" UWORD EH_STANDARD_S5_S3 1 100 0 65535 DISPLAY_IDENTIFIER di_obd_iumpr_numerator[38].ZFEH_EepromData ECU_ADDRESS 0xFFF832FE /end MEASUREMENT
/begin MEASUREMENT ZFEH_EepromData.di_obd_iumpr_numerator[39] "error code related numerator [index = KFC-1]" UWORD EH_STANDARD_S5_S3 1 100 0 65535 DISPLAY_IDENTIFIER di_obd_iumpr_numerator[39].ZFEH_EepromData ECU_ADDRESS 0xFFF83300 /end MEASUREMENT
/begin MEASUREMENT ZFEH_EepromData.di_obd_iumpr_numerator[40] "error code related numerator [index = KFC-1]" UWORD EH_STANDARD_S5_S3 1 100 0 65535 DISPLAY_IDENTIFIER di_obd_iumpr_numerator[40].ZFEH_EepromData ECU_ADDRESS 0xFFF83302 /end MEASUREMENT
/begin MEASUREMENT ZFEH_EepromData.di_obd_iumpr_numerator[41] "error code related numerator [index = KFC-1]" UWORD EH_STANDARD_S5_S3 1 100 0 65535 DISPLAY_IDENTIFIER di_obd_iumpr_numerator[41].ZFEH_EepromData ECU_ADDRESS 0xFFF83304 /end MEASUREMENT
/begin MEASUREMENT ZFEH_EepromData.di_obd_iumpr_numerator[42] "error code related numerator [index = KFC-1]" UWORD EH_STANDARD_S5_S3 1 100 0 65535 DISPLAY_IDENTIFIER di_obd_iumpr_numerator[42].ZFEH_EepromData ECU_ADDRESS 0xFFF83306 /end MEASUREMENT
/begin MEASUREMENT ZFEH_EepromData.di_obd_iumpr_numerator[43] "error code related numerator [index = KFC-1]" UWORD EH_STANDARD_S5_S3 1 100 0 65535 DISPLAY_IDENTIFIER di_obd_iumpr_numerator[43].ZFEH_EepromData ECU_ADDRESS 0xFFF83308 /end MEASUREMENT
/begin MEASUREMENT ZFEH_EepromData.di_obd_iumpr_numerator[44] "error code related numerator [index = KFC-1]" UWORD EH_STANDARD_S5_S3 1 100 0 65535 DISPLAY_IDENTIFIER di_obd_iumpr_numerator[44].ZFEH_EepromData ECU_ADDRESS 0xFFF8330A /end MEASUREMENT
/begin MEASUREMENT ZFEH_EepromData.di_obd_iumpr_numerator[45] "error code related numerator [index = KFC-1]" UWORD EH_STANDARD_S5_S3 1 100 0 65535 DISPLAY_IDENTIFIER di_obd_iumpr_numerator[45].ZFEH_EepromData ECU_ADDRESS 0xFFF8330C /end MEASUREMENT
/begin MEASUREMENT ZFEH_EepromData.di_obd_iumpr_numerator[46] "error code related numerator [index = KFC-1]" UWORD EH_STANDARD_S5_S3 1 100 0 65535 DISPLAY_IDENTIFIER di_obd_iumpr_numerator[46].ZFEH_EepromData ECU_ADDRESS 0xFFF8330E /end MEASUREMENT
/begin MEASUREMENT ZFEH_EepromData.di_obd_iumpr_numerator[47] "error code related numerator [index = KFC-1]" UWORD EH_STANDARD_S5_S3 1 100 0 65535 DISPLAY_IDENTIFIER di_obd_iumpr_numerator[47].ZFEH_EepromData ECU_ADDRESS 0xFFF83310 /end MEASUREMENT
/begin MEASUREMENT ZFEH_EepromData.di_obd_iumpr_numerator[48] "error code related numerator [index = KFC-1]" UWORD EH_STANDARD_S5_S3 1 100 0 65535 DISPLAY_IDENTIFIER di_obd_iumpr_numerator[48].ZFEH_EepromData ECU_ADDRESS 0xFFF83312 /end MEASUREMENT
/begin MEASUREMENT ZFEH_EepromData.di_obd_iumpr_numerator[49] "error code related numerator [index = KFC-1]" UWORD EH_STANDARD_S5_S3 1 100 0 65535 DISPLAY_IDENTIFIER di_obd_iumpr_numerator[49].ZFEH_EepromData ECU_ADDRESS 0xFFF83314 /end MEASUREMENT
/begin MEASUREMENT ZFEH_EepromData.di_obd_iumpr_numerator[50] "error code related numerator [index = KFC-1]" UWORD EH_STANDARD_S5_S3 1 100 0 65535 DISPLAY_IDENTIFIER di_obd_iumpr_numerator[50].ZFEH_EepromData ECU_ADDRESS 0xFFF83316 /end MEASUREMENT
/begin MEASUREMENT ZFEH_EepromData.di_obd_iumpr_numerator[51] "error code related numerator [index = KFC-1]" UWORD EH_STANDARD_S5_S3 1 100 0 65535 DISPLAY_IDENTIFIER di_obd_iumpr_numerator[51].ZFEH_EepromData ECU_ADDRESS 0xFFF83318 /end MEASUREMENT
/begin MEASUREMENT ZFEH_EepromData.di_obd_iumpr_numerator[52] "error code related numerator [index = KFC-1]" UWORD EH_STANDARD_S5_S3 1 100 0 65535 DISPLAY_IDENTIFIER di_obd_iumpr_numerator[52].ZFEH_EepromData ECU_ADDRESS 0xFFF8331A /end MEASUREMENT
/begin MEASUREMENT ZFEH_EepromData.di_obd_iumpr_numerator[53] "error code related numerator [index = KFC-1]" UWORD EH_STANDARD_S5_S3 1 100 0 65535 DISPLAY_IDENTIFIER di_obd_iumpr_numerator[53].ZFEH_EepromData ECU_ADDRESS 0xFFF8331C /end MEASUREMENT
/begin MEASUREMENT ZFEH_EepromData.di_obd_iumpr_numerator[54] "error code related numerator [index = KFC-1]" UWORD EH_STANDARD_S5_S3 1 100 0 65535 DISPLAY_IDENTIFIER di_obd_iumpr_numerator[54].ZFEH_EepromData ECU_ADDRESS 0xFFF8331E /end MEASUREMENT
/begin MEASUREMENT ZFEH_EepromData.di_obd_iumpr_numerator[55] "error code related numerator [index = KFC-1]" UWORD EH_STANDARD_S5_S3 1 100 0 65535 DISPLAY_IDENTIFIER di_obd_iumpr_numerator[55].ZFEH_EepromData ECU_ADDRESS 0xFFF83320 /end MEASUREMENT
/begin MEASUREMENT ZFEH_EepromData.di_obd_iumpr_numerator[56] "error code related numerator [index = KFC-1]" UWORD EH_STANDARD_S5_S3 1 100 0 65535 DISPLAY_IDENTIFIER di_obd_iumpr_numerator[56].ZFEH_EepromData ECU_ADDRESS 0xFFF83322 /end MEASUREMENT
/begin MEASUREMENT ZFEH_EepromData.di_obd_iumpr_numerator[57] "error code related numerator [index = KFC-1]" UWORD EH_STANDARD_S5_S3 1 100 0 65535 DISPLAY_IDENTIFIER di_obd_iumpr_numerator[57].ZFEH_EepromData ECU_ADDRESS 0xFFF83324 /end MEASUREMENT
/begin MEASUREMENT ZFEH_EepromData.di_obd_iumpr_numerator[58] "error code related numerator [index = KFC-1]" UWORD EH_STANDARD_S5_S3 1 100 0 65535 DISPLAY_IDENTIFIER di_obd_iumpr_numerator[58].ZFEH_EepromData ECU_ADDRESS 0xFFF83326 /end MEASUREMENT
/begin MEASUREMENT ZFEH_EepromData.di_obd_iumpr_numerator[59] "error code related numerator [index = KFC-1]" UWORD EH_STANDARD_S5_S3 1 100 0 65535 DISPLAY_IDENTIFIER di_obd_iumpr_numerator[59].ZFEH_EepromData ECU_ADDRESS 0xFFF83328 /end MEASUREMENT
/begin MEASUREMENT ZFEH_EepromData.di_obd_iumpr_numerator[60] "error code related numerator [index = KFC-1]" UWORD EH_STANDARD_S5_S3 1 100 0 65535 DISPLAY_IDENTIFIER di_obd_iumpr_numerator[60].ZFEH_EepromData ECU_ADDRESS 0xFFF8332A /end MEASUREMENT
/begin MEASUREMENT ZFEH_EepromData.di_obd_iumpr_numerator[61] "error code related numerator [index = KFC-1]" UWORD EH_STANDARD_S5_S3 1 100 0 65535 DISPLAY_IDENTIFIER di_obd_iumpr_numerator[61].ZFEH_EepromData ECU_ADDRESS 0xFFF8332C /end MEASUREMENT
/begin MEASUREMENT ZFEH_EepromData.di_obd_iumpr_numerator[62] "error code related numerator [index = KFC-1]" UWORD EH_STANDARD_S5_S3 1 100 0 65535 DISPLAY_IDENTIFIER di_obd_iumpr_numerator[62].ZFEH_EepromData ECU_ADDRESS 0xFFF8332E /end MEASUREMENT
/begin MEASUREMENT ZFEH_EepromData.di_obd_iumpr_numerator[63] "error code related numerator [index = KFC-1]" UWORD EH_STANDARD_S5_S3 1 100 0 65535 DISPLAY_IDENTIFIER di_obd_iumpr_numerator[63].ZFEH_EepromData ECU_ADDRESS 0xFFF83330 /end MEASUREMENT
/begin MEASUREMENT ZFEH_EepromData.di_obd_iumpr_numerator[64] "error code related numerator [index = KFC-1]" UWORD EH_STANDARD_S5_S3 1 100 0 65535 DISPLAY_IDENTIFIER di_obd_iumpr_numerator[64].ZFEH_EepromData ECU_ADDRESS 0xFFF83332 /end MEASUREMENT
/begin MEASUREMENT ZFEH_EepromData.di_obd_iumpr_numerator[65] "error code related numerator [index = KFC-1]" UWORD EH_STANDARD_S5_S3 1 100 0 65535 DISPLAY_IDENTIFIER di_obd_iumpr_numerator[65].ZFEH_EepromData ECU_ADDRESS 0xFFF83334 /end MEASUREMENT
/begin MEASUREMENT ZFEH_EepromData.di_obd_iumpr_numerator[66] "error code related numerator [index = KFC-1]" UWORD EH_STANDARD_S5_S3 1 100 0 65535 DISPLAY_IDENTIFIER di_obd_iumpr_numerator[66].ZFEH_EepromData ECU_ADDRESS 0xFFF83336 /end MEASUREMENT
/begin MEASUREMENT ZFEH_EepromData.di_obd_iumpr_numerator[67] "error code related numerator [index = KFC-1]" UWORD EH_STANDARD_S5_S3 1 100 0 65535 DISPLAY_IDENTIFIER di_obd_iumpr_numerator[67].ZFEH_EepromData ECU_ADDRESS 0xFFF83338 /end MEASUREMENT
/begin MEASUREMENT ZFEH_EepromData.di_obd_iumpr_numerator[68] "error code related numerator [index = KFC-1]" UWORD EH_STANDARD_S5_S3 1 100 0 65535 DISPLAY_IDENTIFIER di_obd_iumpr_numerator[68].ZFEH_EepromData ECU_ADDRESS 0xFFF8333A /end MEASUREMENT
/begin MEASUREMENT ZFEH_EepromData.di_obd_iumpr_numerator[100] "error code related numerator [index = KFC-1]" UWORD EH_STANDARD_S5_S3 1 100 0 65535 DISPLAY_IDENTIFIER di_obd_iumpr_numerator[100].ZFEH_EepromData ECU_ADDRESS 0xFFF8337A /end MEASUREMENT
/begin MEASUREMENT ZFEH_EepromData.di_obd_iumpr_numerator[101] "error code related numerator [index = KFC-1]" UWORD EH_STANDARD_S5_S3 1 100 0 65535 DISPLAY_IDENTIFIER di_obd_iumpr_numerator[101].ZFEH_EepromData ECU_ADDRESS 0xFFF8337C /end MEASUREMENT
/begin MEASUREMENT ZFEH_EepromData.di_obd_iumpr_numerator[102] "error code related numerator [index = KFC-1]" UWORD EH_STANDARD_S5_S3 1 100 0 65535 DISPLAY_IDENTIFIER di_obd_iumpr_numerator[102].ZFEH_EepromData ECU_ADDRESS 0xFFF8337E /end MEASUREMENT
/begin MEASUREMENT ZFEH_EepromData.di_obd_iumpr_numerator[103] "error code related numerator [index = KFC-1]" UWORD EH_STANDARD_S5_S3 1 100 0 65535 DISPLAY_IDENTIFIER di_obd_iumpr_numerator[103].ZFEH_EepromData ECU_ADDRESS 0xFFF83380 /end MEASUREMENT
/begin MEASUREMENT ZFEH_EepromData.di_obd_iumpr_numerator[104] "error code related numerator [index = KFC-1]" UWORD EH_STANDARD_S5_S3 1 100 0 65535 DISPLAY_IDENTIFIER di_obd_iumpr_numerator[104].ZFEH_EepromData ECU_ADDRESS 0xFFF83382 /end MEASUREMENT
/begin MEASUREMENT ZFEH_EepromData.di_obd_iumpr_numerator[105] "error code related numerator [index = KFC-1]" UWORD EH_STANDARD_S5_S3 1 100 0 65535 DISPLAY_IDENTIFIER di_obd_iumpr_numerator[105].ZFEH_EepromData ECU_ADDRESS 0xFFF83384 /end MEASUREMENT
/begin MEASUREMENT ZFEH_EepromData.di_obd_iumpr_numerator[106] "error code related numerator [index = KFC-1]" UWORD EH_STANDARD_S5_S3 1 100 0 65535 DISPLAY_IDENTIFIER di_obd_iumpr_numerator[106].ZFEH_EepromData ECU_ADDRESS 0xFFF83386 /end MEASUREMENT
/begin MEASUREMENT ZFEH_EepromData.di_obd_iumpr_numerator[107] "error code related numerator [index = KFC-1]" UWORD EH_STANDARD_S5_S3 1 100 0 65535 DISPLAY_IDENTIFIER di_obd_iumpr_numerator[107].ZFEH_EepromData ECU_ADDRESS 0xFFF83388 /end MEASUREMENT
/begin MEASUREMENT ZFEH_EepromData.di_obd_iumpr_numerator[108] "error code related numerator [index = KFC-1]" UWORD EH_STANDARD_S5_S3 1 100 0 65535 DISPLAY_IDENTIFIER di_obd_iumpr_numerator[108].ZFEH_EepromData ECU_ADDRESS 0xFFF8338A /end MEASUREMENT
/begin MEASUREMENT ZFEH_EepromData.di_obd_iumpr_numerator[109] "error code related numerator [index = KFC-1]" UWORD EH_STANDARD_S5_S3 1 100 0 65535 DISPLAY_IDENTIFIER di_obd_iumpr_numerator[109].ZFEH_EepromData ECU_ADDRESS 0xFFF8338C /end MEASUREMENT
/begin MEASUREMENT ZFEH_EepromData.di_obd_iumpr_numerator[110] "error code related numerator [index = KFC-1]" UWORD EH_STANDARD_S5_S3 1 100 0 65535 DISPLAY_IDENTIFIER di_obd_iumpr_numerator[110].ZFEH_EepromData ECU_ADDRESS 0xFFF8338E /end MEASUREMENT
/begin MEASUREMENT ZFEH_EepromData.di_obd_iumpr_numerator[111] "error code related numerator [index = KFC-1]" UWORD EH_STANDARD_S5_S3 1 100 0 65535 DISPLAY_IDENTIFIER di_obd_iumpr_numerator[111].ZFEH_EepromData ECU_ADDRESS 0xFFF83390 /end MEASUREMENT
/begin MEASUREMENT ZFEH_EepromData.di_obd_iumpr_numerator[112] "error code related numerator [index = KFC-1]" UWORD EH_STANDARD_S5_S3 1 100 0 65535 DISPLAY_IDENTIFIER di_obd_iumpr_numerator[112].ZFEH_EepromData ECU_ADDRESS 0xFFF83392 /end MEASUREMENT
/begin MEASUREMENT ZFEH_EepromData.di_obd_iumpr_numerator[113] "error code related numerator [index = KFC-1]" UWORD EH_STANDARD_S5_S3 1 100 0 65535 DISPLAY_IDENTIFIER di_obd_iumpr_numerator[113].ZFEH_EepromData ECU_ADDRESS 0xFFF83394 /end MEASUREMENT
/begin MEASUREMENT ZFEH_EepromData.di_obd_iumpr_numerator[114] "error code related numerator [index = KFC-1]" UWORD EH_STANDARD_S5_S3 1 100 0 65535 DISPLAY_IDENTIFIER di_obd_iumpr_numerator[114].ZFEH_EepromData ECU_ADDRESS 0xFFF83396 /end MEASUREMENT
/begin MEASUREMENT ZFEH_EepromData.di_obd_iumpr_numerator[115] "error code related numerator [index = KFC-1]" UWORD EH_STANDARD_S5_S3 1 100 0 65535 DISPLAY_IDENTIFIER di_obd_iumpr_numerator[115].ZFEH_EepromData ECU_ADDRESS 0xFFF83398 /end MEASUREMENT
/begin MEASUREMENT ZFEH_EepromData.di_obd_iumpr_numerator[116] "error code related numerator [index = KFC-1]" UWORD EH_STANDARD_S5_S3 1 100 0 65535 DISPLAY_IDENTIFIER di_obd_iumpr_numerator[116].ZFEH_EepromData ECU_ADDRESS 0xFFF8339A /end MEASUREMENT
/begin MEASUREMENT ZFEH_EepromData.di_obd_iumpr_numerator[117] "error code related numerator [index = KFC-1]" UWORD EH_STANDARD_S5_S3 1 100 0 65535 DISPLAY_IDENTIFIER di_obd_iumpr_numerator[117].ZFEH_EepromData ECU_ADDRESS 0xFFF8339C /end MEASUREMENT
/begin MEASUREMENT ZFEH_EepromData.di_obd_iumpr_numerator[118] "error code related numerator [index = KFC-1]" UWORD EH_STANDARD_S5_S3 1 100 0 65535 DISPLAY_IDENTIFIER di_obd_iumpr_numerator[118].ZFEH_EepromData ECU_ADDRESS 0xFFF8339E /end MEASUREMENT
/begin MEASUREMENT ZFEH_EepromData.di_obd_iumpr_numerator[119] "error code related numerator [index = KFC-1]" UWORD EH_STANDARD_S5_S3 1 100 0 65535 DISPLAY_IDENTIFIER di_obd_iumpr_numerator[119].ZFEH_EepromData ECU_ADDRESS 0xFFF833A0 /end MEASUREMENT
/begin MEASUREMENT ZFEH_EepromData.di_obd_iumpr_numerator[120] "error code related numerator [index = KFC-1]" UWORD EH_STANDARD_S5_S3 1 100 0 65535 DISPLAY_IDENTIFIER di_obd_iumpr_numerator[120].ZFEH_EepromData ECU_ADDRESS 0xFFF833A2 /end MEASUREMENT
/begin MEASUREMENT ZFEH_EepromData.di_obd_iumpr_numerator[121] "error code related numerator [index = KFC-1]" UWORD EH_STANDARD_S5_S3 1 100 0 65535 DISPLAY_IDENTIFIER di_obd_iumpr_numerator[121].ZFEH_EepromData ECU_ADDRESS 0xFFF833A4 /end MEASUREMENT
/begin MEASUREMENT ZFEH_EepromData.di_obd_iumpr_numerator[122] "error code related numerator [index = KFC-1]" UWORD EH_STANDARD_S5_S3 1 100 0 65535 DISPLAY_IDENTIFIER di_obd_iumpr_numerator[122].ZFEH_EepromData ECU_ADDRESS 0xFFF833A6 /end MEASUREMENT
/begin MEASUREMENT ZFEH_EepromData.di_obd_iumpr_numerator[123] "error code related numerator [index = KFC-1]" UWORD EH_STANDARD_S5_S3 1 100 0 65535 DISPLAY_IDENTIFIER di_obd_iumpr_numerator[123].ZFEH_EepromData ECU_ADDRESS 0xFFF833A8 /end MEASUREMENT
/begin MEASUREMENT ZFEH_EepromData.di_obd_iumpr_numerator[124] "error code related numerator [index = KFC-1]" UWORD EH_STANDARD_S5_S3 1 100 0 65535 DISPLAY_IDENTIFIER di_obd_iumpr_numerator[124].ZFEH_EepromData ECU_ADDRESS 0xFFF833AA /end MEASUREMENT
/begin MEASUREMENT ZFEH_EepromData.di_obd_iumpr_numerator[125] "error code related numerator [index = KFC-1]" UWORD EH_STANDARD_S5_S3 1 100 0 65535 DISPLAY_IDENTIFIER di_obd_iumpr_numerator[125].ZFEH_EepromData ECU_ADDRESS 0xFFF833AC /end MEASUREMENT
/begin MEASUREMENT ZFEH_EepromData.di_obd_iumpr_numerator[126] "error code related numerator [index = KFC-1]" UWORD EH_STANDARD_S5_S3 1 100 0 65535 DISPLAY_IDENTIFIER di_obd_iumpr_numerator[126].ZFEH_EepromData ECU_ADDRESS 0xFFF833AE /end MEASUREMENT
/begin MEASUREMENT ZFEH_EepromData.di_obd_iumpr_numerator[127] "error code related numerator [index = KFC-1]" UWORD EH_STANDARD_S5_S3 1 100 0 65535 DISPLAY_IDENTIFIER di_obd_iumpr_numerator[127].ZFEH_EepromData ECU_ADDRESS 0xFFF833B0 /end MEASUREMENT
/begin MEASUREMENT ZFEH_EepromData.di_obd_iumpr_numerator[128] "error code related numerator [index = KFC-1]" UWORD EH_STANDARD_S5_S3 1 100 0 65535 DISPLAY_IDENTIFIER di_obd_iumpr_numerator[128].ZFEH_EepromData ECU_ADDRESS 0xFFF833B2 /end MEASUREMENT
/begin MEASUREMENT ZFEH_EepromData.di_obd_iumpr_numerator[129] "error code related numerator [index = KFC-1]" UWORD EH_STANDARD_S5_S3 1 100 0 65535 DISPLAY_IDENTIFIER di_obd_iumpr_numerator[129].ZFEH_EepromData ECU_ADDRESS 0xFFF833B4 /end MEASUREMENT
/begin MEASUREMENT ZFEH_EepromData.di_obd_iumpr_numerator[130] "error code related numerator [index = KFC-1]" UWORD EH_STANDARD_S5_S3 1 100 0 65535 DISPLAY_IDENTIFIER di_obd_iumpr_numerator[130].ZFEH_EepromData ECU_ADDRESS 0xFFF833B6 /end MEASUREMENT
/begin MEASUREMENT ZFEH_EepromData.di_obd_iumpr_numerator[131] "error code related numerator [index = KFC-1]" UWORD EH_STANDARD_S5_S3 1 100 0 65535 DISPLAY_IDENTIFIER di_obd_iumpr_numerator[131].ZFEH_EepromData ECU_ADDRESS 0xFFF833B8 /end MEASUREMENT
/begin MEASUREMENT ZFEH_EepromData.di_obd_iumpr_numerator[132] "error code related numerator [index = KFC-1]" UWORD EH_STANDARD_S5_S3 1 100 0 65535 DISPLAY_IDENTIFIER di_obd_iumpr_numerator[132].ZFEH_EepromData ECU_ADDRESS 0xFFF833BA /end MEASUREMENT
/begin MEASUREMENT ZFEH_EepromData.di_obd_iumpr_numerator[133] "error code related numerator [index = KFC-1]" UWORD EH_STANDARD_S5_S3 1 100 0 65535 DISPLAY_IDENTIFIER di_obd_iumpr_numerator[133].ZFEH_EepromData ECU_ADDRESS 0xFFF833BC /end MEASUREMENT
/begin MEASUREMENT ZFEH_EepromData.di_obd_iumpr_numerator[134] "error code related numerator [index = KFC-1]" UWORD EH_STANDARD_S5_S3 1 100 0 65535 DISPLAY_IDENTIFIER di_obd_iumpr_numerator[134].ZFEH_EepromData ECU_ADDRESS 0xFFF833BE /end MEASUREMENT
/begin MEASUREMENT ZFEH_EepromData.di_obd_iumpr_numerator[135] "error code related numerator [index = KFC-1]" UWORD EH_STANDARD_S5_S3 1 100 0 65535 DISPLAY_IDENTIFIER di_obd_iumpr_numerator[135].ZFEH_EepromData ECU_ADDRESS 0xFFF833C0 /end MEASUREMENT
/begin MEASUREMENT ZFEH_EepromData.di_obd_iumpr_numerator[136] "error code related numerator [index = KFC-1]" UWORD EH_STANDARD_S5_S3 1 100 0 65535 DISPLAY_IDENTIFIER di_obd_iumpr_numerator[136].ZFEH_EepromData ECU_ADDRESS 0xFFF833C2 /end MEASUREMENT
/begin MEASUREMENT ZFEH_EepromData.di_obd_iumpr_numerator[137] "error code related numerator [index = KFC-1]" UWORD EH_STANDARD_S5_S3 1 100 0 65535 DISPLAY_IDENTIFIER di_obd_iumpr_numerator[137].ZFEH_EepromData ECU_ADDRESS 0xFFF833C4 /end MEASUREMENT
/begin MEASUREMENT ZFEH_EepromData.di_obd_iumpr_numerator[138] "error code related numerator [index = KFC-1]" UWORD EH_STANDARD_S5_S3 1 100 0 65535 DISPLAY_IDENTIFIER di_obd_iumpr_numerator[138].ZFEH_EepromData ECU_ADDRESS 0xFFF833C6 /end MEASUREMENT
/begin MEASUREMENT ZFEH_EepromData.di_obd_iumpr_numerator[139] "error code related numerator [index = KFC-1]" UWORD EH_STANDARD_S5_S3 1 100 0 65535 DISPLAY_IDENTIFIER di_obd_iumpr_numerator[139].ZFEH_EepromData ECU_ADDRESS 0xFFF833C8 /end MEASUREMENT
/begin MEASUREMENT ZFEH_EepromData.di_obd_iumpr_numerator[140] "error code related numerator [index = KFC-1]" UWORD EH_STANDARD_S5_S3 1 100 0 65535 DISPLAY_IDENTIFIER di_obd_iumpr_numerator[140].ZFEH_EepromData ECU_ADDRESS 0xFFF833CA /end MEASUREMENT
/begin MEASUREMENT ZFEH_EepromData.di_obd_iumpr_numerator[141] "error code related numerator [index = KFC-1]" UWORD EH_STANDARD_S5_S3 1 100 0 65535 DISPLAY_IDENTIFIER di_obd_iumpr_numerator[141].ZFEH_EepromData ECU_ADDRESS 0xFFF833CC /end MEASUREMENT
/begin MEASUREMENT ZFEH_EepromData.di_obd_iumpr_numerator[142] "error code related numerator [index = KFC-1]" UWORD EH_STANDARD_S5_S3 1 100 0 65535 DISPLAY_IDENTIFIER di_obd_iumpr_numerator[142].ZFEH_EepromData ECU_ADDRESS 0xFFF833CE /end MEASUREMENT
/begin MEASUREMENT ZFEH_EepromData.di_obd_iumpr_numerator[143] "error code related numerator [index = KFC-1]" UWORD EH_STANDARD_S5_S3 1 100 0 65535 DISPLAY_IDENTIFIER di_obd_iumpr_numerator[143].ZFEH_EepromData ECU_ADDRESS 0xFFF833D0 /end MEASUREMENT
/begin MEASUREMENT ZFEH_EepromData.di_obd_iumpr_numerator[144] "error code related numerator [index = KFC-1]" UWORD EH_STANDARD_S5_S3 1 100 0 65535 DISPLAY_IDENTIFIER di_obd_iumpr_numerator[144].ZFEH_EepromData ECU_ADDRESS 0xFFF833D2 /end MEASUREMENT
/begin MEASUREMENT ZFEH_EepromData.di_obd_iumpr_numerator[145] "error code related numerator [index = KFC-1]" UWORD EH_STANDARD_S5_S3 1 100 0 65535 DISPLAY_IDENTIFIER di_obd_iumpr_numerator[145].ZFEH_EepromData ECU_ADDRESS 0xFFF833D4 /end MEASUREMENT
/begin MEASUREMENT ZFEH_EepromData.di_obd_iumpr_numerator[146] "error code related numerator [index = KFC-1]" UWORD EH_STANDARD_S5_S3 1 100 0 65535 DISPLAY_IDENTIFIER di_obd_iumpr_numerator[146].ZFEH_EepromData ECU_ADDRESS 0xFFF833D6 /end MEASUREMENT
/begin MEASUREMENT ZFEH_EepromData.di_obd_iumpr_numerator[147] "error code related numerator [index = KFC-1]" UWORD EH_STANDARD_S5_S3 1 100 0 65535 DISPLAY_IDENTIFIER di_obd_iumpr_numerator[147].ZFEH_EepromData ECU_ADDRESS 0xFFF833D8 /end MEASUREMENT
/begin MEASUREMENT ZFEH_EepromData.di_obd_iumpr_numerator[148] "error code related numerator [index = KFC-1]" UWORD EH_STANDARD_S5_S3 1 100 0 65535 DISPLAY_IDENTIFIER di_obd_iumpr_numerator[148].ZFEH_EepromData ECU_ADDRESS 0xFFF833DA /end MEASUREMENT
/begin MEASUREMENT ZFEH_EepromData.di_obd_iumpr_numerator[149] "error code related numerator [index = KFC-1]" UWORD EH_STANDARD_S5_S3 1 100 0 65535 DISPLAY_IDENTIFIER di_obd_iumpr_numerator[149].ZFEH_EepromData ECU_ADDRESS 0xFFF833DC /end MEASUREMENT
/begin MEASUREMENT ZFEH_EepromData.di_obd_iumpr_numerator[150] "error code related numerator [index = KFC-1]" UWORD EH_STANDARD_S5_S3 1 100 0 65535 DISPLAY_IDENTIFIER di_obd_iumpr_numerator[150].ZFEH_EepromData ECU_ADDRESS 0xFFF833DE /end MEASUREMENT
/begin MEASUREMENT ZFEH_EepromData.di_obd_iumpr_numerator[151] "error code related numerator [index = KFC-1]" UWORD EH_STANDARD_S5_S3 1 100 0 65535 DISPLAY_IDENTIFIER di_obd_iumpr_numerator[151].ZFEH_EepromData ECU_ADDRESS 0xFFF833E0 /end MEASUREMENT
/begin MEASUREMENT ZFEH_EepromData.di_obd_iumpr_numerator[152] "error code related numerator [index = KFC-1]" UWORD EH_STANDARD_S5_S3 1 100 0 65535 DISPLAY_IDENTIFIER di_obd_iumpr_numerator[152].ZFEH_EepromData ECU_ADDRESS 0xFFF833E2 /end MEASUREMENT
/begin MEASUREMENT ZFEH_EepromData.di_obd_iumpr_numerator[153] "error code related numerator [index = KFC-1]" UWORD EH_STANDARD_S5_S3 1 100 0 65535 DISPLAY_IDENTIFIER di_obd_iumpr_numerator[153].ZFEH_EepromData ECU_ADDRESS 0xFFF833E4 /end MEASUREMENT
/begin MEASUREMENT ZFEH_EepromData.di_obd_iumpr_numerator[154] "error code related numerator [index = KFC-1]" UWORD EH_STANDARD_S5_S3 1 100 0 65535 DISPLAY_IDENTIFIER di_obd_iumpr_numerator[154].ZFEH_EepromData ECU_ADDRESS 0xFFF833E6 /end MEASUREMENT
/begin MEASUREMENT ZFEH_EepromData.di_obd_iumpr_numerator[155] "error code related numerator [index = KFC-1]" UWORD EH_STANDARD_S5_S3 1 100 0 65535 DISPLAY_IDENTIFIER di_obd_iumpr_numerator[155].ZFEH_EepromData ECU_ADDRESS 0xFFF833E8 /end MEASUREMENT
/begin MEASUREMENT ZFEH_EepromData.di_obd_iumpr_numerator[156] "error code related numerator [index = KFC-1]" UWORD EH_STANDARD_S5_S3 1 100 0 65535 DISPLAY_IDENTIFIER di_obd_iumpr_numerator[156].ZFEH_EepromData ECU_ADDRESS 0xFFF833EA /end MEASUREMENT
/begin MEASUREMENT ZFEH_EepromData.di_obd_iumpr_numerator[157] "error code related numerator [index = KFC-1]" UWORD EH_STANDARD_S5_S3 1 100 0 65535 DISPLAY_IDENTIFIER di_obd_iumpr_numerator[157].ZFEH_EepromData ECU_ADDRESS 0xFFF833EC /end MEASUREMENT
/begin MEASUREMENT ZFEH_EepromData.di_obd_iumpr_numerator[158] "error code related numerator [index = KFC-1]" UWORD EH_STANDARD_S5_S3 1 100 0 65535 DISPLAY_IDENTIFIER di_obd_iumpr_numerator[158].ZFEH_EepromData ECU_ADDRESS 0xFFF833EE /end MEASUREMENT
/begin MEASUREMENT ZFEH_EepromData.di_obd_iumpr_numerator[159] "error code related numerator [index = KFC-1]" UWORD EH_STANDARD_S5_S3 1 100 0 65535 DISPLAY_IDENTIFIER di_obd_iumpr_numerator[159].ZFEH_EepromData ECU_ADDRESS 0xFFF833F0 /end MEASUREMENT
/begin MEASUREMENT ZFEH_EepromData.di_obd_iumpr_numerator[160] "error code related numerator [index = KFC-1]" UWORD EH_STANDARD_S5_S3 1 100 0 65535 DISPLAY_IDENTIFIER di_obd_iumpr_numerator[160].ZFEH_EepromData ECU_ADDRESS 0xFFF833F2 /end MEASUREMENT
/begin MEASUREMENT ZFEH_EepromData.di_obd_iumpr_numerator[161] "error code related numerator [index = KFC-1]" UWORD EH_STANDARD_S5_S3 1 100 0 65535 DISPLAY_IDENTIFIER di_obd_iumpr_numerator[161].ZFEH_EepromData ECU_ADDRESS 0xFFF833F4 /end MEASUREMENT
/begin MEASUREMENT ZFEH_EepromData.di_obd_iumpr_numerator[162] "error code related numerator [index = KFC-1]" UWORD EH_STANDARD_S5_S3 1 100 0 65535 DISPLAY_IDENTIFIER di_obd_iumpr_numerator[162].ZFEH_EepromData ECU_ADDRESS 0xFFF833F6 /end MEASUREMENT
/begin MEASUREMENT ZFEH_EepromData.di_obd_iumpr_numerator[163] "error code related numerator [index = KFC-1]" UWORD EH_STANDARD_S5_S3 1 100 0 65535 DISPLAY_IDENTIFIER di_obd_iumpr_numerator[163].ZFEH_EepromData ECU_ADDRESS 0xFFF833F8 /end MEASUREMENT
/begin MEASUREMENT ZFEH_EepromData.di_obd_iumpr_numerator[164] "error code related numerator [index = KFC-1]" UWORD EH_STANDARD_S5_S3 1 100 0 65535 DISPLAY_IDENTIFIER di_obd_iumpr_numerator[164].ZFEH_EepromData ECU_ADDRESS 0xFFF833FA /end MEASUREMENT
/begin MEASUREMENT ZFEH_EepromData.di_obd_iumpr_numerator[165] "error code related numerator [index = KFC-1]" UWORD EH_STANDARD_S5_S3 1 100 0 65535 DISPLAY_IDENTIFIER di_obd_iumpr_numerator[165].ZFEH_EepromData ECU_ADDRESS 0xFFF833FC /end MEASUREMENT
/begin MEASUREMENT ZFEH_EepromData.di_obd_iumpr_numerator[166] "error code related numerator [index = KFC-1]" UWORD EH_STANDARD_S5_S3 1 100 0 65535 DISPLAY_IDENTIFIER di_obd_iumpr_numerator[166].ZFEH_EepromData ECU_ADDRESS 0xFFF833FE /end MEASUREMENT
/begin MEASUREMENT ZFEH_EepromData.di_obd_iumpr_numerator[167] "error code related numerator [index = KFC-1]" UWORD EH_STANDARD_S5_S3 1 100 0 65535 DISPLAY_IDENTIFIER di_obd_iumpr_numerator[167].ZFEH_EepromData ECU_ADDRESS 0xFFF83400 /end MEASUREMENT
/begin MEASUREMENT ZFEH_EepromData.di_obd_iumpr_numerator[168] "error code related numerator [index = KFC-1]" UWORD EH_STANDARD_S5_S3 1 100 0 65535 DISPLAY_IDENTIFIER di_obd_iumpr_numerator[168].ZFEH_EepromData ECU_ADDRESS 0xFFF83402 /end MEASUREMENT
/begin MEASUREMENT ZFEH_EepromData.di_obd_iumpr_numerator[169] "error code related numerator [index = KFC-1]" UWORD EH_STANDARD_S5_S3 1 100 0 65535 DISPLAY_IDENTIFIER di_obd_iumpr_numerator[169].ZFEH_EepromData ECU_ADDRESS 0xFFF83404 /end MEASUREMENT
/begin MEASUREMENT ZFEH_EepromData.di_obd_iumpr_numerator[170] "error code related numerator [index = KFC-1]" UWORD EH_STANDARD_S5_S3 1 100 0 65535 DISPLAY_IDENTIFIER di_obd_iumpr_numerator[170].ZFEH_EepromData ECU_ADDRESS 0xFFF83406 /end MEASUREMENT
/begin MEASUREMENT ZFEH_EepromData.di_obd_iumpr_numerator[171] "error code related numerator [index = KFC-1]" UWORD EH_STANDARD_S5_S3 1 100 0 65535 DISPLAY_IDENTIFIER di_obd_iumpr_numerator[171].ZFEH_EepromData ECU_ADDRESS 0xFFF83408 /end MEASUREMENT
/begin MEASUREMENT ZFEH_EepromData.di_obd_iumpr_numerator[172] "error code related numerator [index = KFC-1]" UWORD EH_STANDARD_S5_S3 1 100 0 65535 DISPLAY_IDENTIFIER di_obd_iumpr_numerator[172].ZFEH_EepromData ECU_ADDRESS 0xFFF8340A /end MEASUREMENT
/begin MEASUREMENT ZFEH_EepromData.di_obd_iumpr_numerator[173] "error code related numerator [index = KFC-1]" UWORD EH_STANDARD_S5_S3 1 100 0 65535 DISPLAY_IDENTIFIER di_obd_iumpr_numerator[173].ZFEH_EepromData ECU_ADDRESS 0xFFF8340C /end MEASUREMENT
/begin MEASUREMENT ZFEH_EepromData.di_obd_iumpr_numerator[174] "error code related numerator [index = KFC-1]" UWORD EH_STANDARD_S5_S3 1 100 0 65535 DISPLAY_IDENTIFIER di_obd_iumpr_numerator[174].ZFEH_EepromData ECU_ADDRESS 0xFFF8340E /end MEASUREMENT
/begin MEASUREMENT ZFEH_EepromData.di_obd_iumpr_numerator[175] "error code related numerator [index = KFC-1]" UWORD EH_STANDARD_S5_S3 1 100 0 65535 DISPLAY_IDENTIFIER di_obd_iumpr_numerator[175].ZFEH_EepromData ECU_ADDRESS 0xFFF83410 /end MEASUREMENT
/begin MEASUREMENT ZFEH_EepromData.di_obd_iumpr_numerator[176] "error code related numerator [index = KFC-1]" UWORD EH_STANDARD_S5_S3 1 100 0 65535 DISPLAY_IDENTIFIER di_obd_iumpr_numerator[176].ZFEH_EepromData ECU_ADDRESS 0xFFF83412 /end MEASUREMENT
/begin MEASUREMENT ZFEH_EepromData.di_obd_iumpr_numerator[177] "error code related numerator [index = KFC-1]" UWORD EH_STANDARD_S5_S3 1 100 0 65535 DISPLAY_IDENTIFIER di_obd_iumpr_numerator[177].ZFEH_EepromData ECU_ADDRESS 0xFFF83414 /end MEASUREMENT
/begin MEASUREMENT ZFEH_EepromData.di_obd_iumpr_numerator[178] "error code related numerator [index = KFC-1]" UWORD EH_STANDARD_S5_S3 1 100 0 65535 DISPLAY_IDENTIFIER di_obd_iumpr_numerator[178].ZFEH_EepromData ECU_ADDRESS 0xFFF83416 /end MEASUREMENT
/begin MEASUREMENT ZFEH_EepromData.di_obd_iumpr_numerator[179] "error code related numerator [index = KFC-1]" UWORD EH_STANDARD_S5_S3 1 100 0 65535 DISPLAY_IDENTIFIER di_obd_iumpr_numerator[179].ZFEH_EepromData ECU_ADDRESS 0xFFF83418 /end MEASUREMENT
/begin MEASUREMENT ZFEH_EepromData.di_obd_iumpr_numerator[180] "error code related numerator [index = KFC-1]" UWORD EH_STANDARD_S5_S3 1 100 0 65535 DISPLAY_IDENTIFIER di_obd_iumpr_numerator[180].ZFEH_EepromData ECU_ADDRESS 0xFFF8341A /end MEASUREMENT
/begin MEASUREMENT ZFEH_EepromData.di_obd_iumpr_numerator[181] "error code related numerator [index = KFC-1]" UWORD EH_STANDARD_S5_S3 1 100 0 65535 DISPLAY_IDENTIFIER di_obd_iumpr_numerator[181].ZFEH_EepromData ECU_ADDRESS 0xFFF8341C /end MEASUREMENT
/begin MEASUREMENT ZFEH_EepromData.di_obd_iumpr_numerator[182] "error code related numerator [index = KFC-1]" UWORD EH_STANDARD_S5_S3 1 100 0 65535 DISPLAY_IDENTIFIER di_obd_iumpr_numerator[182].ZFEH_EepromData ECU_ADDRESS 0xFFF8341E /end MEASUREMENT
/begin MEASUREMENT ZFEH_EepromData.di_obd_iumpr_numerator[183] "error code related numerator [index = KFC-1]" UWORD EH_STANDARD_S5_S3 1 100 0 65535 DISPLAY_IDENTIFIER di_obd_iumpr_numerator[183].ZFEH_EepromData ECU_ADDRESS 0xFFF83420 /end MEASUREMENT
/begin MEASUREMENT ZFEH_EepromData.di_obd_iumpr_numerator[184] "error code related numerator [index = KFC-1]" UWORD EH_STANDARD_S5_S3 1 100 0 65535 DISPLAY_IDENTIFIER di_obd_iumpr_numerator[184].ZFEH_EepromData ECU_ADDRESS 0xFFF83422 /end MEASUREMENT
/begin MEASUREMENT ZFEH_EepromData.di_obd_iumpr_numerator[185] "error code related numerator [index = KFC-1]" UWORD EH_STANDARD_S5_S3 1 100 0 65535 DISPLAY_IDENTIFIER di_obd_iumpr_numerator[185].ZFEH_EepromData ECU_ADDRESS 0xFFF83424 /end MEASUREMENT
/begin MEASUREMENT ZFEH_EepromData.di_obd_iumpr_numerator[186] "error code related numerator [index = KFC-1]" UWORD EH_STANDARD_S5_S3 1 100 0 65535 DISPLAY_IDENTIFIER di_obd_iumpr_numerator[186].ZFEH_EepromData ECU_ADDRESS 0xFFF83426 /end MEASUREMENT
/begin MEASUREMENT ZFEH_EepromData.di_obd_iumpr_numerator[187] "error code related numerator [index = KFC-1]" UWORD EH_STANDARD_S5_S3 1 100 0 65535 DISPLAY_IDENTIFIER di_obd_iumpr_numerator[187].ZFEH_EepromData ECU_ADDRESS 0xFFF83428 /end MEASUREMENT
/begin MEASUREMENT ZFEH_EepromData.di_obd_iumpr_numerator[188] "error code related numerator [index = KFC-1]" UWORD EH_STANDARD_S5_S3 1 100 0 65535 DISPLAY_IDENTIFIER di_obd_iumpr_numerator[188].ZFEH_EepromData ECU_ADDRESS 0xFFF8342A /end MEASUREMENT
/begin MEASUREMENT ZFEH_EepromData.di_obd_iumpr_numerator[189] "error code related numerator [index = KFC-1]" UWORD EH_STANDARD_S5_S3 1 100 0 65535 DISPLAY_IDENTIFIER di_obd_iumpr_numerator[189].ZFEH_EepromData ECU_ADDRESS 0xFFF8342C /end MEASUREMENT
/begin MEASUREMENT ZFEH_EepromData.di_obd_iumpr_numerator[190] "error code related numerator [index = KFC-1]" UWORD EH_STANDARD_S5_S3 1 100 0 65535 DISPLAY_IDENTIFIER di_obd_iumpr_numerator[190].ZFEH_EepromData ECU_ADDRESS 0xFFF8342E /end MEASUREMENT
/begin MEASUREMENT ZFEH_EepromData.di_obd_iumpr_numerator[191] "error code related numerator [index = KFC-1]" UWORD EH_STANDARD_S5_S3 1 100 0 65535 DISPLAY_IDENTIFIER di_obd_iumpr_numerator[191].ZFEH_EepromData ECU_ADDRESS 0xFFF83430 /end MEASUREMENT
/begin MEASUREMENT ZFEH_EepromData.di_obd_iumpr_numerator[192] "error code related numerator [index = KFC-1]" UWORD EH_STANDARD_S5_S3 1 100 0 65535 DISPLAY_IDENTIFIER di_obd_iumpr_numerator[192].ZFEH_EepromData ECU_ADDRESS 0xFFF83432 /end MEASUREMENT
/begin MEASUREMENT ZFEH_EepromData.di_obd_iumpr_numerator[193] "error code related numerator [index = KFC-1]" UWORD EH_STANDARD_S5_S3 1 100 0 65535 DISPLAY_IDENTIFIER di_obd_iumpr_numerator[193].ZFEH_EepromData ECU_ADDRESS 0xFFF83434 /end MEASUREMENT
/begin MEASUREMENT ZFEH_EepromData.di_obd_iumpr_numerator[194] "error code related numerator [index = KFC-1]" UWORD EH_STANDARD_S5_S3 1 100 0 65535 DISPLAY_IDENTIFIER di_obd_iumpr_numerator[194].ZFEH_EepromData ECU_ADDRESS 0xFFF83436 /end MEASUREMENT
/begin MEASUREMENT ZFEH_EepromData.di_obd_iumpr_numerator[195] "error code related numerator [index = KFC-1]" UWORD EH_STANDARD_S5_S3 1 100 0 65535 DISPLAY_IDENTIFIER di_obd_iumpr_numerator[195].ZFEH_EepromData ECU_ADDRESS 0xFFF83438 /end MEASUREMENT
/begin MEASUREMENT ZFEH_EepromData.di_obd_iumpr_numerator[196] "error code related numerator [index = KFC-1]" UWORD EH_STANDARD_S5_S3 1 100 0 65535 DISPLAY_IDENTIFIER di_obd_iumpr_numerator[196].ZFEH_EepromData ECU_ADDRESS 0xFFF8343A /end MEASUREMENT
/begin MEASUREMENT ZFEH_EepromData.di_obd_iumpr_numerator[197] "error code related numerator [index = KFC-1]" UWORD EH_STANDARD_S5_S3 1 100 0 65535 DISPLAY_IDENTIFIER di_obd_iumpr_numerator[197].ZFEH_EepromData ECU_ADDRESS 0xFFF8343C /end MEASUREMENT
/begin MEASUREMENT ZFEH_EepromData.di_obd_iumpr_numerator[198] "error code related numerator [index = KFC-1]" UWORD EH_STANDARD_S5_S3 1 100 0 65535 DISPLAY_IDENTIFIER di_obd_iumpr_numerator[198].ZFEH_EepromData ECU_ADDRESS 0xFFF8343E /end MEASUREMENT
/begin MEASUREMENT ZFEH_EepromData.di_obd_iumpr_numerator[199] "error code related numerator [index = KFC-1]" UWORD EH_STANDARD_S5_S3 1 100 0 65535 DISPLAY_IDENTIFIER di_obd_iumpr_numerator[199].ZFEH_EepromData ECU_ADDRESS 0xFFF83440 /end MEASUREMENT
/begin MEASUREMENT ZFEH_EepromData.di_obd_iumpr_numerator[200] "error code related numerator [index = KFC-1]" UWORD EH_STANDARD_S5_S3 1 100 0 65535 DISPLAY_IDENTIFIER di_obd_iumpr_numerator[200].ZFEH_EepromData ECU_ADDRESS 0xFFF83442 /end MEASUREMENT
/begin MEASUREMENT ZFEH_EepromData.di_obd_iumpr_numerator[201] "error code related numerator [index = KFC-1]" UWORD EH_STANDARD_S5_S3 1 100 0 65535 DISPLAY_IDENTIFIER di_obd_iumpr_numerator[201].ZFEH_EepromData ECU_ADDRESS 0xFFF83444 /end MEASUREMENT
/begin MEASUREMENT ZFEH_EepromData.di_obd_iumpr_numerator[202] "error code related numerator [index = KFC-1]" UWORD EH_STANDARD_S5_S3 1 100 0 65535 DISPLAY_IDENTIFIER di_obd_iumpr_numerator[202].ZFEH_EepromData ECU_ADDRESS 0xFFF83446 /end MEASUREMENT
/begin MEASUREMENT ZFEH_EepromData.di_obd_iumpr_numerator[203] "error code related numerator [index = KFC-1]" UWORD EH_STANDARD_S5_S3 1 100 0 65535 DISPLAY_IDENTIFIER di_obd_iumpr_numerator[203].ZFEH_EepromData ECU_ADDRESS 0xFFF83448 /end MEASUREMENT
/begin MEASUREMENT ZFEH_EepromData.di_obd_iumpr_numerator[204] "error code related numerator [index = KFC-1]" UWORD EH_STANDARD_S5_S3 1 100 0 65535 DISPLAY_IDENTIFIER di_obd_iumpr_numerator[204].ZFEH_EepromData ECU_ADDRESS 0xFFF8344A /end MEASUREMENT
/begin MEASUREMENT ZFEH_EepromData.di_obd_iumpr_numerator[205] "error code related numerator [index = KFC-1]" UWORD EH_STANDARD_S5_S3 1 100 0 65535 DISPLAY_IDENTIFIER di_obd_iumpr_numerator[205].ZFEH_EepromData ECU_ADDRESS 0xFFF8344C /end MEASUREMENT
/begin MEASUREMENT ZFEH_EepromData.di_obd_iumpr_numerator[206] "error code related numerator [index = KFC-1]" UWORD EH_STANDARD_S5_S3 1 100 0 65535 DISPLAY_IDENTIFIER di_obd_iumpr_numerator[206].ZFEH_EepromData ECU_ADDRESS 0xFFF8344E /end MEASUREMENT
/begin MEASUREMENT ZFEH_EepromData.di_obd_iumpr_numerator[207] "error code related numerator [index = KFC-1]" UWORD EH_STANDARD_S5_S3 1 100 0 65535 DISPLAY_IDENTIFIER di_obd_iumpr_numerator[207].ZFEH_EepromData ECU_ADDRESS 0xFFF83450 /end MEASUREMENT
/begin MEASUREMENT ZFEH_EepromData.di_obd_iumpr_numerator[208] "error code related numerator [index = KFC-1]" UWORD EH_STANDARD_S5_S3 1 100 0 65535 DISPLAY_IDENTIFIER di_obd_iumpr_numerator[208].ZFEH_EepromData ECU_ADDRESS 0xFFF83452 /end MEASUREMENT
/begin MEASUREMENT ZFEH_EepromData.di_obd_iumpr_numerator[209] "error code related numerator [index = KFC-1]" UWORD EH_STANDARD_S5_S3 1 100 0 65535 DISPLAY_IDENTIFIER di_obd_iumpr_numerator[209].ZFEH_EepromData ECU_ADDRESS 0xFFF83454 /end MEASUREMENT
/begin MEASUREMENT ZFEH_EepromData.di_obd_iumpr_numerator[210] "error code related numerator [index = KFC-1]" UWORD EH_STANDARD_S5_S3 1 100 0 65535 DISPLAY_IDENTIFIER di_obd_iumpr_numerator[210].ZFEH_EepromData ECU_ADDRESS 0xFFF83456 /end MEASUREMENT
/begin MEASUREMENT ZFEH_EepromData.di_obd_iumpr_numerator[211] "error code related numerator [index = KFC-1]" UWORD EH_STANDARD_S5_S3 1 100 0 65535 DISPLAY_IDENTIFIER di_obd_iumpr_numerator[211].ZFEH_EepromData ECU_ADDRESS 0xFFF83458 /end MEASUREMENT
/begin MEASUREMENT ZFEH_EepromData.di_obd_iumpr_numerator[212] "error code related numerator [index = KFC-1]" UWORD EH_STANDARD_S5_S3 1 100 0 65535 DISPLAY_IDENTIFIER di_obd_iumpr_numerator[212].ZFEH_EepromData ECU_ADDRESS 0xFFF8345A /end MEASUREMENT
/begin MEASUREMENT ZFEH_EepromData.di_obd_iumpr_numerator[213] "error code related numerator [index = KFC-1]" UWORD EH_STANDARD_S5_S3 1 100 0 65535 DISPLAY_IDENTIFIER di_obd_iumpr_numerator[213].ZFEH_EepromData ECU_ADDRESS 0xFFF8345C /end MEASUREMENT
/begin MEASUREMENT ZFEH_EepromData.di_obd_iumpr_numerator[214] "error code related numerator [index = KFC-1]" UWORD EH_STANDARD_S5_S3 1 100 0 65535 DISPLAY_IDENTIFIER di_obd_iumpr_numerator[214].ZFEH_EepromData ECU_ADDRESS 0xFFF8345E /end MEASUREMENT
/begin MEASUREMENT ZFEH_EepromData.di_obd_iumpr_numerator[215] "error code related numerator [index = KFC-1]" UWORD EH_STANDARD_S5_S3 1 100 0 65535 DISPLAY_IDENTIFIER di_obd_iumpr_numerator[215].ZFEH_EepromData ECU_ADDRESS 0xFFF83460 /end MEASUREMENT
/begin MEASUREMENT ZFEH_EepromData.di_obd_iumpr_numerator[216] "error code related numerator [index = KFC-1]" UWORD EH_STANDARD_S5_S3 1 100 0 65535 DISPLAY_IDENTIFIER di_obd_iumpr_numerator[216].ZFEH_EepromData ECU_ADDRESS 0xFFF83462 /end MEASUREMENT
/begin MEASUREMENT ZFEH_EepromData.di_obd_iumpr_numerator[217] "error code related numerator [index = KFC-1]" UWORD EH_STANDARD_S5_S3 1 100 0 65535 DISPLAY_IDENTIFIER di_obd_iumpr_numerator[217].ZFEH_EepromData ECU_ADDRESS 0xFFF83464 /end MEASUREMENT
/begin MEASUREMENT ZFEH_EepromData.di_obd_iumpr_numerator[218] "error code related numerator [index = KFC-1]" UWORD EH_STANDARD_S5_S3 1 100 0 65535 DISPLAY_IDENTIFIER di_obd_iumpr_numerator[218].ZFEH_EepromData ECU_ADDRESS 0xFFF83466 /end MEASUREMENT
/begin MEASUREMENT ZFEH_EepromData.di_obd_iumpr_numerator[219] "error code related numerator [index = KFC-1]" UWORD EH_STANDARD_S5_S3 1 100 0 65535 DISPLAY_IDENTIFIER di_obd_iumpr_numerator[219].ZFEH_EepromData ECU_ADDRESS 0xFFF83468 /end MEASUREMENT
/begin MEASUREMENT ZFEH_EepromData.di_obd_iumpr_numerator[220] "error code related numerator [index = KFC-1]" UWORD EH_STANDARD_S5_S3 1 100 0 65535 DISPLAY_IDENTIFIER di_obd_iumpr_numerator[220].ZFEH_EepromData ECU_ADDRESS 0xFFF8346A /end MEASUREMENT
/begin MEASUREMENT ZFEH_EepromData.di_obd_iumpr_numerator[221] "error code related numerator [index = KFC-1]" UWORD EH_STANDARD_S5_S3 1 100 0 65535 DISPLAY_IDENTIFIER di_obd_iumpr_numerator[221].ZFEH_EepromData ECU_ADDRESS 0xFFF8346C /end MEASUREMENT
/begin MEASUREMENT ZFEH_EepromData.di_obd_iumpr_numerator[222] "error code related numerator [index = KFC-1]" UWORD EH_STANDARD_S5_S3 1 100 0 65535 DISPLAY_IDENTIFIER di_obd_iumpr_numerator[222].ZFEH_EepromData ECU_ADDRESS 0xFFF8346E /end MEASUREMENT
/begin MEASUREMENT ZFEH_EepromData.di_obd_iumpr_numerator[223] "error code related numerator [index = KFC-1]" UWORD EH_STANDARD_S5_S3 1 100 0 65535 DISPLAY_IDENTIFIER di_obd_iumpr_numerator[223].ZFEH_EepromData ECU_ADDRESS 0xFFF83470 /end MEASUREMENT
/begin MEASUREMENT ZFEH_EepromData.di_obd_iumpr_numerator[224] "error code related numerator [index = KFC-1]" UWORD EH_STANDARD_S5_S3 1 100 0 65535 DISPLAY_IDENTIFIER di_obd_iumpr_numerator[224].ZFEH_EepromData ECU_ADDRESS 0xFFF83472 /end MEASUREMENT
/begin MEASUREMENT ZFEH_EepromData.di_obd_iumpr_numerator[225] "error code related numerator [index = KFC-1]" UWORD EH_STANDARD_S5_S3 1 100 0 65535 DISPLAY_IDENTIFIER di_obd_iumpr_numerator[225].ZFEH_EepromData ECU_ADDRESS 0xFFF83474 /end MEASUREMENT
/begin MEASUREMENT ZFEH_EepromData.di_obd_iumpr_numerator[226] "error code related numerator [index = KFC-1]" UWORD EH_STANDARD_S5_S3 1 100 0 65535 DISPLAY_IDENTIFIER di_obd_iumpr_numerator[226].ZFEH_EepromData ECU_ADDRESS 0xFFF83476 /end MEASUREMENT
/begin MEASUREMENT ZFEH_EepromData.di_obd_iumpr_numerator[227] "error code related numerator [index = KFC-1]" UWORD EH_STANDARD_S5_S3 1 100 0 65535 DISPLAY_IDENTIFIER di_obd_iumpr_numerator[227].ZFEH_EepromData ECU_ADDRESS 0xFFF83478 /end MEASUREMENT
/begin MEASUREMENT ZFEH_EepromData.di_obd_iumpr_numerator[228] "error code related numerator [index = KFC-1]" UWORD EH_STANDARD_S5_S3 1 100 0 65535 DISPLAY_IDENTIFIER di_obd_iumpr_numerator[228].ZFEH_EepromData ECU_ADDRESS 0xFFF8347A /end MEASUREMENT
/begin MEASUREMENT ZFEH_EepromData.di_obd_iumpr_numerator[229] "error code related numerator [index = KFC-1]" UWORD EH_STANDARD_S5_S3 1 100 0 65535 DISPLAY_IDENTIFIER di_obd_iumpr_numerator[229].ZFEH_EepromData ECU_ADDRESS 0xFFF8347C /end MEASUREMENT
/begin MEASUREMENT ZFEH_EepromData.di_obd_iumpr_numerator[230] "error code related numerator [index = KFC-1]" UWORD EH_STANDARD_S5_S3 1 100 0 65535 DISPLAY_IDENTIFIER di_obd_iumpr_numerator[230].ZFEH_EepromData ECU_ADDRESS 0xFFF8347E /end MEASUREMENT
/begin MEASUREMENT ZFEH_EepromData.di_obd_iumpr_numerator[231] "error code related numerator [index = KFC-1]" UWORD EH_STANDARD_S5_S3 1 100 0 65535 DISPLAY_IDENTIFIER di_obd_iumpr_numerator[231].ZFEH_EepromData ECU_ADDRESS 0xFFF83480 /end MEASUREMENT
/begin MEASUREMENT ZFEH_EepromData.di_obd_iumpr_numerator[232] "error code related numerator [index = KFC-1]" UWORD EH_STANDARD_S5_S3 1 100 0 65535 DISPLAY_IDENTIFIER di_obd_iumpr_numerator[232].ZFEH_EepromData ECU_ADDRESS 0xFFF83482 /end MEASUREMENT
/begin MEASUREMENT ZFEH_EepromData.di_obd_iumpr_numerator[233] "error code related numerator [index = KFC-1]" UWORD EH_STANDARD_S5_S3 1 100 0 65535 DISPLAY_IDENTIFIER di_obd_iumpr_numerator[233].ZFEH_EepromData ECU_ADDRESS 0xFFF83484 /end MEASUREMENT
/begin MEASUREMENT ZFEH_EepromData.di_obd_iumpr_numerator[234] "error code related numerator [index = KFC-1]" UWORD EH_STANDARD_S5_S3 1 100 0 65535 DISPLAY_IDENTIFIER di_obd_iumpr_numerator[234].ZFEH_EepromData ECU_ADDRESS 0xFFF83486 /end MEASUREMENT
/begin MEASUREMENT ZFEH_EepromData.di_obd_iumpr_numerator[235] "error code related numerator [index = KFC-1]" UWORD EH_STANDARD_S5_S3 1 100 0 65535 DISPLAY_IDENTIFIER di_obd_iumpr_numerator[235].ZFEH_EepromData ECU_ADDRESS 0xFFF83488 /end MEASUREMENT
/begin MEASUREMENT ZFEH_EepromData.di_obd_iumpr_numerator[236] "error code related numerator [index = KFC-1]" UWORD EH_STANDARD_S5_S3 1 100 0 65535 DISPLAY_IDENTIFIER di_obd_iumpr_numerator[236].ZFEH_EepromData ECU_ADDRESS 0xFFF8348A /end MEASUREMENT
/begin MEASUREMENT ZFEH_EepromData.di_obd_iumpr_numerator[237] "error code related numerator [index = KFC-1]" UWORD EH_STANDARD_S5_S3 1 100 0 65535 DISPLAY_IDENTIFIER di_obd_iumpr_numerator[237].ZFEH_EepromData ECU_ADDRESS 0xFFF8348C /end MEASUREMENT
/begin MEASUREMENT ZFEH_EepromData.di_obd_iumpr_numerator[238] "error code related numerator [index = KFC-1]" UWORD EH_STANDARD_S5_S3 1 100 0 65535 DISPLAY_IDENTIFIER di_obd_iumpr_numerator[238].ZFEH_EepromData ECU_ADDRESS 0xFFF8348E /end MEASUREMENT
/begin MEASUREMENT ZFEH_EepromData.di_obd_iumpr_numerator[239] "error code related numerator [index = KFC-1]" UWORD EH_STANDARD_S5_S3 1 100 0 65535 DISPLAY_IDENTIFIER di_obd_iumpr_numerator[239].ZFEH_EepromData ECU_ADDRESS 0xFFF83490 /end MEASUREMENT
/begin MEASUREMENT ZFEH_EepromData.di_obd_iumpr_numerator[240] "error code related numerator [index = KFC-1]" UWORD EH_STANDARD_S5_S3 1 100 0 65535 DISPLAY_IDENTIFIER di_obd_iumpr_numerator[240].ZFEH_EepromData ECU_ADDRESS 0xFFF83492 /end MEASUREMENT
/begin MEASUREMENT ZFEH_EepromData.di_obd_iumpr_numerator[241] "error code related numerator [index = KFC-1]" UWORD EH_STANDARD_S5_S3 1 100 0 65535 DISPLAY_IDENTIFIER di_obd_iumpr_numerator[241].ZFEH_EepromData ECU_ADDRESS 0xFFF83494 /end MEASUREMENT
/begin MEASUREMENT ZFEH_EepromData.di_obd_iumpr_numerator[242] "error code related numerator [index = KFC-1]" UWORD EH_STANDARD_S5_S3 1 100 0 65535 DISPLAY_IDENTIFIER di_obd_iumpr_numerator[242].ZFEH_EepromData ECU_ADDRESS 0xFFF83496 /end MEASUREMENT
/begin MEASUREMENT ZFEH_EepromData.di_obd_iumpr_numerator[243] "error code related numerator [index = KFC-1]" UWORD EH_STANDARD_S5_S3 1 100 0 65535 DISPLAY_IDENTIFIER di_obd_iumpr_numerator[243].ZFEH_EepromData ECU_ADDRESS 0xFFF83498 /end MEASUREMENT
/begin MEASUREMENT ZFEH_EepromData.di_obd_iumpr_numerator[244] "error code related numerator [index = KFC-1]" UWORD EH_STANDARD_S5_S3 1 100 0 65535 DISPLAY_IDENTIFIER di_obd_iumpr_numerator[244].ZFEH_EepromData ECU_ADDRESS 0xFFF8349A /end MEASUREMENT
/begin MEASUREMENT ZFEH_EepromData.di_obd_iumpr_numerator[245] "error code related numerator [index = KFC-1]" UWORD EH_STANDARD_S5_S3 1 100 0 65535 DISPLAY_IDENTIFIER di_obd_iumpr_numerator[245].ZFEH_EepromData ECU_ADDRESS 0xFFF8349C /end MEASUREMENT
/begin MEASUREMENT ZFEH_EepromData.di_obd_iumpr_numerator[246] "error code related numerator [index = KFC-1]" UWORD EH_STANDARD_S5_S3 1 100 0 65535 DISPLAY_IDENTIFIER di_obd_iumpr_numerator[246].ZFEH_EepromData ECU_ADDRESS 0xFFF8349E /end MEASUREMENT
/begin MEASUREMENT ZFEH_EepromData.di_obd_iumpr_numerator[247] "error code related numerator [index = KFC-1]" UWORD EH_STANDARD_S5_S3 1 100 0 65535 DISPLAY_IDENTIFIER di_obd_iumpr_numerator[247].ZFEH_EepromData ECU_ADDRESS 0xFFF834A0 /end MEASUREMENT
/begin MEASUREMENT ZFEH_EepromData.di_obd_iumpr_numerator[248] "error code related numerator [index = KFC-1]" UWORD EH_STANDARD_S5_S3 1 100 0 65535 DISPLAY_IDENTIFIER di_obd_iumpr_numerator[248].ZFEH_EepromData ECU_ADDRESS 0xFFF834A2 /end MEASUREMENT
/begin MEASUREMENT ZFEH_EepromData.di_obd_iumpr_numerator[249] "error code related numerator [index = KFC-1]" UWORD EH_STANDARD_S5_S3 1 100 0 65535 DISPLAY_IDENTIFIER di_obd_iumpr_numerator[249].ZFEH_EepromData ECU_ADDRESS 0xFFF834A4 /end MEASUREMENT
/begin MEASUREMENT ZFEH_EepromData.di_obd_iumpr_numerator[250] "error code related numerator [index = KFC-1]" UWORD EH_STANDARD_S5_S3 1 100 0 65535 DISPLAY_IDENTIFIER di_obd_iumpr_numerator[250].ZFEH_EepromData ECU_ADDRESS 0xFFF834A6 /end MEASUREMENT
/begin MEASUREMENT ZFEH_EepromData.di_obd_iumpr_numerator[251] "error code related numerator [index = KFC-1]" UWORD EH_STANDARD_S5_S3 1 100 0 65535 DISPLAY_IDENTIFIER di_obd_iumpr_numerator[251].ZFEH_EepromData ECU_ADDRESS 0xFFF834A8 /end MEASUREMENT
/begin MEASUREMENT ZFEH_EepromData.di_obd_iumpr_numerator[252] "error code related numerator [index = KFC-1]" UWORD EH_STANDARD_S5_S3 1 100 0 65535 DISPLAY_IDENTIFIER di_obd_iumpr_numerator[252].ZFEH_EepromData ECU_ADDRESS 0xFFF834AA /end MEASUREMENT
/begin MEASUREMENT ZFEH_EepromData.di_obd_iumpr_numerator[253] "error code related numerator [index = KFC-1]" UWORD EH_STANDARD_S5_S3 1 100 0 65535 DISPLAY_IDENTIFIER di_obd_iumpr_numerator[253].ZFEH_EepromData ECU_ADDRESS 0xFFF834AC /end MEASUREMENT
/begin MEASUREMENT ZFEH_EepromData.di_obd_iumpr_denominator[0] "error code related denominator [index = KFC-1]" UWORD EH_STANDARD_S5_S3 1 100 0 65535 DISPLAY_IDENTIFIER di_obd_iumpr_denominator[0].ZFEH_EepromData ECU_ADDRESS 0xFFF834AE /end MEASUREMENT
/begin MEASUREMENT ZFEH_EepromData.di_obd_iumpr_denominator[1] "error code related denominator [index = KFC-1]" UWORD EH_STANDARD_S5_S3 1 100 0 65535 DISPLAY_IDENTIFIER di_obd_iumpr_denominator[1].ZFEH_EepromData ECU_ADDRESS 0xFFF834B0 /end MEASUREMENT
/begin MEASUREMENT ZFEH_EepromData.di_obd_iumpr_denominator[2] "error code related denominator [index = KFC-1]" UWORD EH_STANDARD_S5_S3 1 100 0 65535 DISPLAY_IDENTIFIER di_obd_iumpr_denominator[2].ZFEH_EepromData ECU_ADDRESS 0xFFF834B2 /end MEASUREMENT
/begin MEASUREMENT ZFEH_EepromData.di_obd_iumpr_denominator[3] "error code related denominator [index = KFC-1]" UWORD EH_STANDARD_S5_S3 1 100 0 65535 DISPLAY_IDENTIFIER di_obd_iumpr_denominator[3].ZFEH_EepromData ECU_ADDRESS 0xFFF834B4 /end MEASUREMENT
/begin MEASUREMENT ZFEH_EepromData.di_obd_iumpr_denominator[4] "error code related denominator [index = KFC-1]" UWORD EH_STANDARD_S5_S3 1 100 0 65535 DISPLAY_IDENTIFIER di_obd_iumpr_denominator[4].ZFEH_EepromData ECU_ADDRESS 0xFFF834B6 /end MEASUREMENT
/begin MEASUREMENT ZFEH_EepromData.di_obd_iumpr_denominator[5] "error code related denominator [index = KFC-1]" UWORD EH_STANDARD_S5_S3 1 100 0 65535 DISPLAY_IDENTIFIER di_obd_iumpr_denominator[5].ZFEH_EepromData ECU_ADDRESS 0xFFF834B8 /end MEASUREMENT
/begin MEASUREMENT ZFEH_EepromData.di_obd_iumpr_denominator[6] "error code related denominator [index = KFC-1]" UWORD EH_STANDARD_S5_S3 1 100 0 65535 DISPLAY_IDENTIFIER di_obd_iumpr_denominator[6].ZFEH_EepromData ECU_ADDRESS 0xFFF834BA /end MEASUREMENT
/begin MEASUREMENT ZFEH_EepromData.di_obd_iumpr_denominator[7] "error code related denominator [index = KFC-1]" UWORD EH_STANDARD_S5_S3 1 100 0 65535 DISPLAY_IDENTIFIER di_obd_iumpr_denominator[7].ZFEH_EepromData ECU_ADDRESS 0xFFF834BC /end MEASUREMENT
/begin MEASUREMENT ZFEH_EepromData.di_obd_iumpr_denominator[8] "error code related denominator [index = KFC-1]" UWORD EH_STANDARD_S5_S3 1 100 0 65535 DISPLAY_IDENTIFIER di_obd_iumpr_denominator[8].ZFEH_EepromData ECU_ADDRESS 0xFFF834BE /end MEASUREMENT
/begin MEASUREMENT ZFEH_EepromData.di_obd_iumpr_denominator[9] "error code related denominator [index = KFC-1]" UWORD EH_STANDARD_S5_S3 1 100 0 65535 DISPLAY_IDENTIFIER di_obd_iumpr_denominator[9].ZFEH_EepromData ECU_ADDRESS 0xFFF834C0 /end MEASUREMENT
/begin MEASUREMENT ZFEH_EepromData.di_obd_iumpr_denominator[10] "error code related denominator [index = KFC-1]" UWORD EH_STANDARD_S5_S3 1 100 0 65535 DISPLAY_IDENTIFIER di_obd_iumpr_denominator[10].ZFEH_EepromData ECU_ADDRESS 0xFFF834C2 /end MEASUREMENT
/begin MEASUREMENT ZFEH_EepromData.di_obd_iumpr_denominator[11] "error code related denominator [index = KFC-1]" UWORD EH_STANDARD_S5_S3 1 100 0 65535 DISPLAY_IDENTIFIER di_obd_iumpr_denominator[11].ZFEH_EepromData ECU_ADDRESS 0xFFF834C4 /end MEASUREMENT
/begin MEASUREMENT ZFEH_EepromData.di_obd_iumpr_denominator[12] "error code related denominator [index = KFC-1]" UWORD EH_STANDARD_S5_S3 1 100 0 65535 DISPLAY_IDENTIFIER di_obd_iumpr_denominator[12].ZFEH_EepromData ECU_ADDRESS 0xFFF834C6 /end MEASUREMENT
/begin MEASUREMENT ZFEH_EepromData.di_obd_iumpr_denominator[13] "error code related denominator [index = KFC-1]" UWORD EH_STANDARD_S5_S3 1 100 0 65535 DISPLAY_IDENTIFIER di_obd_iumpr_denominator[13].ZFEH_EepromData ECU_ADDRESS 0xFFF834C8 /end MEASUREMENT
/begin MEASUREMENT ZFEH_EepromData.di_obd_iumpr_denominator[14] "error code related denominator [index = KFC-1]" UWORD EH_STANDARD_S5_S3 1 100 0 65535 DISPLAY_IDENTIFIER di_obd_iumpr_denominator[14].ZFEH_EepromData ECU_ADDRESS 0xFFF834CA /end MEASUREMENT
/begin MEASUREMENT ZFEH_EepromData.di_obd_iumpr_denominator[15] "error code related denominator [index = KFC-1]" UWORD EH_STANDARD_S5_S3 1 100 0 65535 DISPLAY_IDENTIFIER di_obd_iumpr_denominator[15].ZFEH_EepromData ECU_ADDRESS 0xFFF834CC /end MEASUREMENT
/begin MEASUREMENT ZFEH_EepromData.di_obd_iumpr_denominator[16] "error code related denominator [index = KFC-1]" UWORD EH_STANDARD_S5_S3 1 100 0 65535 DISPLAY_IDENTIFIER di_obd_iumpr_denominator[16].ZFEH_EepromData ECU_ADDRESS 0xFFF834CE /end MEASUREMENT
/begin MEASUREMENT ZFEH_EepromData.di_obd_iumpr_denominator[17] "error code related denominator [index = KFC-1]" UWORD EH_STANDARD_S5_S3 1 100 0 65535 DISPLAY_IDENTIFIER di_obd_iumpr_denominator[17].ZFEH_EepromData ECU_ADDRESS 0xFFF834D0 /end MEASUREMENT
/begin MEASUREMENT ZFEH_EepromData.di_obd_iumpr_denominator[18] "error code related denominator [index = KFC-1]" UWORD EH_STANDARD_S5_S3 1 100 0 65535 DISPLAY_IDENTIFIER di_obd_iumpr_denominator[18].ZFEH_EepromData ECU_ADDRESS 0xFFF834D2 /end MEASUREMENT
/begin MEASUREMENT ZFEH_EepromData.di_obd_iumpr_denominator[19] "error code related denominator [index = KFC-1]" UWORD EH_STANDARD_S5_S3 1 100 0 65535 DISPLAY_IDENTIFIER di_obd_iumpr_denominator[19].ZFEH_EepromData ECU_ADDRESS 0xFFF834D4 /end MEASUREMENT
/begin MEASUREMENT ZFEH_EepromData.di_obd_iumpr_denominator[20] "error code related denominator [index = KFC-1]" UWORD EH_STANDARD_S5_S3 1 100 0 65535 DISPLAY_IDENTIFIER di_obd_iumpr_denominator[20].ZFEH_EepromData ECU_ADDRESS 0xFFF834D6 /end MEASUREMENT
/begin MEASUREMENT ZFEH_EepromData.di_obd_iumpr_denominator[21] "error code related denominator [index = KFC-1]" UWORD EH_STANDARD_S5_S3 1 100 0 65535 DISPLAY_IDENTIFIER di_obd_iumpr_denominator[21].ZFEH_EepromData ECU_ADDRESS 0xFFF834D8 /end MEASUREMENT
/begin MEASUREMENT ZFEH_EepromData.di_obd_iumpr_denominator[22] "error code related denominator [index = KFC-1]" UWORD EH_STANDARD_S5_S3 1 100 0 65535 DISPLAY_IDENTIFIER di_obd_iumpr_denominator[22].ZFEH_EepromData ECU_ADDRESS 0xFFF834DA /end MEASUREMENT
/begin MEASUREMENT ZFEH_EepromData.di_obd_iumpr_denominator[23] "error code related denominator [index = KFC-1]" UWORD EH_STANDARD_S5_S3 1 100 0 65535 DISPLAY_IDENTIFIER di_obd_iumpr_denominator[23].ZFEH_EepromData ECU_ADDRESS 0xFFF834DC /end MEASUREMENT
/begin MEASUREMENT ZFEH_EepromData.di_obd_iumpr_denominator[24] "error code related denominator [index = KFC-1]" UWORD EH_STANDARD_S5_S3 1 100 0 65535 DISPLAY_IDENTIFIER di_obd_iumpr_denominator[24].ZFEH_EepromData ECU_ADDRESS 0xFFF834DE /end MEASUREMENT
/begin MEASUREMENT ZFEH_EepromData.di_obd_iumpr_denominator[25] "error code related denominator [index = KFC-1]" UWORD EH_STANDARD_S5_S3 1 100 0 65535 DISPLAY_IDENTIFIER di_obd_iumpr_denominator[25].ZFEH_EepromData ECU_ADDRESS 0xFFF834E0 /end MEASUREMENT
/begin MEASUREMENT ZFEH_EepromData.di_obd_iumpr_denominator[26] "error code related denominator [index = KFC-1]" UWORD EH_STANDARD_S5_S3 1 100 0 65535 DISPLAY_IDENTIFIER di_obd_iumpr_denominator[26].ZFEH_EepromData ECU_ADDRESS 0xFFF834E2 /end MEASUREMENT
/begin MEASUREMENT ZFEH_EepromData.di_obd_iumpr_denominator[27] "error code related denominator [index = KFC-1]" UWORD EH_STANDARD_S5_S3 1 100 0 65535 DISPLAY_IDENTIFIER di_obd_iumpr_denominator[27].ZFEH_EepromData ECU_ADDRESS 0xFFF834E4 /end MEASUREMENT
/begin MEASUREMENT ZFEH_EepromData.di_obd_iumpr_denominator[28] "error code related denominator [index = KFC-1]" UWORD EH_STANDARD_S5_S3 1 100 0 65535 DISPLAY_IDENTIFIER di_obd_iumpr_denominator[28].ZFEH_EepromData ECU_ADDRESS 0xFFF834E6 /end MEASUREMENT
/begin MEASUREMENT ZFEH_EepromData.di_obd_iumpr_denominator[29] "error code related denominator [index = KFC-1]" UWORD EH_STANDARD_S5_S3 1 100 0 65535 DISPLAY_IDENTIFIER di_obd_iumpr_denominator[29].ZFEH_EepromData ECU_ADDRESS 0xFFF834E8 /end MEASUREMENT
/begin MEASUREMENT ZFEH_EepromData.di_obd_iumpr_denominator[30] "error code related denominator [index = KFC-1]" UWORD EH_STANDARD_S5_S3 1 100 0 65535 DISPLAY_IDENTIFIER di_obd_iumpr_denominator[30].ZFEH_EepromData ECU_ADDRESS 0xFFF834EA /end MEASUREMENT
/begin MEASUREMENT ZFEH_EepromData.di_obd_iumpr_denominator[31] "error code related denominator [index = KFC-1]" UWORD EH_STANDARD_S5_S3 1 100 0 65535 DISPLAY_IDENTIFIER di_obd_iumpr_denominator[31].ZFEH_EepromData ECU_ADDRESS 0xFFF834EC /end MEASUREMENT
/begin MEASUREMENT ZFEH_EepromData.di_obd_iumpr_denominator[32] "error code related denominator [index = KFC-1]" UWORD EH_STANDARD_S5_S3 1 100 0 65535 DISPLAY_IDENTIFIER di_obd_iumpr_denominator[32].ZFEH_EepromData ECU_ADDRESS 0xFFF834EE /end MEASUREMENT
/begin MEASUREMENT ZFEH_EepromData.di_obd_iumpr_denominator[33] "error code related denominator [index = KFC-1]" UWORD EH_STANDARD_S5_S3 1 100 0 65535 DISPLAY_IDENTIFIER di_obd_iumpr_denominator[33].ZFEH_EepromData ECU_ADDRESS 0xFFF834F0 /end MEASUREMENT
/begin MEASUREMENT ZFEH_EepromData.di_obd_iumpr_denominator[34] "error code related denominator [index = KFC-1]" UWORD EH_STANDARD_S5_S3 1 100 0 65535 DISPLAY_IDENTIFIER di_obd_iumpr_denominator[34].ZFEH_EepromData ECU_ADDRESS 0xFFF834F2 /end MEASUREMENT
/begin MEASUREMENT ZFEH_EepromData.di_obd_iumpr_denominator[35] "error code related denominator [index = KFC-1]" UWORD EH_STANDARD_S5_S3 1 100 0 65535 DISPLAY_IDENTIFIER di_obd_iumpr_denominator[35].ZFEH_EepromData ECU_ADDRESS 0xFFF834F4 /end MEASUREMENT
/begin MEASUREMENT ZFEH_EepromData.di_obd_iumpr_denominator[36] "error code related denominator [index = KFC-1]" UWORD EH_STANDARD_S5_S3 1 100 0 65535 DISPLAY_IDENTIFIER di_obd_iumpr_denominator[36].ZFEH_EepromData ECU_ADDRESS 0xFFF834F6 /end MEASUREMENT
/begin MEASUREMENT ZFEH_EepromData.di_obd_iumpr_denominator[37] "error code related denominator [index = KFC-1]" UWORD EH_STANDARD_S5_S3 1 100 0 65535 DISPLAY_IDENTIFIER di_obd_iumpr_denominator[37].ZFEH_EepromData ECU_ADDRESS 0xFFF834F8 /end MEASUREMENT
/begin MEASUREMENT ZFEH_EepromData.di_obd_iumpr_denominator[38] "error code related denominator [index = KFC-1]" UWORD EH_STANDARD_S5_S3 1 100 0 65535 DISPLAY_IDENTIFIER di_obd_iumpr_denominator[38].ZFEH_EepromData ECU_ADDRESS 0xFFF834FA /end MEASUREMENT
/begin MEASUREMENT ZFEH_EepromData.di_obd_iumpr_denominator[39] "error code related denominator [index = KFC-1]" UWORD EH_STANDARD_S5_S3 1 100 0 65535 DISPLAY_IDENTIFIER di_obd_iumpr_denominator[39].ZFEH_EepromData ECU_ADDRESS 0xFFF834FC /end MEASUREMENT
/begin MEASUREMENT ZFEH_EepromData.di_obd_iumpr_denominator[40] "error code related denominator [index = KFC-1]" UWORD EH_STANDARD_S5_S3 1 100 0 65535 DISPLAY_IDENTIFIER di_obd_iumpr_denominator[40].ZFEH_EepromData ECU_ADDRESS 0xFFF834FE /end MEASUREMENT
/begin MEASUREMENT ZFEH_EepromData.di_obd_iumpr_denominator[41] "error code related denominator [index = KFC-1]" UWORD EH_STANDARD_S5_S3 1 100 0 65535 DISPLAY_IDENTIFIER di_obd_iumpr_denominator[41].ZFEH_EepromData ECU_ADDRESS 0xFFF83500 /end MEASUREMENT
/begin MEASUREMENT ZFEH_EepromData.di_obd_iumpr_denominator[42] "error code related denominator [index = KFC-1]" UWORD EH_STANDARD_S5_S3 1 100 0 65535 DISPLAY_IDENTIFIER di_obd_iumpr_denominator[42].ZFEH_EepromData ECU_ADDRESS 0xFFF83502 /end MEASUREMENT
/begin MEASUREMENT ZFEH_EepromData.di_obd_iumpr_denominator[43] "error code related denominator [index = KFC-1]" UWORD EH_STANDARD_S5_S3 1 100 0 65535 DISPLAY_IDENTIFIER di_obd_iumpr_denominator[43].ZFEH_EepromData ECU_ADDRESS 0xFFF83504 /end MEASUREMENT
/begin MEASUREMENT ZFEH_EepromData.di_obd_iumpr_denominator[44] "error code related denominator [index = KFC-1]" UWORD EH_STANDARD_S5_S3 1 100 0 65535 DISPLAY_IDENTIFIER di_obd_iumpr_denominator[44].ZFEH_EepromData ECU_ADDRESS 0xFFF83506 /end MEASUREMENT
/begin MEASUREMENT ZFEH_EepromData.di_obd_iumpr_denominator[45] "error code related denominator [index = KFC-1]" UWORD EH_STANDARD_S5_S3 1 100 0 65535 DISPLAY_IDENTIFIER di_obd_iumpr_denominator[45].ZFEH_EepromData ECU_ADDRESS 0xFFF83508 /end MEASUREMENT
/begin MEASUREMENT ZFEH_EepromData.di_obd_iumpr_denominator[46] "error code related denominator [index = KFC-1]" UWORD EH_STANDARD_S5_S3 1 100 0 65535 DISPLAY_IDENTIFIER di_obd_iumpr_denominator[46].ZFEH_EepromData ECU_ADDRESS 0xFFF8350A /end MEASUREMENT
/begin MEASUREMENT ZFEH_EepromData.di_obd_iumpr_denominator[47] "error code related denominator [index = KFC-1]" UWORD EH_STANDARD_S5_S3 1 100 0 65535 DISPLAY_IDENTIFIER di_obd_iumpr_denominator[47].ZFEH_EepromData ECU_ADDRESS 0xFFF8350C /end MEASUREMENT
/begin MEASUREMENT ZFEH_EepromData.di_obd_iumpr_denominator[48] "error code related denominator [index = KFC-1]" UWORD EH_STANDARD_S5_S3 1 100 0 65535 DISPLAY_IDENTIFIER di_obd_iumpr_denominator[48].ZFEH_EepromData ECU_ADDRESS 0xFFF8350E /end MEASUREMENT
/begin MEASUREMENT ZFEH_EepromData.di_obd_iumpr_denominator[49] "error code related denominator [index = KFC-1]" UWORD EH_STANDARD_S5_S3 1 100 0 65535 DISPLAY_IDENTIFIER di_obd_iumpr_denominator[49].ZFEH_EepromData ECU_ADDRESS 0xFFF83510 /end MEASUREMENT
/begin MEASUREMENT ZFEH_EepromData.di_obd_iumpr_denominator[50] "error code related denominator [index = KFC-1]" UWORD EH_STANDARD_S5_S3 1 100 0 65535 DISPLAY_IDENTIFIER di_obd_iumpr_denominator[50].ZFEH_EepromData ECU_ADDRESS 0xFFF83512 /end MEASUREMENT
/begin MEASUREMENT ZFEH_EepromData.di_obd_iumpr_denominator[51] "error code related denominator [index = KFC-1]" UWORD EH_STANDARD_S5_S3 1 100 0 65535 DISPLAY_IDENTIFIER di_obd_iumpr_denominator[51].ZFEH_EepromData ECU_ADDRESS 0xFFF83514 /end MEASUREMENT
/begin MEASUREMENT ZFEH_EepromData.di_obd_iumpr_denominator[52] "error code related denominator [index = KFC-1]" UWORD EH_STANDARD_S5_S3 1 100 0 65535 DISPLAY_IDENTIFIER di_obd_iumpr_denominator[52].ZFEH_EepromData ECU_ADDRESS 0xFFF83516 /end MEASUREMENT
/begin MEASUREMENT ZFEH_EepromData.di_obd_iumpr_denominator[53] "error code related denominator [index = KFC-1]" UWORD EH_STANDARD_S5_S3 1 100 0 65535 DISPLAY_IDENTIFIER di_obd_iumpr_denominator[53].ZFEH_EepromData ECU_ADDRESS 0xFFF83518 /end MEASUREMENT
/begin MEASUREMENT ZFEH_EepromData.di_obd_iumpr_denominator[54] "error code related denominator [index = KFC-1]" UWORD EH_STANDARD_S5_S3 1 100 0 65535 DISPLAY_IDENTIFIER di_obd_iumpr_denominator[54].ZFEH_EepromData ECU_ADDRESS 0xFFF8351A /end MEASUREMENT
/begin MEASUREMENT ZFEH_EepromData.di_obd_iumpr_denominator[55] "error code related denominator [index = KFC-1]" UWORD EH_STANDARD_S5_S3 1 100 0 65535 DISPLAY_IDENTIFIER di_obd_iumpr_denominator[55].ZFEH_EepromData ECU_ADDRESS 0xFFF8351C /end MEASUREMENT
/begin MEASUREMENT ZFEH_EepromData.di_obd_iumpr_denominator[56] "error code related denominator [index = KFC-1]" UWORD EH_STANDARD_S5_S3 1 100 0 65535 DISPLAY_IDENTIFIER di_obd_iumpr_denominator[56].ZFEH_EepromData ECU_ADDRESS 0xFFF8351E /end MEASUREMENT
/begin MEASUREMENT ZFEH_EepromData.di_obd_iumpr_denominator[57] "error code related denominator [index = KFC-1]" UWORD EH_STANDARD_S5_S3 1 100 0 65535 DISPLAY_IDENTIFIER di_obd_iumpr_denominator[57].ZFEH_EepromData ECU_ADDRESS 0xFFF83520 /end MEASUREMENT
/begin MEASUREMENT ZFEH_EepromData.di_obd_iumpr_denominator[58] "error code related denominator [index = KFC-1]" UWORD EH_STANDARD_S5_S3 1 100 0 65535 DISPLAY_IDENTIFIER di_obd_iumpr_denominator[58].ZFEH_EepromData ECU_ADDRESS 0xFFF83522 /end MEASUREMENT
/begin MEASUREMENT ZFEH_EepromData.di_obd_iumpr_denominator[59] "error code related denominator [index = KFC-1]" UWORD EH_STANDARD_S5_S3 1 100 0 65535 DISPLAY_IDENTIFIER di_obd_iumpr_denominator[59].ZFEH_EepromData ECU_ADDRESS 0xFFF83524 /end MEASUREMENT
/begin MEASUREMENT ZFEH_EepromData.di_obd_iumpr_denominator[60] "error code related denominator [index = KFC-1]" UWORD EH_STANDARD_S5_S3 1 100 0 65535 DISPLAY_IDENTIFIER di_obd_iumpr_denominator[60].ZFEH_EepromData ECU_ADDRESS 0xFFF83526 /end MEASUREMENT
/begin MEASUREMENT ZFEH_EepromData.di_obd_iumpr_denominator[61] "error code related denominator [index = KFC-1]" UWORD EH_STANDARD_S5_S3 1 100 0 65535 DISPLAY_IDENTIFIER di_obd_iumpr_denominator[61].ZFEH_EepromData ECU_ADDRESS 0xFFF83528 /end MEASUREMENT
/begin MEASUREMENT ZFEH_EepromData.di_obd_iumpr_denominator[62] "error code related denominator [index = KFC-1]" UWORD EH_STANDARD_S5_S3 1 100 0 65535 DISPLAY_IDENTIFIER di_obd_iumpr_denominator[62].ZFEH_EepromData ECU_ADDRESS 0xFFF8352A /end MEASUREMENT
/begin MEASUREMENT ZFEH_EepromData.di_obd_iumpr_denominator[63] "error code related denominator [index = KFC-1]" UWORD EH_STANDARD_S5_S3 1 100 0 65535 DISPLAY_IDENTIFIER di_obd_iumpr_denominator[63].ZFEH_EepromData ECU_ADDRESS 0xFFF8352C /end MEASUREMENT
/begin MEASUREMENT ZFEH_EepromData.di_obd_iumpr_denominator[64] "error code related denominator [index = KFC-1]" UWORD EH_STANDARD_S5_S3 1 100 0 65535 DISPLAY_IDENTIFIER di_obd_iumpr_denominator[64].ZFEH_EepromData ECU_ADDRESS 0xFFF8352E /end MEASUREMENT
/begin MEASUREMENT ZFEH_EepromData.di_obd_iumpr_denominator[65] "error code related denominator [index = KFC-1]" UWORD EH_STANDARD_S5_S3 1 100 0 65535 DISPLAY_IDENTIFIER di_obd_iumpr_denominator[65].ZFEH_EepromData ECU_ADDRESS 0xFFF83530 /end MEASUREMENT
/begin MEASUREMENT ZFEH_EepromData.di_obd_iumpr_denominator[66] "error code related denominator [index = KFC-1]" UWORD EH_STANDARD_S5_S3 1 100 0 65535 DISPLAY_IDENTIFIER di_obd_iumpr_denominator[66].ZFEH_EepromData ECU_ADDRESS 0xFFF83532 /end MEASUREMENT
/begin MEASUREMENT ZFEH_EepromData.di_obd_iumpr_denominator[67] "error code related denominator [index = KFC-1]" UWORD EH_STANDARD_S5_S3 1 100 0 65535 DISPLAY_IDENTIFIER di_obd_iumpr_denominator[67].ZFEH_EepromData ECU_ADDRESS 0xFFF83534 /end MEASUREMENT
/begin MEASUREMENT ZFEH_EepromData.di_obd_iumpr_denominator[68] "error code related denominator [index = KFC-1]" UWORD EH_STANDARD_S5_S3 1 100 0 65535 DISPLAY_IDENTIFIER di_obd_iumpr_denominator[68].ZFEH_EepromData ECU_ADDRESS 0xFFF83536 /end MEASUREMENT
/begin MEASUREMENT ZFEH_EepromData.di_obd_iumpr_denominator[69] "error code related denominator [index = KFC-1]" UWORD EH_STANDARD_S5_S3 1 100 0 65535 DISPLAY_IDENTIFIER di_obd_iumpr_denominator[69].ZFEH_EepromData ECU_ADDRESS 0xFFF83538 /end MEASUREMENT
/begin MEASUREMENT ZFEH_EepromData.di_obd_iumpr_denominator[70] "error code related denominator [index = KFC-1]" UWORD EH_STANDARD_S5_S3 1 100 0 65535 DISPLAY_IDENTIFIER di_obd_iumpr_denominator[70].ZFEH_EepromData ECU_ADDRESS 0xFFF8353A /end MEASUREMENT
/begin MEASUREMENT ZFEH_EepromData.di_obd_iumpr_denominator[71] "error code related denominator [index = KFC-1]" UWORD EH_STANDARD_S5_S3 1 100 0 65535 DISPLAY_IDENTIFIER di_obd_iumpr_denominator[71].ZFEH_EepromData ECU_ADDRESS 0xFFF8353C /end MEASUREMENT
/begin MEASUREMENT ZFEH_EepromData.di_obd_iumpr_denominator[72] "error code related denominator [index = KFC-1]" UWORD EH_STANDARD_S5_S3 1 100 0 65535 DISPLAY_IDENTIFIER di_obd_iumpr_denominator[72].ZFEH_EepromData ECU_ADDRESS 0xFFF8353E /end MEASUREMENT
/begin MEASUREMENT ZFEH_EepromData.di_obd_iumpr_denominator[73] "error code related denominator [index = KFC-1]" UWORD EH_STANDARD_S5_S3 1 100 0 65535 DISPLAY_IDENTIFIER di_obd_iumpr_denominator[73].ZFEH_EepromData ECU_ADDRESS 0xFFF83540 /end MEASUREMENT
/begin MEASUREMENT ZFEH_EepromData.di_obd_iumpr_denominator[74] "error code related denominator [index = KFC-1]" UWORD EH_STANDARD_S5_S3 1 100 0 65535 DISPLAY_IDENTIFIER di_obd_iumpr_denominator[74].ZFEH_EepromData ECU_ADDRESS 0xFFF83542 /end MEASUREMENT
/begin MEASUREMENT ZFEH_EepromData.di_obd_iumpr_denominator[75] "error code related denominator [index = KFC-1]" UWORD EH_STANDARD_S5_S3 1 100 0 65535 DISPLAY_IDENTIFIER di_obd_iumpr_denominator[75].ZFEH_EepromData ECU_ADDRESS 0xFFF83544 /end MEASUREMENT
/begin MEASUREMENT ZFEH_EepromData.di_obd_iumpr_denominator[76] "error code related denominator [index = KFC-1]" UWORD EH_STANDARD_S5_S3 1 100 0 65535 DISPLAY_IDENTIFIER di_obd_iumpr_denominator[76].ZFEH_EepromData ECU_ADDRESS 0xFFF83546 /end MEASUREMENT
/begin MEASUREMENT ZFEH_EepromData.di_obd_iumpr_denominator[77] "error code related denominator [index = KFC-1]" UWORD EH_STANDARD_S5_S3 1 100 0 65535 DISPLAY_IDENTIFIER di_obd_iumpr_denominator[77].ZFEH_EepromData ECU_ADDRESS 0xFFF83548 /end MEASUREMENT
/begin MEASUREMENT ZFEH_EepromData.di_obd_iumpr_denominator[78] "error code related denominator [index = KFC-1]" UWORD EH_STANDARD_S5_S3 1 100 0 65535 DISPLAY_IDENTIFIER di_obd_iumpr_denominator[78].ZFEH_EepromData ECU_ADDRESS 0xFFF8354A /end MEASUREMENT
/begin MEASUREMENT ZFEH_EepromData.di_obd_iumpr_denominator[79] "error code related denominator [index = KFC-1]" UWORD EH_STANDARD_S5_S3 1 100 0 65535 DISPLAY_IDENTIFIER di_obd_iumpr_denominator[79].ZFEH_EepromData ECU_ADDRESS 0xFFF8354C /end MEASUREMENT
/begin MEASUREMENT ZFEH_EepromData.di_obd_iumpr_denominator[80] "error code related denominator [index = KFC-1]" UWORD EH_STANDARD_S5_S3 1 100 0 65535 DISPLAY_IDENTIFIER di_obd_iumpr_denominator[80].ZFEH_EepromData ECU_ADDRESS 0xFFF8354E /end MEASUREMENT
/begin MEASUREMENT ZFEH_EepromData.di_obd_iumpr_denominator[81] "error code related denominator [index = KFC-1]" UWORD EH_STANDARD_S5_S3 1 100 0 65535 DISPLAY_IDENTIFIER di_obd_iumpr_denominator[81].ZFEH_EepromData ECU_ADDRESS 0xFFF83550 /end MEASUREMENT
/begin MEASUREMENT ZFEH_EepromData.di_obd_iumpr_denominator[82] "error code related denominator [index = KFC-1]" UWORD EH_STANDARD_S5_S3 1 100 0 65535 DISPLAY_IDENTIFIER di_obd_iumpr_denominator[82].ZFEH_EepromData ECU_ADDRESS 0xFFF83552 /end MEASUREMENT
/begin MEASUREMENT ZFEH_EepromData.di_obd_iumpr_denominator[83] "error code related denominator [index = KFC-1]" UWORD EH_STANDARD_S5_S3 1 100 0 65535 DISPLAY_IDENTIFIER di_obd_iumpr_denominator[83].ZFEH_EepromData ECU_ADDRESS 0xFFF83554 /end MEASUREMENT
/begin MEASUREMENT ZFEH_EepromData.di_obd_iumpr_denominator[84] "error code related denominator [index = KFC-1]" UWORD EH_STANDARD_S5_S3 1 100 0 65535 DISPLAY_IDENTIFIER di_obd_iumpr_denominator[84].ZFEH_EepromData ECU_ADDRESS 0xFFF83556 /end MEASUREMENT
/begin MEASUREMENT ZFEH_EepromData.di_obd_iumpr_denominator[85] "error code related denominator [index = KFC-1]" UWORD EH_STANDARD_S5_S3 1 100 0 65535 DISPLAY_IDENTIFIER di_obd_iumpr_denominator[85].ZFEH_EepromData ECU_ADDRESS 0xFFF83558 /end MEASUREMENT
/begin MEASUREMENT ZFEH_EepromData.di_obd_iumpr_denominator[86] "error code related denominator [index = KFC-1]" UWORD EH_STANDARD_S5_S3 1 100 0 65535 DISPLAY_IDENTIFIER di_obd_iumpr_denominator[86].ZFEH_EepromData ECU_ADDRESS 0xFFF8355A /end MEASUREMENT
/begin MEASUREMENT ZFEH_EepromData.di_obd_iumpr_denominator[87] "error code related denominator [index = KFC-1]" UWORD EH_STANDARD_S5_S3 1 100 0 65535 DISPLAY_IDENTIFIER di_obd_iumpr_denominator[87].ZFEH_EepromData ECU_ADDRESS 0xFFF8355C /end MEASUREMENT
/begin MEASUREMENT ZFEH_EepromData.di_obd_iumpr_denominator[88] "error code related denominator [index = KFC-1]" UWORD EH_STANDARD_S5_S3 1 100 0 65535 DISPLAY_IDENTIFIER di_obd_iumpr_denominator[88].ZFEH_EepromData ECU_ADDRESS 0xFFF8355E /end MEASUREMENT
/begin MEASUREMENT ZFEH_EepromData.di_obd_iumpr_denominator[89] "error code related denominator [index = KFC-1]" UWORD EH_STANDARD_S5_S3 1 100 0 65535 DISPLAY_IDENTIFIER di_obd_iumpr_denominator[89].ZFEH_EepromData ECU_ADDRESS 0xFFF83560 /end MEASUREMENT
/begin MEASUREMENT ZFEH_EepromData.di_obd_iumpr_denominator[90] "error code related denominator [index = KFC-1]" UWORD EH_STANDARD_S5_S3 1 100 0 65535 DISPLAY_IDENTIFIER di_obd_iumpr_denominator[90].ZFEH_EepromData ECU_ADDRESS 0xFFF83562 /end MEASUREMENT
/begin MEASUREMENT ZFEH_EepromData.di_obd_iumpr_denominator[91] "error code related denominator [index = KFC-1]" UWORD EH_STANDARD_S5_S3 1 100 0 65535 DISPLAY_IDENTIFIER di_obd_iumpr_denominator[91].ZFEH_EepromData ECU_ADDRESS 0xFFF83564 /end MEASUREMENT
/begin MEASUREMENT ZFEH_EepromData.di_obd_iumpr_denominator[92] "error code related denominator [index = KFC-1]" UWORD EH_STANDARD_S5_S3 1 100 0 65535 DISPLAY_IDENTIFIER di_obd_iumpr_denominator[92].ZFEH_EepromData ECU_ADDRESS 0xFFF83566 /end MEASUREMENT
/begin MEASUREMENT ZFEH_EepromData.di_obd_iumpr_denominator[93] "error code related denominator [index = KFC-1]" UWORD EH_STANDARD_S5_S3 1 100 0 65535 DISPLAY_IDENTIFIER di_obd_iumpr_denominator[93].ZFEH_EepromData ECU_ADDRESS 0xFFF83568 /end MEASUREMENT
/begin MEASUREMENT ZFEH_EepromData.di_obd_iumpr_denominator[94] "error code related denominator [index = KFC-1]" UWORD EH_STANDARD_S5_S3 1 100 0 65535 DISPLAY_IDENTIFIER di_obd_iumpr_denominator[94].ZFEH_EepromData ECU_ADDRESS 0xFFF8356A /end MEASUREMENT
/begin MEASUREMENT ZFEH_EepromData.di_obd_iumpr_denominator[95] "error code related denominator [index = KFC-1]" UWORD EH_STANDARD_S5_S3 1 100 0 65535 DISPLAY_IDENTIFIER di_obd_iumpr_denominator[95].ZFEH_EepromData ECU_ADDRESS 0xFFF8356C /end MEASUREMENT
/begin MEASUREMENT ZFEH_EepromData.di_obd_iumpr_denominator[96] "error code related denominator [index = KFC-1]" UWORD EH_STANDARD_S5_S3 1 100 0 65535 DISPLAY_IDENTIFIER di_obd_iumpr_denominator[96].ZFEH_EepromData ECU_ADDRESS 0xFFF8356E /end MEASUREMENT
/begin MEASUREMENT ZFEH_EepromData.di_obd_iumpr_denominator[97] "error code related denominator [index = KFC-1]" UWORD EH_STANDARD_S5_S3 1 100 0 65535 DISPLAY_IDENTIFIER di_obd_iumpr_denominator[97].ZFEH_EepromData ECU_ADDRESS 0xFFF83570 /end MEASUREMENT
/begin MEASUREMENT ZFEH_EepromData.di_obd_iumpr_denominator[98] "error code related denominator [index = KFC-1]" UWORD EH_STANDARD_S5_S3 1 100 0 65535 DISPLAY_IDENTIFIER di_obd_iumpr_denominator[98].ZFEH_EepromData ECU_ADDRESS 0xFFF83572 /end MEASUREMENT
/begin MEASUREMENT ZFEH_EepromData.di_obd_iumpr_denominator[99] "error code related denominator [index = KFC-1]" UWORD EH_STANDARD_S5_S3 1 100 0 65535 DISPLAY_IDENTIFIER di_obd_iumpr_denominator[99].ZFEH_EepromData ECU_ADDRESS 0xFFF83574 /end MEASUREMENT
/begin MEASUREMENT ZFEH_EepromData.di_obd_iumpr_denominator[100] "error code related denominator [index = KFC-1]" UWORD EH_STANDARD_S5_S3 1 100 0 65535 DISPLAY_IDENTIFIER di_obd_iumpr_denominator[100].ZFEH_EepromData ECU_ADDRESS 0xFFF83576 /end MEASUREMENT
/begin MEASUREMENT ZFEH_EepromData.di_obd_iumpr_denominator[101] "error code related denominator [index = KFC-1]" UWORD EH_STANDARD_S5_S3 1 100 0 65535 DISPLAY_IDENTIFIER di_obd_iumpr_denominator[101].ZFEH_EepromData ECU_ADDRESS 0xFFF83578 /end MEASUREMENT
/begin MEASUREMENT ZFEH_EepromData.di_obd_iumpr_denominator[102] "error code related denominator [index = KFC-1]" UWORD EH_STANDARD_S5_S3 1 100 0 65535 DISPLAY_IDENTIFIER di_obd_iumpr_denominator[102].ZFEH_EepromData ECU_ADDRESS 0xFFF8357A /end MEASUREMENT
/begin MEASUREMENT ZFEH_EepromData.di_obd_iumpr_denominator[103] "error code related denominator [index = KFC-1]" UWORD EH_STANDARD_S5_S3 1 100 0 65535 DISPLAY_IDENTIFIER di_obd_iumpr_denominator[103].ZFEH_EepromData ECU_ADDRESS 0xFFF8357C /end MEASUREMENT
/begin MEASUREMENT ZFEH_EepromData.di_obd_iumpr_denominator[104] "error code related denominator [index = KFC-1]" UWORD EH_STANDARD_S5_S3 1 100 0 65535 DISPLAY_IDENTIFIER di_obd_iumpr_denominator[104].ZFEH_EepromData ECU_ADDRESS 0xFFF8357E /end MEASUREMENT
/begin MEASUREMENT ZFEH_EepromData.di_obd_iumpr_denominator[105] "error code related denominator [index = KFC-1]" UWORD EH_STANDARD_S5_S3 1 100 0 65535 DISPLAY_IDENTIFIER di_obd_iumpr_denominator[105].ZFEH_EepromData ECU_ADDRESS 0xFFF83580 /end MEASUREMENT
/begin MEASUREMENT ZFEH_EepromData.di_obd_iumpr_denominator[106] "error code related denominator [index = KFC-1]" UWORD EH_STANDARD_S5_S3 1 100 0 65535 DISPLAY_IDENTIFIER di_obd_iumpr_denominator[106].ZFEH_EepromData ECU_ADDRESS 0xFFF83582 /end MEASUREMENT
/begin MEASUREMENT ZFEH_EepromData.di_obd_iumpr_denominator[107] "error code related denominator [index = KFC-1]" UWORD EH_STANDARD_S5_S3 1 100 0 65535 DISPLAY_IDENTIFIER di_obd_iumpr_denominator[107].ZFEH_EepromData ECU_ADDRESS 0xFFF83584 /end MEASUREMENT
/begin MEASUREMENT ZFEH_EepromData.di_obd_iumpr_denominator[108] "error code related denominator [index = KFC-1]" UWORD EH_STANDARD_S5_S3 1 100 0 65535 DISPLAY_IDENTIFIER di_obd_iumpr_denominator[108].ZFEH_EepromData ECU_ADDRESS 0xFFF83586 /end MEASUREMENT
/begin MEASUREMENT ZFEH_EepromData.di_obd_iumpr_denominator[109] "error code related denominator [index = KFC-1]" UWORD EH_STANDARD_S5_S3 1 100 0 65535 DISPLAY_IDENTIFIER di_obd_iumpr_denominator[109].ZFEH_EepromData ECU_ADDRESS 0xFFF83588 /end MEASUREMENT
/begin MEASUREMENT ZFEH_EepromData.di_obd_iumpr_denominator[110] "error code related denominator [index = KFC-1]" UWORD EH_STANDARD_S5_S3 1 100 0 65535 DISPLAY_IDENTIFIER di_obd_iumpr_denominator[110].ZFEH_EepromData ECU_ADDRESS 0xFFF8358A /end MEASUREMENT
/begin MEASUREMENT ZFEH_EepromData.di_obd_iumpr_denominator[111] "error code related denominator [index = KFC-1]" UWORD EH_STANDARD_S5_S3 1 100 0 65535 DISPLAY_IDENTIFIER di_obd_iumpr_denominator[111].ZFEH_EepromData ECU_ADDRESS 0xFFF8358C /end MEASUREMENT
/begin MEASUREMENT ZFEH_EepromData.di_obd_iumpr_denominator[112] "error code related denominator [index = KFC-1]" UWORD EH_STANDARD_S5_S3 1 100 0 65535 DISPLAY_IDENTIFIER di_obd_iumpr_denominator[112].ZFEH_EepromData ECU_ADDRESS 0xFFF8358E /end MEASUREMENT
/begin MEASUREMENT ZFEH_EepromData.di_obd_iumpr_denominator[113] "error code related denominator [index = KFC-1]" UWORD EH_STANDARD_S5_S3 1 100 0 65535 DISPLAY_IDENTIFIER di_obd_iumpr_denominator[113].ZFEH_EepromData ECU_ADDRESS 0xFFF83590 /end MEASUREMENT
/begin MEASUREMENT ZFEH_EepromData.di_obd_iumpr_denominator[114] "error code related denominator [index = KFC-1]" UWORD EH_STANDARD_S5_S3 1 100 0 65535 DISPLAY_IDENTIFIER di_obd_iumpr_denominator[114].ZFEH_EepromData ECU_ADDRESS 0xFFF83592 /end MEASUREMENT
/begin MEASUREMENT ZFEH_EepromData.di_obd_iumpr_denominator[115] "error code related denominator [index = KFC-1]" UWORD EH_STANDARD_S5_S3 1 100 0 65535 DISPLAY_IDENTIFIER di_obd_iumpr_denominator[115].ZFEH_EepromData ECU_ADDRESS 0xFFF83594 /end MEASUREMENT
/begin MEASUREMENT ZFEH_EepromData.di_obd_iumpr_denominator[116] "error code related denominator [index = KFC-1]" UWORD EH_STANDARD_S5_S3 1 100 0 65535 DISPLAY_IDENTIFIER di_obd_iumpr_denominator[116].ZFEH_EepromData ECU_ADDRESS 0xFFF83596 /end MEASUREMENT
/begin MEASUREMENT ZFEH_EepromData.di_obd_iumpr_denominator[117] "error code related denominator [index = KFC-1]" UWORD EH_STANDARD_S5_S3 1 100 0 65535 DISPLAY_IDENTIFIER di_obd_iumpr_denominator[117].ZFEH_EepromData ECU_ADDRESS 0xFFF83598 /end MEASUREMENT
/begin MEASUREMENT ZFEH_EepromData.di_obd_iumpr_denominator[118] "error code related denominator [index = KFC-1]" UWORD EH_STANDARD_S5_S3 1 100 0 65535 DISPLAY_IDENTIFIER di_obd_iumpr_denominator[118].ZFEH_EepromData ECU_ADDRESS 0xFFF8359A /end MEASUREMENT
/begin MEASUREMENT ZFEH_EepromData.di_obd_iumpr_denominator[119] "error code related denominator [index = KFC-1]" UWORD EH_STANDARD_S5_S3 1 100 0 65535 DISPLAY_IDENTIFIER di_obd_iumpr_denominator[119].ZFEH_EepromData ECU_ADDRESS 0xFFF8359C /end MEASUREMENT
/begin MEASUREMENT ZFEH_EepromData.di_obd_iumpr_denominator[120] "error code related denominator [index = KFC-1]" UWORD EH_STANDARD_S5_S3 1 100 0 65535 DISPLAY_IDENTIFIER di_obd_iumpr_denominator[120].ZFEH_EepromData ECU_ADDRESS 0xFFF8359E /end MEASUREMENT
/begin MEASUREMENT ZFEH_EepromData.di_obd_iumpr_denominator[121] "error code related denominator [index = KFC-1]" UWORD EH_STANDARD_S5_S3 1 100 0 65535 DISPLAY_IDENTIFIER di_obd_iumpr_denominator[121].ZFEH_EepromData ECU_ADDRESS 0xFFF835A0 /end MEASUREMENT
/begin MEASUREMENT ZFEH_EepromData.di_obd_iumpr_denominator[122] "error code related denominator [index = KFC-1]" UWORD EH_STANDARD_S5_S3 1 100 0 65535 DISPLAY_IDENTIFIER di_obd_iumpr_denominator[122].ZFEH_EepromData ECU_ADDRESS 0xFFF835A2 /end MEASUREMENT
/begin MEASUREMENT ZFEH_EepromData.di_obd_iumpr_denominator[123] "error code related denominator [index = KFC-1]" UWORD EH_STANDARD_S5_S3 1 100 0 65535 DISPLAY_IDENTIFIER di_obd_iumpr_denominator[123].ZFEH_EepromData ECU_ADDRESS 0xFFF835A4 /end MEASUREMENT
/begin MEASUREMENT ZFEH_EepromData.di_obd_iumpr_denominator[124] "error code related denominator [index = KFC-1]" UWORD EH_STANDARD_S5_S3 1 100 0 65535 DISPLAY_IDENTIFIER di_obd_iumpr_denominator[124].ZFEH_EepromData ECU_ADDRESS 0xFFF835A6 /end MEASUREMENT
/begin MEASUREMENT ZFEH_EepromData.di_obd_iumpr_denominator[125] "error code related denominator [index = KFC-1]" UWORD EH_STANDARD_S5_S3 1 100 0 65535 DISPLAY_IDENTIFIER di_obd_iumpr_denominator[125].ZFEH_EepromData ECU_ADDRESS 0xFFF835A8 /end MEASUREMENT
/begin MEASUREMENT ZFEH_EepromData.di_obd_iumpr_denominator[126] "error code related denominator [index = KFC-1]" UWORD EH_STANDARD_S5_S3 1 100 0 65535 DISPLAY_IDENTIFIER di_obd_iumpr_denominator[126].ZFEH_EepromData ECU_ADDRESS 0xFFF835AA /end MEASUREMENT
/begin MEASUREMENT ZFEH_EepromData.di_obd_iumpr_denominator[127] "error code related denominator [index = KFC-1]" UWORD EH_STANDARD_S5_S3 1 100 0 65535 DISPLAY_IDENTIFIER di_obd_iumpr_denominator[127].ZFEH_EepromData ECU_ADDRESS 0xFFF835AC /end MEASUREMENT
/begin MEASUREMENT ZFEH_EepromData.di_obd_iumpr_denominator[128] "error code related denominator [index = KFC-1]" UWORD EH_STANDARD_S5_S3 1 100 0 65535 DISPLAY_IDENTIFIER di_obd_iumpr_denominator[128].ZFEH_EepromData ECU_ADDRESS 0xFFF835AE /end MEASUREMENT
/begin MEASUREMENT ZFEH_EepromData.di_obd_iumpr_denominator[129] "error code related denominator [index = KFC-1]" UWORD EH_STANDARD_S5_S3 1 100 0 65535 DISPLAY_IDENTIFIER di_obd_iumpr_denominator[129].ZFEH_EepromData ECU_ADDRESS 0xFFF835B0 /end MEASUREMENT
/begin MEASUREMENT ZFEH_EepromData.di_obd_iumpr_denominator[130] "error code related denominator [index = KFC-1]" UWORD EH_STANDARD_S5_S3 1 100 0 65535 DISPLAY_IDENTIFIER di_obd_iumpr_denominator[130].ZFEH_EepromData ECU_ADDRESS 0xFFF835B2 /end MEASUREMENT
/begin MEASUREMENT ZFEH_EepromData.di_obd_iumpr_denominator[131] "error code related denominator [index = KFC-1]" UWORD EH_STANDARD_S5_S3 1 100 0 65535 DISPLAY_IDENTIFIER di_obd_iumpr_denominator[131].ZFEH_EepromData ECU_ADDRESS 0xFFF835B4 /end MEASUREMENT
/begin MEASUREMENT ZFEH_EepromData.di_obd_iumpr_denominator[132] "error code related denominator [index = KFC-1]" UWORD EH_STANDARD_S5_S3 1 100 0 65535 DISPLAY_IDENTIFIER di_obd_iumpr_denominator[132].ZFEH_EepromData ECU_ADDRESS 0xFFF835B6 /end MEASUREMENT
/begin MEASUREMENT ZFEH_EepromData.di_obd_iumpr_denominator[133] "error code related denominator [index = KFC-1]" UWORD EH_STANDARD_S5_S3 1 100 0 65535 DISPLAY_IDENTIFIER di_obd_iumpr_denominator[133].ZFEH_EepromData ECU_ADDRESS 0xFFF835B8 /end MEASUREMENT
/begin MEASUREMENT ZFEH_EepromData.di_obd_iumpr_denominator[134] "error code related denominator [index = KFC-1]" UWORD EH_STANDARD_S5_S3 1 100 0 65535 DISPLAY_IDENTIFIER di_obd_iumpr_denominator[134].ZFEH_EepromData ECU_ADDRESS 0xFFF835BA /end MEASUREMENT
/begin MEASUREMENT ZFEH_EepromData.di_obd_iumpr_denominator[135] "error code related denominator [index = KFC-1]" UWORD EH_STANDARD_S5_S3 1 100 0 65535 DISPLAY_IDENTIFIER di_obd_iumpr_denominator[135].ZFEH_EepromData ECU_ADDRESS 0xFFF835BC /end MEASUREMENT
/begin MEASUREMENT ZFEH_EepromData.di_obd_iumpr_denominator[136] "error code related denominator [index = KFC-1]" UWORD EH_STANDARD_S5_S3 1 100 0 65535 DISPLAY_IDENTIFIER di_obd_iumpr_denominator[136].ZFEH_EepromData ECU_ADDRESS 0xFFF835BE /end MEASUREMENT
/begin MEASUREMENT ZFEH_EepromData.di_obd_iumpr_denominator[137] "error code related denominator [index = KFC-1]" UWORD EH_STANDARD_S5_S3 1 100 0 65535 DISPLAY_IDENTIFIER di_obd_iumpr_denominator[137].ZFEH_EepromData ECU_ADDRESS 0xFFF835C0 /end MEASUREMENT
/begin MEASUREMENT ZFEH_EepromData.di_obd_iumpr_denominator[138] "error code related denominator [index = KFC-1]" UWORD EH_STANDARD_S5_S3 1 100 0 65535 DISPLAY_IDENTIFIER di_obd_iumpr_denominator[138].ZFEH_EepromData ECU_ADDRESS 0xFFF835C2 /end MEASUREMENT
/begin MEASUREMENT ZFEH_EepromData.di_obd_iumpr_denominator[139] "error code related denominator [index = KFC-1]" UWORD EH_STANDARD_S5_S3 1 100 0 65535 DISPLAY_IDENTIFIER di_obd_iumpr_denominator[139].ZFEH_EepromData ECU_ADDRESS 0xFFF835C4 /end MEASUREMENT
/begin MEASUREMENT ZFEH_EepromData.di_obd_iumpr_denominator[140] "error code related denominator [index = KFC-1]" UWORD EH_STANDARD_S5_S3 1 100 0 65535 DISPLAY_IDENTIFIER di_obd_iumpr_denominator[140].ZFEH_EepromData ECU_ADDRESS 0xFFF835C6 /end MEASUREMENT
/begin MEASUREMENT ZFEH_EepromData.di_obd_iumpr_denominator[141] "error code related denominator [index = KFC-1]" UWORD EH_STANDARD_S5_S3 1 100 0 65535 DISPLAY_IDENTIFIER di_obd_iumpr_denominator[141].ZFEH_EepromData ECU_ADDRESS 0xFFF835C8 /end MEASUREMENT
/begin MEASUREMENT ZFEH_EepromData.di_obd_iumpr_denominator[142] "error code related denominator [index = KFC-1]" UWORD EH_STANDARD_S5_S3 1 100 0 65535 DISPLAY_IDENTIFIER di_obd_iumpr_denominator[142].ZFEH_EepromData ECU_ADDRESS 0xFFF835CA /end MEASUREMENT
/begin MEASUREMENT ZFEH_EepromData.di_obd_iumpr_denominator[143] "error code related denominator [index = KFC-1]" UWORD EH_STANDARD_S5_S3 1 100 0 65535 DISPLAY_IDENTIFIER di_obd_iumpr_denominator[143].ZFEH_EepromData ECU_ADDRESS 0xFFF835CC /end MEASUREMENT
/begin MEASUREMENT ZFEH_EepromData.di_obd_iumpr_denominator[144] "error code related denominator [index = KFC-1]" UWORD EH_STANDARD_S5_S3 1 100 0 65535 DISPLAY_IDENTIFIER di_obd_iumpr_denominator[144].ZFEH_EepromData ECU_ADDRESS 0xFFF835CE /end MEASUREMENT
/begin MEASUREMENT ZFEH_EepromData.di_obd_iumpr_denominator[145] "error code related denominator [index = KFC-1]" UWORD EH_STANDARD_S5_S3 1 100 0 65535 DISPLAY_IDENTIFIER di_obd_iumpr_denominator[145].ZFEH_EepromData ECU_ADDRESS 0xFFF835D0 /end MEASUREMENT
/begin MEASUREMENT ZFEH_EepromData.di_obd_iumpr_denominator[146] "error code related denominator [index = KFC-1]" UWORD EH_STANDARD_S5_S3 1 100 0 65535 DISPLAY_IDENTIFIER di_obd_iumpr_denominator[146].ZFEH_EepromData ECU_ADDRESS 0xFFF835D2 /end MEASUREMENT
/begin MEASUREMENT ZFEH_EepromData.di_obd_iumpr_denominator[147] "error code related denominator [index = KFC-1]" UWORD EH_STANDARD_S5_S3 1 100 0 65535 DISPLAY_IDENTIFIER di_obd_iumpr_denominator[147].ZFEH_EepromData ECU_ADDRESS 0xFFF835D4 /end MEASUREMENT
/begin MEASUREMENT ZFEH_EepromData.di_obd_iumpr_denominator[148] "error code related denominator [index = KFC-1]" UWORD EH_STANDARD_S5_S3 1 100 0 65535 DISPLAY_IDENTIFIER di_obd_iumpr_denominator[148].ZFEH_EepromData ECU_ADDRESS 0xFFF835D6 /end MEASUREMENT
/begin MEASUREMENT ZFEH_EepromData.di_obd_iumpr_denominator[149] "error code related denominator [index = KFC-1]" UWORD EH_STANDARD_S5_S3 1 100 0 65535 DISPLAY_IDENTIFIER di_obd_iumpr_denominator[149].ZFEH_EepromData ECU_ADDRESS 0xFFF835D8 /end MEASUREMENT
/begin MEASUREMENT ZFEH_EepromData.di_obd_iumpr_denominator[150] "error code related denominator [index = KFC-1]" UWORD EH_STANDARD_S5_S3 1 100 0 65535 DISPLAY_IDENTIFIER di_obd_iumpr_denominator[150].ZFEH_EepromData ECU_ADDRESS 0xFFF835DA /end MEASUREMENT
/begin MEASUREMENT ZFEH_EepromData.di_obd_iumpr_denominator[151] "error code related denominator [index = KFC-1]" UWORD EH_STANDARD_S5_S3 1 100 0 65535 DISPLAY_IDENTIFIER di_obd_iumpr_denominator[151].ZFEH_EepromData ECU_ADDRESS 0xFFF835DC /end MEASUREMENT
/begin MEASUREMENT ZFEH_EepromData.di_obd_iumpr_denominator[152] "error code related denominator [index = KFC-1]" UWORD EH_STANDARD_S5_S3 1 100 0 65535 DISPLAY_IDENTIFIER di_obd_iumpr_denominator[152].ZFEH_EepromData ECU_ADDRESS 0xFFF835DE /end MEASUREMENT
/begin MEASUREMENT ZFEH_EepromData.di_obd_iumpr_denominator[153] "error code related denominator [index = KFC-1]" UWORD EH_STANDARD_S5_S3 1 100 0 65535 DISPLAY_IDENTIFIER di_obd_iumpr_denominator[153].ZFEH_EepromData ECU_ADDRESS 0xFFF835E0 /end MEASUREMENT
/begin MEASUREMENT ZFEH_EepromData.di_obd_iumpr_denominator[154] "error code related denominator [index = KFC-1]" UWORD EH_STANDARD_S5_S3 1 100 0 65535 DISPLAY_IDENTIFIER di_obd_iumpr_denominator[154].ZFEH_EepromData ECU_ADDRESS 0xFFF835E2 /end MEASUREMENT
/begin MEASUREMENT ZFEH_EepromData.di_obd_iumpr_denominator[155] "error code related denominator [index = KFC-1]" UWORD EH_STANDARD_S5_S3 1 100 0 65535 DISPLAY_IDENTIFIER di_obd_iumpr_denominator[155].ZFEH_EepromData ECU_ADDRESS 0xFFF835E4 /end MEASUREMENT
/begin MEASUREMENT ZFEH_EepromData.di_obd_iumpr_denominator[156] "error code related denominator [index = KFC-1]" UWORD EH_STANDARD_S5_S3 1 100 0 65535 DISPLAY_IDENTIFIER di_obd_iumpr_denominator[156].ZFEH_EepromData ECU_ADDRESS 0xFFF835E6 /end MEASUREMENT
/begin MEASUREMENT ZFEH_EepromData.di_obd_iumpr_denominator[157] "error code related denominator [index = KFC-1]" UWORD EH_STANDARD_S5_S3 1 100 0 65535 DISPLAY_IDENTIFIER di_obd_iumpr_denominator[157].ZFEH_EepromData ECU_ADDRESS 0xFFF835E8 /end MEASUREMENT
/begin MEASUREMENT ZFEH_EepromData.di_obd_iumpr_denominator[158] "error code related denominator [index = KFC-1]" UWORD EH_STANDARD_S5_S3 1 100 0 65535 DISPLAY_IDENTIFIER di_obd_iumpr_denominator[158].ZFEH_EepromData ECU_ADDRESS 0xFFF835EA /end MEASUREMENT
/begin MEASUREMENT ZFEH_EepromData.di_obd_iumpr_denominator[159] "error code related denominator [index = KFC-1]" UWORD EH_STANDARD_S5_S3 1 100 0 65535 DISPLAY_IDENTIFIER di_obd_iumpr_denominator[159].ZFEH_EepromData ECU_ADDRESS 0xFFF835EC /end MEASUREMENT
/begin MEASUREMENT ZFEH_EepromData.di_obd_iumpr_denominator[160] "error code related denominator [index = KFC-1]" UWORD EH_STANDARD_S5_S3 1 100 0 65535 DISPLAY_IDENTIFIER di_obd_iumpr_denominator[160].ZFEH_EepromData ECU_ADDRESS 0xFFF835EE /end MEASUREMENT
/begin MEASUREMENT ZFEH_EepromData.di_obd_iumpr_denominator[161] "error code related denominator [index = KFC-1]" UWORD EH_STANDARD_S5_S3 1 100 0 65535 DISPLAY_IDENTIFIER di_obd_iumpr_denominator[161].ZFEH_EepromData ECU_ADDRESS 0xFFF835F0 /end MEASUREMENT
/begin MEASUREMENT ZFEH_EepromData.di_obd_iumpr_denominator[162] "error code related denominator [index = KFC-1]" UWORD EH_STANDARD_S5_S3 1 100 0 65535 DISPLAY_IDENTIFIER di_obd_iumpr_denominator[162].ZFEH_EepromData ECU_ADDRESS 0xFFF835F2 /end MEASUREMENT
/begin MEASUREMENT ZFEH_EepromData.di_obd_iumpr_denominator[163] "error code related denominator [index = KFC-1]" UWORD EH_STANDARD_S5_S3 1 100 0 65535 DISPLAY_IDENTIFIER di_obd_iumpr_denominator[163].ZFEH_EepromData ECU_ADDRESS 0xFFF835F4 /end MEASUREMENT
/begin MEASUREMENT ZFEH_EepromData.di_obd_iumpr_denominator[164] "error code related denominator [index = KFC-1]" UWORD EH_STANDARD_S5_S3 1 100 0 65535 DISPLAY_IDENTIFIER di_obd_iumpr_denominator[164].ZFEH_EepromData ECU_ADDRESS 0xFFF835F6 /end MEASUREMENT
/begin MEASUREMENT ZFEH_EepromData.di_obd_iumpr_denominator[165] "error code related denominator [index = KFC-1]" UWORD EH_STANDARD_S5_S3 1 100 0 65535 DISPLAY_IDENTIFIER di_obd_iumpr_denominator[165].ZFEH_EepromData ECU_ADDRESS 0xFFF835F8 /end MEASUREMENT
/begin MEASUREMENT ZFEH_EepromData.di_obd_iumpr_denominator[166] "error code related denominator [index = KFC-1]" UWORD EH_STANDARD_S5_S3 1 100 0 65535 DISPLAY_IDENTIFIER di_obd_iumpr_denominator[166].ZFEH_EepromData ECU_ADDRESS 0xFFF835FA /end MEASUREMENT
/begin MEASUREMENT ZFEH_EepromData.di_obd_iumpr_denominator[167] "error code related denominator [index = KFC-1]" UWORD EH_STANDARD_S5_S3 1 100 0 65535 DISPLAY_IDENTIFIER di_obd_iumpr_denominator[167].ZFEH_EepromData ECU_ADDRESS 0xFFF835FC /end MEASUREMENT
/begin MEASUREMENT ZFEH_EepromData.di_obd_iumpr_denominator[168] "error code related denominator [index = KFC-1]" UWORD EH_STANDARD_S5_S3 1 100 0 65535 DISPLAY_IDENTIFIER di_obd_iumpr_denominator[168].ZFEH_EepromData ECU_ADDRESS 0xFFF835FE /end MEASUREMENT
/begin MEASUREMENT ZFEH_EepromData.di_obd_iumpr_denominator[169] "error code related denominator [index = KFC-1]" UWORD EH_STANDARD_S5_S3 1 100 0 65535 DISPLAY_IDENTIFIER di_obd_iumpr_denominator[169].ZFEH_EepromData ECU_ADDRESS 0xFFF83600 /end MEASUREMENT
/begin MEASUREMENT ZFEH_EepromData.di_obd_iumpr_denominator[170] "error code related denominator [index = KFC-1]" UWORD EH_STANDARD_S5_S3 1 100 0 65535 DISPLAY_IDENTIFIER di_obd_iumpr_denominator[170].ZFEH_EepromData ECU_ADDRESS 0xFFF83602 /end MEASUREMENT
/begin MEASUREMENT ZFEH_EepromData.di_obd_iumpr_denominator[171] "error code related denominator [index = KFC-1]" UWORD EH_STANDARD_S5_S3 1 100 0 65535 DISPLAY_IDENTIFIER di_obd_iumpr_denominator[171].ZFEH_EepromData ECU_ADDRESS 0xFFF83604 /end MEASUREMENT
/begin MEASUREMENT ZFEH_EepromData.di_obd_iumpr_denominator[172] "error code related denominator [index = KFC-1]" UWORD EH_STANDARD_S5_S3 1 100 0 65535 DISPLAY_IDENTIFIER di_obd_iumpr_denominator[172].ZFEH_EepromData ECU_ADDRESS 0xFFF83606 /end MEASUREMENT
/begin MEASUREMENT ZFEH_EepromData.di_obd_iumpr_denominator[173] "error code related denominator [index = KFC-1]" UWORD EH_STANDARD_S5_S3 1 100 0 65535 DISPLAY_IDENTIFIER di_obd_iumpr_denominator[173].ZFEH_EepromData ECU_ADDRESS 0xFFF83608 /end MEASUREMENT
/begin MEASUREMENT ZFEH_EepromData.di_obd_iumpr_denominator[174] "error code related denominator [index = KFC-1]" UWORD EH_STANDARD_S5_S3 1 100 0 65535 DISPLAY_IDENTIFIER di_obd_iumpr_denominator[174].ZFEH_EepromData ECU_ADDRESS 0xFFF8360A /end MEASUREMENT
/begin MEASUREMENT ZFEH_EepromData.di_obd_iumpr_denominator[175] "error code related denominator [index = KFC-1]" UWORD EH_STANDARD_S5_S3 1 100 0 65535 DISPLAY_IDENTIFIER di_obd_iumpr_denominator[175].ZFEH_EepromData ECU_ADDRESS 0xFFF8360C /end MEASUREMENT
/begin MEASUREMENT ZFEH_EepromData.di_obd_iumpr_denominator[176] "error code related denominator [index = KFC-1]" UWORD EH_STANDARD_S5_S3 1 100 0 65535 DISPLAY_IDENTIFIER di_obd_iumpr_denominator[176].ZFEH_EepromData ECU_ADDRESS 0xFFF8360E /end MEASUREMENT
/begin MEASUREMENT ZFEH_EepromData.di_obd_iumpr_denominator[177] "error code related denominator [index = KFC-1]" UWORD EH_STANDARD_S5_S3 1 100 0 65535 DISPLAY_IDENTIFIER di_obd_iumpr_denominator[177].ZFEH_EepromData ECU_ADDRESS 0xFFF83610 /end MEASUREMENT
/begin MEASUREMENT ZFEH_EepromData.di_obd_iumpr_denominator[178] "error code related denominator [index = KFC-1]" UWORD EH_STANDARD_S5_S3 1 100 0 65535 DISPLAY_IDENTIFIER di_obd_iumpr_denominator[178].ZFEH_EepromData ECU_ADDRESS 0xFFF83612 /end MEASUREMENT
/begin MEASUREMENT ZFEH_EepromData.di_obd_iumpr_denominator[179] "error code related denominator [index = KFC-1]" UWORD EH_STANDARD_S5_S3 1 100 0 65535 DISPLAY_IDENTIFIER di_obd_iumpr_denominator[179].ZFEH_EepromData ECU_ADDRESS 0xFFF83614 /end MEASUREMENT
/begin MEASUREMENT ZFEH_EepromData.di_obd_iumpr_denominator[180] "error code related denominator [index = KFC-1]" UWORD EH_STANDARD_S5_S3 1 100 0 65535 DISPLAY_IDENTIFIER di_obd_iumpr_denominator[180].ZFEH_EepromData ECU_ADDRESS 0xFFF83616 /end MEASUREMENT
/begin MEASUREMENT ZFEH_EepromData.di_obd_iumpr_denominator[181] "error code related denominator [index = KFC-1]" UWORD EH_STANDARD_S5_S3 1 100 0 65535 DISPLAY_IDENTIFIER di_obd_iumpr_denominator[181].ZFEH_EepromData ECU_ADDRESS 0xFFF83618 /end MEASUREMENT
/begin MEASUREMENT ZFEH_EepromData.di_obd_iumpr_denominator[182] "error code related denominator [index = KFC-1]" UWORD EH_STANDARD_S5_S3 1 100 0 65535 DISPLAY_IDENTIFIER di_obd_iumpr_denominator[182].ZFEH_EepromData ECU_ADDRESS 0xFFF8361A /end MEASUREMENT
/begin MEASUREMENT ZFEH_EepromData.di_obd_iumpr_denominator[183] "error code related denominator [index = KFC-1]" UWORD EH_STANDARD_S5_S3 1 100 0 65535 DISPLAY_IDENTIFIER di_obd_iumpr_denominator[183].ZFEH_EepromData ECU_ADDRESS 0xFFF8361C /end MEASUREMENT
/begin MEASUREMENT ZFEH_EepromData.di_obd_iumpr_denominator[184] "error code related denominator [index = KFC-1]" UWORD EH_STANDARD_S5_S3 1 100 0 65535 DISPLAY_IDENTIFIER di_obd_iumpr_denominator[184].ZFEH_EepromData ECU_ADDRESS 0xFFF8361E /end MEASUREMENT
/begin MEASUREMENT ZFEH_EepromData.di_obd_iumpr_denominator[185] "error code related denominator [index = KFC-1]" UWORD EH_STANDARD_S5_S3 1 100 0 65535 DISPLAY_IDENTIFIER di_obd_iumpr_denominator[185].ZFEH_EepromData ECU_ADDRESS 0xFFF83620 /end MEASUREMENT
/begin MEASUREMENT ZFEH_EepromData.di_obd_iumpr_denominator[186] "error code related denominator [index = KFC-1]" UWORD EH_STANDARD_S5_S3 1 100 0 65535 DISPLAY_IDENTIFIER di_obd_iumpr_denominator[186].ZFEH_EepromData ECU_ADDRESS 0xFFF83622 /end MEASUREMENT
/begin MEASUREMENT ZFEH_EepromData.di_obd_iumpr_denominator[187] "error code related denominator [index = KFC-1]" UWORD EH_STANDARD_S5_S3 1 100 0 65535 DISPLAY_IDENTIFIER di_obd_iumpr_denominator[187].ZFEH_EepromData ECU_ADDRESS 0xFFF83624 /end MEASUREMENT
/begin MEASUREMENT ZFEH_EepromData.di_obd_iumpr_denominator[188] "error code related denominator [index = KFC-1]" UWORD EH_STANDARD_S5_S3 1 100 0 65535 DISPLAY_IDENTIFIER di_obd_iumpr_denominator[188].ZFEH_EepromData ECU_ADDRESS 0xFFF83626 /end MEASUREMENT
/begin MEASUREMENT ZFEH_EepromData.di_obd_iumpr_denominator[189] "error code related denominator [index = KFC-1]" UWORD EH_STANDARD_S5_S3 1 100 0 65535 DISPLAY_IDENTIFIER di_obd_iumpr_denominator[189].ZFEH_EepromData ECU_ADDRESS 0xFFF83628 /end MEASUREMENT
/begin MEASUREMENT ZFEH_EepromData.di_obd_iumpr_denominator[190] "error code related denominator [index = KFC-1]" UWORD EH_STANDARD_S5_S3 1 100 0 65535 DISPLAY_IDENTIFIER di_obd_iumpr_denominator[190].ZFEH_EepromData ECU_ADDRESS 0xFFF8362A /end MEASUREMENT
/begin MEASUREMENT ZFEH_EepromData.di_obd_iumpr_denominator[191] "error code related denominator [index = KFC-1]" UWORD EH_STANDARD_S5_S3 1 100 0 65535 DISPLAY_IDENTIFIER di_obd_iumpr_denominator[191].ZFEH_EepromData ECU_ADDRESS 0xFFF8362C /end MEASUREMENT
/begin MEASUREMENT ZFEH_EepromData.di_obd_iumpr_denominator[192] "error code related denominator [index = KFC-1]" UWORD EH_STANDARD_S5_S3 1 100 0 65535 DISPLAY_IDENTIFIER di_obd_iumpr_denominator[192].ZFEH_EepromData ECU_ADDRESS 0xFFF8362E /end MEASUREMENT
/begin MEASUREMENT ZFEH_EepromData.di_obd_iumpr_denominator[193] "error code related denominator [index = KFC-1]" UWORD EH_STANDARD_S5_S3 1 100 0 65535 DISPLAY_IDENTIFIER di_obd_iumpr_denominator[193].ZFEH_EepromData ECU_ADDRESS 0xFFF83630 /end MEASUREMENT
/begin MEASUREMENT ZFEH_EepromData.di_obd_iumpr_denominator[194] "error code related denominator [index = KFC-1]" UWORD EH_STANDARD_S5_S3 1 100 0 65535 DISPLAY_IDENTIFIER di_obd_iumpr_denominator[194].ZFEH_EepromData ECU_ADDRESS 0xFFF83632 /end MEASUREMENT
/begin MEASUREMENT ZFEH_EepromData.di_obd_iumpr_denominator[195] "error code related denominator [index = KFC-1]" UWORD EH_STANDARD_S5_S3 1 100 0 65535 DISPLAY_IDENTIFIER di_obd_iumpr_denominator[195].ZFEH_EepromData ECU_ADDRESS 0xFFF83634 /end MEASUREMENT
/begin MEASUREMENT ZFEH_EepromData.di_obd_iumpr_denominator[196] "error code related denominator [index = KFC-1]" UWORD EH_STANDARD_S5_S3 1 100 0 65535 DISPLAY_IDENTIFIER di_obd_iumpr_denominator[196].ZFEH_EepromData ECU_ADDRESS 0xFFF83636 /end MEASUREMENT
/begin MEASUREMENT ZFEH_EepromData.di_obd_iumpr_denominator[197] "error code related denominator [index = KFC-1]" UWORD EH_STANDARD_S5_S3 1 100 0 65535 DISPLAY_IDENTIFIER di_obd_iumpr_denominator[197].ZFEH_EepromData ECU_ADDRESS 0xFFF83638 /end MEASUREMENT
/begin MEASUREMENT ZFEH_EepromData.di_obd_iumpr_denominator[198] "error code related denominator [index = KFC-1]" UWORD EH_STANDARD_S5_S3 1 100 0 65535 DISPLAY_IDENTIFIER di_obd_iumpr_denominator[198].ZFEH_EepromData ECU_ADDRESS 0xFFF8363A /end MEASUREMENT
/begin MEASUREMENT ZFEH_EepromData.di_obd_iumpr_denominator[199] "error code related denominator [index = KFC-1]" UWORD EH_STANDARD_S5_S3 1 100 0 65535 DISPLAY_IDENTIFIER di_obd_iumpr_denominator[199].ZFEH_EepromData ECU_ADDRESS 0xFFF8363C /end MEASUREMENT
/begin MEASUREMENT ZFEH_EepromData.di_obd_iumpr_denominator[200] "error code related denominator [index = KFC-1]" UWORD EH_STANDARD_S5_S3 1 100 0 65535 DISPLAY_IDENTIFIER di_obd_iumpr_denominator[200].ZFEH_EepromData ECU_ADDRESS 0xFFF8363E /end MEASUREMENT
/begin MEASUREMENT ZFEH_EepromData.di_obd_iumpr_denominator[201] "error code related denominator [index = KFC-1]" UWORD EH_STANDARD_S5_S3 1 100 0 65535 DISPLAY_IDENTIFIER di_obd_iumpr_denominator[201].ZFEH_EepromData ECU_ADDRESS 0xFFF83640 /end MEASUREMENT
/begin MEASUREMENT ZFEH_EepromData.di_obd_iumpr_denominator[202] "error code related denominator [index = KFC-1]" UWORD EH_STANDARD_S5_S3 1 100 0 65535 DISPLAY_IDENTIFIER di_obd_iumpr_denominator[202].ZFEH_EepromData ECU_ADDRESS 0xFFF83642 /end MEASUREMENT
/begin MEASUREMENT ZFEH_EepromData.di_obd_iumpr_denominator[203] "error code related denominator [index = KFC-1]" UWORD EH_STANDARD_S5_S3 1 100 0 65535 DISPLAY_IDENTIFIER di_obd_iumpr_denominator[203].ZFEH_EepromData ECU_ADDRESS 0xFFF83644 /end MEASUREMENT
/begin MEASUREMENT ZFEH_EepromData.di_obd_iumpr_denominator[204] "error code related denominator [index = KFC-1]" UWORD EH_STANDARD_S5_S3 1 100 0 65535 DISPLAY_IDENTIFIER di_obd_iumpr_denominator[204].ZFEH_EepromData ECU_ADDRESS 0xFFF83646 /end MEASUREMENT
/begin MEASUREMENT ZFEH_EepromData.di_obd_iumpr_denominator[205] "error code related denominator [index = KFC-1]" UWORD EH_STANDARD_S5_S3 1 100 0 65535 DISPLAY_IDENTIFIER di_obd_iumpr_denominator[205].ZFEH_EepromData ECU_ADDRESS 0xFFF83648 /end MEASUREMENT
/begin MEASUREMENT ZFEH_EepromData.di_obd_iumpr_denominator[206] "error code related denominator [index = KFC-1]" UWORD EH_STANDARD_S5_S3 1 100 0 65535 DISPLAY_IDENTIFIER di_obd_iumpr_denominator[206].ZFEH_EepromData ECU_ADDRESS 0xFFF8364A /end MEASUREMENT
/begin MEASUREMENT ZFEH_EepromData.di_obd_iumpr_denominator[207] "error code related denominator [index = KFC-1]" UWORD EH_STANDARD_S5_S3 1 100 0 65535 DISPLAY_IDENTIFIER di_obd_iumpr_denominator[207].ZFEH_EepromData ECU_ADDRESS 0xFFF8364C /end MEASUREMENT
/begin MEASUREMENT ZFEH_EepromData.di_obd_iumpr_denominator[208] "error code related denominator [index = KFC-1]" UWORD EH_STANDARD_S5_S3 1 100 0 65535 DISPLAY_IDENTIFIER di_obd_iumpr_denominator[208].ZFEH_EepromData ECU_ADDRESS 0xFFF8364E /end MEASUREMENT
/begin MEASUREMENT ZFEH_EepromData.di_obd_iumpr_denominator[209] "error code related denominator [index = KFC-1]" UWORD EH_STANDARD_S5_S3 1 100 0 65535 DISPLAY_IDENTIFIER di_obd_iumpr_denominator[209].ZFEH_EepromData ECU_ADDRESS 0xFFF83650 /end MEASUREMENT
/begin MEASUREMENT ZFEH_EepromData.di_obd_iumpr_denominator[210] "error code related denominator [index = KFC-1]" UWORD EH_STANDARD_S5_S3 1 100 0 65535 DISPLAY_IDENTIFIER di_obd_iumpr_denominator[210].ZFEH_EepromData ECU_ADDRESS 0xFFF83652 /end MEASUREMENT
/begin MEASUREMENT ZFEH_EepromData.di_obd_iumpr_denominator[211] "error code related denominator [index = KFC-1]" UWORD EH_STANDARD_S5_S3 1 100 0 65535 DISPLAY_IDENTIFIER di_obd_iumpr_denominator[211].ZFEH_EepromData ECU_ADDRESS 0xFFF83654 /end MEASUREMENT
/begin MEASUREMENT ZFEH_EepromData.di_obd_iumpr_denominator[212] "error code related denominator [index = KFC-1]" UWORD EH_STANDARD_S5_S3 1 100 0 65535 DISPLAY_IDENTIFIER di_obd_iumpr_denominator[212].ZFEH_EepromData ECU_ADDRESS 0xFFF83656 /end MEASUREMENT
/begin MEASUREMENT ZFEH_EepromData.di_obd_iumpr_denominator[213] "error code related denominator [index = KFC-1]" UWORD EH_STANDARD_S5_S3 1 100 0 65535 DISPLAY_IDENTIFIER di_obd_iumpr_denominator[213].ZFEH_EepromData ECU_ADDRESS 0xFFF83658 /end MEASUREMENT
/begin MEASUREMENT ZFEH_EepromData.di_obd_iumpr_denominator[214] "error code related denominator [index = KFC-1]" UWORD EH_STANDARD_S5_S3 1 100 0 65535 DISPLAY_IDENTIFIER di_obd_iumpr_denominator[214].ZFEH_EepromData ECU_ADDRESS 0xFFF8365A /end MEASUREMENT
/begin MEASUREMENT ZFEH_EepromData.di_obd_iumpr_denominator[215] "error code related denominator [index = KFC-1]" UWORD EH_STANDARD_S5_S3 1 100 0 65535 DISPLAY_IDENTIFIER di_obd_iumpr_denominator[215].ZFEH_EepromData ECU_ADDRESS 0xFFF8365C /end MEASUREMENT
/begin MEASUREMENT ZFEH_EepromData.di_obd_iumpr_denominator[216] "error code related denominator [index = KFC-1]" UWORD EH_STANDARD_S5_S3 1 100 0 65535 DISPLAY_IDENTIFIER di_obd_iumpr_denominator[216].ZFEH_EepromData ECU_ADDRESS 0xFFF8365E /end MEASUREMENT
/begin MEASUREMENT ZFEH_EepromData.di_obd_iumpr_denominator[217] "error code related denominator [index = KFC-1]" UWORD EH_STANDARD_S5_S3 1 100 0 65535 DISPLAY_IDENTIFIER di_obd_iumpr_denominator[217].ZFEH_EepromData ECU_ADDRESS 0xFFF83660 /end MEASUREMENT
/begin MEASUREMENT ZFEH_EepromData.di_obd_iumpr_denominator[218] "error code related denominator [index = KFC-1]" UWORD EH_STANDARD_S5_S3 1 100 0 65535 DISPLAY_IDENTIFIER di_obd_iumpr_denominator[218].ZFEH_EepromData ECU_ADDRESS 0xFFF83662 /end MEASUREMENT
/begin MEASUREMENT ZFEH_EepromData.di_obd_iumpr_denominator[219] "error code related denominator [index = KFC-1]" UWORD EH_STANDARD_S5_S3 1 100 0 65535 DISPLAY_IDENTIFIER di_obd_iumpr_denominator[219].ZFEH_EepromData ECU_ADDRESS 0xFFF83664 /end MEASUREMENT
/begin MEASUREMENT ZFEH_EepromData.di_obd_iumpr_denominator[220] "error code related denominator [index = KFC-1]" UWORD EH_STANDARD_S5_S3 1 100 0 65535 DISPLAY_IDENTIFIER di_obd_iumpr_denominator[220].ZFEH_EepromData ECU_ADDRESS 0xFFF83666 /end MEASUREMENT
/begin MEASUREMENT ZFEH_EepromData.di_obd_iumpr_denominator[221] "error code related denominator [index = KFC-1]" UWORD EH_STANDARD_S5_S3 1 100 0 65535 DISPLAY_IDENTIFIER di_obd_iumpr_denominator[221].ZFEH_EepromData ECU_ADDRESS 0xFFF83668 /end MEASUREMENT
/begin MEASUREMENT ZFEH_EepromData.di_obd_iumpr_denominator[222] "error code related denominator [index = KFC-1]" UWORD EH_STANDARD_S5_S3 1 100 0 65535 DISPLAY_IDENTIFIER di_obd_iumpr_denominator[222].ZFEH_EepromData ECU_ADDRESS 0xFFF8366A /end MEASUREMENT
/begin MEASUREMENT ZFEH_EepromData.di_obd_iumpr_denominator[223] "error code related denominator [index = KFC-1]" UWORD EH_STANDARD_S5_S3 1 100 0 65535 DISPLAY_IDENTIFIER di_obd_iumpr_denominator[223].ZFEH_EepromData ECU_ADDRESS 0xFFF8366C /end MEASUREMENT
/begin MEASUREMENT ZFEH_EepromData.di_obd_iumpr_denominator[224] "error code related denominator [index = KFC-1]" UWORD EH_STANDARD_S5_S3 1 100 0 65535 DISPLAY_IDENTIFIER di_obd_iumpr_denominator[224].ZFEH_EepromData ECU_ADDRESS 0xFFF8366E /end MEASUREMENT
/begin MEASUREMENT ZFEH_EepromData.di_obd_iumpr_denominator[225] "error code related denominator [index = KFC-1]" UWORD EH_STANDARD_S5_S3 1 100 0 65535 DISPLAY_IDENTIFIER di_obd_iumpr_denominator[225].ZFEH_EepromData ECU_ADDRESS 0xFFF83670 /end MEASUREMENT
/begin MEASUREMENT ZFEH_EepromData.di_obd_iumpr_denominator[226] "error code related denominator [index = KFC-1]" UWORD EH_STANDARD_S5_S3 1 100 0 65535 DISPLAY_IDENTIFIER di_obd_iumpr_denominator[226].ZFEH_EepromData ECU_ADDRESS 0xFFF83672 /end MEASUREMENT
/begin MEASUREMENT ZFEH_EepromData.di_obd_iumpr_denominator[227] "error code related denominator [index = KFC-1]" UWORD EH_STANDARD_S5_S3 1 100 0 65535 DISPLAY_IDENTIFIER di_obd_iumpr_denominator[227].ZFEH_EepromData ECU_ADDRESS 0xFFF83674 /end MEASUREMENT
/begin MEASUREMENT ZFEH_EepromData.di_obd_iumpr_denominator[228] "error code related denominator [index = KFC-1]" UWORD EH_STANDARD_S5_S3 1 100 0 65535 DISPLAY_IDENTIFIER di_obd_iumpr_denominator[228].ZFEH_EepromData ECU_ADDRESS 0xFFF83676 /end MEASUREMENT
/begin MEASUREMENT ZFEH_EepromData.di_obd_iumpr_denominator[229] "error code related denominator [index = KFC-1]" UWORD EH_STANDARD_S5_S3 1 100 0 65535 DISPLAY_IDENTIFIER di_obd_iumpr_denominator[229].ZFEH_EepromData ECU_ADDRESS 0xFFF83678 /end MEASUREMENT
/begin MEASUREMENT ZFEH_EepromData.di_obd_iumpr_denominator[230] "error code related denominator [index = KFC-1]" UWORD EH_STANDARD_S5_S3 1 100 0 65535 DISPLAY_IDENTIFIER di_obd_iumpr_denominator[230].ZFEH_EepromData ECU_ADDRESS 0xFFF8367A /end MEASUREMENT
/begin MEASUREMENT ZFEH_EepromData.di_obd_iumpr_denominator[231] "error code related denominator [index = KFC-1]" UWORD EH_STANDARD_S5_S3 1 100 0 65535 DISPLAY_IDENTIFIER di_obd_iumpr_denominator[231].ZFEH_EepromData ECU_ADDRESS 0xFFF8367C /end MEASUREMENT
/begin MEASUREMENT ZFEH_EepromData.di_obd_iumpr_denominator[232] "error code related denominator [index = KFC-1]" UWORD EH_STANDARD_S5_S3 1 100 0 65535 DISPLAY_IDENTIFIER di_obd_iumpr_denominator[232].ZFEH_EepromData ECU_ADDRESS 0xFFF8367E /end MEASUREMENT
/begin MEASUREMENT ZFEH_EepromData.di_obd_iumpr_denominator[233] "error code related denominator [index = KFC-1]" UWORD EH_STANDARD_S5_S3 1 100 0 65535 DISPLAY_IDENTIFIER di_obd_iumpr_denominator[233].ZFEH_EepromData ECU_ADDRESS 0xFFF83680 /end MEASUREMENT
/begin MEASUREMENT ZFEH_EepromData.di_obd_iumpr_denominator[234] "error code related denominator [index = KFC-1]" UWORD EH_STANDARD_S5_S3 1 100 0 65535 DISPLAY_IDENTIFIER di_obd_iumpr_denominator[234].ZFEH_EepromData ECU_ADDRESS 0xFFF83682 /end MEASUREMENT
/begin MEASUREMENT ZFEH_EepromData.di_obd_iumpr_denominator[235] "error code related denominator [index = KFC-1]" UWORD EH_STANDARD_S5_S3 1 100 0 65535 DISPLAY_IDENTIFIER di_obd_iumpr_denominator[235].ZFEH_EepromData ECU_ADDRESS 0xFFF83684 /end MEASUREMENT
/begin MEASUREMENT ZFEH_EepromData.di_obd_iumpr_denominator[236] "error code related denominator [index = KFC-1]" UWORD EH_STANDARD_S5_S3 1 100 0 65535 DISPLAY_IDENTIFIER di_obd_iumpr_denominator[236].ZFEH_EepromData ECU_ADDRESS 0xFFF83686 /end MEASUREMENT
/begin MEASUREMENT ZFEH_EepromData.di_obd_iumpr_denominator[237] "error code related denominator [index = KFC-1]" UWORD EH_STANDARD_S5_S3 1 100 0 65535 DISPLAY_IDENTIFIER di_obd_iumpr_denominator[237].ZFEH_EepromData ECU_ADDRESS 0xFFF83688 /end MEASUREMENT
/begin MEASUREMENT ZFEH_EepromData.di_obd_iumpr_denominator[238] "error code related denominator [index = KFC-1]" UWORD EH_STANDARD_S5_S3 1 100 0 65535 DISPLAY_IDENTIFIER di_obd_iumpr_denominator[238].ZFEH_EepromData ECU_ADDRESS 0xFFF8368A /end MEASUREMENT
/begin MEASUREMENT ZFEH_EepromData.di_obd_iumpr_denominator[239] "error code related denominator [index = KFC-1]" UWORD EH_STANDARD_S5_S3 1 100 0 65535 DISPLAY_IDENTIFIER di_obd_iumpr_denominator[239].ZFEH_EepromData ECU_ADDRESS 0xFFF8368C /end MEASUREMENT
/begin MEASUREMENT ZFEH_EepromData.di_obd_iumpr_denominator[240] "error code related denominator [index = KFC-1]" UWORD EH_STANDARD_S5_S3 1 100 0 65535 DISPLAY_IDENTIFIER di_obd_iumpr_denominator[240].ZFEH_EepromData ECU_ADDRESS 0xFFF8368E /end MEASUREMENT
/begin MEASUREMENT ZFEH_EepromData.di_obd_iumpr_denominator[241] "error code related denominator [index = KFC-1]" UWORD EH_STANDARD_S5_S3 1 100 0 65535 DISPLAY_IDENTIFIER di_obd_iumpr_denominator[241].ZFEH_EepromData ECU_ADDRESS 0xFFF83690 /end MEASUREMENT
/begin MEASUREMENT ZFEH_EepromData.di_obd_iumpr_denominator[242] "error code related denominator [index = KFC-1]" UWORD EH_STANDARD_S5_S3 1 100 0 65535 DISPLAY_IDENTIFIER di_obd_iumpr_denominator[242].ZFEH_EepromData ECU_ADDRESS 0xFFF83692 /end MEASUREMENT
/begin MEASUREMENT ZFEH_EepromData.di_obd_iumpr_denominator[243] "error code related denominator [index = KFC-1]" UWORD EH_STANDARD_S5_S3 1 100 0 65535 DISPLAY_IDENTIFIER di_obd_iumpr_denominator[243].ZFEH_EepromData ECU_ADDRESS 0xFFF83694 /end MEASUREMENT
/begin MEASUREMENT ZFEH_EepromData.di_obd_iumpr_denominator[244] "error code related denominator [index = KFC-1]" UWORD EH_STANDARD_S5_S3 1 100 0 65535 DISPLAY_IDENTIFIER di_obd_iumpr_denominator[244].ZFEH_EepromData ECU_ADDRESS 0xFFF83696 /end MEASUREMENT
/begin MEASUREMENT ZFEH_EepromData.di_obd_iumpr_denominator[245] "error code related denominator [index = KFC-1]" UWORD EH_STANDARD_S5_S3 1 100 0 65535 DISPLAY_IDENTIFIER di_obd_iumpr_denominator[245].ZFEH_EepromData ECU_ADDRESS 0xFFF83698 /end MEASUREMENT
/begin MEASUREMENT ZFEH_EepromData.di_obd_iumpr_denominator[246] "error code related denominator [index = KFC-1]" UWORD EH_STANDARD_S5_S3 1 100 0 65535 DISPLAY_IDENTIFIER di_obd_iumpr_denominator[246].ZFEH_EepromData ECU_ADDRESS 0xFFF8369A /end MEASUREMENT
/begin MEASUREMENT ZFEH_EepromData.di_obd_iumpr_denominator[247] "error code related denominator [index = KFC-1]" UWORD EH_STANDARD_S5_S3 1 100 0 65535 DISPLAY_IDENTIFIER di_obd_iumpr_denominator[247].ZFEH_EepromData ECU_ADDRESS 0xFFF8369C /end MEASUREMENT
/begin MEASUREMENT ZFEH_EepromData.di_obd_iumpr_denominator[248] "error code related denominator [index = KFC-1]" UWORD EH_STANDARD_S5_S3 1 100 0 65535 DISPLAY_IDENTIFIER di_obd_iumpr_denominator[248].ZFEH_EepromData ECU_ADDRESS 0xFFF8369E /end MEASUREMENT
/begin MEASUREMENT ZFEH_EepromData.di_obd_iumpr_denominator[249] "error code related denominator [index = KFC-1]" UWORD EH_STANDARD_S5_S3 1 100 0 65535 DISPLAY_IDENTIFIER di_obd_iumpr_denominator[249].ZFEH_EepromData ECU_ADDRESS 0xFFF836A0 /end MEASUREMENT
/begin MEASUREMENT ZFEH_EepromData.di_obd_iumpr_denominator[250] "error code related denominator [index = KFC-1]" UWORD EH_STANDARD_S5_S3 1 100 0 65535 DISPLAY_IDENTIFIER di_obd_iumpr_denominator[250].ZFEH_EepromData ECU_ADDRESS 0xFFF836A2 /end MEASUREMENT
/begin MEASUREMENT ZFEH_EepromData.di_obd_iumpr_denominator[251] "error code related denominator [index = KFC-1]" UWORD EH_STANDARD_S5_S3 1 100 0 65535 DISPLAY_IDENTIFIER di_obd_iumpr_denominator[251].ZFEH_EepromData ECU_ADDRESS 0xFFF836A4 /end MEASUREMENT
/begin MEASUREMENT ZFEH_EepromData.di_obd_iumpr_denominator[252] "error code related denominator [index = KFC-1]" UWORD EH_STANDARD_S5_S3 1 100 0 65535 DISPLAY_IDENTIFIER di_obd_iumpr_denominator[252].ZFEH_EepromData ECU_ADDRESS 0xFFF836A6 /end MEASUREMENT
/begin MEASUREMENT ZFEH_EepromData.di_obd_iumpr_denominator[253] "error code related denominator [index = KFC-1]" UWORD EH_STANDARD_S5_S3 1 100 0 65535 DISPLAY_IDENTIFIER di_obd_iumpr_denominator[253].ZFEH_EepromData ECU_ADDRESS 0xFFF836A8 /end MEASUREMENT
/begin MEASUREMENT ZFEH_EepromData.di_obd_iumpr_comp_active_time[1] "error code related component active time [index = KFC-1]" UBYTE EH_STANDARD_S5_S3 1 100 0 255 DISPLAY_IDENTIFIER di_obd_iumpr_comp_active_time[1].ZFEH_EepromData ECU_ADDRESS 0xFFF837A9 /end MEASUREMENT
/begin MEASUREMENT ZFEH_EepromData.di_obd_iumpr_comp_active_time[2] "error code related component active time [index = KFC-1]" UBYTE EH_STANDARD_S5_S3 1 100 0 255 DISPLAY_IDENTIFIER di_obd_iumpr_comp_active_time[2].ZFEH_EepromData ECU_ADDRESS 0xFFF837AA /end MEASUREMENT
/begin MEASUREMENT ZFEH_EepromData.di_obd_iumpr_comp_active_time[3] "error code related component active time [index = KFC-1]" UBYTE EH_STANDARD_S5_S3 1 100 0 255 DISPLAY_IDENTIFIER di_obd_iumpr_comp_active_time[3].ZFEH_EepromData ECU_ADDRESS 0xFFF837AB /end MEASUREMENT
/begin MEASUREMENT ZFEH_EepromData.di_obd_iumpr_comp_active_time[4] "error code related component active time [index = KFC-1]" UBYTE EH_STANDARD_S5_S3 1 100 0 255 DISPLAY_IDENTIFIER di_obd_iumpr_comp_active_time[4].ZFEH_EepromData ECU_ADDRESS 0xFFF837AC /end MEASUREMENT
/begin MEASUREMENT ZFEH_EepromData.di_obd_iumpr_comp_active_time[5] "error code related component active time [index = KFC-1]" UBYTE EH_STANDARD_S5_S3 1 100 0 255 DISPLAY_IDENTIFIER di_obd_iumpr_comp_active_time[5].ZFEH_EepromData ECU_ADDRESS 0xFFF837AD /end MEASUREMENT
/begin MEASUREMENT ZFEH_EepromData.di_obd_iumpr_comp_active_time[6] "error code related component active time [index = KFC-1]" UBYTE EH_STANDARD_S5_S3 1 100 0 255 DISPLAY_IDENTIFIER di_obd_iumpr_comp_active_time[6].ZFEH_EepromData ECU_ADDRESS 0xFFF837AE /end MEASUREMENT
/begin MEASUREMENT ZFEH_EepromData.di_obd_iumpr_comp_active_time[7] "error code related component active time [index = KFC-1]" UBYTE EH_STANDARD_S5_S3 1 100 0 255 DISPLAY_IDENTIFIER di_obd_iumpr_comp_active_time[7].ZFEH_EepromData ECU_ADDRESS 0xFFF837AF /end MEASUREMENT
/begin MEASUREMENT ZFEH_EepromData.di_obd_iumpr_comp_active_time[8] "error code related component active time [index = KFC-1]" UBYTE EH_STANDARD_S5_S3 1 100 0 255 DISPLAY_IDENTIFIER di_obd_iumpr_comp_active_time[8].ZFEH_EepromData ECU_ADDRESS 0xFFF837B0 /end MEASUREMENT
/begin MEASUREMENT ZFEH_EepromData.di_obd_iumpr_comp_active_time[9] "error code related component active time [index = KFC-1]" UBYTE EH_STANDARD_S5_S3 1 100 0 255 DISPLAY_IDENTIFIER di_obd_iumpr_comp_active_time[9].ZFEH_EepromData ECU_ADDRESS 0xFFF837B1 /end MEASUREMENT
/begin MEASUREMENT ZFEH_EepromData.di_obd_iumpr_comp_active_time[17] "error code related component active time [index = KFC-1]" UBYTE EH_STANDARD_S5_S3 1 100 0 255 DISPLAY_IDENTIFIER di_obd_iumpr_comp_active_time[17].ZFEH_EepromData ECU_ADDRESS 0xFFF837B9 /end MEASUREMENT
/begin MEASUREMENT ZFEH_EepromData.di_obd_iumpr_comp_active_time[18] "error code related component active time [index = KFC-1]" UBYTE EH_STANDARD_S5_S3 1 100 0 255 DISPLAY_IDENTIFIER di_obd_iumpr_comp_active_time[18].ZFEH_EepromData ECU_ADDRESS 0xFFF837BA /end MEASUREMENT
/begin MEASUREMENT ZFEH_EepromData.di_obd_iumpr_comp_active_time[19] "error code related component active time [index = KFC-1]" UBYTE EH_STANDARD_S5_S3 1 100 0 255 DISPLAY_IDENTIFIER di_obd_iumpr_comp_active_time[19].ZFEH_EepromData ECU_ADDRESS 0xFFF837BB /end MEASUREMENT
/begin MEASUREMENT ZFEH_EepromData.di_obd_iumpr_comp_active_time[20] "error code related component active time [index = KFC-1]" UBYTE EH_STANDARD_S5_S3 1 100 0 255 DISPLAY_IDENTIFIER di_obd_iumpr_comp_active_time[20].ZFEH_EepromData ECU_ADDRESS 0xFFF837BC /end MEASUREMENT
/begin MEASUREMENT ZFEH_EepromData.di_obd_iumpr_comp_active_time[21] "error code related component active time [index = KFC-1]" UBYTE EH_STANDARD_S5_S3 1 100 0 255 DISPLAY_IDENTIFIER di_obd_iumpr_comp_active_time[21].ZFEH_EepromData ECU_ADDRESS 0xFFF837BD /end MEASUREMENT
/begin MEASUREMENT ZFEH_EepromData.di_obd_iumpr_comp_active_time[22] "error code related component active time [index = KFC-1]" UBYTE EH_STANDARD_S5_S3 1 100 0 255 DISPLAY_IDENTIFIER di_obd_iumpr_comp_active_time[22].ZFEH_EepromData ECU_ADDRESS 0xFFF837BE /end MEASUREMENT
/begin MEASUREMENT ZFEH_EepromData.di_obd_iumpr_comp_active_time[23] "error code related component active time [index = KFC-1]" UBYTE EH_STANDARD_S5_S3 1 100 0 255 DISPLAY_IDENTIFIER di_obd_iumpr_comp_active_time[23].ZFEH_EepromData ECU_ADDRESS 0xFFF837BF /end MEASUREMENT
/begin MEASUREMENT ZFEH_EepromData.di_obd_iumpr_comp_active_time[24] "error code related component active time [index = KFC-1]" UBYTE EH_STANDARD_S5_S3 1 100 0 255 DISPLAY_IDENTIFIER di_obd_iumpr_comp_active_time[24].ZFEH_EepromData ECU_ADDRESS 0xFFF837C0 /end MEASUREMENT
/begin MEASUREMENT ZFEH_EepromData.di_obd_iumpr_comp_active_time[25] "error code related component active time [index = KFC-1]" UBYTE EH_STANDARD_S5_S3 1 100 0 255 DISPLAY_IDENTIFIER di_obd_iumpr_comp_active_time[25].ZFEH_EepromData ECU_ADDRESS 0xFFF837C1 /end MEASUREMENT
/begin MEASUREMENT ZFEH_EepromData.di_obd_iumpr_comp_active_time[26] "error code related component active time [index = KFC-1]" UBYTE EH_STANDARD_S5_S3 1 100 0 255 DISPLAY_IDENTIFIER di_obd_iumpr_comp_active_time[26].ZFEH_EepromData ECU_ADDRESS 0xFFF837C2 /end MEASUREMENT
/begin MEASUREMENT ZFEH_EepromData.di_obd_iumpr_comp_active_time[27] "error code related component active time [index = KFC-1]" UBYTE EH_STANDARD_S5_S3 1 100 0 255 DISPLAY_IDENTIFIER di_obd_iumpr_comp_active_time[27].ZFEH_EepromData ECU_ADDRESS 0xFFF837C3 /end MEASUREMENT
/begin MEASUREMENT ZFEH_EepromData.di_obd_iumpr_comp_active_time[28] "error code related component active time [index = KFC-1]" UBYTE EH_STANDARD_S5_S3 1 100 0 255 DISPLAY_IDENTIFIER di_obd_iumpr_comp_active_time[28].ZFEH_EepromData ECU_ADDRESS 0xFFF837C4 /end MEASUREMENT
/begin MEASUREMENT ZFEH_EepromData.di_obd_iumpr_comp_active_time[29] "error code related component active time [index = KFC-1]" UBYTE EH_STANDARD_S5_S3 1 100 0 255 DISPLAY_IDENTIFIER di_obd_iumpr_comp_active_time[29].ZFEH_EepromData ECU_ADDRESS 0xFFF837C5 /end MEASUREMENT
/begin MEASUREMENT ZFEH_EepromData.di_obd_iumpr_comp_active_time[30] "error code related component active time [index = KFC-1]" UBYTE EH_STANDARD_S5_S3 1 100 0 255 DISPLAY_IDENTIFIER di_obd_iumpr_comp_active_time[30].ZFEH_EepromData ECU_ADDRESS 0xFFF837C6 /end MEASUREMENT
/begin MEASUREMENT ZFEH_EepromData.di_obd_iumpr_comp_active_time[31] "error code related component active time [index = KFC-1]" UBYTE EH_STANDARD_S5_S3 1 100 0 255 DISPLAY_IDENTIFIER di_obd_iumpr_comp_active_time[31].ZFEH_EepromData ECU_ADDRESS 0xFFF837C7 /end MEASUREMENT
/begin MEASUREMENT ZFEH_EepromData.di_obd_iumpr_comp_active_time[32] "error code related component active time [index = KFC-1]" UBYTE EH_STANDARD_S5_S3 1 100 0 255 DISPLAY_IDENTIFIER di_obd_iumpr_comp_active_time[32].ZFEH_EepromData ECU_ADDRESS 0xFFF837C8 /end MEASUREMENT
/begin MEASUREMENT ZFEH_EepromData.di_obd_iumpr_comp_active_time[33] "error code related component active time [index = KFC-1]" UBYTE EH_STANDARD_S5_S3 1 100 0 255 DISPLAY_IDENTIFIER di_obd_iumpr_comp_active_time[33].ZFEH_EepromData ECU_ADDRESS 0xFFF837C9 /end MEASUREMENT
/begin MEASUREMENT ZFEH_EepromData.di_obd_iumpr_comp_active_time[34] "error code related component active time [index = KFC-1]" UBYTE EH_STANDARD_S5_S3 1 100 0 255 DISPLAY_IDENTIFIER di_obd_iumpr_comp_active_time[34].ZFEH_EepromData ECU_ADDRESS 0xFFF837CA /end MEASUREMENT
/begin MEASUREMENT ZFEH_EepromData.di_obd_iumpr_comp_active_time[35] "error code related component active time [index = KFC-1]" UBYTE EH_STANDARD_S5_S3 1 100 0 255 DISPLAY_IDENTIFIER di_obd_iumpr_comp_active_time[35].ZFEH_EepromData ECU_ADDRESS 0xFFF837CB /end MEASUREMENT
/begin MEASUREMENT ZFEH_EepromData.di_obd_iumpr_comp_active_time[36] "error code related component active time [index = KFC-1]" UBYTE EH_STANDARD_S5_S3 1 100 0 255 DISPLAY_IDENTIFIER di_obd_iumpr_comp_active_time[36].ZFEH_EepromData ECU_ADDRESS 0xFFF837CC /end MEASUREMENT
/begin MEASUREMENT ZFEH_EepromData.di_obd_iumpr_comp_active_time[37] "error code related component active time [index = KFC-1]" UBYTE EH_STANDARD_S5_S3 1 100 0 255 DISPLAY_IDENTIFIER di_obd_iumpr_comp_active_time[37].ZFEH_EepromData ECU_ADDRESS 0xFFF837CD /end MEASUREMENT
/begin MEASUREMENT ZFEH_EepromData.di_obd_iumpr_comp_active_time[38] "error code related component active time [index = KFC-1]" UBYTE EH_STANDARD_S5_S3 1 100 0 255 DISPLAY_IDENTIFIER di_obd_iumpr_comp_active_time[38].ZFEH_EepromData ECU_ADDRESS 0xFFF837CE /end MEASUREMENT
/begin MEASUREMENT ZFEH_EepromData.di_obd_iumpr_comp_active_time[39] "error code related component active time [index = KFC-1]" UBYTE EH_STANDARD_S5_S3 1 100 0 255 DISPLAY_IDENTIFIER di_obd_iumpr_comp_active_time[39].ZFEH_EepromData ECU_ADDRESS 0xFFF837CF /end MEASUREMENT
/begin MEASUREMENT ZFEH_EepromData.di_obd_iumpr_comp_active_time[40] "error code related component active time [index = KFC-1]" UBYTE EH_STANDARD_S5_S3 1 100 0 255 DISPLAY_IDENTIFIER di_obd_iumpr_comp_active_time[40].ZFEH_EepromData ECU_ADDRESS 0xFFF837D0 /end MEASUREMENT
/begin MEASUREMENT ZFEH_EepromData.di_obd_iumpr_comp_active_time[41] "error code related component active time [index = KFC-1]" UBYTE EH_STANDARD_S5_S3 1 100 0 255 DISPLAY_IDENTIFIER di_obd_iumpr_comp_active_time[41].ZFEH_EepromData ECU_ADDRESS 0xFFF837D1 /end MEASUREMENT
/begin MEASUREMENT ZFEH_EepromData.di_obd_iumpr_comp_active_time[42] "error code related component active time [index = KFC-1]" UBYTE EH_STANDARD_S5_S3 1 100 0 255 DISPLAY_IDENTIFIER di_obd_iumpr_comp_active_time[42].ZFEH_EepromData ECU_ADDRESS 0xFFF837D2 /end MEASUREMENT
/begin MEASUREMENT ZFEH_EepromData.di_obd_iumpr_comp_active_time[43] "error code related component active time [index = KFC-1]" UBYTE EH_STANDARD_S5_S3 1 100 0 255 DISPLAY_IDENTIFIER di_obd_iumpr_comp_active_time[43].ZFEH_EepromData ECU_ADDRESS 0xFFF837D3 /end MEASUREMENT
/begin MEASUREMENT ZFEH_EepromData.di_obd_iumpr_comp_active_time[44] "error code related component active time [index = KFC-1]" UBYTE EH_STANDARD_S5_S3 1 100 0 255 DISPLAY_IDENTIFIER di_obd_iumpr_comp_active_time[44].ZFEH_EepromData ECU_ADDRESS 0xFFF837D4 /end MEASUREMENT
/begin MEASUREMENT ZFEH_EepromData.di_obd_iumpr_comp_active_time[45] "error code related component active time [index = KFC-1]" UBYTE EH_STANDARD_S5_S3 1 100 0 255 DISPLAY_IDENTIFIER di_obd_iumpr_comp_active_time[45].ZFEH_EepromData ECU_ADDRESS 0xFFF837D5 /end MEASUREMENT
/begin MEASUREMENT ZFEH_EepromData.di_obd_iumpr_comp_active_time[46] "error code related component active time [index = KFC-1]" UBYTE EH_STANDARD_S5_S3 1 100 0 255 DISPLAY_IDENTIFIER di_obd_iumpr_comp_active_time[46].ZFEH_EepromData ECU_ADDRESS 0xFFF837D6 /end MEASUREMENT
/begin MEASUREMENT ZFEH_EepromData.di_obd_iumpr_comp_active_time[47] "error code related component active time [index = KFC-1]" UBYTE EH_STANDARD_S5_S3 1 100 0 255 DISPLAY_IDENTIFIER di_obd_iumpr_comp_active_time[47].ZFEH_EepromData ECU_ADDRESS 0xFFF837D7 /end MEASUREMENT
/begin MEASUREMENT ZFEH_EepromData.di_obd_iumpr_comp_active_time[48] "error code related component active time [index = KFC-1]" UBYTE EH_STANDARD_S5_S3 1 100 0 255 DISPLAY_IDENTIFIER di_obd_iumpr_comp_active_time[48].ZFEH_EepromData ECU_ADDRESS 0xFFF837D8 /end MEASUREMENT
/begin MEASUREMENT ZFEH_EepromData.di_obd_iumpr_comp_active_time[49] "error code related component active time [index = KFC-1]" UBYTE EH_STANDARD_S5_S3 1 100 0 255 DISPLAY_IDENTIFIER di_obd_iumpr_comp_active_time[49].ZFEH_EepromData ECU_ADDRESS 0xFFF837D9 /end MEASUREMENT
/begin MEASUREMENT ZFEH_EepromData.di_obd_iumpr_comp_active_time[50] "error code related component active time [index = KFC-1]" UBYTE EH_STANDARD_S5_S3 1 100 0 255 DISPLAY_IDENTIFIER di_obd_iumpr_comp_active_time[50].ZFEH_EepromData ECU_ADDRESS 0xFFF837DA /end MEASUREMENT
/begin MEASUREMENT ZFEH_EepromData.di_obd_iumpr_comp_active_time[51] "error code related component active time [index = KFC-1]" UBYTE EH_STANDARD_S5_S3 1 100 0 255 DISPLAY_IDENTIFIER di_obd_iumpr_comp_active_time[51].ZFEH_EepromData ECU_ADDRESS 0xFFF837DB /end MEASUREMENT
/begin MEASUREMENT ZFEH_EepromData.di_obd_iumpr_comp_active_time[52] "error code related component active time [index = KFC-1]" UBYTE EH_STANDARD_S5_S3 1 100 0 255 DISPLAY_IDENTIFIER di_obd_iumpr_comp_active_time[52].ZFEH_EepromData ECU_ADDRESS 0xFFF837DC /end MEASUREMENT
/begin MEASUREMENT ZFEH_EepromData.di_obd_iumpr_comp_active_time[53] "error code related component active time [index = KFC-1]" UBYTE EH_STANDARD_S5_S3 1 100 0 255 DISPLAY_IDENTIFIER di_obd_iumpr_comp_active_time[53].ZFEH_EepromData ECU_ADDRESS 0xFFF837DD /end MEASUREMENT
/begin MEASUREMENT ZFEH_EepromData.di_obd_iumpr_comp_active_time[54] "error code related component active time [index = KFC-1]" UBYTE EH_STANDARD_S5_S3 1 100 0 255 DISPLAY_IDENTIFIER di_obd_iumpr_comp_active_time[54].ZFEH_EepromData ECU_ADDRESS 0xFFF837DE /end MEASUREMENT
/begin MEASUREMENT ZFEH_EepromData.di_obd_iumpr_comp_active_time[55] "error code related component active time [index = KFC-1]" UBYTE EH_STANDARD_S5_S3 1 100 0 255 DISPLAY_IDENTIFIER di_obd_iumpr_comp_active_time[55].ZFEH_EepromData ECU_ADDRESS 0xFFF837DF /end MEASUREMENT
/begin MEASUREMENT ZFEH_EepromData.di_obd_iumpr_comp_active_time[56] "error code related component active time [index = KFC-1]" UBYTE EH_STANDARD_S5_S3 1 100 0 255 DISPLAY_IDENTIFIER di_obd_iumpr_comp_active_time[56].ZFEH_EepromData ECU_ADDRESS 0xFFF837E0 /end MEASUREMENT
/begin MEASUREMENT ZFEH_EepromData.di_obd_iumpr_comp_active_time[57] "error code related component active time [index = KFC-1]" UBYTE EH_STANDARD_S5_S3 1 100 0 255 DISPLAY_IDENTIFIER di_obd_iumpr_comp_active_time[57].ZFEH_EepromData ECU_ADDRESS 0xFFF837E1 /end MEASUREMENT
/begin MEASUREMENT ZFEH_EepromData.di_obd_iumpr_comp_active_time[58] "error code related component active time [index = KFC-1]" UBYTE EH_STANDARD_S5_S3 1 100 0 255 DISPLAY_IDENTIFIER di_obd_iumpr_comp_active_time[58].ZFEH_EepromData ECU_ADDRESS 0xFFF837E2 /end MEASUREMENT
/begin MEASUREMENT ZFEH_EepromData.di_obd_iumpr_comp_active_time[59] "error code related component active time [index = KFC-1]" UBYTE EH_STANDARD_S5_S3 1 100 0 255 DISPLAY_IDENTIFIER di_obd_iumpr_comp_active_time[59].ZFEH_EepromData ECU_ADDRESS 0xFFF837E3 /end MEASUREMENT
/begin MEASUREMENT ZFEH_EepromData.di_obd_iumpr_comp_active_time[60] "error code related component active time [index = KFC-1]" UBYTE EH_STANDARD_S5_S3 1 100 0 255 DISPLAY_IDENTIFIER di_obd_iumpr_comp_active_time[60].ZFEH_EepromData ECU_ADDRESS 0xFFF837E4 /end MEASUREMENT
/begin MEASUREMENT ZFEH_EepromData.di_obd_iumpr_comp_active_time[61] "error code related component active time [index = KFC-1]" UBYTE EH_STANDARD_S5_S3 1 100 0 255 DISPLAY_IDENTIFIER di_obd_iumpr_comp_active_time[61].ZFEH_EepromData ECU_ADDRESS 0xFFF837E5 /end MEASUREMENT
/begin MEASUREMENT ZFEH_EepromData.di_obd_iumpr_comp_active_time[62] "error code related component active time [index = KFC-1]" UBYTE EH_STANDARD_S5_S3 1 100 0 255 DISPLAY_IDENTIFIER di_obd_iumpr_comp_active_time[62].ZFEH_EepromData ECU_ADDRESS 0xFFF837E6 /end MEASUREMENT
/begin MEASUREMENT ZFEH_EepromData.di_obd_iumpr_comp_active_time[63] "error code related component active time [index = KFC-1]" UBYTE EH_STANDARD_S5_S3 1 100 0 255 DISPLAY_IDENTIFIER di_obd_iumpr_comp_active_time[63].ZFEH_EepromData ECU_ADDRESS 0xFFF837E7 /end MEASUREMENT
/begin MEASUREMENT ZFEH_EepromData.di_obd_iumpr_comp_active_time[64] "error code related component active time [index = KFC-1]" UBYTE EH_STANDARD_S5_S3 1 100 0 255 DISPLAY_IDENTIFIER di_obd_iumpr_comp_active_time[64].ZFEH_EepromData ECU_ADDRESS 0xFFF837E8 /end MEASUREMENT
/begin MEASUREMENT ZFEH_EepromData.di_obd_iumpr_comp_active_time[65] "error code related component active time [index = KFC-1]" UBYTE EH_STANDARD_S5_S3 1 100 0 255 DISPLAY_IDENTIFIER di_obd_iumpr_comp_active_time[65].ZFEH_EepromData ECU_ADDRESS 0xFFF837E9 /end MEASUREMENT
/begin MEASUREMENT ZFEH_EepromData.di_obd_iumpr_comp_active_time[66] "error code related component active time [index = KFC-1]" UBYTE EH_STANDARD_S5_S3 1 100 0 255 DISPLAY_IDENTIFIER di_obd_iumpr_comp_active_time[66].ZFEH_EepromData ECU_ADDRESS 0xFFF837EA /end MEASUREMENT
/begin MEASUREMENT ZFEH_EepromData.di_obd_iumpr_comp_active_time[67] "error code related component active time [index = KFC-1]" UBYTE EH_STANDARD_S5_S3 1 100 0 255 DISPLAY_IDENTIFIER di_obd_iumpr_comp_active_time[67].ZFEH_EepromData ECU_ADDRESS 0xFFF837EB /end MEASUREMENT
/begin MEASUREMENT ZFEH_EepromData.di_obd_iumpr_comp_active_time[68] "error code related component active time [index = KFC-1]" UBYTE EH_STANDARD_S5_S3 1 100 0 255 DISPLAY_IDENTIFIER di_obd_iumpr_comp_active_time[68].ZFEH_EepromData ECU_ADDRESS 0xFFF837EC /end MEASUREMENT
/begin MEASUREMENT ZFEH_EepromData.di_obd_iumpr_comp_active_time[69] "error code related component active time [index = KFC-1]" UBYTE EH_STANDARD_S5_S3 1 100 0 255 DISPLAY_IDENTIFIER di_obd_iumpr_comp_active_time[69].ZFEH_EepromData ECU_ADDRESS 0xFFF837ED /end MEASUREMENT
/begin MEASUREMENT ZFEH_EepromData.di_obd_iumpr_comp_active_time[70] "error code related component active time [index = KFC-1]" UBYTE EH_STANDARD_S5_S3 1 100 0 255 DISPLAY_IDENTIFIER di_obd_iumpr_comp_active_time[70].ZFEH_EepromData ECU_ADDRESS 0xFFF837EE /end MEASUREMENT
/begin MEASUREMENT ZFEH_EepromData.di_obd_iumpr_comp_active_time[71] "error code related component active time [index = KFC-1]" UBYTE EH_STANDARD_S5_S3 1 100 0 255 DISPLAY_IDENTIFIER di_obd_iumpr_comp_active_time[71].ZFEH_EepromData ECU_ADDRESS 0xFFF837EF /end MEASUREMENT
/begin MEASUREMENT ZFEH_EepromData.di_obd_iumpr_comp_active_time[72] "error code related component active time [index = KFC-1]" UBYTE EH_STANDARD_S5_S3 1 100 0 255 DISPLAY_IDENTIFIER di_obd_iumpr_comp_active_time[72].ZFEH_EepromData ECU_ADDRESS 0xFFF837F0 /end MEASUREMENT
/begin MEASUREMENT ZFEH_EepromData.di_obd_iumpr_comp_active_time[73] "error code related component active time [index = KFC-1]" UBYTE EH_STANDARD_S5_S3 1 100 0 255 DISPLAY_IDENTIFIER di_obd_iumpr_comp_active_time[73].ZFEH_EepromData ECU_ADDRESS 0xFFF837F1 /end MEASUREMENT
/begin MEASUREMENT ZFEH_EepromData.di_obd_iumpr_comp_active_time[74] "error code related component active time [index = KFC-1]" UBYTE EH_STANDARD_S5_S3 1 100 0 255 DISPLAY_IDENTIFIER di_obd_iumpr_comp_active_time[74].ZFEH_EepromData ECU_ADDRESS 0xFFF837F2 /end MEASUREMENT
/begin MEASUREMENT ZFEH_EepromData.di_obd_iumpr_comp_active_time[75] "error code related component active time [index = KFC-1]" UBYTE EH_STANDARD_S5_S3 1 100 0 255 DISPLAY_IDENTIFIER di_obd_iumpr_comp_active_time[75].ZFEH_EepromData ECU_ADDRESS 0xFFF837F3 /end MEASUREMENT
/begin MEASUREMENT ZFEH_EepromData.di_obd_iumpr_comp_active_time[76] "error code related component active time [index = KFC-1]" UBYTE EH_STANDARD_S5_S3 1 100 0 255 DISPLAY_IDENTIFIER di_obd_iumpr_comp_active_time[76].ZFEH_EepromData ECU_ADDRESS 0xFFF837F4 /end MEASUREMENT
/begin MEASUREMENT ZFEH_EepromData.di_obd_iumpr_comp_active_time[77] "error code related component active time [index = KFC-1]" UBYTE EH_STANDARD_S5_S3 1 100 0 255 DISPLAY_IDENTIFIER di_obd_iumpr_comp_active_time[77].ZFEH_EepromData ECU_ADDRESS 0xFFF837F5 /end MEASUREMENT
/begin MEASUREMENT ZFEH_EepromData.di_obd_iumpr_comp_active_time[78] "error code related component active time [index = KFC-1]" UBYTE EH_STANDARD_S5_S3 1 100 0 255 DISPLAY_IDENTIFIER di_obd_iumpr_comp_active_time[78].ZFEH_EepromData ECU_ADDRESS 0xFFF837F6 /end MEASUREMENT
/begin MEASUREMENT ZFEH_EepromData.di_obd_iumpr_comp_active_time[79] "error code related component active time [index = KFC-1]" UBYTE EH_STANDARD_S5_S3 1 100 0 255 DISPLAY_IDENTIFIER di_obd_iumpr_comp_active_time[79].ZFEH_EepromData ECU_ADDRESS 0xFFF837F7 /end MEASUREMENT
/begin MEASUREMENT ZFEH_EepromData.di_obd_iumpr_comp_active_time[80] "error code related component active time [index = KFC-1]" UBYTE EH_STANDARD_S5_S3 1 100 0 255 DISPLAY_IDENTIFIER di_obd_iumpr_comp_active_time[80].ZFEH_EepromData ECU_ADDRESS 0xFFF837F8 /end MEASUREMENT
/begin MEASUREMENT ZFEH_EepromData.di_obd_iumpr_comp_active_time[81] "error code related component active time [index = KFC-1]" UBYTE EH_STANDARD_S5_S3 1 100 0 255 DISPLAY_IDENTIFIER di_obd_iumpr_comp_active_time[81].ZFEH_EepromData ECU_ADDRESS 0xFFF837F9 /end MEASUREMENT
/begin MEASUREMENT ZFEH_EepromData.di_obd_iumpr_comp_active_time[82] "error code related component active time [index = KFC-1]" UBYTE EH_STANDARD_S5_S3 1 100 0 255 DISPLAY_IDENTIFIER di_obd_iumpr_comp_active_time[82].ZFEH_EepromData ECU_ADDRESS 0xFFF837FA /end MEASUREMENT
/begin MEASUREMENT ZFEH_EepromData.di_obd_iumpr_comp_active_time[83] "error code related component active time [index = KFC-1]" UBYTE EH_STANDARD_S5_S3 1 100 0 255 DISPLAY_IDENTIFIER di_obd_iumpr_comp_active_time[83].ZFEH_EepromData ECU_ADDRESS 0xFFF837FB /end MEASUREMENT
/begin MEASUREMENT ZFEH_EepromData.di_obd_iumpr_comp_active_time[84] "error code related component active time [index = KFC-1]" UBYTE EH_STANDARD_S5_S3 1 100 0 255 DISPLAY_IDENTIFIER di_obd_iumpr_comp_active_time[84].ZFEH_EepromData ECU_ADDRESS 0xFFF837FC /end MEASUREMENT
/begin MEASUREMENT ZFEH_EepromData.di_obd_iumpr_comp_active_time[85] "error code related component active time [index = KFC-1]" UBYTE EH_STANDARD_S5_S3 1 100 0 255 DISPLAY_IDENTIFIER di_obd_iumpr_comp_active_time[85].ZFEH_EepromData ECU_ADDRESS 0xFFF837FD /end MEASUREMENT
/begin MEASUREMENT ZFEH_EepromData.di_obd_iumpr_comp_active_time[86] "error code related component active time [index = KFC-1]" UBYTE EH_STANDARD_S5_S3 1 100 0 255 DISPLAY_IDENTIFIER di_obd_iumpr_comp_active_time[86].ZFEH_EepromData ECU_ADDRESS 0xFFF837FE /end MEASUREMENT
/begin MEASUREMENT ZFEH_EepromData.di_obd_iumpr_comp_active_time[87] "error code related component active time [index = KFC-1]" UBYTE EH_STANDARD_S5_S3 1 100 0 255 DISPLAY_IDENTIFIER di_obd_iumpr_comp_active_time[87].ZFEH_EepromData ECU_ADDRESS 0xFFF837FF /end MEASUREMENT
/begin MEASUREMENT ZFEH_EepromData.di_obd_iumpr_comp_active_time[88] "error code related component active time [index = KFC-1]" UBYTE EH_STANDARD_S5_S3 1 100 0 255 DISPLAY_IDENTIFIER di_obd_iumpr_comp_active_time[88].ZFEH_EepromData ECU_ADDRESS 0xFFF83800 /end MEASUREMENT
/begin MEASUREMENT ZFEH_EepromData.di_obd_iumpr_comp_active_time[89] "error code related component active time [index = KFC-1]" UBYTE EH_STANDARD_S5_S3 1 100 0 255 DISPLAY_IDENTIFIER di_obd_iumpr_comp_active_time[89].ZFEH_EepromData ECU_ADDRESS 0xFFF83801 /end MEASUREMENT
/begin MEASUREMENT ZFEH_EepromData.di_obd_iumpr_comp_active_time[90] "error code related component active time [index = KFC-1]" UBYTE EH_STANDARD_S5_S3 1 100 0 255 DISPLAY_IDENTIFIER di_obd_iumpr_comp_active_time[90].ZFEH_EepromData ECU_ADDRESS 0xFFF83802 /end MEASUREMENT
/begin MEASUREMENT ZFEH_EepromData.di_obd_iumpr_comp_active_time[91] "error code related component active time [index = KFC-1]" UBYTE EH_STANDARD_S5_S3 1 100 0 255 DISPLAY_IDENTIFIER di_obd_iumpr_comp_active_time[91].ZFEH_EepromData ECU_ADDRESS 0xFFF83803 /end MEASUREMENT
/begin MEASUREMENT ZFEH_EepromData.di_obd_iumpr_comp_active_time[92] "error code related component active time [index = KFC-1]" UBYTE EH_STANDARD_S5_S3 1 100 0 255 DISPLAY_IDENTIFIER di_obd_iumpr_comp_active_time[92].ZFEH_EepromData ECU_ADDRESS 0xFFF83804 /end MEASUREMENT
/begin MEASUREMENT ZFEH_EepromData.di_obd_iumpr_comp_active_time[93] "error code related component active time [index = KFC-1]" UBYTE EH_STANDARD_S5_S3 1 100 0 255 DISPLAY_IDENTIFIER di_obd_iumpr_comp_active_time[93].ZFEH_EepromData ECU_ADDRESS 0xFFF83805 /end MEASUREMENT
/begin MEASUREMENT ZFEH_EepromData.di_obd_iumpr_comp_active_time[94] "error code related component active time [index = KFC-1]" UBYTE EH_STANDARD_S5_S3 1 100 0 255 DISPLAY_IDENTIFIER di_obd_iumpr_comp_active_time[94].ZFEH_EepromData ECU_ADDRESS 0xFFF83806 /end MEASUREMENT
/begin MEASUREMENT ZFEH_EepromData.di_obd_iumpr_comp_active_time[95] "error code related component active time [index = KFC-1]" UBYTE EH_STANDARD_S5_S3 1 100 0 255 DISPLAY_IDENTIFIER di_obd_iumpr_comp_active_time[95].ZFEH_EepromData ECU_ADDRESS 0xFFF83807 /end MEASUREMENT
/begin MEASUREMENT ZFEH_EepromData.di_obd_iumpr_comp_active_time[96] "error code related component active time [index = KFC-1]" UBYTE EH_STANDARD_S5_S3 1 100 0 255 DISPLAY_IDENTIFIER di_obd_iumpr_comp_active_time[96].ZFEH_EepromData ECU_ADDRESS 0xFFF83808 /end MEASUREMENT
/begin MEASUREMENT ZFEH_EepromData.di_obd_iumpr_comp_active_time[97] "error code related component active time [index = KFC-1]" UBYTE EH_STANDARD_S5_S3 1 100 0 255 DISPLAY_IDENTIFIER di_obd_iumpr_comp_active_time[97].ZFEH_EepromData ECU_ADDRESS 0xFFF83809 /end MEASUREMENT
/begin MEASUREMENT ZFEH_EepromData.di_obd_iumpr_comp_active_time[98] "error code related component active time [index = KFC-1]" UBYTE EH_STANDARD_S5_S3 1 100 0 255 DISPLAY_IDENTIFIER di_obd_iumpr_comp_active_time[98].ZFEH_EepromData ECU_ADDRESS 0xFFF8380A /end MEASUREMENT
/begin MEASUREMENT ZFEH_EepromData.di_obd_iumpr_comp_active_time[99] "error code related component active time [index = KFC-1]" UBYTE EH_STANDARD_S5_S3 1 100 0 255 DISPLAY_IDENTIFIER di_obd_iumpr_comp_active_time[99].ZFEH_EepromData ECU_ADDRESS 0xFFF8380B /end MEASUREMENT
/begin MEASUREMENT ZFEH_EepromData.di_obd_iumpr_comp_active_time[170] "error code related component active time [index = KFC-1]" UBYTE EH_STANDARD_S5_S3 1 100 0 255 DISPLAY_IDENTIFIER di_obd_iumpr_comp_active_time[170].ZFEH_EepromData ECU_ADDRESS 0xFFF83852 /end MEASUREMENT
/begin MEASUREMENT ZFEH_EepromData.di_obd_iumpr_comp_active_time[171] "error code related component active time [index = KFC-1]" UBYTE EH_STANDARD_S5_S3 1 100 0 255 DISPLAY_IDENTIFIER di_obd_iumpr_comp_active_time[171].ZFEH_EepromData ECU_ADDRESS 0xFFF83853 /end MEASUREMENT
/begin MEASUREMENT ZFEH_EepromData.di_obd_iumpr_comp_active_time[172] "error code related component active time [index = KFC-1]" UBYTE EH_STANDARD_S5_S3 1 100 0 255 DISPLAY_IDENTIFIER di_obd_iumpr_comp_active_time[172].ZFEH_EepromData ECU_ADDRESS 0xFFF83854 /end MEASUREMENT
/begin MEASUREMENT ZFEH_EepromData.di_obd_iumpr_comp_active_time[173] "error code related component active time [index = KFC-1]" UBYTE EH_STANDARD_S5_S3 1 100 0 255 DISPLAY_IDENTIFIER di_obd_iumpr_comp_active_time[173].ZFEH_EepromData ECU_ADDRESS 0xFFF83855 /end MEASUREMENT
/begin MEASUREMENT ZFEH_EepromData.di_obd_iumpr_comp_active_time[174] "error code related component active time [index = KFC-1]" UBYTE EH_STANDARD_S5_S3 1 100 0 255 DISPLAY_IDENTIFIER di_obd_iumpr_comp_active_time[174].ZFEH_EepromData ECU_ADDRESS 0xFFF83856 /end MEASUREMENT
/begin MEASUREMENT ZFEH_EepromData.di_obd_iumpr_comp_active_time[175] "error code related component active time [index = KFC-1]" UBYTE EH_STANDARD_S5_S3 1 100 0 255 DISPLAY_IDENTIFIER di_obd_iumpr_comp_active_time[175].ZFEH_EepromData ECU_ADDRESS 0xFFF83857 /end MEASUREMENT
/begin MEASUREMENT ZFEH_EepromData.di_obd_iumpr_comp_active_time[176] "error code related component active time [index = KFC-1]" UBYTE EH_STANDARD_S5_S3 1 100 0 255 DISPLAY_IDENTIFIER di_obd_iumpr_comp_active_time[176].ZFEH_EepromData ECU_ADDRESS 0xFFF83858 /end MEASUREMENT
/begin MEASUREMENT ZFEH_EepromData.di_obd_iumpr_comp_active_time[177] "error code related component active time [index = KFC-1]" UBYTE EH_STANDARD_S5_S3 1 100 0 255 DISPLAY_IDENTIFIER di_obd_iumpr_comp_active_time[177].ZFEH_EepromData ECU_ADDRESS 0xFFF83859 /end MEASUREMENT
/begin MEASUREMENT ZFEH_EepromData.di_obd_iumpr_comp_active_time[178] "error code related component active time [index = KFC-1]" UBYTE EH_STANDARD_S5_S3 1 100 0 255 DISPLAY_IDENTIFIER di_obd_iumpr_comp_active_time[178].ZFEH_EepromData ECU_ADDRESS 0xFFF8385A /end MEASUREMENT
/begin MEASUREMENT ZFEH_EepromData.di_obd_iumpr_comp_active_time[179] "error code related component active time [index = KFC-1]" UBYTE EH_STANDARD_S5_S3 1 100 0 255 DISPLAY_IDENTIFIER di_obd_iumpr_comp_active_time[179].ZFEH_EepromData ECU_ADDRESS 0xFFF8385B /end MEASUREMENT
/begin MEASUREMENT ZFEH_EepromData.di_obd_iumpr_comp_active_time[180] "error code related component active time [index = KFC-1]" UBYTE EH_STANDARD_S5_S3 1 100 0 255 DISPLAY_IDENTIFIER di_obd_iumpr_comp_active_time[180].ZFEH_EepromData ECU_ADDRESS 0xFFF8385C /end MEASUREMENT
/begin MEASUREMENT ZFEH_EepromData.di_obd_iumpr_comp_active_time[181] "error code related component active time [index = KFC-1]" UBYTE EH_STANDARD_S5_S3 1 100 0 255 DISPLAY_IDENTIFIER di_obd_iumpr_comp_active_time[181].ZFEH_EepromData ECU_ADDRESS 0xFFF8385D /end MEASUREMENT
/begin MEASUREMENT ZFEH_EepromData.di_obd_iumpr_comp_active_time[182] "error code related component active time [index = KFC-1]" UBYTE EH_STANDARD_S5_S3 1 100 0 255 DISPLAY_IDENTIFIER di_obd_iumpr_comp_active_time[182].ZFEH_EepromData ECU_ADDRESS 0xFFF8385E /end MEASUREMENT
/begin MEASUREMENT ZFEH_EepromData.di_obd_iumpr_comp_active_time[183] "error code related component active time [index = KFC-1]" UBYTE EH_STANDARD_S5_S3 1 100 0 255 DISPLAY_IDENTIFIER di_obd_iumpr_comp_active_time[183].ZFEH_EepromData ECU_ADDRESS 0xFFF8385F /end MEASUREMENT
/begin MEASUREMENT ZFEH_EepromData.di_obd_iumpr_comp_active_time[184] "error code related component active time [index = KFC-1]" UBYTE EH_STANDARD_S5_S3 1 100 0 255 DISPLAY_IDENTIFIER di_obd_iumpr_comp_active_time[184].ZFEH_EepromData ECU_ADDRESS 0xFFF83860 /end MEASUREMENT
/begin MEASUREMENT ZFEH_EepromData.di_obd_iumpr_comp_active_time[185] "error code related component active time [index = KFC-1]" UBYTE EH_STANDARD_S5_S3 1 100 0 255 DISPLAY_IDENTIFIER di_obd_iumpr_comp_active_time[185].ZFEH_EepromData ECU_ADDRESS 0xFFF83861 /end MEASUREMENT
/begin MEASUREMENT ZFEH_EepromData.di_obd_iumpr_comp_active_time[186] "error code related component active time [index = KFC-1]" UBYTE EH_STANDARD_S5_S3 1 100 0 255 DISPLAY_IDENTIFIER di_obd_iumpr_comp_active_time[186].ZFEH_EepromData ECU_ADDRESS 0xFFF83862 /end MEASUREMENT
/begin MEASUREMENT ZFEH_EepromData.di_obd_iumpr_comp_active_time[187] "error code related component active time [index = KFC-1]" UBYTE EH_STANDARD_S5_S3 1 100 0 255 DISPLAY_IDENTIFIER di_obd_iumpr_comp_active_time[187].ZFEH_EepromData ECU_ADDRESS 0xFFF83863 /end MEASUREMENT
/begin MEASUREMENT ZFEH_EepromData.di_obd_iumpr_comp_active_time[188] "error code related component active time [index = KFC-1]" UBYTE EH_STANDARD_S5_S3 1 100 0 255 DISPLAY_IDENTIFIER di_obd_iumpr_comp_active_time[188].ZFEH_EepromData ECU_ADDRESS 0xFFF83864 /end MEASUREMENT
/begin MEASUREMENT ZFEH_EepromData.di_obd_iumpr_comp_active_time[189] "error code related component active time [index = KFC-1]" UBYTE EH_STANDARD_S5_S3 1 100 0 255 DISPLAY_IDENTIFIER di_obd_iumpr_comp_active_time[189].ZFEH_EepromData ECU_ADDRESS 0xFFF83865 /end MEASUREMENT
/begin MEASUREMENT ZFEH_EepromData.di_obd_iumpr_comp_active_time[190] "error code related component active time [index = KFC-1]" UBYTE EH_STANDARD_S5_S3 1 100 0 255 DISPLAY_IDENTIFIER di_obd_iumpr_comp_active_time[190].ZFEH_EepromData ECU_ADDRESS 0xFFF83866 /end MEASUREMENT
/begin MEASUREMENT ZFEH_EepromData.di_obd_iumpr_comp_active_time[191] "error code related component active time [index = KFC-1]" UBYTE EH_STANDARD_S5_S3 1 100 0 255 DISPLAY_IDENTIFIER di_obd_iumpr_comp_active_time[191].ZFEH_EepromData ECU_ADDRESS 0xFFF83867 /end MEASUREMENT
/begin MEASUREMENT ZFEH_EepromData.di_obd_iumpr_comp_active_time[192] "error code related component active time [index = KFC-1]" UBYTE EH_STANDARD_S5_S3 1 100 0 255 DISPLAY_IDENTIFIER di_obd_iumpr_comp_active_time[192].ZFEH_EepromData ECU_ADDRESS 0xFFF83868 /end MEASUREMENT
/begin MEASUREMENT ZFEH_EepromData.di_obd_iumpr_comp_active_time[193] "error code related component active time [index = KFC-1]" UBYTE EH_STANDARD_S5_S3 1 100 0 255 DISPLAY_IDENTIFIER di_obd_iumpr_comp_active_time[193].ZFEH_EepromData ECU_ADDRESS 0xFFF83869 /end MEASUREMENT
/begin MEASUREMENT ZFEH_EepromData.di_obd_iumpr_comp_active_time[194] "error code related component active time [index = KFC-1]" UBYTE EH_STANDARD_S5_S3 1 100 0 255 DISPLAY_IDENTIFIER di_obd_iumpr_comp_active_time[194].ZFEH_EepromData ECU_ADDRESS 0xFFF8386A /end MEASUREMENT
/begin MEASUREMENT ZFEH_EepromData.di_obd_iumpr_comp_active_time[195] "error code related component active time [index = KFC-1]" UBYTE EH_STANDARD_S5_S3 1 100 0 255 DISPLAY_IDENTIFIER di_obd_iumpr_comp_active_time[195].ZFEH_EepromData ECU_ADDRESS 0xFFF8386B /end MEASUREMENT
/begin MEASUREMENT ZFEH_EepromData.di_obd_iumpr_comp_active_time[196] "error code related component active time [index = KFC-1]" UBYTE EH_STANDARD_S5_S3 1 100 0 255 DISPLAY_IDENTIFIER di_obd_iumpr_comp_active_time[196].ZFEH_EepromData ECU_ADDRESS 0xFFF8386C /end MEASUREMENT
/begin MEASUREMENT ZFEH_EepromData.di_obd_iumpr_comp_active_time[197] "error code related component active time [index = KFC-1]" UBYTE EH_STANDARD_S5_S3 1 100 0 255 DISPLAY_IDENTIFIER di_obd_iumpr_comp_active_time[197].ZFEH_EepromData ECU_ADDRESS 0xFFF8386D /end MEASUREMENT
/begin MEASUREMENT ZFEH_EepromData.di_obd_iumpr_comp_active_time[198] "error code related component active time [index = KFC-1]" UBYTE EH_STANDARD_S5_S3 1 100 0 255 DISPLAY_IDENTIFIER di_obd_iumpr_comp_active_time[198].ZFEH_EepromData ECU_ADDRESS 0xFFF8386E /end MEASUREMENT
/begin MEASUREMENT ZFEH_EepromData.di_obd_iumpr_comp_active_time[199] "error code related component active time [index = KFC-1]" UBYTE EH_STANDARD_S5_S3 1 100 0 255 DISPLAY_IDENTIFIER di_obd_iumpr_comp_active_time[199].ZFEH_EepromData ECU_ADDRESS 0xFFF8386F /end MEASUREMENT
/begin MEASUREMENT ZFEH_EepromData.di_obd_iumpr_comp_active_time[200] "error code related component active time [index = KFC-1]" UBYTE EH_STANDARD_S5_S3 1 100 0 255 DISPLAY_IDENTIFIER di_obd_iumpr_comp_active_time[200].ZFEH_EepromData ECU_ADDRESS 0xFFF83870 /end MEASUREMENT
/begin MEASUREMENT ZFEH_EepromData.di_obd_iumpr_comp_active_time[201] "error code related component active time [index = KFC-1]" UBYTE EH_STANDARD_S5_S3 1 100 0 255 DISPLAY_IDENTIFIER di_obd_iumpr_comp_active_time[201].ZFEH_EepromData ECU_ADDRESS 0xFFF83871 /end MEASUREMENT
/begin MEASUREMENT ZFEH_EepromData.di_obd_iumpr_comp_active_time[202] "error code related component active time [index = KFC-1]" UBYTE EH_STANDARD_S5_S3 1 100 0 255 DISPLAY_IDENTIFIER di_obd_iumpr_comp_active_time[202].ZFEH_EepromData ECU_ADDRESS 0xFFF83872 /end MEASUREMENT
/begin MEASUREMENT ZFEH_EepromData.di_obd_iumpr_comp_active_time[203] "error code related component active time [index = KFC-1]" UBYTE EH_STANDARD_S5_S3 1 100 0 255 DISPLAY_IDENTIFIER di_obd_iumpr_comp_active_time[203].ZFEH_EepromData ECU_ADDRESS 0xFFF83873 /end MEASUREMENT
/begin MEASUREMENT ZFEH_EepromData.di_obd_iumpr_comp_active_time[204] "error code related component active time [index = KFC-1]" UBYTE EH_STANDARD_S5_S3 1 100 0 255 DISPLAY_IDENTIFIER di_obd_iumpr_comp_active_time[204].ZFEH_EepromData ECU_ADDRESS 0xFFF83874 /end MEASUREMENT
/begin MEASUREMENT ZFEH_EepromData.di_obd_iumpr_comp_active_time[205] "error code related component active time [index = KFC-1]" UBYTE EH_STANDARD_S5_S3 1 100 0 255 DISPLAY_IDENTIFIER di_obd_iumpr_comp_active_time[205].ZFEH_EepromData ECU_ADDRESS 0xFFF83875 /end MEASUREMENT
/begin MEASUREMENT ZFEH_EepromData.di_obd_iumpr_comp_active_time[206] "error code related component active time [index = KFC-1]" UBYTE EH_STANDARD_S5_S3 1 100 0 255 DISPLAY_IDENTIFIER di_obd_iumpr_comp_active_time[206].ZFEH_EepromData ECU_ADDRESS 0xFFF83876 /end MEASUREMENT
/begin MEASUREMENT ZFEH_EepromData.di_obd_iumpr_comp_active_time[207] "error code related component active time [index = KFC-1]" UBYTE EH_STANDARD_S5_S3 1 100 0 255 DISPLAY_IDENTIFIER di_obd_iumpr_comp_active_time[207].ZFEH_EepromData ECU_ADDRESS 0xFFF83877 /end MEASUREMENT
/begin MEASUREMENT ZFEH_EepromData.di_obd_iumpr_comp_active_time[208] "error code related component active time [index = KFC-1]" UBYTE EH_STANDARD_S5_S3 1 100 0 255 DISPLAY_IDENTIFIER di_obd_iumpr_comp_active_time[208].ZFEH_EepromData ECU_ADDRESS 0xFFF83878 /end MEASUREMENT
/begin MEASUREMENT ZFEH_EepromData.di_obd_iumpr_comp_active_time[209] "error code related component active time [index = KFC-1]" UBYTE EH_STANDARD_S5_S3 1 100 0 255 DISPLAY_IDENTIFIER di_obd_iumpr_comp_active_time[209].ZFEH_EepromData ECU_ADDRESS 0xFFF83879 /end MEASUREMENT
/begin MEASUREMENT ZFEH_EepromData.di_obd_iumpr_comp_active_time[210] "error code related component active time [index = KFC-1]" UBYTE EH_STANDARD_S5_S3 1 100 0 255 DISPLAY_IDENTIFIER di_obd_iumpr_comp_active_time[210].ZFEH_EepromData ECU_ADDRESS 0xFFF8387A /end MEASUREMENT
/begin MEASUREMENT ZFEH_EepromData.di_obd_iumpr_comp_active_time[211] "error code related component active time [index = KFC-1]" UBYTE EH_STANDARD_S5_S3 1 100 0 255 DISPLAY_IDENTIFIER di_obd_iumpr_comp_active_time[211].ZFEH_EepromData ECU_ADDRESS 0xFFF8387B /end MEASUREMENT
/begin MEASUREMENT ZFEH_EepromData.di_obd_iumpr_comp_active_time[212] "error code related component active time [index = KFC-1]" UBYTE EH_STANDARD_S5_S3 1 100 0 255 DISPLAY_IDENTIFIER di_obd_iumpr_comp_active_time[212].ZFEH_EepromData ECU_ADDRESS 0xFFF8387C /end MEASUREMENT
/begin MEASUREMENT ZFEH_EepromData.di_obd_iumpr_comp_active_time[213] "error code related component active time [index = KFC-1]" UBYTE EH_STANDARD_S5_S3 1 100 0 255 DISPLAY_IDENTIFIER di_obd_iumpr_comp_active_time[213].ZFEH_EepromData ECU_ADDRESS 0xFFF8387D /end MEASUREMENT
/begin MEASUREMENT ZFEH_EepromData.di_obd_iumpr_comp_active_time[214] "error code related component active time [index = KFC-1]" UBYTE EH_STANDARD_S5_S3 1 100 0 255 DISPLAY_IDENTIFIER di_obd_iumpr_comp_active_time[214].ZFEH_EepromData ECU_ADDRESS 0xFFF8387E /end MEASUREMENT
/begin MEASUREMENT ZFEH_EepromData.di_obd_iumpr_comp_active_time[215] "error code related component active time [index = KFC-1]" UBYTE EH_STANDARD_S5_S3 1 100 0 255 DISPLAY_IDENTIFIER di_obd_iumpr_comp_active_time[215].ZFEH_EepromData ECU_ADDRESS 0xFFF8387F /end MEASUREMENT
/begin MEASUREMENT ZFEH_EepromData.di_obd_iumpr_comp_active_time[216] "error code related component active time [index = KFC-1]" UBYTE EH_STANDARD_S5_S3 1 100 0 255 DISPLAY_IDENTIFIER di_obd_iumpr_comp_active_time[216].ZFEH_EepromData ECU_ADDRESS 0xFFF83880 /end MEASUREMENT
/begin MEASUREMENT ZFEH_EepromData.di_obd_iumpr_comp_active_time[217] "error code related component active time [index = KFC-1]" UBYTE EH_STANDARD_S5_S3 1 100 0 255 DISPLAY_IDENTIFIER di_obd_iumpr_comp_active_time[217].ZFEH_EepromData ECU_ADDRESS 0xFFF83881 /end MEASUREMENT
/begin MEASUREMENT ZFEH_EepromData.di_obd_iumpr_comp_active_time[218] "error code related component active time [index = KFC-1]" UBYTE EH_STANDARD_S5_S3 1 100 0 255 DISPLAY_IDENTIFIER di_obd_iumpr_comp_active_time[218].ZFEH_EepromData ECU_ADDRESS 0xFFF83882 /end MEASUREMENT
/begin MEASUREMENT ZFEH_EepromData.di_obd_iumpr_comp_active_time[219] "error code related component active time [index = KFC-1]" UBYTE EH_STANDARD_S5_S3 1 100 0 255 DISPLAY_IDENTIFIER di_obd_iumpr_comp_active_time[219].ZFEH_EepromData ECU_ADDRESS 0xFFF83883 /end MEASUREMENT
/begin MEASUREMENT ZFEH_EepromData.di_obd_iumpr_comp_active_time[220] "error code related component active time [index = KFC-1]" UBYTE EH_STANDARD_S5_S3 1 100 0 255 DISPLAY_IDENTIFIER di_obd_iumpr_comp_active_time[220].ZFEH_EepromData ECU_ADDRESS 0xFFF83884 /end MEASUREMENT
/begin MEASUREMENT ZFEH_EepromData.di_obd_iumpr_comp_active_time[221] "error code related component active time [index = KFC-1]" UBYTE EH_STANDARD_S5_S3 1 100 0 255 DISPLAY_IDENTIFIER di_obd_iumpr_comp_active_time[221].ZFEH_EepromData ECU_ADDRESS 0xFFF83885 /end MEASUREMENT
/begin MEASUREMENT ZFEH_EepromData.di_obd_iumpr_comp_active_time[222] "error code related component active time [index = KFC-1]" UBYTE EH_STANDARD_S5_S3 1 100 0 255 DISPLAY_IDENTIFIER di_obd_iumpr_comp_active_time[222].ZFEH_EepromData ECU_ADDRESS 0xFFF83886 /end MEASUREMENT
/begin MEASUREMENT ZFEH_EepromData.di_obd_iumpr_comp_active_time[223] "error code related component active time [index = KFC-1]" UBYTE EH_STANDARD_S5_S3 1 100 0 255 DISPLAY_IDENTIFIER di_obd_iumpr_comp_active_time[223].ZFEH_EepromData ECU_ADDRESS 0xFFF83887 /end MEASUREMENT
/begin MEASUREMENT ZFEH_EepromData.di_obd_iumpr_comp_active_time[224] "error code related component active time [index = KFC-1]" UBYTE EH_STANDARD_S5_S3 1 100 0 255 DISPLAY_IDENTIFIER di_obd_iumpr_comp_active_time[224].ZFEH_EepromData ECU_ADDRESS 0xFFF83888 /end MEASUREMENT
/begin MEASUREMENT ZFEH_EepromData.di_obd_iumpr_comp_active_time[225] "error code related component active time [index = KFC-1]" UBYTE EH_STANDARD_S5_S3 1 100 0 255 DISPLAY_IDENTIFIER di_obd_iumpr_comp_active_time[225].ZFEH_EepromData ECU_ADDRESS 0xFFF83889 /end MEASUREMENT
/begin MEASUREMENT ZFEH_EepromData.di_obd_iumpr_comp_active_time[226] "error code related component active time [index = KFC-1]" UBYTE EH_STANDARD_S5_S3 1 100 0 255 DISPLAY_IDENTIFIER di_obd_iumpr_comp_active_time[226].ZFEH_EepromData ECU_ADDRESS 0xFFF8388A /end MEASUREMENT
/begin MEASUREMENT ZFEH_EepromData.di_obd_iumpr_comp_active_time[227] "error code related component active time [index = KFC-1]" UBYTE EH_STANDARD_S5_S3 1 100 0 255 DISPLAY_IDENTIFIER di_obd_iumpr_comp_active_time[227].ZFEH_EepromData ECU_ADDRESS 0xFFF8388B /end MEASUREMENT
/begin MEASUREMENT ZFEH_EepromData.di_obd_iumpr_comp_active_time[228] "error code related component active time [index = KFC-1]" UBYTE EH_STANDARD_S5_S3 1 100 0 255 DISPLAY_IDENTIFIER di_obd_iumpr_comp_active_time[228].ZFEH_EepromData ECU_ADDRESS 0xFFF8388C /end MEASUREMENT
/begin MEASUREMENT ZFEH_EepromData.di_obd_iumpr_comp_active_time[229] "error code related component active time [index = KFC-1]" UBYTE EH_STANDARD_S5_S3 1 100 0 255 DISPLAY_IDENTIFIER di_obd_iumpr_comp_active_time[229].ZFEH_EepromData ECU_ADDRESS 0xFFF8388D /end MEASUREMENT
/begin MEASUREMENT ZFEH_EepromData.di_obd_iumpr_comp_active_time[230] "error code related component active time [index = KFC-1]" UBYTE EH_STANDARD_S5_S3 1 100 0 255 DISPLAY_IDENTIFIER di_obd_iumpr_comp_active_time[230].ZFEH_EepromData ECU_ADDRESS 0xFFF8388E /end MEASUREMENT
/begin MEASUREMENT ZFEH_EepromData.di_obd_iumpr_comp_active_time[231] "error code related component active time [index = KFC-1]" UBYTE EH_STANDARD_S5_S3 1 100 0 255 DISPLAY_IDENTIFIER di_obd_iumpr_comp_active_time[231].ZFEH_EepromData ECU_ADDRESS 0xFFF8388F /end MEASUREMENT
/begin MEASUREMENT ZFEH_EepromData.di_obd_iumpr_comp_active_time[232] "error code related component active time [index = KFC-1]" UBYTE EH_STANDARD_S5_S3 1 100 0 255 DISPLAY_IDENTIFIER di_obd_iumpr_comp_active_time[232].ZFEH_EepromData ECU_ADDRESS 0xFFF83890 /end MEASUREMENT
/begin MEASUREMENT ZFEH_EepromData.di_obd_iumpr_comp_active_time[233] "error code related component active time [index = KFC-1]" UBYTE EH_STANDARD_S5_S3 1 100 0 255 DISPLAY_IDENTIFIER di_obd_iumpr_comp_active_time[233].ZFEH_EepromData ECU_ADDRESS 0xFFF83891 /end MEASUREMENT
/begin MEASUREMENT ZFEH_EepromData.di_obd_iumpr_comp_active_time[234] "error code related component active time [index = KFC-1]" UBYTE EH_STANDARD_S5_S3 1 100 0 255 DISPLAY_IDENTIFIER di_obd_iumpr_comp_active_time[234].ZFEH_EepromData ECU_ADDRESS 0xFFF83892 /end MEASUREMENT
/begin MEASUREMENT ZFEH_EepromData.di_obd_iumpr_comp_active_time[235] "error code related component active time [index = KFC-1]" UBYTE EH_STANDARD_S5_S3 1 100 0 255 DISPLAY_IDENTIFIER di_obd_iumpr_comp_active_time[235].ZFEH_EepromData ECU_ADDRESS 0xFFF83893 /end MEASUREMENT
/begin MEASUREMENT ZFEH_EepromData.di_obd_iumpr_comp_active_time[236] "error code related component active time [index = KFC-1]" UBYTE EH_STANDARD_S5_S3 1 100 0 255 DISPLAY_IDENTIFIER di_obd_iumpr_comp_active_time[236].ZFEH_EepromData ECU_ADDRESS 0xFFF83894 /end MEASUREMENT
/begin MEASUREMENT ZFEH_EepromData.di_obd_iumpr_comp_active_time[237] "error code related component active time [index = KFC-1]" UBYTE EH_STANDARD_S5_S3 1 100 0 255 DISPLAY_IDENTIFIER di_obd_iumpr_comp_active_time[237].ZFEH_EepromData ECU_ADDRESS 0xFFF83895 /end MEASUREMENT
/begin MEASUREMENT ZFEH_EepromData.di_obd_iumpr_comp_active_time[238] "error code related component active time [index = KFC-1]" UBYTE EH_STANDARD_S5_S3 1 100 0 255 DISPLAY_IDENTIFIER di_obd_iumpr_comp_active_time[238].ZFEH_EepromData ECU_ADDRESS 0xFFF83896 /end MEASUREMENT
/begin MEASUREMENT ZFEH_EepromData.di_obd_iumpr_comp_active_time[239] "error code related component active time [index = KFC-1]" UBYTE EH_STANDARD_S5_S3 1 100 0 255 DISPLAY_IDENTIFIER di_obd_iumpr_comp_active_time[239].ZFEH_EepromData ECU_ADDRESS 0xFFF83897 /end MEASUREMENT
/begin MEASUREMENT ZFEH_EepromData.di_obd_iumpr_comp_active_time[240] "error code related component active time [index = KFC-1]" UBYTE EH_STANDARD_S5_S3 1 100 0 255 DISPLAY_IDENTIFIER di_obd_iumpr_comp_active_time[240].ZFEH_EepromData ECU_ADDRESS 0xFFF83898 /end MEASUREMENT
/begin MEASUREMENT ZFEH_EepromData.di_obd_iumpr_comp_active_time[241] "error code related component active time [index = KFC-1]" UBYTE EH_STANDARD_S5_S3 1 100 0 255 DISPLAY_IDENTIFIER di_obd_iumpr_comp_active_time[241].ZFEH_EepromData ECU_ADDRESS 0xFFF83899 /end MEASUREMENT
/begin MEASUREMENT ZFEH_EepromData.di_obd_iumpr_comp_active_time[242] "error code related component active time [index = KFC-1]" UBYTE EH_STANDARD_S5_S3 1 100 0 255 DISPLAY_IDENTIFIER di_obd_iumpr_comp_active_time[242].ZFEH_EepromData ECU_ADDRESS 0xFFF8389A /end MEASUREMENT
/begin MEASUREMENT ZFEH_EepromData.di_obd_iumpr_comp_active_time[243] "error code related component active time [index = KFC-1]" UBYTE EH_STANDARD_S5_S3 1 100 0 255 DISPLAY_IDENTIFIER di_obd_iumpr_comp_active_time[243].ZFEH_EepromData ECU_ADDRESS 0xFFF8389B /end MEASUREMENT
/begin MEASUREMENT ZFEH_EepromData.di_obd_iumpr_comp_active_time[244] "error code related component active time [index = KFC-1]" UBYTE EH_STANDARD_S5_S3 1 100 0 255 DISPLAY_IDENTIFIER di_obd_iumpr_comp_active_time[244].ZFEH_EepromData ECU_ADDRESS 0xFFF8389C /end MEASUREMENT
/begin MEASUREMENT ZFEH_EepromData.di_obd_iumpr_comp_active_time[245] "error code related component active time [index = KFC-1]" UBYTE EH_STANDARD_S5_S3 1 100 0 255 DISPLAY_IDENTIFIER di_obd_iumpr_comp_active_time[245].ZFEH_EepromData ECU_ADDRESS 0xFFF8389D /end MEASUREMENT
/begin MEASUREMENT ZFEH_EepromData.di_obd_iumpr_comp_active_time[246] "error code related component active time [index = KFC-1]" UBYTE EH_STANDARD_S5_S3 1 100 0 255 DISPLAY_IDENTIFIER di_obd_iumpr_comp_active_time[246].ZFEH_EepromData ECU_ADDRESS 0xFFF8389E /end MEASUREMENT
/begin MEASUREMENT ZFEH_EepromData.di_obd_iumpr_comp_active_time[247] "error code related component active time [index = KFC-1]" UBYTE EH_STANDARD_S5_S3 1 100 0 255 DISPLAY_IDENTIFIER di_obd_iumpr_comp_active_time[247].ZFEH_EepromData ECU_ADDRESS 0xFFF8389F /end MEASUREMENT
/begin MEASUREMENT ZFEH_EepromData.di_obd_iumpr_comp_active_time[248] "error code related component active time [index = KFC-1]" UBYTE EH_STANDARD_S5_S3 1 100 0 255 DISPLAY_IDENTIFIER di_obd_iumpr_comp_active_time[248].ZFEH_EepromData ECU_ADDRESS 0xFFF838A0 /end MEASUREMENT
/begin MEASUREMENT ZFEH_EepromData.di_obd_iumpr_comp_active_time[249] "error code related component active time [index = KFC-1]" UBYTE EH_STANDARD_S5_S3 1 100 0 255 DISPLAY_IDENTIFIER di_obd_iumpr_comp_active_time[249].ZFEH_EepromData ECU_ADDRESS 0xFFF838A1 /end MEASUREMENT
/begin MEASUREMENT ZFEH_EepromData.di_obd_iumpr_comp_active_time[250] "error code related component active time [index = KFC-1]" UBYTE EH_STANDARD_S5_S3 1 100 0 255 DISPLAY_IDENTIFIER di_obd_iumpr_comp_active_time[250].ZFEH_EepromData ECU_ADDRESS 0xFFF838A2 /end MEASUREMENT
/begin MEASUREMENT ZFEH_EepromData.di_obd_iumpr_comp_active_time[251] "error code related component active time [index = KFC-1]" UBYTE EH_STANDARD_S5_S3 1 100 0 255 DISPLAY_IDENTIFIER di_obd_iumpr_comp_active_time[251].ZFEH_EepromData ECU_ADDRESS 0xFFF838A3 /end MEASUREMENT
/begin MEASUREMENT ZFEH_EepromData.di_obd_iumpr_comp_active_time[252] "error code related component active time [index = KFC-1]" UBYTE EH_STANDARD_S5_S3 1 100 0 255 DISPLAY_IDENTIFIER di_obd_iumpr_comp_active_time[252].ZFEH_EepromData ECU_ADDRESS 0xFFF838A4 /end MEASUREMENT
/begin MEASUREMENT ZFEH_EepromData.di_obd_iumpr_comp_active_time[253] "error code related component active time [index = KFC-1]" UBYTE EH_STANDARD_S5_S3 1 100 0 255 DISPLAY_IDENTIFIER di_obd_iumpr_comp_active_time[253].ZFEH_EepromData ECU_ADDRESS 0xFFF838A5 /end MEASUREMENT
/begin COMPU_METHOD EH_STANDARD_S5_S3 "int = ((phys * 1) / 1) - (0) -" RAT_FUNC "%2.0" "-" COEFFS 0 1 -0 0 0 1 /end COMPU_METHOD
/begin FUNCTION zff_EH_Obd "desc_en"
 /begin LOC_MEASUREMENT ZFEH_EepromData.di_obd_iumpr_comp_active_time[170] ZFEH_EepromData.di_obd_iumpr_comp_active_time[171] ZFEH_EepromData.di_obd_iumpr_comp_active_time[172] ZFEH_EepromData.di_obd_iumpr_comp_active_time[173] ZFEH_EepromData.di_obd_iumpr_comp_active_time[174] ZFEH_EepromData.di_obd_iumpr_comp_active_time[175] ZFEH_EepromData.di_obd_iumpr_comp_active_time[176] ZFEH_EepromData.di_obd_iumpr_comp_active_time[177] ZFEH_EepromData.di_obd_iumpr_comp_active_time[178] ZFEH_EepromData.di_obd_iumpr_comp_active_time[179] ZFEH_EepromData.di_obd_iumpr_comp_active_time[17] ZFEH_EepromData.di_obd_iumpr_comp_active_time[180] ZFEH_EepromData.di_obd_iumpr_comp_active_time[181] ZFEH_EepromData.di_obd_iumpr_comp_active_time[182] ZFEH_EepromData.di_obd_iumpr_comp_active_time[183] ZFEH_EepromData.di_obd_iumpr_comp_active_time[184] ZFEH_EepromData.di_obd_iumpr_comp_active_time[185] ZFEH_EepromData.di_obd_iumpr_comp_active_time[186] ZFEH_EepromData.di_obd_iumpr_comp_active_time[187] ZFEH_EepromData.di_obd_iumpr_comp_active_time[188] ZFEH_EepromData.di_obd_iumpr_comp_active_time[189] ZFEH_EepromData.di_obd_iumpr_comp_active_time[18] ZFEH_EepromData.di_obd_iumpr_comp_active_time[190] ZFEH_EepromData.di_obd_iumpr_comp_active_time[191] ZFEH_EepromData.di_obd_iumpr_comp_active_time[192] ZFEH_EepromData.di_obd_iumpr_comp_active_time[193] ZFEH_EepromData.di_obd_iumpr_comp_active_time[194] ZFEH_EepromData.di_obd_iumpr_comp_active_time[195] ZFEH_EepromData.di_obd_iumpr_comp_active_time[196] ZFEH_EepromData.di_obd_iumpr_comp_active_time[197] ZFEH_EepromData.di_obd_iumpr_comp_active_time[198] ZFEH_EepromData.di_obd_iumpr_comp_active_time[199] ZFEH_EepromData.di_obd_iumpr_comp_active_time[19] ZFEH_EepromData.di_obd_iumpr_comp_active_time[1] ZFEH_EepromData.di_obd_iumpr_comp_active_time[200] ZFEH_EepromData.di_obd_iumpr_comp_active_time[201] ZFEH_EepromData.di_obd_iumpr_comp_active_time[202] ZFEH_EepromData.di_obd_iumpr_comp_active_time[203] ZFEH_EepromData.di_obd_iumpr_comp_active_time[204] ZFEH_EepromData.di_obd_iumpr_comp_active_time[205] ZFEH_EepromData.di_obd_iumpr_comp_active_time[206] ZFEH_EepromData.di_obd_iumpr_comp_active_time[207] ZFEH_EepromData.di_obd_iumpr_comp_active_time[208] ZFEH_EepromData.di_obd_iumpr_comp_active_time[209] ZFEH_EepromData.di_obd_iumpr_comp_active_time[20] ZFEH_EepromData.di_obd_iumpr_comp_active_time[210] ZFEH_EepromData.di_obd_iumpr_comp_active_time[211] ZFEH_EepromData.di_obd_iumpr_comp_active_time[212] ZFEH_EepromData.di_obd_iumpr_comp_active_time[213] ZFEH_EepromData.di_obd_iumpr_comp_active_time[214] ZFEH_EepromData.di_obd_iumpr_comp_active_time[215] ZFEH_EepromData.di_obd_iumpr_comp_active_time[216] ZFEH_EepromData.di_obd_iumpr_comp_active_time[217] ZFEH_EepromData.di_obd_iumpr_comp_active_time[218] ZFEH_EepromData.di_obd_iumpr_comp_active_time[219] ZFEH_EepromData.di_obd_iumpr_comp_active_time[21] ZFEH_EepromData.di_obd_iumpr_comp_active_time[220] ZFEH_EepromData.di_obd_iumpr_comp_active_time[221] ZFEH_EepromData.di_obd_iumpr_comp_active_time[222] ZFEH_EepromData.di_obd_iumpr_comp_active_time[223] ZFEH_EepromData.di_obd_iumpr_comp_active_time[224] ZFEH_EepromData.di_obd_iumpr_comp_active_time[225] ZFEH_EepromData.di_obd_iumpr_comp_active_time[226] ZFEH_EepromData.di_obd_iumpr_comp_active_time[227] ZFEH_EepromData.di_obd_iumpr_comp_active_time[228] ZFEH_EepromData.di_obd_iumpr_comp_active_time[229] ZFEH_EepromData.di_obd_iumpr_comp_active_time[22] ZFEH_EepromData.di_obd_iumpr_comp_active_time[230] ZFEH_EepromData.di_obd_iumpr_comp_active_time[231] ZFEH_EepromData.di_obd_iumpr_comp_active_time[232] ZFEH_EepromData.di_obd_iumpr_comp_active_time[233] ZFEH_EepromData.di_obd_iumpr_comp_active_time[234] ZFEH_EepromData.di_obd_iumpr_comp_active_time[235] ZFEH_EepromData.di_obd_iumpr_comp_active_time[236] ZFEH_EepromData.di_obd_iumpr_comp_active_time[237] ZFEH_EepromData.di_obd_iumpr_comp_active_time[238] ZFEH_EepromData.di_obd_iumpr_comp_active_time[239] ZFEH_EepromData.di_obd_iumpr_comp_active_time[23] ZFEH_EepromData.di_obd_iumpr_comp_active_time[240] ZFEH_EepromData.di_obd_iumpr_comp_active_time[241] ZFEH_EepromData.di_obd_iumpr_comp_active_time[242] ZFEH_EepromData.di_obd_iumpr_comp_active_time[243] ZFEH_EepromData.di_obd_iumpr_comp_active_time[244] ZFEH_EepromData.di_obd_iumpr_comp_active_time[245] ZFEH_EepromData.di_obd_iumpr_comp_active_time[246] ZFEH_EepromData.di_obd_iumpr_comp_active_time[247] ZFEH_EepromData.di_obd_iumpr_comp_active_time[248] ZFEH_EepromData.di_obd_iumpr_comp_active_time[249] ZFEH_EepromData.di_obd_iumpr_comp_active_time[24] ZFEH_EepromData.di_obd_iumpr_comp_active_time[250] ZFEH_EepromData.di_obd_iumpr_comp_active_time[251] ZFEH_EepromData.di_obd_iumpr_comp_active_time[252] ZFEH_EepromData.di_obd_iumpr_comp_active_time[253] ZFEH_EepromData.di_obd_iumpr_comp_active_time[25] ZFEH_EepromData.di_obd_iumpr_comp_active_time[26] ZFEH_EepromData.di_obd_iumpr_comp_active_time[27] ZFEH_EepromData.di_obd_iumpr_comp_active_time[28] ZFEH_EepromData.di_obd_iumpr_comp_active_time[29] ZFEH_EepromData.di_obd_iumpr_comp_active_time[2] ZFEH_EepromData.di_obd_iumpr_comp_active_time[30] ZFEH_EepromData.di_obd_iumpr_comp_active_time[31] ZFEH_EepromData.di_obd_iumpr_comp_active_time[32] ZFEH_EepromData.di_obd_iumpr_comp_active_time[33] ZFEH_EepromData.di_obd_iumpr_comp_active_time[34] ZFEH_EepromData.di_obd_iumpr_comp_active_time[35] ZFEH_EepromData.di_obd_iumpr_comp_active_time[36] ZFEH_EepromData.di_obd_iumpr_comp_active_time[37] ZFEH_EepromData.di_obd_iumpr_comp_active_time[38] ZFEH_EepromData.di_obd_iumpr_comp_active_time[39] ZFEH_EepromData.di_obd_iumpr_comp_active_time[3] ZFEH_EepromData.di_obd_iumpr_comp_active_time[40] ZFEH_EepromData.di_obd_iumpr_comp_active_time[41] ZFEH_EepromData.di_obd_iumpr_comp_active_time[42] ZFEH_EepromData.di_obd_iumpr_comp_active_time[43] ZFEH_EepromData.di_obd_iumpr_comp_active_time[44] ZFEH_EepromData.di_obd_iumpr_comp_active_time[45] ZFEH_EepromData.di_obd_iumpr_comp_active_time[46] ZFEH_EepromData.di_obd_iumpr_comp_active_time[47] ZFEH_EepromData.di_obd_iumpr_comp_active_time[48] ZFEH_EepromData.di_obd_iumpr_comp_active_time[49] ZFEH_EepromData.di_obd_iumpr_comp_active_time[4] ZFEH_EepromData.di_obd_iumpr_comp_active_time[50] ZFEH_EepromData.di_obd_iumpr_comp_active_time[51] ZFEH_EepromData.di_obd_iumpr_comp_active_time[52] ZFEH_EepromData.di_obd_iumpr_comp_active_time[53] ZFEH_EepromData.di_obd_iumpr_comp_active_time[54] ZFEH_EepromData.di_obd_iumpr_comp_active_time[55] ZFEH_EepromData.di_obd_iumpr_comp_active_time[56] ZFEH_EepromData.di_obd_iumpr_comp_active_time[57] ZFEH_EepromData.di_obd_iumpr_comp_active_time[58] ZFEH_EepromData.di_obd_iumpr_comp_active_time[59] ZFEH_EepromData.di_obd_iumpr_comp_active_time[5] ZFEH_EepromData.di_obd_iumpr_comp_active_time[60] ZFEH_EepromData.di_obd_iumpr_comp_active_time[61] ZFEH_EepromData.di_obd_iumpr_comp_active_time[62] ZFEH_EepromData.di_obd_iumpr_comp_active_time[63] ZFEH_EepromData.di_obd_iumpr_comp_active_time[64] ZFEH_EepromData.di_obd_iumpr_comp_active_time[65] ZFEH_EepromData.di_obd_iumpr_comp_active_time[66] ZFEH_EepromData.di_obd_iumpr_comp_active_time[67] ZFEH_EepromData.di_obd_iumpr_comp_active_time[68] ZFEH_EepromData.di_obd_iumpr_comp_active_time[69] ZFEH_EepromData.di_obd_iumpr_comp_active_time[6] ZFEH_EepromData.di_obd_iumpr_comp_active_time[70] ZFEH_EepromData.di_obd_iumpr_comp_active_time[71] ZFEH_EepromData.di_obd_iumpr_comp_active_time[72] ZFEH_EepromData.di_obd_iumpr_comp_active_time[73] ZFEH_EepromData.di_obd_iumpr_comp_active_time[74] ZFEH_EepromData.di_obd_iumpr_comp_active_time[75] ZFEH_EepromData.di_obd_iumpr_comp_active_time[76] ZFEH_EepromData.di_obd_iumpr_comp_active_time[77] ZFEH_EepromData.di_obd_iumpr_comp_active_time[78] ZFEH_EepromData.di_obd_iumpr_comp_active_time[79] ZFEH_EepromData.di_obd_iumpr_comp_active_time[7] ZFEH_EepromData.di_obd_iumpr_comp_active_time[80] ZFEH_EepromData.di_obd_iumpr_comp_active_time[81] ZFEH_EepromData.di_obd_iumpr_comp_active_time[82] ZFEH_EepromData.di_obd_iumpr_comp_active_time[83] ZFEH_EepromData.di_obd_iumpr_comp_active_time[84] ZFEH_EepromData.di_obd_iumpr_comp_active_time[85] ZFEH_EepromData.di_obd_iumpr_comp_active_time[86] ZFEH_EepromData.di_obd_iumpr_comp_active_time[87] ZFEH_EepromData.di_obd_iumpr_comp_active_time[88] ZFEH_EepromData.di_obd_iumpr_comp_active_time[89] ZFEH_EepromData.di_obd_iumpr_comp_active_time[8] ZFEH_EepromData.di_obd_iumpr_comp_active_time[90] ZFEH_EepromData.di_obd_iumpr_comp_active_time[91] ZFEH_EepromData.di_obd_iumpr_comp_active_time[92] ZFEH_EepromData.di_obd_iumpr_comp_active_time[93] ZFEH_EepromData.di_obd_iumpr_comp_active_time[94] ZFEH_EepromData.di_obd_iumpr_comp_active_time[95] ZFEH_EepromData.di_obd_iumpr_comp_active_time[96] ZFEH_EepromData.di_obd_iumpr_comp_active_time[97] ZFEH_EepromData.di_obd_iumpr_comp_active_time[98] ZFEH_EepromData.di_obd_iumpr_comp_active_time[99] ZFEH_EepromData.di_obd_iumpr_comp_active_time[9] ZFEH_EepromData.di_obd_iumpr_denominator[0] ZFEH_EepromData.di_obd_iumpr_denominator[100] ZFEH_EepromData.di_obd_iumpr_denominator[101] ZFEH_EepromData.di_obd_iumpr_denominator[102] ZFEH_EepromData.di_obd_iumpr_denominator[103] ZFEH_EepromData.di_obd_iumpr_denominator[104] ZFEH_EepromData.di_obd_iumpr_denominator[105] ZFEH_EepromData.di_obd_iumpr_denominator[106] ZFEH_EepromData.di_obd_iumpr_denominator[107] ZFEH_EepromData.di_obd_iumpr_denominator[108] ZFEH_EepromData.di_obd_iumpr_denominator[109] ZFEH_EepromData.di_obd_iumpr_denominator[10] ZFEH_EepromData.di_obd_iumpr_denominator[110] ZFEH_EepromData.di_obd_iumpr_denominator[111] ZFEH_EepromData.di_obd_iumpr_denominator[112] ZFEH_EepromData.di_obd_iumpr_denominator[113] ZFEH_EepromData.di_obd_iumpr_denominator[114] ZFEH_EepromData.di_obd_iumpr_denominator[115] ZFEH_EepromData.di_obd_iumpr_denominator[116] ZFEH_EepromData.di_obd_iumpr_denominator[117] ZFEH_EepromData.di_obd_iumpr_denominator[118] ZFEH_EepromData.di_obd_iumpr_denominator[119] ZFEH_EepromData.di_obd_iumpr_denominator[11] ZFEH_EepromData.di_obd_iumpr_denominator[120] ZFEH_EepromData.di_obd_iumpr_denominator[121] ZFEH_EepromData.di_obd_iumpr_denominator[122] ZFEH_EepromData.di_obd_iumpr_denominator[123] ZFEH_EepromData.di_obd_iumpr_denominator[124] ZFEH_EepromData.di_obd_iumpr_denominator[125] ZFEH_EepromData.di_obd_iumpr_denominator[126] ZFEH_EepromData.di_obd_iumpr_denominator[127] ZFEH_EepromData.di_obd_iumpr_denominator[128] ZFEH_EepromData.di_obd_iumpr_denominator[129] ZFEH_EepromData.di_obd_iumpr_denominator[12] ZFEH_EepromData.di_obd_iumpr_denominator[130] ZFEH_EepromData.di_obd_iumpr_denominator[131] ZFEH_EepromData.di_obd_iumpr_denominator[132] ZFEH_EepromData.di_obd_iumpr_denominator[133] ZFEH_EepromData.di_obd_iumpr_denominator[134] ZFEH_EepromData.di_obd_iumpr_denominator[135] ZFEH_EepromData.di_obd_iumpr_denominator[136] ZFEH_EepromData.di_obd_iumpr_denominator[137] ZFEH_EepromData.di_obd_iumpr_denominator[138] ZFEH_EepromData.di_obd_iumpr_denominator[139] ZFEH_EepromData.di_obd_iumpr_denominator[13] ZFEH_EepromData.di_obd_iumpr_denominator[140] ZFEH_EepromData.di_obd_iumpr_denominator[141] ZFEH_EepromData.di_obd_iumpr_denominator[142] ZFEH_EepromData.di_obd_iumpr_denominator[143] ZFEH_EepromData.di_obd_iumpr_denominator[144] ZFEH_EepromData.di_obd_iumpr_denominator[145] ZFEH_EepromData.di_obd_iumpr_denominator[146] ZFEH_EepromData.di_obd_iumpr_denominator[147] ZFEH_EepromData.di_obd_iumpr_denominator[148] ZFEH_EepromData.di_obd_iumpr_denominator[149] ZFEH_EepromData.di_obd_iumpr_denominator[14] ZFEH_EepromData.di_obd_iumpr_denominator[150] ZFEH_EepromData.di_obd_iumpr_denominator[151] ZFEH_EepromData.di_obd_iumpr_denominator[152] ZFEH_EepromData.di_obd_iumpr_denominator[153] ZFEH_EepromData.di_obd_iumpr_denominator[154] ZFEH_EepromData.di_obd_iumpr_denominator[155] ZFEH_EepromData.di_obd_iumpr_denominator[156] ZFEH_EepromData.di_obd_iumpr_denominator[157] ZFEH_EepromData.di_obd_iumpr_denominator[158] ZFEH_EepromData.di_obd_iumpr_denominator[159] ZFEH_EepromData.di_obd_iumpr_denominator[15] ZFEH_EepromData.di_obd_iumpr_denominator[160] ZFEH_EepromData.di_obd_iumpr_denominator[161] ZFEH_EepromData.di_obd_iumpr_denominator[162] ZFEH_EepromData.di_obd_iumpr_denominator[163] ZFEH_EepromData.di_obd_iumpr_denominator[164] ZFEH_EepromData.di_obd_iumpr_denominator[165] ZFEH_EepromData.di_obd_iumpr_denominator[166] ZFEH_EepromData.di_obd_iumpr_denominator[167] ZFEH_EepromData.di_obd_iumpr_denominator[168] ZFEH_EepromData.di_obd_iumpr_denominator[169] ZFEH_EepromData.di_obd_iumpr_denominator[16] ZFEH_EepromData.di_obd_iumpr_denominator[170] ZFEH_EepromData.di_obd_iumpr_denominator[171] ZFEH_EepromData.di_obd_iumpr_denominator[172] ZFEH_EepromData.di_obd_iumpr_denominator[173] ZFEH_EepromData.di_obd_iumpr_denominator[174] ZFEH_EepromData.di_obd_iumpr_denominator[175] ZFEH_EepromData.di_obd_iumpr_denominator[176] ZFEH_EepromData.di_obd_iumpr_denominator[177] ZFEH_EepromData.di_obd_iumpr_denominator[178] ZFEH_EepromData.di_obd_iumpr_denominator[179] ZFEH_EepromData.di_obd_iumpr_denominator[17] ZFEH_EepromData.di_obd_iumpr_denominator[180] ZFEH_EepromData.di_obd_iumpr_denominator[181] ZFEH_EepromData.di_obd_iumpr_denominator[182] ZFEH_EepromData.di_obd_iumpr_denominator[183] ZFEH_EepromData.di_obd_iumpr_denominator[184] ZFEH_EepromData.di_obd_iumpr_denominator[185] ZFEH_EepromData.di_obd_iumpr_denominator[186] ZFEH_EepromData.di_obd_iumpr_denominator[187] ZFEH_EepromData.di_obd_iumpr_denominator[188] ZFEH_EepromData.di_obd_iumpr_denominator[189] ZFEH_EepromData.di_obd_iumpr_denominator[18] ZFEH_EepromData.di_obd_iumpr_denominator[190] ZFEH_EepromData.di_obd_iumpr_denominator[191] ZFEH_EepromData.di_obd_iumpr_denominator[192] ZFEH_EepromData.di_obd_iumpr_denominator[193] ZFEH_EepromData.di_obd_iumpr_denominator[194] ZFEH_EepromData.di_obd_iumpr_denominator[195] ZFEH_EepromData.di_obd_iumpr_denominator[196] ZFEH_EepromData.di_obd_iumpr_denominator[197] ZFEH_EepromData.di_obd_iumpr_denominator[198] ZFEH_EepromData.di_obd_iumpr_denominator[199] ZFEH_EepromData.di_obd_iumpr_denominator[19] ZFEH_EepromData.di_obd_iumpr_denominator[1] ZFEH_EepromData.di_obd_iumpr_denominator[200] ZFEH_EepromData.di_obd_iumpr_denominator[201] ZFEH_EepromData.di_obd_iumpr_denominator[202] ZFEH_EepromData.di_obd_iumpr_denominator[203] ZFEH_EepromData.di_obd_iumpr_denominator[204] ZFEH_EepromData.di_obd_iumpr_denominator[205] ZFEH_EepromData.di_obd_iumpr_denominator[206] ZFEH_EepromData.di_obd_iumpr_denominator[207] ZFEH_EepromData.di_obd_iumpr_denominator[208] ZFEH_EepromData.di_obd_iumpr_denominator[209] ZFEH_EepromData.di_obd_iumpr_denominator[20] ZFEH_EepromData.di_obd_iumpr_denominator[210] ZFEH_EepromData.di_obd_iumpr_denominator[211] ZFEH_EepromData.di_obd_iumpr_denominator[212] ZFEH_EepromData.di_obd_iumpr_denominator[213] ZFEH_EepromData.di_obd_iumpr_denominator[214] ZFEH_EepromData.di_obd_iumpr_denominator[215] ZFEH_EepromData.di_obd_iumpr_denominator[216] ZFEH_EepromData.di_obd_iumpr_denominator[217] ZFEH_EepromData.di_obd_iumpr_denominator[218] ZFEH_EepromData.di_obd_iumpr_denominator[219] ZFEH_EepromData.di_obd_iumpr_denominator[21] ZFEH_EepromData.di_obd_iumpr_denominator[220] ZFEH_EepromData.di_obd_iumpr_denominator[221] ZFEH_EepromData.di_obd_iumpr_denominator[222] ZFEH_EepromData.di_obd_iumpr_denominator[223] ZFEH_EepromData.di_obd_iumpr_denominator[224] ZFEH_EepromData.di_obd_iumpr_denominator[225] ZFEH_EepromData.di_obd_iumpr_denominator[226] ZFEH_EepromData.di_obd_iumpr_denominator[227] ZFEH_EepromData.di_obd_iumpr_denominator[228] ZFEH_EepromData.di_obd_iumpr_denominator[229] ZFEH_EepromData.di_obd_iumpr_denominator[22] ZFEH_EepromData.di_obd_iumpr_denominator[230] ZFEH_EepromData.di_obd_iumpr_denominator[231] ZFEH_EepromData.di_obd_iumpr_denominator[232] ZFEH_EepromData.di_obd_iumpr_denominator[233] ZFEH_EepromData.di_obd_iumpr_denominator[234] ZFEH_EepromData.di_obd_iumpr_denominator[235] ZFEH_EepromData.di_obd_iumpr_denominator[236] ZFEH_EepromData.di_obd_iumpr_denominator[237] ZFEH_EepromData.di_obd_iumpr_denominator[238] ZFEH_EepromData.di_obd_iumpr_denominator[239] ZFEH_EepromData.di_obd_iumpr_denominator[23] ZFEH_EepromData.di_obd_iumpr_denominator[240] ZFEH_EepromData.di_obd_iumpr_denominator[241] ZFEH_EepromData.di_obd_iumpr_denominator[242] ZFEH_EepromData.di_obd_iumpr_denominator[243] ZFEH_EepromData.di_obd_iumpr_denominator[244] ZFEH_EepromData.di_obd_iumpr_denominator[245] ZFEH_EepromData.di_obd_iumpr_denominator[246] ZFEH_EepromData.di_obd_iumpr_denominator[247] ZFEH_EepromData.di_obd_iumpr_denominator[248] ZFEH_EepromData.di_obd_iumpr_denominator[249] ZFEH_EepromData.di_obd_iumpr_denominator[24] ZFEH_EepromData.di_obd_iumpr_denominator[250] ZFEH_EepromData.di_obd_iumpr_denominator[251] ZFEH_EepromData.di_obd_iumpr_denominator[252] ZFEH_EepromData.di_obd_iumpr_denominator[253] ZFEH_EepromData.di_obd_iumpr_denominator[25] ZFEH_EepromData.di_obd_iumpr_denominator[26] ZFEH_EepromData.di_obd_iumpr_denominator[27] ZFEH_EepromData.di_obd_iumpr_denominator[28] ZFEH_EepromData.di_obd_iumpr_denominator[29] ZFEH_EepromData.di_obd_iumpr_denominator[2] ZFEH_EepromData.di_obd_iumpr_denominator[30] ZFEH_EepromData.di_obd_iumpr_denominator[31] ZFEH_EepromData.di_obd_iumpr_denominator[32] ZFEH_EepromData.di_obd_iumpr_denominator[33] ZFEH_EepromData.di_obd_iumpr_denominator[34] ZFEH_EepromData.di_obd_iumpr_denominator[35] ZFEH_EepromData.di_obd_iumpr_denominator[36] ZFEH_EepromData.di_obd_iumpr_denominator[37] ZFEH_EepromData.di_obd_iumpr_denominator[38] ZFEH_EepromData.di_obd_iumpr_denominator[39] ZFEH_EepromData.di_obd_iumpr_denominator[3] ZFEH_EepromData.di_obd_iumpr_denominator[40] ZFEH_EepromData.di_obd_iumpr_denominator[41] ZFEH_EepromData.di_obd_iumpr_denominator[42] ZFEH_EepromData.di_obd_iumpr_denominator[43] ZFEH_EepromData.di_obd_iumpr_denominator[44] ZFEH_EepromData.di_obd_iumpr_denominator[45] ZFEH_EepromData.di_obd_iumpr_denominator[46] ZFEH_EepromData.di_obd_iumpr_denominator[47] ZFEH_EepromData.di_obd_iumpr_denominator[48] ZFEH_EepromData.di_obd_iumpr_denominator[49] ZFEH_EepromData.di_obd_iumpr_denominator[4] ZFEH_EepromData.di_obd_iumpr_denominator[50] ZFEH_EepromData.di_obd_iumpr_denominator[51] ZFEH_EepromData.di_obd_iumpr_denominator[52] ZFEH_EepromData.di_obd_iumpr_denominator[53] ZFEH_EepromData.di_obd_iumpr_denominator[54] ZFEH_EepromData.di_obd_iumpr_denominator[55] ZFEH_EepromData.di_obd_iumpr_denominator[56] ZFEH_EepromData.di_obd_iumpr_denominator[57] ZFEH_EepromData.di_obd_iumpr_denominator[58] ZFEH_EepromData.di_obd_iumpr_denominator[59] ZFEH_EepromData.di_obd_iumpr_denominator[5] ZFEH_EepromData.di_obd_iumpr_denominator[60] ZFEH_EepromData.di_obd_iumpr_denominator[61] ZFEH_EepromData.di_obd_iumpr_denominator[62] ZFEH_EepromData.di_obd_iumpr_denominator[63] ZFEH_EepromData.di_obd_iumpr_denominator[64] ZFEH_EepromData.di_obd_iumpr_denominator[65] ZFEH_EepromData.di_obd_iumpr_denominator[66] ZFEH_EepromData.di_obd_iumpr_denominator[67] ZFEH_EepromData.di_obd_iumpr_denominator[68] ZFEH_EepromData.di_obd_iumpr_denominator[69] ZFEH_EepromData.di_obd_iumpr_denominator[6] ZFEH_EepromData.di_obd_iumpr_denominator[70] ZFEH_EepromData.di_obd_iumpr_denominator[71] ZFEH_EepromData.di_obd_iumpr_denominator[72] ZFEH_EepromData.di_obd_iumpr_denominator[73] ZFEH_EepromData.di_obd_iumpr_denominator[74] ZFEH_EepromData.di_obd_iumpr_denominator[75] ZFEH_EepromData.di_obd_iumpr_denominator[76] ZFEH_EepromData.di_obd_iumpr_denominator[77] ZFEH_EepromData.di_obd_iumpr_denominator[78] ZFEH_EepromData.di_obd_iumpr_denominator[79] ZFEH_EepromData.di_obd_iumpr_denominator[7] ZFEH_EepromData.di_obd_iumpr_denominator[80] ZFEH_EepromData.di_obd_iumpr_denominator[81] ZFEH_EepromData.di_obd_iumpr_denominator[82] ZFEH_EepromData.di_obd_iumpr_denominator[83] ZFEH_EepromData.di_obd_iumpr_denominator[84] ZFEH_EepromData.di_obd_iumpr_denominator[85] ZFEH_EepromData.di_obd_iumpr_denominator[86] ZFEH_EepromData.di_obd_iumpr_denominator[87] ZFEH_EepromData.di_obd_iumpr_denominator[88] ZFEH_EepromData.di_obd_iumpr_denominator[89] ZFEH_EepromData.di_obd_iumpr_denominator[8] ZFEH_EepromData.di_obd_iumpr_denominator[90] ZFEH_EepromData.di_obd_iumpr_denominator[91] ZFEH_EepromData.di_obd_iumpr_denominator[92] ZFEH_EepromData.di_obd_iumpr_denominator[93] ZFEH_EepromData.di_obd_iumpr_denominator[94] ZFEH_EepromData.di_obd_iumpr_denominator[95] ZFEH_EepromData.di_obd_iumpr_denominator[96] ZFEH_EepromData.di_obd_iumpr_denominator[97] ZFEH_EepromData.di_obd_iumpr_denominator[98] ZFEH_EepromData.di_obd_iumpr_denominator[99] ZFEH_EepromData.di_obd_iumpr_denominator[9] ZFEH_EepromData.di_obd_iumpr_gen_den ZFEH_EepromData.di_obd_iumpr_ign_cycle ZFEH_EepromData.di_obd_iumpr_numerator[0] ZFEH_EepromData.di_obd_iumpr_numerator[100] ZFEH_EepromData.di_obd_iumpr_numerator[101] ZFEH_EepromData.di_obd_iumpr_numerator[102] ZFEH_EepromData.di_obd_iumpr_numerator[103] ZFEH_EepromData.di_obd_iumpr_numerator[104] ZFEH_EepromData.di_obd_iumpr_numerator[105] ZFEH_EepromData.di_obd_iumpr_numerator[106] ZFEH_EepromData.di_obd_iumpr_numerator[107] ZFEH_EepromData.di_obd_iumpr_numerator[108] ZFEH_EepromData.di_obd_iumpr_numerator[109] ZFEH_EepromData.di_obd_iumpr_numerator[10] ZFEH_EepromData.di_obd_iumpr_numerator[110] ZFEH_EepromData.di_obd_iumpr_numerator[111] ZFEH_EepromData.di_obd_iumpr_numerator[112] ZFEH_EepromData.di_obd_iumpr_numerator[113] ZFEH_EepromData.di_obd_iumpr_numerator[114] ZFEH_EepromData.di_obd_iumpr_numerator[115] ZFEH_EepromData.di_obd_iumpr_numerator[116] ZFEH_EepromData.di_obd_iumpr_numerator[117] ZFEH_EepromData.di_obd_iumpr_numerator[118] ZFEH_EepromData.di_obd_iumpr_numerator[119] ZFEH_EepromData.di_obd_iumpr_numerator[11] ZFEH_EepromData.di_obd_iumpr_numerator[120] ZFEH_EepromData.di_obd_iumpr_numerator[121] ZFEH_EepromData.di_obd_iumpr_numerator[122] ZFEH_EepromData.di_obd_iumpr_numerator[123] ZFEH_EepromData.di_obd_iumpr_numerator[124] ZFEH_EepromData.di_obd_iumpr_numerator[125] ZFEH_EepromData.di_obd_iumpr_numerator[126] ZFEH_EepromData.di_obd_iumpr_numerator[127] ZFEH_EepromData.di_obd_iumpr_numerator[128] ZFEH_EepromData.di_obd_iumpr_numerator[129] ZFEH_EepromData.di_obd_iumpr_numerator[12] ZFEH_EepromData.di_obd_iumpr_numerator[130] ZFEH_EepromData.di_obd_iumpr_numerator[131] ZFEH_EepromData.di_obd_iumpr_numerator[132] ZFEH_EepromData.di_obd_iumpr_numerator[133] ZFEH_EepromData.di_obd_iumpr_numerator[134] ZFEH_EepromData.di_obd_iumpr_numerator[135] ZFEH_EepromData.di_obd_iumpr_numerator[136] ZFEH_EepromData.di_obd_iumpr_numerator[137] ZFEH_EepromData.di_obd_iumpr_numerator[138] ZFEH_EepromData.di_obd_iumpr_numerator[139] ZFEH_EepromData.di_obd_iumpr_numerator[13] ZFEH_EepromData.di_obd_iumpr_numerator[140] ZFEH_EepromData.di_obd_iumpr_numerator[141] ZFEH_EepromData.di_obd_iumpr_numerator[142] ZFEH_EepromData.di_obd_iumpr_numerator[143] ZFEH_EepromData.di_obd_iumpr_numerator[144] ZFEH_EepromData.di_obd_iumpr_numerator[145] ZFEH_EepromData.di_obd_iumpr_numerator[146] ZFEH_EepromData.di_obd_iumpr_numerator[147] ZFEH_EepromData.di_obd_iumpr_numerator[148] ZFEH_EepromData.di_obd_iumpr_numerator[149] ZFEH_EepromData.di_obd_iumpr_numerator[14] ZFEH_EepromData.di_obd_iumpr_numerator[150] ZFEH_EepromData.di_obd_iumpr_numerator[151] ZFEH_EepromData.di_obd_iumpr_numerator[152] ZFEH_EepromData.di_obd_iumpr_numerator[153] ZFEH_EepromData.di_obd_iumpr_numerator[154] ZFEH_EepromData.di_obd_iumpr_numerator[155] ZFEH_EepromData.di_obd_iumpr_numerator[156] ZFEH_EepromData.di_obd_iumpr_numerator[157] ZFEH_EepromData.di_obd_iumpr_numerator[158] ZFEH_EepromData.di_obd_iumpr_numerator[159] ZFEH_EepromData.di_obd_iumpr_numerator[15] ZFEH_EepromData.di_obd_iumpr_numerator[160] ZFEH_EepromData.di_obd_iumpr_numerator[161] ZFEH_EepromData.di_obd_iumpr_numerator[162] ZFEH_EepromData.di_obd_iumpr_numerator[163] ZFEH_EepromData.di_obd_iumpr_numerator[164] ZFEH_EepromData.di_obd_iumpr_numerator[165] ZFEH_EepromData.di_obd_iumpr_numerator[166] ZFEH_EepromData.di_obd_iumpr_numerator[167] ZFEH_EepromData.di_obd_iumpr_numerator[168] ZFEH_EepromData.di_obd_iumpr_numerator[169] ZFEH_EepromData.di_obd_iumpr_numerator[16] ZFEH_EepromData.di_obd_iumpr_numerator[170] ZFEH_EepromData.di_obd_iumpr_numerator[171] ZFEH_EepromData.di_obd_iumpr_numerator[172] ZFEH_EepromData.di_obd_iumpr_numerator[173] ZFEH_EepromData.di_obd_iumpr_numerator[174] ZFEH_EepromData.di_obd_iumpr_numerator[175] ZFEH_EepromData.di_obd_iumpr_numerator[176] ZFEH_EepromData.di_obd_iumpr_numerator[177] ZFEH_EepromData.di_obd_iumpr_numerator[178] ZFEH_EepromData.di_obd_iumpr_numerator[179] ZFEH_EepromData.di_obd_iumpr_numerator[17] ZFEH_EepromData.di_obd_iumpr_numerator[180] ZFEH_EepromData.di_obd_iumpr_numerator[181] ZFEH_EepromData.di_obd_iumpr_numerator[182] ZFEH_EepromData.di_obd_iumpr_numerator[183] ZFEH_EepromData.di_obd_iumpr_numerator[184] ZFEH_EepromData.di_obd_iumpr_numerator[185] ZFEH_EepromData.di_obd_iumpr_numerator[186] ZFEH_EepromData.di_obd_iumpr_numerator[187] ZFEH_EepromData.di_obd_iumpr_numerator[188] ZFEH_EepromData.di_obd_iumpr_numerator[189] ZFEH_EepromData.di_obd_iumpr_numerator[18] ZFEH_EepromData.di_obd_iumpr_numerator[190] ZFEH_EepromData.di_obd_iumpr_numerator[191] ZFEH_EepromData.di_obd_iumpr_numerator[192] ZFEH_EepromData.di_obd_iumpr_numerator[193] ZFEH_EepromData.di_obd_iumpr_numerator[194] ZFEH_EepromData.di_obd_iumpr_numerator[195] ZFEH_EepromData.di_obd_iumpr_numerator[196] ZFEH_EepromData.di_obd_iumpr_numerator[197] ZFEH_EepromData.di_obd_iumpr_numerator[198] ZFEH_EepromData.di_obd_iumpr_numerator[199] ZFEH_EepromData.di_obd_iumpr_numerator[19] ZFEH_EepromData.di_obd_iumpr_numerator[1] ZFEH_EepromData.di_obd_iumpr_numerator[200] ZFEH_EepromData.di_obd_iumpr_numerator[201] ZFEH_EepromData.di_obd_iumpr_numerator[202] ZFEH_EepromData.di_obd_iumpr_numerator[203] ZFEH_EepromData.di_obd_iumpr_numerator[204] ZFEH_EepromData.di_obd_iumpr_numerator[205] ZFEH_EepromData.di_obd_iumpr_numerator[206] ZFEH_EepromData.di_obd_iumpr_numerator[207] ZFEH_EepromData.di_obd_iumpr_numerator[208] ZFEH_EepromData.di_obd_iumpr_numerator[209] ZFEH_EepromData.di_obd_iumpr_numerator[20] ZFEH_EepromData.di_obd_iumpr_numerator[210] ZFEH_EepromData.di_obd_iumpr_numerator[211] ZFEH_EepromData.di_obd_iumpr_numerator[212] ZFEH_EepromData.di_obd_iumpr_numerator[213] ZFEH_EepromData.di_obd_iumpr_numerator[214] ZFEH_EepromData.di_obd_iumpr_numerator[215] ZFEH_EepromData.di_obd_iumpr_numerator[216] ZFEH_EepromData.di_obd_iumpr_numerator[217] ZFEH_EepromData.di_obd_iumpr_numerator[218] ZFEH_EepromData.di_obd_iumpr_numerator[219] ZFEH_EepromData.di_obd_iumpr_numerator[21] ZFEH_EepromData.di_obd_iumpr_numerator[220] ZFEH_EepromData.di_obd_iumpr_numerator[221] ZFEH_EepromData.di_obd_iumpr_numerator[222] ZFEH_EepromData.di_obd_iumpr_numerator[223] ZFEH_EepromData.di_obd_iumpr_numerator[224] ZFEH_EepromData.di_obd_iumpr_numerator[225] ZFEH_EepromData.di_obd_iumpr_numerator[226] ZFEH_EepromData.di_obd_iumpr_numerator[227] ZFEH_EepromData.di_obd_iumpr_numerator[228] ZFEH_EepromData.di_obd_iumpr_numerator[229] ZFEH_EepromData.di_obd_iumpr_numerator[22] ZFEH_EepromData.di_obd_iumpr_numerator[230] ZFEH_EepromData.di_obd_iumpr_numerator[231] ZFEH_EepromData.di_obd_iumpr_numerator[232] ZFEH_EepromData.di_obd_iumpr_numerator[233] ZFEH_EepromData.di_obd_iumpr_numerator[234] ZFEH_EepromData.di_obd_iumpr_numerator[235] ZFEH_EepromData.di_obd_iumpr_numerator[236] ZFEH_EepromData.di_obd_iumpr_numerator[237] ZFEH_EepromData.di_obd_iumpr_numerator[238] ZFEH_EepromData.di_obd_iumpr_numerator[239] ZFEH_EepromData.di_obd_iumpr_numerator[23] ZFEH_EepromData.di_obd_iumpr_numerator[240] ZFEH_EepromData.di_obd_iumpr_numerator[241] ZFEH_EepromData.di_obd_iumpr_numerator[242] ZFEH_EepromData.di_obd_iumpr_numerator[243] ZFEH_EepromData.di_obd_iumpr_numerator[244] ZFEH_EepromData.di_obd_iumpr_numerator[245] ZFEH_EepromData.di_obd_iumpr_numerator[246] ZFEH_EepromData.di_obd_iumpr_numerator[247] ZFEH_EepromData.di_obd_iumpr_numerator[248] ZFEH_EepromData.di_obd_iumpr_numerator[249] ZFEH_EepromData.di_obd_iumpr_numerator[24] ZFEH_EepromData.di_obd_iumpr_numerator[250] ZFEH_EepromData.di_obd_iumpr_numerator[251] ZFEH_EepromData.di_obd_iumpr_numerator[252] ZFEH_EepromData.di_obd_iumpr_numerator[253] ZFEH_EepromData.di_obd_iumpr_numerator[25] ZFEH_EepromData.di_obd_iumpr_numerator[26] ZFEH_EepromData.di_obd_iumpr_numerator[27] ZFEH_EepromData.di_obd_iumpr_numerator[28] ZFEH_EepromData.di_obd_iumpr_numerator[29] ZFEH_EepromData.di_obd_iumpr_numerator[2] ZFEH_EepromData.di_obd_iumpr_numerator[30] ZFEH_EepromData.di_obd_iumpr_numerator[31] ZFEH_EepromData.di_obd_iumpr_numerator[32] ZFEH_EepromData.di_obd_iumpr_numerator[33] ZFEH_EepromData.di_obd_iumpr_numerator[34] ZFEH_EepromData.di_obd_iumpr_numerator[35] ZFEH_EepromData.di_obd_iumpr_numerator[36] ZFEH_EepromData.di_obd_iumpr_numerator[37] ZFEH_EepromData.di_obd_iumpr_numerator[38] ZFEH_EepromData.di_obd_iumpr_numerator[39] ZFEH_EepromData.di_obd_iumpr_numerator[3] ZFEH_EepromData.di_obd_iumpr_numerator[40] ZFEH_EepromData.di_obd_iumpr_numerator[41] ZFEH_EepromData.di_obd_iumpr_numerator[42] ZFEH_EepromData.di_obd_iumpr_numerator[43] ZFEH_EepromData.di_obd_iumpr_numerator[44] ZFEH_EepromData.di_obd_iumpr_numerator[45] ZFEH_EepromData.di_obd_iumpr_numerator[46] ZFEH_EepromData.di_obd_iumpr_numerator[47] ZFEH_EepromData.di_obd_iumpr_numerator[48] ZFEH_EepromData.di_obd_iumpr_numerator[49] ZFEH_EepromData.di_obd_iumpr_numerator[4] ZFEH_EepromData.di_obd_iumpr_numerator[50] ZFEH_EepromData.di_obd_iumpr_numerator[51] ZFEH_EepromData.di_obd_iumpr_numerator[52] ZFEH_EepromData.di_obd_iumpr_numerator[53] ZFEH_EepromData.di_obd_iumpr_numerator[54] ZFEH_EepromData.di_obd_iumpr_numerator[55] ZFEH_EepromData.di_obd_iumpr_numerator[56] ZFEH_EepromData.di_obd_iumpr_numerator[57] ZFEH_EepromData.di_obd_iumpr_numerator[58] ZFEH_EepromData.di_obd_iumpr_numerator[59] ZFEH_EepromData.di_obd_iumpr_numerator[5] ZFEH_EepromData.di_obd_iumpr_numerator[60] ZFEH_EepromData.di_obd_iumpr_numerator[61] ZFEH_EepromData.di_obd_iumpr_numerator[62] ZFEH_EepromData.di_obd_iumpr_numerator[63] ZFEH_EepromData.di_obd_iumpr_numerator[64] ZFEH_EepromData.di_obd_iumpr_numerator[65] ZFEH_EepromData.di_obd_iumpr_numerator[66] ZFEH_EepromData.di_obd_iumpr_numerator[67] ZFEH_EepromData.di_obd_iumpr_numerator[68] /end LOC_MEASUREMENT
/end FUNCTION
/end MODULE
/end PROJECT
