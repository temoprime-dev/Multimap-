ASAP2_VERSION 1 51
/begin PROJECT _929_929 "Gen2_BMW_System_Supplier_Lib"
/begin HEADER "" VERSION "C_03_03" PROJECT_NO _929_929 /end HEADER
/begin MODULE DIM ""
/begin MOD_COMMON "" BYTE_ORDER MSB_FIRST ALIGNMENT_BYTE 1 ALIGNMENT_WORD 2 ALIGNMENT_LONG 4 ALIGNMENT_FLOAT32_IEEE 4 /end MOD_COMMON
/begin CHARACTERISTIC KF_TSYNCGMTHINSYNSPORT31 "Zeit vor sync. fur Rampenstart Haltephase in Synchron" MAP 0x237624 kf_ui8_S6_S3 2550 UMR_MSEC__10_1_M255_S6_S3 -2550 0
 /begin AXIS_DESCR STD_AXIS zff_atsys._.iSignale._.obj.sig_c_getr UMR_GRADC__1_1_M40_S6_S3 4 -40 215 DEPOSIT ABSOLUTE MONOTONY MON_INCREASE /end AXIS_DESCR
 /begin AXIS_DESCR STD_AXIS zff_atsys._.iSignale._.obj.sig_m_t8 UMR_NM__8_1_M50_S6_S3 4 -400 1640 DEPOSIT ABSOLUTE MONOTONY MON_INCREASE /end AXIS_DESCR
/end CHARACTERISTIC
/begin CHARACTERISTIC KF_TSYNCGMTHINSYNRASPORT31 "Zeit vor sync. fur Rampenende Haltephase in Synchron" MAP 0x237644 kf_ui8_S6_S3 2550 UMR_MSEC__10_1_M255_S6_S3 -2550 0
 /begin AXIS_DESCR STD_AXIS zff_atsys._.iSignale._.obj.sig_c_getr UMR_GRADC__1_1_M40_S6_S3 4 -40 215 DEPOSIT ABSOLUTE MONOTONY MON_INCREASE /end AXIS_DESCR
 /begin AXIS_DESCR STD_AXIS zff_atsys._.iSignale._.obj.sig_m_t8 UMR_NM__8_1_M50_S6_S3 4 -400 1640 DEPOSIT ABSOLUTE MONOTONY MON_INCREASE /end AXIS_DESCR
/end CHARACTERISTIC
/begin CHARACTERISTIC KF_TSYNCGMTHINSYNSPORT42 "Zeit vor sync. fur Rampenstart Haltephase in Synchron" MAP 0x237664 kf_ui8_S6_S3 2550 UMR_MSEC__10_1_M255_S6_S3 -2550 0
 /begin AXIS_DESCR STD_AXIS zff_atsys._.iSignale._.obj.sig_c_getr UMR_GRADC__1_1_M40_S6_S3 4 -40 215 DEPOSIT ABSOLUTE MONOTONY MON_INCREASE /end AXIS_DESCR
 /begin AXIS_DESCR STD_AXIS zff_atsys._.iSignale._.obj.sig_m_t8 UMR_NM__8_1_M50_S6_S3 4 -400 1640 DEPOSIT ABSOLUTE MONOTONY MON_INCREASE /end AXIS_DESCR
/end CHARACTERISTIC
/begin CHARACTERISTIC KF_TSYNCGMTHINSYNRASPORT42 "Zeit vor sync. fur Rampenende Haltephase in Synchron" MAP 0x237684 kf_ui8_S6_S3 2550 UMR_MSEC__10_1_M255_S6_S3 -2550 0
 /begin AXIS_DESCR STD_AXIS zff_atsys._.iSignale._.obj.sig_c_getr UMR_GRADC__1_1_M40_S6_S3 4 -40 215 DEPOSIT ABSOLUTE MONOTONY MON_INCREASE /end AXIS_DESCR
 /begin AXIS_DESCR STD_AXIS zff_atsys._.iSignale._.obj.sig_m_t8 UMR_NM__8_1_M50_S6_S3 4 -400 1640 DEPOSIT ABSOLUTE MONOTONY MON_INCREASE /end AXIS_DESCR
/end CHARACTERISTIC
/begin CHARACTERISTIC KF_TSYNCGMTHINSYNSPORT51 "Zeit vor sync. fur Rampenstart Haltephase in Synchron" MAP 0x2376A4 kf_ui8_S6_S3 2550 UMR_MSEC__10_1_M255_S6_S3 -2550 0
 /begin AXIS_DESCR STD_AXIS zff_atsys._.iSignale._.obj.sig_c_getr UMR_GRADC__1_1_M40_S6_S3 4 -40 215 DEPOSIT ABSOLUTE MONOTONY MON_INCREASE /end AXIS_DESCR
 /begin AXIS_DESCR STD_AXIS zff_atsys._.iSignale._.obj.sig_m_t8 UMR_NM__8_1_M50_S6_S3 4 -400 1640 DEPOSIT ABSOLUTE MONOTONY MON_INCREASE /end AXIS_DESCR
/end CHARACTERISTIC
/begin CHARACTERISTIC KF_TSYNCGMTHINSYNRASPORT51 "Zeit vor sync. fur Rampenende Haltephase in Synchron" MAP 0x2376C4 kf_ui8_S6_S3 2550 UMR_MSEC__10_1_M255_S6_S3 -2550 0
 /begin AXIS_DESCR STD_AXIS zff_atsys._.iSignale._.obj.sig_c_getr UMR_GRADC__1_1_M40_S6_S3 4 -40 215 DEPOSIT ABSOLUTE MONOTONY MON_INCREASE /end AXIS_DESCR
 /begin AXIS_DESCR STD_AXIS zff_atsys._.iSignale._.obj.sig_m_t8 UMR_NM__8_1_M50_S6_S3 4 -400 1640 DEPOSIT ABSOLUTE MONOTONY MON_INCREASE /end AXIS_DESCR
/end CHARACTERISTIC
/begin CHARACTERISTIC KF_TSYNCGMTHINSYNSPORT53 "Zeit vor sync. fur Rampenstart Haltephase in Synchron" MAP 0x2376E4 kf_ui8_S6_S3 2550 UMR_MSEC__10_1_M255_S6_S3 -2550 0
 /begin AXIS_DESCR STD_AXIS zff_atsys._.iSignale._.obj.sig_c_getr UMR_GRADC__1_1_M40_S6_S3 4 -40 215 DEPOSIT ABSOLUTE MONOTONY MON_INCREASE /end AXIS_DESCR
 /begin AXIS_DESCR STD_AXIS zff_atsys._.iSignale._.obj.sig_m_t8 UMR_NM__8_1_M50_S6_S3 4 -400 1640 DEPOSIT ABSOLUTE MONOTONY MON_INCREASE /end AXIS_DESCR
/end CHARACTERISTIC
/begin CHARACTERISTIC KF_TSYNCGMTHINSYNRASPORT53 "Zeit vor sync. fur Rampenende Haltephase in Synchron" MAP 0x237704 kf_ui8_S6_S3 2550 UMR_MSEC__10_1_M255_S6_S3 -2550 0
 /begin AXIS_DESCR STD_AXIS zff_atsys._.iSignale._.obj.sig_c_getr UMR_GRADC__1_1_M40_S6_S3 4 -40 215 DEPOSIT ABSOLUTE MONOTONY MON_INCREASE /end AXIS_DESCR
 /begin AXIS_DESCR STD_AXIS zff_atsys._.iSignale._.obj.sig_m_t8 UMR_NM__8_1_M50_S6_S3 4 -400 1640 DEPOSIT ABSOLUTE MONOTONY MON_INCREASE /end AXIS_DESCR
/end CHARACTERISTIC
/begin CHARACTERISTIC KF_TSYNCGMTHINSYNSPORT63 "Zeit vor sync. fur Rampenstart Haltephase in Synchron" MAP 0x237724 kf_ui8_S6_S3 2550 UMR_MSEC__10_1_M255_S6_S3 -2550 0
 /begin AXIS_DESCR STD_AXIS zff_atsys._.iSignale._.obj.sig_c_getr UMR_GRADC__1_1_M40_S6_S3 4 -40 215 DEPOSIT ABSOLUTE MONOTONY MON_INCREASE /end AXIS_DESCR
 /begin AXIS_DESCR STD_AXIS zff_atsys._.iSignale._.obj.sig_m_t8 UMR_NM__8_1_M50_S6_S3 4 -400 1640 DEPOSIT ABSOLUTE MONOTONY MON_INCREASE /end AXIS_DESCR
/end CHARACTERISTIC
/begin CHARACTERISTIC KF_TSYNCGMTHINSYNRASPORT63 "Zeit vor sync. fur Rampenende Haltephase in Synchron" MAP 0x237744 kf_ui8_S6_S3 2550 UMR_MSEC__10_1_M255_S6_S3 -2550 0
 /begin AXIS_DESCR STD_AXIS zff_atsys._.iSignale._.obj.sig_c_getr UMR_GRADC__1_1_M40_S6_S3 4 -40 215 DEPOSIT ABSOLUTE MONOTONY MON_INCREASE /end AXIS_DESCR
 /begin AXIS_DESCR STD_AXIS zff_atsys._.iSignale._.obj.sig_m_t8 UMR_NM__8_1_M50_S6_S3 4 -400 1640 DEPOSIT ABSOLUTE MONOTONY MON_INCREASE /end AXIS_DESCR
/end CHARACTERISTIC
/begin CHARACTERISTIC KF_TSYNCGMTHINSYNSPORT64 "Zeit vor sync. fur Rampenstart Haltephase in Synchron" MAP 0x237764 kf_ui8_S6_S3 2550 UMR_MSEC__10_1_M255_S6_S3 -2550 0
 /begin AXIS_DESCR STD_AXIS zff_atsys._.iSignale._.obj.sig_c_getr UMR_GRADC__1_1_M40_S6_S3 4 -40 215 DEPOSIT ABSOLUTE MONOTONY MON_INCREASE /end AXIS_DESCR
 /begin AXIS_DESCR STD_AXIS zff_atsys._.iSignale._.obj.sig_m_t8 UMR_NM__8_1_M50_S6_S3 4 -400 1640 DEPOSIT ABSOLUTE MONOTONY MON_INCREASE /end AXIS_DESCR
/end CHARACTERISTIC
/begin CHARACTERISTIC KF_TSYNCGMTHINSYNRASPORT64 "Zeit vor sync. fur Rampenende Haltephase in Synchron" MAP 0x237784 kf_ui8_S6_S3 2550 UMR_MSEC__10_1_M255_S6_S3 -2550 0
 /begin AXIS_DESCR STD_AXIS zff_atsys._.iSignale._.obj.sig_c_getr UMR_GRADC__1_1_M40_S6_S3 4 -40 215 DEPOSIT ABSOLUTE MONOTONY MON_INCREASE /end AXIS_DESCR
 /begin AXIS_DESCR STD_AXIS zff_atsys._.iSignale._.obj.sig_m_t8 UMR_NM__8_1_M50_S6_S3 4 -400 1640 DEPOSIT ABSOLUTE MONOTONY MON_INCREASE /end AXIS_DESCR
/end CHARACTERISTIC
/begin CHARACTERISTIC KF_TSYNCGMTHINSYNSPORT71 "Zeit vor sync. fur Rampenstart Haltephase in Synchron" MAP 0x2377A4 kf_ui8_S6_S3 2550 UMR_MSEC__10_1_M255_S6_S3 -2550 0
 /begin AXIS_DESCR STD_AXIS zff_atsys._.iSignale._.obj.sig_c_getr UMR_GRADC__1_1_M40_S6_S3 4 -40 215 DEPOSIT ABSOLUTE MONOTONY MON_INCREASE /end AXIS_DESCR
 /begin AXIS_DESCR STD_AXIS zff_atsys._.iSignale._.obj.sig_m_t8 UMR_NM__8_1_M50_S6_S3 4 -400 1640 DEPOSIT ABSOLUTE MONOTONY MON_INCREASE /end AXIS_DESCR
/end CHARACTERISTIC
/begin CHARACTERISTIC KF_TSYNCGMTHINSYNRASPORT71 "Zeit vor sync. fur Rampenende Haltephase in Synchron" MAP 0x2377C4 kf_ui8_S6_S3 2550 UMR_MSEC__10_1_M255_S6_S3 -2550 0
 /begin AXIS_DESCR STD_AXIS zff_atsys._.iSignale._.obj.sig_c_getr UMR_GRADC__1_1_M40_S6_S3 4 -40 215 DEPOSIT ABSOLUTE MONOTONY MON_INCREASE /end AXIS_DESCR
 /begin AXIS_DESCR STD_AXIS zff_atsys._.iSignale._.obj.sig_m_t8 UMR_NM__8_1_M50_S6_S3 4 -400 1640 DEPOSIT ABSOLUTE MONOTONY MON_INCREASE /end AXIS_DESCR
/end CHARACTERISTIC
/begin CHARACTERISTIC KF_TSYNCGMTHINSYNSPORT75 "Zeit vor sync. fur Rampenstart Haltephase in Synchron" MAP 0x2377E4 kf_ui8_S6_S3 2550 UMR_MSEC__10_1_M255_S6_S3 -2550 0
 /begin AXIS_DESCR STD_AXIS zff_atsys._.iSignale._.obj.sig_c_getr UMR_GRADC__1_1_M40_S6_S3 4 -40 215 DEPOSIT ABSOLUTE MONOTONY MON_INCREASE /end AXIS_DESCR
 /begin AXIS_DESCR STD_AXIS zff_atsys._.iSignale._.obj.sig_m_t8 UMR_NM__8_1_M50_S6_S3 4 -400 1640 DEPOSIT ABSOLUTE MONOTONY MON_INCREASE /end AXIS_DESCR
/end CHARACTERISTIC
/begin CHARACTERISTIC KF_TSYNCGMTHINSYNRASPORT75 "Zeit vor sync. fur Rampenende Haltephase in Synchron" MAP 0x237804 kf_ui8_S6_S3 2550 UMR_MSEC__10_1_M255_S6_S3 -2550 0
 /begin AXIS_DESCR STD_AXIS zff_atsys._.iSignale._.obj.sig_c_getr UMR_GRADC__1_1_M40_S6_S3 4 -40 215 DEPOSIT ABSOLUTE MONOTONY MON_INCREASE /end AXIS_DESCR
 /begin AXIS_DESCR STD_AXIS zff_atsys._.iSignale._.obj.sig_m_t8 UMR_NM__8_1_M50_S6_S3 4 -400 1640 DEPOSIT ABSOLUTE MONOTONY MON_INCREASE /end AXIS_DESCR
/end CHARACTERISTIC
/begin CHARACTERISTIC KF_TSYNCGMTHINSYNSPORT82 "Zeit vor sync. fur Rampenstart Haltephase in Synchron" MAP 0x237824 kf_ui8_S6_S3 2550 UMR_MSEC__10_1_M255_S6_S3 -2550 0
 /begin AXIS_DESCR STD_AXIS zff_atsys._.iSignale._.obj.sig_c_getr UMR_GRADC__1_1_M40_S6_S3 4 -40 215 DEPOSIT ABSOLUTE MONOTONY MON_INCREASE /end AXIS_DESCR
 /begin AXIS_DESCR STD_AXIS zff_atsys._.iSignale._.obj.sig_m_t8 UMR_NM__8_1_M50_S6_S3 4 -400 1640 DEPOSIT ABSOLUTE MONOTONY MON_INCREASE /end AXIS_DESCR
/end CHARACTERISTIC
/begin CHARACTERISTIC KF_TSYNCGMTHINSYNRASPORT82 "Zeit vor sync. fur Rampenende Haltephase in Synchron" MAP 0x237844 kf_ui8_S6_S3 2550 UMR_MSEC__10_1_M255_S6_S3 -2550 0
 /begin AXIS_DESCR STD_AXIS zff_atsys._.iSignale._.obj.sig_c_getr UMR_GRADC__1_1_M40_S6_S3 4 -40 215 DEPOSIT ABSOLUTE MONOTONY MON_INCREASE /end AXIS_DESCR
 /begin AXIS_DESCR STD_AXIS zff_atsys._.iSignale._.obj.sig_m_t8 UMR_NM__8_1_M50_S6_S3 4 -400 1640 DEPOSIT ABSOLUTE MONOTONY MON_INCREASE /end AXIS_DESCR
/end CHARACTERISTIC
/begin CHARACTERISTIC KF_TSYNCGMTHINSYNSPORT84 "Zeit vor sync. fur Rampenstart Haltephase in Synchron" MAP 0x237864 kf_ui8_S6_S3 2550 UMR_MSEC__10_1_M255_S6_S3 -2550 0
 /begin AXIS_DESCR STD_AXIS zff_atsys._.iSignale._.obj.sig_c_getr UMR_GRADC__1_1_M40_S6_S3 4 -40 215 DEPOSIT ABSOLUTE MONOTONY MON_INCREASE /end AXIS_DESCR
 /begin AXIS_DESCR STD_AXIS zff_atsys._.iSignale._.obj.sig_m_t8 UMR_NM__8_1_M50_S6_S3 4 -400 1640 DEPOSIT ABSOLUTE MONOTONY MON_INCREASE /end AXIS_DESCR
/end CHARACTERISTIC
/begin CHARACTERISTIC KF_TSYNCGMTHINSYNRASPORT84 "Zeit vor sync. fur Rampenende Haltephase in Synchron" MAP 0x237884 kf_ui8_S6_S3 2550 UMR_MSEC__10_1_M255_S6_S3 -2550 0
 /begin AXIS_DESCR STD_AXIS zff_atsys._.iSignale._.obj.sig_c_getr UMR_GRADC__1_1_M40_S6_S3 4 -40 215 DEPOSIT ABSOLUTE MONOTONY MON_INCREASE /end AXIS_DESCR
 /begin AXIS_DESCR STD_AXIS zff_atsys._.iSignale._.obj.sig_m_t8 UMR_NM__8_1_M50_S6_S3 4 -400 1640 DEPOSIT ABSOLUTE MONOTONY MON_INCREASE /end AXIS_DESCR
/end CHARACTERISTIC
/begin CHARACTERISTIC KF_TSYNCGMTHINSYNSPORT86 "Zeit vor sync. fur Rampenstart Haltephase in Synchron" MAP 0x2378A4 kf_ui8_S6_S3 2550 UMR_MSEC__10_1_M255_S6_S3 -2550 0
 /begin AXIS_DESCR STD_AXIS zff_atsys._.iSignale._.obj.sig_c_getr UMR_GRADC__1_1_M40_S6_S3 4 -40 215 DEPOSIT ABSOLUTE MONOTONY MON_INCREASE /end AXIS_DESCR
 /begin AXIS_DESCR STD_AXIS zff_atsys._.iSignale._.obj.sig_m_t8 UMR_NM__8_1_M50_S6_S3 4 -400 1640 DEPOSIT ABSOLUTE MONOTONY MON_INCREASE /end AXIS_DESCR
/end CHARACTERISTIC
/begin CHARACTERISTIC KF_TSYNCGMTHINSYNRASPORT86 "Zeit vor sync. fur Rampenende Haltephase in Synchron" MAP 0x2378C4 kf_ui8_S6_S3 2550 UMR_MSEC__10_1_M255_S6_S3 -2550 0
 /begin AXIS_DESCR STD_AXIS zff_atsys._.iSignale._.obj.sig_c_getr UMR_GRADC__1_1_M40_S6_S3 4 -40 215 DEPOSIT ABSOLUTE MONOTONY MON_INCREASE /end AXIS_DESCR
 /begin AXIS_DESCR STD_AXIS zff_atsys._.iSignale._.obj.sig_m_t8 UMR_NM__8_1_M50_S6_S3 4 -400 1640 DEPOSIT ABSOLUTE MONOTONY MON_INCREASE /end AXIS_DESCR
/end CHARACTERISTIC
/begin CHARACTERISTIC KF_ZWME12 "Zwangsmotoreingriff Schaltablauf" MAP 0x22E490 kf_si16_S6_S3 870 UMR_NM__6_1_M145_S6_S3 -870 0
 /begin AXIS_DESCR STD_AXIS NO_INPUT_QUANTITY UMR_U_MIN_1_1_0_S6_S3 6 -8000 8000 DEPOSIT ABSOLUTE MONOTONY MON_INCREASE /end AXIS_DESCR
 /begin AXIS_DESCR STD_AXIS zff_atsys._.iSignale._.obj.sig_m_t UMR_NM__1_1_0_S6_S3 6 -400 1640 DEPOSIT ABSOLUTE MONOTONY MON_INCREASE /end AXIS_DESCR
/end CHARACTERISTIC
/begin CHARACTERISTIC T_FMEHAUPTPOSA12 "Filterzeit Start Hauptmotoreingriff" VALUE 0x26D81C kw_si16_S6_S3 508 UMR_MSEC__1_1_0_S6_S3 -254 254 /end CHARACTERISTIC
/begin CHARACTERISTIC K_FMEHAUPTPOSA12 "Filterkonstante (aehnl INPT) Start Hauptmotoreingriff" VALUE 0x26D81E kw_si16_S6_S3 65.535 UMR___1_1000_0_S6_S3 -32.768 32.767 /end CHARACTERISTIC
/begin CHARACTERISTIC KL_FMEHAUPTPOSE12 "Faktor fuer Ruecknahmerampe bei Momentenerhoehung" CURVE 0x22E4F8 kl_ui8_S6_S3 1 UMR___1_100_0_S6_S3 0 1
 /begin AXIS_DESCR STD_AXIS iMoeMesaf.timer_zmes UMR_MSEC__10_1_0_S6_S3 6 0 2550 DEPOSIT ABSOLUTE MONOTONY MON_INCREASE /end AXIS_DESCR
/end CHARACTERISTIC
/begin CHARACTERISTIC KL_TSYNMEHAUPTPOSE12 "Zeitkriterium fuer Ende Haupt-ME bei Momentenerhoehung" CURVE 0x22E508 kl_ui8_S6_S3 2550 UMR_MSEC__10_1_M128_S6_S3 -1280 1270
 /begin AXIS_DESCR STD_AXIS iSasZentr.iSchaltend.n_tkf UMR_U_MIN_32_1_0_S6_S3 6 0 8160 DEPOSIT ABSOLUTE MONOTONY MON_INCREASE /end AXIS_DESCR
/end CHARACTERISTIC
/begin CHARACTERISTIC KF_TSYNMTNMOTMEHAUPTA12 "Zeitkriterium Start Haupt-ME bei Momentenerhoehung" MAP 0x22E518 kf_si16_S6_S3 5000 UMR_MSEC__10_1_0_S6_S3 -5000 0
 /begin AXIS_DESCR STD_AXIS zff_atsys._.iSignale._.obj.sig_m_t UMR_NM__1_1_0_S6_S3 4 -400 1640 DEPOSIT ABSOLUTE MONOTONY MON_INCREASE /end AXIS_DESCR
 /begin AXIS_DESCR STD_AXIS zff_atsys._.iSignale._.obj.sig_n_mot UMR_U_MIN_1_1_0_S6_S3 4 0 8160 DEPOSIT ABSOLUTE MONOTONY MON_INCREASE /end AXIS_DESCR
/end CHARACTERISTIC
/begin CHARACTERISTIC KL_MEKPOSCM12 "Erhoehungsfaktor ME f(Mot.temp)" CURVE 0x22E550 kl_ui8_S6_S3 100 UMR_PROZENT__20_51_0_S6_S3 0 100
 /begin AXIS_DESCR STD_AXIS zff_atsys._.iSignale._.obj.sig_c_mot UMR_GRADC__1_1_M48_S6_S3 4 -48 144 DEPOSIT ABSOLUTE MONOTONY MON_INCREASE /end AXIS_DESCR
/end CHARACTERISTIC
/begin CHARACTERISTIC KF_MEKREDCMMT12 "Reduzierfaktor ME f(Mot.temp)" MAP 0x22E55C kf_ui8_S6_S3 100 UMR_PROZENT__20_51_0_S6_S3 0 100
 /begin AXIS_DESCR STD_AXIS zff_atsys._.iSignale._.obj.sig_c_mot UMR_GRADC__1_1_M48_S6_S3 4 -48 144 DEPOSIT ABSOLUTE MONOTONY MON_INCREASE /end AXIS_DESCR
 /begin AXIS_DESCR STD_AXIS zff_atsys._.iSignale._.obj.sig_m_t8 UMR_NM__8_1_M50_S6_S3 4 -400 1640 DEPOSIT ABSOLUTE MONOTONY MON_INCREASE /end AXIS_DESCR
/end CHARACTERISTIC
/begin CHARACTERISTIC KF_MEKREDCMMT12_EL "Reduzierfaktor ME f(Mot.temp)" MAP 0x22E57C kf_ui8_S6_S3 100 UMR_PROZENT__20_51_0_S6_S3 0 100
 /begin AXIS_DESCR STD_AXIS zff_atsys._.iSignale._.obj.sig_c_mot UMR_GRADC__1_1_M48_S6_S3 4 -48 144 DEPOSIT ABSOLUTE MONOTONY MON_INCREASE /end AXIS_DESCR
 /begin AXIS_DESCR STD_AXIS zff_atsys._.iSignale._.obj.sig_m_t8 UMR_NM__8_1_M50_S6_S3 4 -400 1640 DEPOSIT ABSOLUTE MONOTONY MON_INCREASE /end AXIS_DESCR
/end CHARACTERISTIC
/begin CHARACTERISTIC T_RAMEE12 "Dauer Rampe ME bei Schaltungsende" VALUE 0x26E586 kw_ui8_S6_S3 2540 UMR_MSEC__10_1_0_S6_S3 0 2540 /end CHARACTERISTIC
/begin CHARACTERISTIC MS_TSSCHR12 "Turbinenmomentschwelle Schrittschaltungsmotoreingriff" VALUE 0x26D820 kw_si16_S6_S3 2040 UMR_NM__1_1_0_S6_S3 -400 1640 /end CHARACTERISTIC
/begin CHARACTERISTIC KF_TSYNMTNMOTMEHAUPTA_LRHS12 "Zeitkriterium für Start Hauptmotoreingriff bei Momentenerhöhung bei Lastrücknahme Funktion" MAP 0x22E59C kf_si16_S6_S3 5000 UMR_MSEC__10_1_0_S6_S3 -5000 0
 /begin AXIS_DESCR STD_AXIS zff_atsys._.iSignale._.obj.sig_m_t UMR_NM__1_1_0_S6_S3 4 -400 1640 DEPOSIT ABSOLUTE MONOTONY MON_INCREASE /end AXIS_DESCR
 /begin AXIS_DESCR STD_AXIS zff_atsys._.iSignale._.obj.sig_n_mot UMR_U_MIN_1_1_0_S6_S3 4 0 8160 DEPOSIT ABSOLUTE MONOTONY MON_INCREASE /end AXIS_DESCR
/end CHARACTERISTIC
/begin CHARACTERISTIC KF_ZWME23 "Zwangsmotoreingriff Schaltablauf" MAP 0x22E5D4 kf_si16_S6_S3 870 UMR_NM__6_1_M145_S6_S3 -870 0
 /begin AXIS_DESCR STD_AXIS NO_INPUT_QUANTITY UMR_U_MIN_1_1_0_S6_S3 6 -8000 8000 DEPOSIT ABSOLUTE MONOTONY MON_INCREASE /end AXIS_DESCR
 /begin AXIS_DESCR STD_AXIS zff_atsys._.iSignale._.obj.sig_m_t UMR_NM__1_1_0_S6_S3 6 -400 1640 DEPOSIT ABSOLUTE MONOTONY MON_INCREASE /end AXIS_DESCR
/end CHARACTERISTIC
/begin CHARACTERISTIC T_FMEHAUPTPOSA23 "Filterzeit Start Hauptmotoreingriff" VALUE 0x26D822 kw_si16_S6_S3 508 UMR_MSEC__1_1_0_S6_S3 -254 254 /end CHARACTERISTIC
/begin CHARACTERISTIC K_FMEHAUPTPOSA23 "Filterkonstante (aehnl INPT) Start Hauptmotoreingriff" VALUE 0x26D824 kw_si16_S6_S3 65.535 UMR___1_1000_0_S6_S3 -32.768 32.767 /end CHARACTERISTIC
/begin CHARACTERISTIC KL_FMEHAUPTPOSE23 "Faktor fuer Ruecknahmerampe bei Momentenerhoehung" CURVE 0x22E63C kl_ui8_S6_S3 1 UMR___1_100_0_S6_S3 0 1
 /begin AXIS_DESCR STD_AXIS iMoeMesaf.timer_zmes UMR_MSEC__10_1_0_S6_S3 6 0 2550 DEPOSIT ABSOLUTE MONOTONY MON_INCREASE /end AXIS_DESCR
/end CHARACTERISTIC
/begin CHARACTERISTIC KL_TSYNMEHAUPTPOSE23 "Zeitkriterium fuer Ende Haupt-ME bei Momentenerhoehung" CURVE 0x22E64C kl_ui8_S6_S3 2550 UMR_MSEC__10_1_M128_S6_S3 -1280 1270
 /begin AXIS_DESCR STD_AXIS iSasZentr.iSchaltend.n_tkf UMR_U_MIN_32_1_0_S6_S3 6 0 8160 DEPOSIT ABSOLUTE MONOTONY MON_INCREASE /end AXIS_DESCR
/end CHARACTERISTIC
/begin CHARACTERISTIC KF_TSYNMTNMOTMEHAUPTA23 "Zeitkriterium Start Haupt-ME bei Momentenerhoehung" MAP 0x22E65C kf_si16_S6_S3 5000 UMR_MSEC__10_1_0_S6_S3 -5000 0
 /begin AXIS_DESCR STD_AXIS zff_atsys._.iSignale._.obj.sig_m_t UMR_NM__1_1_0_S6_S3 4 -400 1640 DEPOSIT ABSOLUTE MONOTONY MON_INCREASE /end AXIS_DESCR
 /begin AXIS_DESCR STD_AXIS zff_atsys._.iSignale._.obj.sig_n_mot UMR_U_MIN_1_1_0_S6_S3 4 0 8160 DEPOSIT ABSOLUTE MONOTONY MON_INCREASE /end AXIS_DESCR
/end CHARACTERISTIC
/begin CHARACTERISTIC KL_MEKPOSCM23 "Erhoehungsfaktor ME f(Mot.temp)" CURVE 0x22E694 kl_ui8_S6_S3 100 UMR_PROZENT__20_51_0_S6_S3 0 100
 /begin AXIS_DESCR STD_AXIS zff_atsys._.iSignale._.obj.sig_c_mot UMR_GRADC__1_1_M48_S6_S3 4 -48 144 DEPOSIT ABSOLUTE MONOTONY MON_INCREASE /end AXIS_DESCR
/end CHARACTERISTIC
/begin CHARACTERISTIC KF_MEKREDCMMT23 "Reduzierfaktor ME f(Mot.temp)" MAP 0x22E6A0 kf_ui8_S6_S3 100 UMR_PROZENT__20_51_0_S6_S3 0 100
 /begin AXIS_DESCR STD_AXIS zff_atsys._.iSignale._.obj.sig_c_mot UMR_GRADC__1_1_M48_S6_S3 4 -48 144 DEPOSIT ABSOLUTE MONOTONY MON_INCREASE /end AXIS_DESCR
 /begin AXIS_DESCR STD_AXIS zff_atsys._.iSignale._.obj.sig_m_t8 UMR_NM__8_1_M50_S6_S3 4 -400 1640 DEPOSIT ABSOLUTE MONOTONY MON_INCREASE /end AXIS_DESCR
/end CHARACTERISTIC
/begin CHARACTERISTIC KF_MEKREDCMMT23_EL "Reduzierfaktor ME f(Mot.temp)" MAP 0x22E6C0 kf_ui8_S6_S3 100 UMR_PROZENT__20_51_0_S6_S3 0 100
 /begin AXIS_DESCR STD_AXIS zff_atsys._.iSignale._.obj.sig_c_mot UMR_GRADC__1_1_M48_S6_S3 4 -48 144 DEPOSIT ABSOLUTE MONOTONY MON_INCREASE /end AXIS_DESCR
 /begin AXIS_DESCR STD_AXIS zff_atsys._.iSignale._.obj.sig_m_t8 UMR_NM__8_1_M50_S6_S3 4 -400 1640 DEPOSIT ABSOLUTE MONOTONY MON_INCREASE /end AXIS_DESCR
/end CHARACTERISTIC
/begin CHARACTERISTIC T_RAMEE23 "Dauer Rampe ME bei Schaltungsende" VALUE 0x26E587 kw_ui8_S6_S3 2540 UMR_MSEC__10_1_0_S6_S3 0 2540 /end CHARACTERISTIC
/begin CHARACTERISTIC MS_TSSCHR23 "Turbinenmomentschwelle Schrittschaltungsmotoreingriff" VALUE 0x26D826 kw_si16_S6_S3 2040 UMR_NM__1_1_0_S6_S3 -400 1640 /end CHARACTERISTIC
/begin CHARACTERISTIC KF_TSYNMTNMOTMEHAUPTA_LRHS23 "Zeitkriterium für Start Hauptmotoreingriff bei Momentenerhöhung bei Lastrücknahme Funktion" MAP 0x22E6E0 kf_si16_S6_S3 5000 UMR_MSEC__10_1_0_S6_S3 -5000 0
 /begin AXIS_DESCR STD_AXIS zff_atsys._.iSignale._.obj.sig_m_t UMR_NM__1_1_0_S6_S3 4 -400 1640 DEPOSIT ABSOLUTE MONOTONY MON_INCREASE /end AXIS_DESCR
 /begin AXIS_DESCR STD_AXIS zff_atsys._.iSignale._.obj.sig_n_mot UMR_U_MIN_1_1_0_S6_S3 4 0 8160 DEPOSIT ABSOLUTE MONOTONY MON_INCREASE /end AXIS_DESCR
/end CHARACTERISTIC
/begin CHARACTERISTIC KF_ZWME34 "Zwangsmotoreingriff Schaltablauf" MAP 0x22E718 kf_si16_S6_S3 870 UMR_NM__6_1_M145_S6_S3 -870 0
 /begin AXIS_DESCR STD_AXIS NO_INPUT_QUANTITY UMR_U_MIN_1_1_0_S6_S3 6 -8000 8000 DEPOSIT ABSOLUTE MONOTONY MON_INCREASE /end AXIS_DESCR
 /begin AXIS_DESCR STD_AXIS zff_atsys._.iSignale._.obj.sig_m_t UMR_NM__1_1_0_S6_S3 6 -400 1640 DEPOSIT ABSOLUTE MONOTONY MON_INCREASE /end AXIS_DESCR
/end CHARACTERISTIC
/begin CHARACTERISTIC T_FMEHAUPTPOSA34 "Filterzeit Start Hauptmotoreingriff" VALUE 0x26D828 kw_si16_S6_S3 508 UMR_MSEC__1_1_0_S6_S3 -254 254 /end CHARACTERISTIC
/begin CHARACTERISTIC K_FMEHAUPTPOSA34 "Filterkonstante (aehnl INPT) Start Hauptmotoreingriff" VALUE 0x26D82A kw_si16_S6_S3 65.535 UMR___1_1000_0_S6_S3 -32.768 32.767 /end CHARACTERISTIC
/begin CHARACTERISTIC KL_FMEHAUPTPOSE34 "Faktor fuer Ruecknahmerampe bei Momentenerhoehung" CURVE 0x22E780 kl_ui8_S6_S3 1 UMR___1_100_0_S6_S3 0 1
 /begin AXIS_DESCR STD_AXIS iMoeMesaf.timer_zmes UMR_MSEC__10_1_0_S6_S3 6 0 2550 DEPOSIT ABSOLUTE MONOTONY MON_INCREASE /end AXIS_DESCR
/end CHARACTERISTIC
/begin CHARACTERISTIC KL_TSYNMEHAUPTPOSE34 "Zeitkriterium fuer Ende Haupt-ME bei Momentenerhoehung" CURVE 0x22E790 kl_ui8_S6_S3 2550 UMR_MSEC__10_1_M128_S6_S3 -1280 1270
 /begin AXIS_DESCR STD_AXIS iSasZentr.iSchaltend.n_tkf UMR_U_MIN_32_1_0_S6_S3 6 0 8160 DEPOSIT ABSOLUTE MONOTONY MON_INCREASE /end AXIS_DESCR
/end CHARACTERISTIC
/begin CHARACTERISTIC KF_TSYNMTNMOTMEHAUPTA34 "Zeitkriterium Start Haupt-ME bei Momentenerhoehung" MAP 0x22E7A0 kf_si16_S6_S3 5000 UMR_MSEC__10_1_0_S6_S3 -5000 0
 /begin AXIS_DESCR STD_AXIS zff_atsys._.iSignale._.obj.sig_m_t UMR_NM__1_1_0_S6_S3 4 -400 1640 DEPOSIT ABSOLUTE MONOTONY MON_INCREASE /end AXIS_DESCR
 /begin AXIS_DESCR STD_AXIS zff_atsys._.iSignale._.obj.sig_n_mot UMR_U_MIN_1_1_0_S6_S3 4 0 8160 DEPOSIT ABSOLUTE MONOTONY MON_INCREASE /end AXIS_DESCR
/end CHARACTERISTIC
/begin CHARACTERISTIC KL_MEKPOSCM34 "Erhoehungsfaktor ME f(Mot.temp)" CURVE 0x22E7D8 kl_ui8_S6_S3 100 UMR_PROZENT__20_51_0_S6_S3 0 100
 /begin AXIS_DESCR STD_AXIS zff_atsys._.iSignale._.obj.sig_c_mot UMR_GRADC__1_1_M48_S6_S3 4 -48 144 DEPOSIT ABSOLUTE MONOTONY MON_INCREASE /end AXIS_DESCR
/end CHARACTERISTIC
/begin CHARACTERISTIC KF_MEKREDCMMT34 "Reduzierfaktor ME f(Mot.temp)" MAP 0x22E7E4 kf_ui8_S6_S3 100 UMR_PROZENT__20_51_0_S6_S3 0 100
 /begin AXIS_DESCR STD_AXIS zff_atsys._.iSignale._.obj.sig_c_mot UMR_GRADC__1_1_M48_S6_S3 4 -48 144 DEPOSIT ABSOLUTE MONOTONY MON_INCREASE /end AXIS_DESCR
 /begin AXIS_DESCR STD_AXIS zff_atsys._.iSignale._.obj.sig_m_t8 UMR_NM__8_1_M50_S6_S3 4 -400 1640 DEPOSIT ABSOLUTE MONOTONY MON_INCREASE /end AXIS_DESCR
/end CHARACTERISTIC
/begin CHARACTERISTIC KF_MEKREDCMMT34_EL "Reduzierfaktor ME f(Mot.temp)" MAP 0x22E804 kf_ui8_S6_S3 100 UMR_PROZENT__20_51_0_S6_S3 0 100
 /begin AXIS_DESCR STD_AXIS zff_atsys._.iSignale._.obj.sig_c_mot UMR_GRADC__1_1_M48_S6_S3 4 -48 144 DEPOSIT ABSOLUTE MONOTONY MON_INCREASE /end AXIS_DESCR
 /begin AXIS_DESCR STD_AXIS zff_atsys._.iSignale._.obj.sig_m_t8 UMR_NM__8_1_M50_S6_S3 4 -400 1640 DEPOSIT ABSOLUTE MONOTONY MON_INCREASE /end AXIS_DESCR
/end CHARACTERISTIC
/begin CHARACTERISTIC T_RAMEE34 "Dauer Rampe ME bei Schaltungsende" VALUE 0x26E588 kw_ui8_S6_S3 2540 UMR_MSEC__10_1_0_S6_S3 0 2540 /end CHARACTERISTIC
/begin CHARACTERISTIC MS_TSSCHR34 "Turbinenmomentschwelle Schrittschaltungsmotoreingriff" VALUE 0x26D82C kw_si16_S6_S3 2040 UMR_NM__1_1_0_S6_S3 -400 1640 /end CHARACTERISTIC
/begin CHARACTERISTIC KF_TSYNMTNMOTMEHAUPTA_LRHS34 "Zeitkriterium für Start Hauptmotoreingriff bei Momentenerhöhung bei Lastrücknahme Funktion" MAP 0x22E824 kf_si16_S6_S3 5000 UMR_MSEC__10_1_0_S6_S3 -5000 0
 /begin AXIS_DESCR STD_AXIS zff_atsys._.iSignale._.obj.sig_m_t UMR_NM__1_1_0_S6_S3 4 -400 1640 DEPOSIT ABSOLUTE MONOTONY MON_INCREASE /end AXIS_DESCR
 /begin AXIS_DESCR STD_AXIS zff_atsys._.iSignale._.obj.sig_n_mot UMR_U_MIN_1_1_0_S6_S3 4 0 8160 DEPOSIT ABSOLUTE MONOTONY MON_INCREASE /end AXIS_DESCR
/end CHARACTERISTIC
/begin CHARACTERISTIC KF_ZWME45 "Zwangsmotoreingriff Schaltablauf" MAP 0x22E85C kf_si16_S6_S3 870 UMR_NM__6_1_M145_S6_S3 -870 0
 /begin AXIS_DESCR STD_AXIS NO_INPUT_QUANTITY UMR_U_MIN_1_1_0_S6_S3 6 -8000 8000 DEPOSIT ABSOLUTE MONOTONY MON_INCREASE /end AXIS_DESCR
 /begin AXIS_DESCR STD_AXIS zff_atsys._.iSignale._.obj.sig_m_t UMR_NM__1_1_0_S6_S3 6 -400 1640 DEPOSIT ABSOLUTE MONOTONY MON_INCREASE /end AXIS_DESCR
/end CHARACTERISTIC
/begin CHARACTERISTIC T_FMEHAUPTPOSA45 "Filterzeit Start Hauptmotoreingriff" VALUE 0x26D82E kw_si16_S6_S3 508 UMR_MSEC__1_1_0_S6_S3 -254 254 /end CHARACTERISTIC
/begin CHARACTERISTIC K_FMEHAUPTPOSA45 "Filterkonstante (aehnl INPT) Start Hauptmotoreingriff" VALUE 0x26D830 kw_si16_S6_S3 65.535 UMR___1_1000_0_S6_S3 -32.768 32.767 /end CHARACTERISTIC
/begin CHARACTERISTIC KL_FMEHAUPTPOSE45 "Faktor fuer Ruecknahmerampe bei Momentenerhoehung" CURVE 0x22E8C4 kl_ui8_S6_S3 1 UMR___1_100_0_S6_S3 0 1
 /begin AXIS_DESCR STD_AXIS iMoeMesaf.timer_zmes UMR_MSEC__10_1_0_S6_S3 6 0 2550 DEPOSIT ABSOLUTE MONOTONY MON_INCREASE /end AXIS_DESCR
/end CHARACTERISTIC
/begin CHARACTERISTIC KL_TSYNMEHAUPTPOSE45 "Zeitkriterium fuer Ende Haupt-ME bei Momentenerhoehung" CURVE 0x22E8D4 kl_ui8_S6_S3 2550 UMR_MSEC__10_1_M128_S6_S3 -1280 1270
 /begin AXIS_DESCR STD_AXIS iSasZentr.iSchaltend.n_tkf UMR_U_MIN_32_1_0_S6_S3 6 0 8160 DEPOSIT ABSOLUTE MONOTONY MON_INCREASE /end AXIS_DESCR
/end CHARACTERISTIC
/begin CHARACTERISTIC KF_TSYNMTNMOTMEHAUPTA45 "Zeitkriterium Start Haupt-ME bei Momentenerhoehung" MAP 0x22E8E4 kf_si16_S6_S3 5000 UMR_MSEC__10_1_0_S6_S3 -5000 0
 /begin AXIS_DESCR STD_AXIS zff_atsys._.iSignale._.obj.sig_m_t UMR_NM__1_1_0_S6_S3 4 -400 1640 DEPOSIT ABSOLUTE MONOTONY MON_INCREASE /end AXIS_DESCR
 /begin AXIS_DESCR STD_AXIS zff_atsys._.iSignale._.obj.sig_n_mot UMR_U_MIN_1_1_0_S6_S3 4 0 8160 DEPOSIT ABSOLUTE MONOTONY MON_INCREASE /end AXIS_DESCR
/end CHARACTERISTIC
/begin CHARACTERISTIC KL_MEKPOSCM45 "Erhoehungsfaktor ME f(Mot.temp)" CURVE 0x22E91C kl_ui8_S6_S3 100 UMR_PROZENT__20_51_0_S6_S3 0 100
 /begin AXIS_DESCR STD_AXIS zff_atsys._.iSignale._.obj.sig_c_mot UMR_GRADC__1_1_M48_S6_S3 4 -48 144 DEPOSIT ABSOLUTE MONOTONY MON_INCREASE /end AXIS_DESCR
/end CHARACTERISTIC
/begin CHARACTERISTIC KF_MEKREDCMMT45 "Reduzierfaktor ME f(Mot.temp)" MAP 0x22E928 kf_ui8_S6_S3 100 UMR_PROZENT__20_51_0_S6_S3 0 100
 /begin AXIS_DESCR STD_AXIS zff_atsys._.iSignale._.obj.sig_c_mot UMR_GRADC__1_1_M48_S6_S3 4 -48 144 DEPOSIT ABSOLUTE MONOTONY MON_INCREASE /end AXIS_DESCR
 /begin AXIS_DESCR STD_AXIS zff_atsys._.iSignale._.obj.sig_m_t8 UMR_NM__8_1_M50_S6_S3 4 -400 1640 DEPOSIT ABSOLUTE MONOTONY MON_INCREASE /end AXIS_DESCR
/end CHARACTERISTIC
/begin CHARACTERISTIC KF_MEKREDCMMT45_EL "Reduzierfaktor ME f(Mot.temp)" MAP 0x22E948 kf_ui8_S6_S3 100 UMR_PROZENT__20_51_0_S6_S3 0 100
 /begin AXIS_DESCR STD_AXIS zff_atsys._.iSignale._.obj.sig_c_mot UMR_GRADC__1_1_M48_S6_S3 4 -48 144 DEPOSIT ABSOLUTE MONOTONY MON_INCREASE /end AXIS_DESCR
 /begin AXIS_DESCR STD_AXIS zff_atsys._.iSignale._.obj.sig_m_t8 UMR_NM__8_1_M50_S6_S3 4 -400 1640 DEPOSIT ABSOLUTE MONOTONY MON_INCREASE /end AXIS_DESCR
/end CHARACTERISTIC
/begin CHARACTERISTIC T_RAMEE45 "Dauer Rampe ME bei Schaltungsende" VALUE 0x26E589 kw_ui8_S6_S3 2540 UMR_MSEC__10_1_0_S6_S3 0 2540 /end CHARACTERISTIC
/begin CHARACTERISTIC MS_TSSCHR45 "Turbinenmomentschwelle Schrittschaltungsmotoreingriff" VALUE 0x26D832 kw_si16_S6_S3 2040 UMR_NM__1_1_0_S6_S3 -400 1640 /end CHARACTERISTIC
/begin CHARACTERISTIC KF_TSYNMTNMOTMEHAUPTA_LRHS45 "Zeitkriterium für Start Hauptmotoreingriff bei Momentenerhöhung bei Lastrücknahme Funktion" MAP 0x22E968 kf_si16_S6_S3 5000 UMR_MSEC__10_1_0_S6_S3 -5000 0
 /begin AXIS_DESCR STD_AXIS zff_atsys._.iSignale._.obj.sig_m_t UMR_NM__1_1_0_S6_S3 4 -400 1640 DEPOSIT ABSOLUTE MONOTONY MON_INCREASE /end AXIS_DESCR
 /begin AXIS_DESCR STD_AXIS zff_atsys._.iSignale._.obj.sig_n_mot UMR_U_MIN_1_1_0_S6_S3 4 0 8160 DEPOSIT ABSOLUTE MONOTONY MON_INCREASE /end AXIS_DESCR
/end CHARACTERISTIC
/begin CHARACTERISTIC KF_ZWME56 "Zwangsmotoreingriff Schaltablauf" MAP 0x22E9A0 kf_si16_S6_S3 870 UMR_NM__6_1_M145_S6_S3 -870 0
 /begin AXIS_DESCR STD_AXIS NO_INPUT_QUANTITY UMR_U_MIN_1_1_0_S6_S3 6 -8000 8000 DEPOSIT ABSOLUTE MONOTONY MON_INCREASE /end AXIS_DESCR
 /begin AXIS_DESCR STD_AXIS zff_atsys._.iSignale._.obj.sig_m_t UMR_NM__1_1_0_S6_S3 6 -400 1640 DEPOSIT ABSOLUTE MONOTONY MON_INCREASE /end AXIS_DESCR
/end CHARACTERISTIC
/begin CHARACTERISTIC T_FMEHAUPTPOSA56 "Filterzeit Start Hauptmotoreingriff" VALUE 0x26D834 kw_si16_S6_S3 508 UMR_MSEC__1_1_0_S6_S3 -254 254 /end CHARACTERISTIC
/begin CHARACTERISTIC K_FMEHAUPTPOSA56 "Filterkonstante (aehnl INPT) Start Hauptmotoreingriff" VALUE 0x26D836 kw_si16_S6_S3 65.535 UMR___1_1000_0_S6_S3 -32.768 32.767 /end CHARACTERISTIC
/begin CHARACTERISTIC KL_FMEHAUPTPOSE56 "Faktor fuer Ruecknahmerampe bei Momentenerhoehung" CURVE 0x22EA08 kl_ui8_S6_S3 1 UMR___1_100_0_S6_S3 0 1
 /begin AXIS_DESCR STD_AXIS iMoeMesaf.timer_zmes UMR_MSEC__10_1_0_S6_S3 6 0 2550 DEPOSIT ABSOLUTE MONOTONY MON_INCREASE /end AXIS_DESCR
/end CHARACTERISTIC
/begin CHARACTERISTIC KL_TSYNMEHAUPTPOSE56 "Zeitkriterium fuer Ende Haupt-ME bei Momentenerhoehung" CURVE 0x22EA18 kl_ui8_S6_S3 2550 UMR_MSEC__10_1_M128_S6_S3 -1280 1270
 /begin AXIS_DESCR STD_AXIS iSasZentr.iSchaltend.n_tkf UMR_U_MIN_32_1_0_S6_S3 6 0 8160 DEPOSIT ABSOLUTE MONOTONY MON_INCREASE /end AXIS_DESCR
/end CHARACTERISTIC
/begin CHARACTERISTIC KF_TSYNMTNMOTMEHAUPTA56 "Zeitkriterium Start Haupt-ME bei Momentenerhoehung" MAP 0x22EA28 kf_si16_S6_S3 5000 UMR_MSEC__10_1_0_S6_S3 -5000 0
 /begin AXIS_DESCR STD_AXIS zff_atsys._.iSignale._.obj.sig_m_t UMR_NM__1_1_0_S6_S3 4 -400 1640 DEPOSIT ABSOLUTE MONOTONY MON_INCREASE /end AXIS_DESCR
 /begin AXIS_DESCR STD_AXIS zff_atsys._.iSignale._.obj.sig_n_mot UMR_U_MIN_1_1_0_S6_S3 4 0 8160 DEPOSIT ABSOLUTE MONOTONY MON_INCREASE /end AXIS_DESCR
/end CHARACTERISTIC
/begin CHARACTERISTIC KL_MEKPOSCM56 "Erhoehungsfaktor ME f(Mot.temp)" CURVE 0x22EA60 kl_ui8_S6_S3 100 UMR_PROZENT__20_51_0_S6_S3 0 100
 /begin AXIS_DESCR STD_AXIS zff_atsys._.iSignale._.obj.sig_c_mot UMR_GRADC__1_1_M48_S6_S3 4 -48 144 DEPOSIT ABSOLUTE MONOTONY MON_INCREASE /end AXIS_DESCR
/end CHARACTERISTIC
/begin CHARACTERISTIC KF_MEKREDCMMT56 "Reduzierfaktor ME f(Mot.temp)" MAP 0x22EA6C kf_ui8_S6_S3 100 UMR_PROZENT__20_51_0_S6_S3 0 100
 /begin AXIS_DESCR STD_AXIS zff_atsys._.iSignale._.obj.sig_c_mot UMR_GRADC__1_1_M48_S6_S3 4 -48 144 DEPOSIT ABSOLUTE MONOTONY MON_INCREASE /end AXIS_DESCR
 /begin AXIS_DESCR STD_AXIS zff_atsys._.iSignale._.obj.sig_m_t8 UMR_NM__8_1_M50_S6_S3 4 -400 1640 DEPOSIT ABSOLUTE MONOTONY MON_INCREASE /end AXIS_DESCR
/end CHARACTERISTIC
/begin CHARACTERISTIC KF_MEKREDCMMT56_EL "Reduzierfaktor ME f(Mot.temp)" MAP 0x22EA8C kf_ui8_S6_S3 100 UMR_PROZENT__20_51_0_S6_S3 0 100
 /begin AXIS_DESCR STD_AXIS zff_atsys._.iSignale._.obj.sig_c_mot UMR_GRADC__1_1_M48_S6_S3 4 -48 144 DEPOSIT ABSOLUTE MONOTONY MON_INCREASE /end AXIS_DESCR
 /begin AXIS_DESCR STD_AXIS zff_atsys._.iSignale._.obj.sig_m_t8 UMR_NM__8_1_M50_S6_S3 4 -400 1640 DEPOSIT ABSOLUTE MONOTONY MON_INCREASE /end AXIS_DESCR
/end CHARACTERISTIC
/begin CHARACTERISTIC T_RAMEE56 "Dauer Rampe ME bei Schaltungsende" VALUE 0x26E58A kw_ui8_S6_S3 2540 UMR_MSEC__10_1_0_S6_S3 0 2540 /end CHARACTERISTIC
/begin CHARACTERISTIC MS_TSSCHR56 "Turbinenmomentschwelle Schrittschaltungsmotoreingriff" VALUE 0x26D838 kw_si16_S6_S3 2040 UMR_NM__1_1_0_S6_S3 -400 1640 /end CHARACTERISTIC
/begin CHARACTERISTIC KF_TSYNMTNMOTMEHAUPTA_LRHS56 "Zeitkriterium für Start Hauptmotoreingriff bei Momentenerhöhung bei Lastrücknahme Funktion" MAP 0x22EAAC kf_si16_S6_S3 5000 UMR_MSEC__10_1_0_S6_S3 -5000 0
 /begin AXIS_DESCR STD_AXIS zff_atsys._.iSignale._.obj.sig_m_t UMR_NM__1_1_0_S6_S3 4 -400 1640 DEPOSIT ABSOLUTE MONOTONY MON_INCREASE /end AXIS_DESCR
 /begin AXIS_DESCR STD_AXIS zff_atsys._.iSignale._.obj.sig_n_mot UMR_U_MIN_1_1_0_S6_S3 4 0 8160 DEPOSIT ABSOLUTE MONOTONY MON_INCREASE /end AXIS_DESCR
/end CHARACTERISTIC
/begin CHARACTERISTIC KF_ZWME67 "Zwangsmotoreingriff Schaltablauf" MAP 0x22EAE4 kf_si16_S6_S3 870 UMR_NM__6_1_M145_S6_S3 -870 0
 /begin AXIS_DESCR STD_AXIS NO_INPUT_QUANTITY UMR_U_MIN_1_1_0_S6_S3 6 -8000 8000 DEPOSIT ABSOLUTE MONOTONY MON_INCREASE /end AXIS_DESCR
 /begin AXIS_DESCR STD_AXIS zff_atsys._.iSignale._.obj.sig_m_t UMR_NM__1_1_0_S6_S3 6 -400 1640 DEPOSIT ABSOLUTE MONOTONY MON_INCREASE /end AXIS_DESCR
/end CHARACTERISTIC
/begin CHARACTERISTIC T_FMEHAUPTPOSA67 "Filterzeit Start Hauptmotoreingriff" VALUE 0x26D83A kw_si16_S6_S3 508 UMR_MSEC__1_1_0_S6_S3 -254 254 /end CHARACTERISTIC
/begin CHARACTERISTIC K_FMEHAUPTPOSA67 "Filterkonstante (aehnl INPT) Start Hauptmotoreingriff" VALUE 0x26D83C kw_si16_S6_S3 65.535 UMR___1_1000_0_S6_S3 -32.768 32.767 /end CHARACTERISTIC
/begin CHARACTERISTIC KL_FMEHAUPTPOSE67 "Faktor fuer Ruecknahmerampe bei Momentenerhoehung" CURVE 0x22EB4C kl_ui8_S6_S3 1 UMR___1_100_0_S6_S3 0 1
 /begin AXIS_DESCR STD_AXIS iMoeMesaf.timer_zmes UMR_MSEC__10_1_0_S6_S3 6 0 2550 DEPOSIT ABSOLUTE MONOTONY MON_INCREASE /end AXIS_DESCR
/end CHARACTERISTIC
/begin CHARACTERISTIC KL_TSYNMEHAUPTPOSE67 "Zeitkriterium fuer Ende Haupt-ME bei Momentenerhoehung" CURVE 0x22EB5C kl_ui8_S6_S3 2550 UMR_MSEC__10_1_M128_S6_S3 -1280 1270
 /begin AXIS_DESCR STD_AXIS iSasZentr.iSchaltend.n_tkf UMR_U_MIN_32_1_0_S6_S3 6 0 8160 DEPOSIT ABSOLUTE MONOTONY MON_INCREASE /end AXIS_DESCR
/end CHARACTERISTIC
/begin CHARACTERISTIC KF_TSYNMTNMOTMEHAUPTA67 "Zeitkriterium Start Haupt-ME bei Momentenerhoehung" MAP 0x22EB6C kf_si16_S6_S3 5000 UMR_MSEC__10_1_0_S6_S3 -5000 0
 /begin AXIS_DESCR STD_AXIS zff_atsys._.iSignale._.obj.sig_m_t UMR_NM__1_1_0_S6_S3 4 -400 1640 DEPOSIT ABSOLUTE MONOTONY MON_INCREASE /end AXIS_DESCR
 /begin AXIS_DESCR STD_AXIS zff_atsys._.iSignale._.obj.sig_n_mot UMR_U_MIN_1_1_0_S6_S3 4 0 8160 DEPOSIT ABSOLUTE MONOTONY MON_INCREASE /end AXIS_DESCR
/end CHARACTERISTIC
/begin CHARACTERISTIC KL_MEKPOSCM67 "Erhoehungsfaktor ME f(Mot.temp)" CURVE 0x22EBA4 kl_ui8_S6_S3 100 UMR_PROZENT__20_51_0_S6_S3 0 100
 /begin AXIS_DESCR STD_AXIS zff_atsys._.iSignale._.obj.sig_c_mot UMR_GRADC__1_1_M48_S6_S3 4 -48 144 DEPOSIT ABSOLUTE MONOTONY MON_INCREASE /end AXIS_DESCR
/end CHARACTERISTIC
/begin CHARACTERISTIC KF_MEKREDCMMT67 "Reduzierfaktor ME f(Mot.temp)" MAP 0x22EBB0 kf_ui8_S6_S3 100 UMR_PROZENT__20_51_0_S6_S3 0 100
 /begin AXIS_DESCR STD_AXIS zff_atsys._.iSignale._.obj.sig_c_mot UMR_GRADC__1_1_M48_S6_S3 4 -48 144 DEPOSIT ABSOLUTE MONOTONY MON_INCREASE /end AXIS_DESCR
 /begin AXIS_DESCR STD_AXIS zff_atsys._.iSignale._.obj.sig_m_t8 UMR_NM__8_1_M50_S6_S3 4 -400 1640 DEPOSIT ABSOLUTE MONOTONY MON_INCREASE /end AXIS_DESCR
/end CHARACTERISTIC
/begin CHARACTERISTIC KF_MEKREDCMMT67_EL "Reduzierfaktor ME f(Mot.temp)" MAP 0x22EBD0 kf_ui8_S6_S3 100 UMR_PROZENT__20_51_0_S6_S3 0 100
 /begin AXIS_DESCR STD_AXIS zff_atsys._.iSignale._.obj.sig_c_mot UMR_GRADC__1_1_M48_S6_S3 4 -48 144 DEPOSIT ABSOLUTE MONOTONY MON_INCREASE /end AXIS_DESCR
 /begin AXIS_DESCR STD_AXIS zff_atsys._.iSignale._.obj.sig_m_t8 UMR_NM__8_1_M50_S6_S3 4 -400 1640 DEPOSIT ABSOLUTE MONOTONY MON_INCREASE /end AXIS_DESCR
/end CHARACTERISTIC
/begin CHARACTERISTIC T_RAMEE67 "Dauer Rampe ME bei Schaltungsende" VALUE 0x26E58B kw_ui8_S6_S3 2540 UMR_MSEC__10_1_0_S6_S3 0 2540 /end CHARACTERISTIC
/begin CHARACTERISTIC MS_TSSCHR67 "Turbinenmomentschwelle Schrittschaltungsmotoreingriff" VALUE 0x26D83E kw_si16_S6_S3 2040 UMR_NM__1_1_0_S6_S3 -400 1640 /end CHARACTERISTIC
/begin CHARACTERISTIC KF_TSYNMTNMOTMEHAUPTA_LRHS67 "Zeitkriterium für Start Hauptmotoreingriff bei Momentenerhöhung bei Lastrücknahme Funktion" MAP 0x22EBF0 kf_si16_S6_S3 5000 UMR_MSEC__10_1_0_S6_S3 -5000 0
 /begin AXIS_DESCR STD_AXIS zff_atsys._.iSignale._.obj.sig_m_t UMR_NM__1_1_0_S6_S3 4 -400 1640 DEPOSIT ABSOLUTE MONOTONY MON_INCREASE /end AXIS_DESCR
 /begin AXIS_DESCR STD_AXIS zff_atsys._.iSignale._.obj.sig_n_mot UMR_U_MIN_1_1_0_S6_S3 4 0 8160 DEPOSIT ABSOLUTE MONOTONY MON_INCREASE /end AXIS_DESCR
/end CHARACTERISTIC
/begin CHARACTERISTIC KF_ZWME78 "Zwangsmotoreingriff Schaltablauf" MAP 0x22EC28 kf_si16_S6_S3 870 UMR_NM__6_1_M145_S6_S3 -870 0
 /begin AXIS_DESCR STD_AXIS NO_INPUT_QUANTITY UMR_U_MIN_1_1_0_S6_S3 6 -8000 8000 DEPOSIT ABSOLUTE MONOTONY MON_INCREASE /end AXIS_DESCR
 /begin AXIS_DESCR STD_AXIS zff_atsys._.iSignale._.obj.sig_m_t UMR_NM__1_1_0_S6_S3 6 -400 1640 DEPOSIT ABSOLUTE MONOTONY MON_INCREASE /end AXIS_DESCR
/end CHARACTERISTIC
/begin CHARACTERISTIC T_FMEHAUPTPOSA78 "Filterzeit Start Hauptmotoreingriff" VALUE 0x26D840 kw_si16_S6_S3 508 UMR_MSEC__1_1_0_S6_S3 -254 254 /end CHARACTERISTIC
/begin CHARACTERISTIC K_FMEHAUPTPOSA78 "Filterkonstante (aehnl INPT) Start Hauptmotoreingriff" VALUE 0x26D842 kw_si16_S6_S3 65.535 UMR___1_1000_0_S6_S3 -32.768 32.767 /end CHARACTERISTIC
/begin CHARACTERISTIC KL_FMEHAUPTPOSE78 "Faktor fuer Ruecknahmerampe bei Momentenerhoehung" CURVE 0x22EC90 kl_ui8_S6_S3 1 UMR___1_100_0_S6_S3 0 1
 /begin AXIS_DESCR STD_AXIS iMoeMesaf.timer_zmes UMR_MSEC__10_1_0_S6_S3 6 0 2550 DEPOSIT ABSOLUTE MONOTONY MON_INCREASE /end AXIS_DESCR
/end CHARACTERISTIC
/begin CHARACTERISTIC KL_TSYNMEHAUPTPOSE78 "Zeitkriterium fuer Ende Haupt-ME bei Momentenerhoehung" CURVE 0x22ECA0 kl_ui8_S6_S3 2550 UMR_MSEC__10_1_M128_S6_S3 -1280 1270
 /begin AXIS_DESCR STD_AXIS iSasZentr.iSchaltend.n_tkf UMR_U_MIN_32_1_0_S6_S3 6 0 8160 DEPOSIT ABSOLUTE MONOTONY MON_INCREASE /end AXIS_DESCR
/end CHARACTERISTIC
/begin CHARACTERISTIC KF_TSYNMTNMOTMEHAUPTA78 "Zeitkriterium Start Haupt-ME bei Momentenerhoehung" MAP 0x22ECB0 kf_si16_S6_S3 5000 UMR_MSEC__10_1_0_S6_S3 -5000 0
 /begin AXIS_DESCR STD_AXIS zff_atsys._.iSignale._.obj.sig_m_t UMR_NM__1_1_0_S6_S3 4 -400 1640 DEPOSIT ABSOLUTE MONOTONY MON_INCREASE /end AXIS_DESCR
 /begin AXIS_DESCR STD_AXIS zff_atsys._.iSignale._.obj.sig_n_mot UMR_U_MIN_1_1_0_S6_S3 4 0 8160 DEPOSIT ABSOLUTE MONOTONY MON_INCREASE /end AXIS_DESCR
/end CHARACTERISTIC
/begin CHARACTERISTIC KL_MEKPOSCM78 "Erhoehungsfaktor ME f(Mot.temp)" CURVE 0x22ECE8 kl_ui8_S6_S3 100 UMR_PROZENT__20_51_0_S6_S3 0 100
 /begin AXIS_DESCR STD_AXIS zff_atsys._.iSignale._.obj.sig_c_mot UMR_GRADC__1_1_M48_S6_S3 4 -48 144 DEPOSIT ABSOLUTE MONOTONY MON_INCREASE /end AXIS_DESCR
/end CHARACTERISTIC
/begin CHARACTERISTIC KF_MEKREDCMMT78 "Reduzierfaktor ME f(Mot.temp)" MAP 0x22ECF4 kf_ui8_S6_S3 100 UMR_PROZENT__20_51_0_S6_S3 0 100
 /begin AXIS_DESCR STD_AXIS zff_atsys._.iSignale._.obj.sig_c_mot UMR_GRADC__1_1_M48_S6_S3 4 -48 144 DEPOSIT ABSOLUTE MONOTONY MON_INCREASE /end AXIS_DESCR
 /begin AXIS_DESCR STD_AXIS zff_atsys._.iSignale._.obj.sig_m_t8 UMR_NM__8_1_M50_S6_S3 4 -400 1640 DEPOSIT ABSOLUTE MONOTONY MON_INCREASE /end AXIS_DESCR
/end CHARACTERISTIC
/begin CHARACTERISTIC KF_MEKREDCMMT78_EL "Reduzierfaktor ME f(Mot.temp)" MAP 0x22ED14 kf_ui8_S6_S3 100 UMR_PROZENT__20_51_0_S6_S3 0 100
 /begin AXIS_DESCR STD_AXIS zff_atsys._.iSignale._.obj.sig_c_mot UMR_GRADC__1_1_M48_S6_S3 4 -48 144 DEPOSIT ABSOLUTE MONOTONY MON_INCREASE /end AXIS_DESCR
 /begin AXIS_DESCR STD_AXIS zff_atsys._.iSignale._.obj.sig_m_t8 UMR_NM__8_1_M50_S6_S3 4 -400 1640 DEPOSIT ABSOLUTE MONOTONY MON_INCREASE /end AXIS_DESCR
/end CHARACTERISTIC
/begin CHARACTERISTIC T_RAMEE78 "Dauer Rampe ME bei Schaltungsende" VALUE 0x26E58C kw_ui8_S6_S3 2540 UMR_MSEC__10_1_0_S6_S3 0 2540 /end CHARACTERISTIC
/begin CHARACTERISTIC MS_TSSCHR78 "Turbinenmomentschwelle Schrittschaltungsmotoreingriff" VALUE 0x26D844 kw_si16_S6_S3 2040 UMR_NM__1_1_0_S6_S3 -400 1640 /end CHARACTERISTIC
/begin CHARACTERISTIC KF_TSYNMTNMOTMEHAUPTA_LRHS78 "Zeitkriterium für Start Hauptmotoreingriff bei Momentenerhöhung bei Lastrücknahme Funktion" MAP 0x22ED34 kf_si16_S6_S3 5000 UMR_MSEC__10_1_0_S6_S3 -5000 0
 /begin AXIS_DESCR STD_AXIS zff_atsys._.iSignale._.obj.sig_m_t UMR_NM__1_1_0_S6_S3 4 -400 1640 DEPOSIT ABSOLUTE MONOTONY MON_INCREASE /end AXIS_DESCR
 /begin AXIS_DESCR STD_AXIS zff_atsys._.iSignale._.obj.sig_n_mot UMR_U_MIN_1_1_0_S6_S3 4 0 8160 DEPOSIT ABSOLUTE MONOTONY MON_INCREASE /end AXIS_DESCR
/end CHARACTERISTIC
/begin CHARACTERISTIC KF_ZWME13 "Zwangsmotoreingriff Schaltablauf" MAP 0x22ED6C kf_si16_S6_S3 870 UMR_NM__6_1_M145_S6_S3 -870 0
 /begin AXIS_DESCR STD_AXIS NO_INPUT_QUANTITY UMR_U_MIN_1_1_0_S6_S3 6 -8000 8000 DEPOSIT ABSOLUTE MONOTONY MON_INCREASE /end AXIS_DESCR
 /begin AXIS_DESCR STD_AXIS zff_atsys._.iSignale._.obj.sig_m_t UMR_NM__1_1_0_S6_S3 6 -400 1640 DEPOSIT ABSOLUTE MONOTONY MON_INCREASE /end AXIS_DESCR
/end CHARACTERISTIC
/begin CHARACTERISTIC T_FMEHAUPTPOSA13 "Filterzeit Start Hauptmotoreingriff" VALUE 0x26D846 kw_si16_S6_S3 508 UMR_MSEC__1_1_0_S6_S3 -254 254 /end CHARACTERISTIC
/begin CHARACTERISTIC K_FMEHAUPTPOSA13 "Filterkonstante (aehnl INPT) Start Hauptmotoreingriff" VALUE 0x26D848 kw_si16_S6_S3 65.535 UMR___1_1000_0_S6_S3 -32.768 32.767 /end CHARACTERISTIC
/begin CHARACTERISTIC KL_FMEHAUPTPOSE13 "Faktor fuer Ruecknahmerampe bei Momentenerhoehung" CURVE 0x22EDD4 kl_ui8_S6_S3 1 UMR___1_100_0_S6_S3 0 1
 /begin AXIS_DESCR STD_AXIS iMoeMesaf.timer_zmes UMR_MSEC__10_1_0_S6_S3 6 0 2550 DEPOSIT ABSOLUTE MONOTONY MON_INCREASE /end AXIS_DESCR
/end CHARACTERISTIC
/begin CHARACTERISTIC KL_TSYNMEHAUPTPOSE13 "Zeitkriterium fuer Ende Haupt-ME bei Momentenerhoehung" CURVE 0x22EDE4 kl_ui8_S6_S3 2550 UMR_MSEC__10_1_M128_S6_S3 -1280 1270
 /begin AXIS_DESCR STD_AXIS iSasZentr.iSchaltend.n_tkf UMR_U_MIN_32_1_0_S6_S3 6 0 8160 DEPOSIT ABSOLUTE MONOTONY MON_INCREASE /end AXIS_DESCR
/end CHARACTERISTIC
/begin CHARACTERISTIC KF_TSYNMTNMOTMEHAUPTA13 "Zeitkriterium Start Haupt-ME bei Momentenerhoehung" MAP 0x22EDF4 kf_si16_S6_S3 5000 UMR_MSEC__10_1_0_S6_S3 -5000 0
 /begin AXIS_DESCR STD_AXIS zff_atsys._.iSignale._.obj.sig_m_t UMR_NM__1_1_0_S6_S3 4 -400 1640 DEPOSIT ABSOLUTE MONOTONY MON_INCREASE /end AXIS_DESCR
 /begin AXIS_DESCR STD_AXIS zff_atsys._.iSignale._.obj.sig_n_mot UMR_U_MIN_1_1_0_S6_S3 4 0 8160 DEPOSIT ABSOLUTE MONOTONY MON_INCREASE /end AXIS_DESCR
/end CHARACTERISTIC
/begin CHARACTERISTIC KL_MEKPOSCM13 "Erhoehungsfaktor ME f(Mot.temp)" CURVE 0x22EE2C kl_ui8_S6_S3 100 UMR_PROZENT__20_51_0_S6_S3 0 100
 /begin AXIS_DESCR STD_AXIS zff_atsys._.iSignale._.obj.sig_c_mot UMR_GRADC__1_1_M48_S6_S3 4 -48 144 DEPOSIT ABSOLUTE MONOTONY MON_INCREASE /end AXIS_DESCR
/end CHARACTERISTIC
/begin CHARACTERISTIC KF_MEKREDCMMT13 "Reduzierfaktor ME f(Mot.temp)" MAP 0x22EE38 kf_ui8_S6_S3 100 UMR_PROZENT__20_51_0_S6_S3 0 100
 /begin AXIS_DESCR STD_AXIS zff_atsys._.iSignale._.obj.sig_c_mot UMR_GRADC__1_1_M48_S6_S3 4 -48 144 DEPOSIT ABSOLUTE MONOTONY MON_INCREASE /end AXIS_DESCR
 /begin AXIS_DESCR STD_AXIS zff_atsys._.iSignale._.obj.sig_m_t8 UMR_NM__8_1_M50_S6_S3 4 -400 1640 DEPOSIT ABSOLUTE MONOTONY MON_INCREASE /end AXIS_DESCR
/end CHARACTERISTIC
/begin CHARACTERISTIC KF_MEKREDCMMT13_EL "Reduzierfaktor ME f(Mot.temp)" MAP 0x22EE58 kf_ui8_S6_S3 100 UMR_PROZENT__20_51_0_S6_S3 0 100
 /begin AXIS_DESCR STD_AXIS zff_atsys._.iSignale._.obj.sig_c_mot UMR_GRADC__1_1_M48_S6_S3 4 -48 144 DEPOSIT ABSOLUTE MONOTONY MON_INCREASE /end AXIS_DESCR
 /begin AXIS_DESCR STD_AXIS zff_atsys._.iSignale._.obj.sig_m_t8 UMR_NM__8_1_M50_S6_S3 4 -400 1640 DEPOSIT ABSOLUTE MONOTONY MON_INCREASE /end AXIS_DESCR
/end CHARACTERISTIC
/begin CHARACTERISTIC T_RAMEE13 "Dauer Rampe ME bei Schaltungsende" VALUE 0x26E58D kw_ui8_S6_S3 2540 UMR_MSEC__10_1_0_S6_S3 0 2540 /end CHARACTERISTIC
/begin CHARACTERISTIC MS_TSSCHR13 "Turbinenmomentschwelle Schrittschaltungsmotoreingriff" VALUE 0x26D84A kw_si16_S6_S3 2040 UMR_NM__1_1_0_S6_S3 -400 1640 /end CHARACTERISTIC
/begin CHARACTERISTIC KF_TSYNMTNMOTMEHAUPTA_LRHS13 "Zeitkriterium für Start Hauptmotoreingriff bei Momentenerhöhung bei Lastrücknahme Funktion" MAP 0x22EE78 kf_si16_S6_S3 5000 UMR_MSEC__10_1_0_S6_S3 -5000 0
 /begin AXIS_DESCR STD_AXIS zff_atsys._.iSignale._.obj.sig_m_t UMR_NM__1_1_0_S6_S3 4 -400 1640 DEPOSIT ABSOLUTE MONOTONY MON_INCREASE /end AXIS_DESCR
 /begin AXIS_DESCR STD_AXIS zff_atsys._.iSignale._.obj.sig_n_mot UMR_U_MIN_1_1_0_S6_S3 4 0 8160 DEPOSIT ABSOLUTE MONOTONY MON_INCREASE /end AXIS_DESCR
/end CHARACTERISTIC
/begin CHARACTERISTIC KF_ZWME24 "Zwangsmotoreingriff Schaltablauf" MAP 0x22EEB0 kf_si16_S6_S3 870 UMR_NM__6_1_M145_S6_S3 -870 0
 /begin AXIS_DESCR STD_AXIS NO_INPUT_QUANTITY UMR_U_MIN_1_1_0_S6_S3 6 -8000 8000 DEPOSIT ABSOLUTE MONOTONY MON_INCREASE /end AXIS_DESCR
 /begin AXIS_DESCR STD_AXIS zff_atsys._.iSignale._.obj.sig_m_t UMR_NM__1_1_0_S6_S3 6 -400 1640 DEPOSIT ABSOLUTE MONOTONY MON_INCREASE /end AXIS_DESCR
/end CHARACTERISTIC
/begin CHARACTERISTIC T_FMEHAUPTPOSA24 "Filterzeit Start Hauptmotoreingriff" VALUE 0x26D84C kw_si16_S6_S3 508 UMR_MSEC__1_1_0_S6_S3 -254 254 /end CHARACTERISTIC
/begin CHARACTERISTIC K_FMEHAUPTPOSA24 "Filterkonstante (aehnl INPT) Start Hauptmotoreingriff" VALUE 0x26D84E kw_si16_S6_S3 65.535 UMR___1_1000_0_S6_S3 -32.768 32.767 /end CHARACTERISTIC
/begin CHARACTERISTIC KL_FMEHAUPTPOSE24 "Faktor fuer Ruecknahmerampe bei Momentenerhoehung" CURVE 0x22EF18 kl_ui8_S6_S3 1 UMR___1_100_0_S6_S3 0 1
 /begin AXIS_DESCR STD_AXIS iMoeMesaf.timer_zmes UMR_MSEC__10_1_0_S6_S3 6 0 2550 DEPOSIT ABSOLUTE MONOTONY MON_INCREASE /end AXIS_DESCR
/end CHARACTERISTIC
/begin CHARACTERISTIC KL_TSYNMEHAUPTPOSE24 "Zeitkriterium fuer Ende Haupt-ME bei Momentenerhoehung" CURVE 0x22EF28 kl_ui8_S6_S3 2550 UMR_MSEC__10_1_M128_S6_S3 -1280 1270
 /begin AXIS_DESCR STD_AXIS iSasZentr.iSchaltend.n_tkf UMR_U_MIN_32_1_0_S6_S3 6 0 8160 DEPOSIT ABSOLUTE MONOTONY MON_INCREASE /end AXIS_DESCR
/end CHARACTERISTIC
/begin CHARACTERISTIC KF_TSYNMTNMOTMEHAUPTA24 "Zeitkriterium Start Haupt-ME bei Momentenerhoehung" MAP 0x22EF38 kf_si16_S6_S3 5000 UMR_MSEC__10_1_0_S6_S3 -5000 0
 /begin AXIS_DESCR STD_AXIS zff_atsys._.iSignale._.obj.sig_m_t UMR_NM__1_1_0_S6_S3 4 -400 1640 DEPOSIT ABSOLUTE MONOTONY MON_INCREASE /end AXIS_DESCR
 /begin AXIS_DESCR STD_AXIS zff_atsys._.iSignale._.obj.sig_n_mot UMR_U_MIN_1_1_0_S6_S3 4 0 8160 DEPOSIT ABSOLUTE MONOTONY MON_INCREASE /end AXIS_DESCR
/end CHARACTERISTIC
/begin CHARACTERISTIC KL_MEKPOSCM24 "Erhoehungsfaktor ME f(Mot.temp)" CURVE 0x22EF70 kl_ui8_S6_S3 100 UMR_PROZENT__20_51_0_S6_S3 0 100
 /begin AXIS_DESCR STD_AXIS zff_atsys._.iSignale._.obj.sig_c_mot UMR_GRADC__1_1_M48_S6_S3 4 -48 144 DEPOSIT ABSOLUTE MONOTONY MON_INCREASE /end AXIS_DESCR
/end CHARACTERISTIC
/begin CHARACTERISTIC KF_MEKREDCMMT24 "Reduzierfaktor ME f(Mot.temp)" MAP 0x22EF7C kf_ui8_S6_S3 100 UMR_PROZENT__20_51_0_S6_S3 0 100
 /begin AXIS_DESCR STD_AXIS zff_atsys._.iSignale._.obj.sig_c_mot UMR_GRADC__1_1_M48_S6_S3 4 -48 144 DEPOSIT ABSOLUTE MONOTONY MON_INCREASE /end AXIS_DESCR
 /begin AXIS_DESCR STD_AXIS zff_atsys._.iSignale._.obj.sig_m_t8 UMR_NM__8_1_M50_S6_S3 4 -400 1640 DEPOSIT ABSOLUTE MONOTONY MON_INCREASE /end AXIS_DESCR
/end CHARACTERISTIC
/begin CHARACTERISTIC KF_MEKREDCMMT24_EL "Reduzierfaktor ME f(Mot.temp)" MAP 0x22EF9C kf_ui8_S6_S3 100 UMR_PROZENT__20_51_0_S6_S3 0 100
 /begin AXIS_DESCR STD_AXIS zff_atsys._.iSignale._.obj.sig_c_mot UMR_GRADC__1_1_M48_S6_S3 4 -48 144 DEPOSIT ABSOLUTE MONOTONY MON_INCREASE /end AXIS_DESCR
 /begin AXIS_DESCR STD_AXIS zff_atsys._.iSignale._.obj.sig_m_t8 UMR_NM__8_1_M50_S6_S3 4 -400 1640 DEPOSIT ABSOLUTE MONOTONY MON_INCREASE /end AXIS_DESCR
/end CHARACTERISTIC
/begin CHARACTERISTIC T_RAMEE24 "Dauer Rampe ME bei Schaltungsende" VALUE 0x26E58E kw_ui8_S6_S3 2540 UMR_MSEC__10_1_0_S6_S3 0 2540 /end CHARACTERISTIC
/begin CHARACTERISTIC MS_TSSCHR24 "Turbinenmomentschwelle Schrittschaltungsmotoreingriff" VALUE 0x26D850 kw_si16_S6_S3 2040 UMR_NM__1_1_0_S6_S3 -400 1640 /end CHARACTERISTIC
/begin CHARACTERISTIC KF_TSYNMTNMOTMEHAUPTA_LRHS24 "Zeitkriterium für Start Hauptmotoreingriff bei Momentenerhöhung bei Lastrücknahme Funktion" MAP 0x22EFBC kf_si16_S6_S3 5000 UMR_MSEC__10_1_0_S6_S3 -5000 0
 /begin AXIS_DESCR STD_AXIS zff_atsys._.iSignale._.obj.sig_m_t UMR_NM__1_1_0_S6_S3 4 -400 1640 DEPOSIT ABSOLUTE MONOTONY MON_INCREASE /end AXIS_DESCR
 /begin AXIS_DESCR STD_AXIS zff_atsys._.iSignale._.obj.sig_n_mot UMR_U_MIN_1_1_0_S6_S3 4 0 8160 DEPOSIT ABSOLUTE MONOTONY MON_INCREASE /end AXIS_DESCR
/end CHARACTERISTIC
/begin CHARACTERISTIC KF_ZWME35 "Zwangsmotoreingriff Schaltablauf" MAP 0x22EFF4 kf_si16_S6_S3 870 UMR_NM__6_1_M145_S6_S3 -870 0
 /begin AXIS_DESCR STD_AXIS NO_INPUT_QUANTITY UMR_U_MIN_1_1_0_S6_S3 6 -8000 8000 DEPOSIT ABSOLUTE MONOTONY MON_INCREASE /end AXIS_DESCR
 /begin AXIS_DESCR STD_AXIS zff_atsys._.iSignale._.obj.sig_m_t UMR_NM__1_1_0_S6_S3 6 -400 1640 DEPOSIT ABSOLUTE MONOTONY MON_INCREASE /end AXIS_DESCR
/end CHARACTERISTIC
/begin CHARACTERISTIC T_FMEHAUPTPOSA35 "Filterzeit Start Hauptmotoreingriff" VALUE 0x26D852 kw_si16_S6_S3 508 UMR_MSEC__1_1_0_S6_S3 -254 254 /end CHARACTERISTIC
/begin CHARACTERISTIC K_FMEHAUPTPOSA35 "Filterkonstante (aehnl INPT) Start Hauptmotoreingriff" VALUE 0x26D854 kw_si16_S6_S3 65.535 UMR___1_1000_0_S6_S3 -32.768 32.767 /end CHARACTERISTIC
/begin CHARACTERISTIC KL_FMEHAUPTPOSE35 "Faktor fuer Ruecknahmerampe bei Momentenerhoehung" CURVE 0x22F05C kl_ui8_S6_S3 1 UMR___1_100_0_S6_S3 0 1
 /begin AXIS_DESCR STD_AXIS iMoeMesaf.timer_zmes UMR_MSEC__10_1_0_S6_S3 6 0 2550 DEPOSIT ABSOLUTE MONOTONY MON_INCREASE /end AXIS_DESCR
/end CHARACTERISTIC
/begin CHARACTERISTIC KL_TSYNMEHAUPTPOSE35 "Zeitkriterium fuer Ende Haupt-ME bei Momentenerhoehung" CURVE 0x22F06C kl_ui8_S6_S3 2550 UMR_MSEC__10_1_M128_S6_S3 -1280 1270
 /begin AXIS_DESCR STD_AXIS iSasZentr.iSchaltend.n_tkf UMR_U_MIN_32_1_0_S6_S3 6 0 8160 DEPOSIT ABSOLUTE MONOTONY MON_INCREASE /end AXIS_DESCR
/end CHARACTERISTIC
/begin CHARACTERISTIC KF_TSYNMTNMOTMEHAUPTA35 "Zeitkriterium Start Haupt-ME bei Momentenerhoehung" MAP 0x22F07C kf_si16_S6_S3 5000 UMR_MSEC__10_1_0_S6_S3 -5000 0
 /begin AXIS_DESCR STD_AXIS zff_atsys._.iSignale._.obj.sig_m_t UMR_NM__1_1_0_S6_S3 4 -400 1640 DEPOSIT ABSOLUTE MONOTONY MON_INCREASE /end AXIS_DESCR
 /begin AXIS_DESCR STD_AXIS zff_atsys._.iSignale._.obj.sig_n_mot UMR_U_MIN_1_1_0_S6_S3 4 0 8160 DEPOSIT ABSOLUTE MONOTONY MON_INCREASE /end AXIS_DESCR
/end CHARACTERISTIC
/begin CHARACTERISTIC KL_MEKPOSCM35 "Erhoehungsfaktor ME f(Mot.temp)" CURVE 0x22F0B4 kl_ui8_S6_S3 100 UMR_PROZENT__20_51_0_S6_S3 0 100
 /begin AXIS_DESCR STD_AXIS zff_atsys._.iSignale._.obj.sig_c_mot UMR_GRADC__1_1_M48_S6_S3 4 -48 144 DEPOSIT ABSOLUTE MONOTONY MON_INCREASE /end AXIS_DESCR
/end CHARACTERISTIC
/begin CHARACTERISTIC KF_MEKREDCMMT35 "Reduzierfaktor ME f(Mot.temp)" MAP 0x22F0C0 kf_ui8_S6_S3 100 UMR_PROZENT__20_51_0_S6_S3 0 100
 /begin AXIS_DESCR STD_AXIS zff_atsys._.iSignale._.obj.sig_c_mot UMR_GRADC__1_1_M48_S6_S3 4 -48 144 DEPOSIT ABSOLUTE MONOTONY MON_INCREASE /end AXIS_DESCR
 /begin AXIS_DESCR STD_AXIS zff_atsys._.iSignale._.obj.sig_m_t8 UMR_NM__8_1_M50_S6_S3 4 -400 1640 DEPOSIT ABSOLUTE MONOTONY MON_INCREASE /end AXIS_DESCR
/end CHARACTERISTIC
/begin CHARACTERISTIC KF_MEKREDCMMT35_EL "Reduzierfaktor ME f(Mot.temp)" MAP 0x22F0E0 kf_ui8_S6_S3 100 UMR_PROZENT__20_51_0_S6_S3 0 100
 /begin AXIS_DESCR STD_AXIS zff_atsys._.iSignale._.obj.sig_c_mot UMR_GRADC__1_1_M48_S6_S3 4 -48 144 DEPOSIT ABSOLUTE MONOTONY MON_INCREASE /end AXIS_DESCR
 /begin AXIS_DESCR STD_AXIS zff_atsys._.iSignale._.obj.sig_m_t8 UMR_NM__8_1_M50_S6_S3 4 -400 1640 DEPOSIT ABSOLUTE MONOTONY MON_INCREASE /end AXIS_DESCR
/end CHARACTERISTIC
/begin CHARACTERISTIC T_RAMEE35 "Dauer Rampe ME bei Schaltungsende" VALUE 0x26E58F kw_ui8_S6_S3 2540 UMR_MSEC__10_1_0_S6_S3 0 2540 /end CHARACTERISTIC
/begin CHARACTERISTIC MS_TSSCHR35 "Turbinenmomentschwelle Schrittschaltungsmotoreingriff" VALUE 0x26D856 kw_si16_S6_S3 2040 UMR_NM__1_1_0_S6_S3 -400 1640 /end CHARACTERISTIC
/begin CHARACTERISTIC KF_TSYNMTNMOTMEHAUPTA_LRHS35 "Zeitkriterium für Start Hauptmotoreingriff bei Momentenerhöhung bei Lastrücknahme Funktion" MAP 0x22F100 kf_si16_S6_S3 5000 UMR_MSEC__10_1_0_S6_S3 -5000 0
 /begin AXIS_DESCR STD_AXIS zff_atsys._.iSignale._.obj.sig_m_t UMR_NM__1_1_0_S6_S3 4 -400 1640 DEPOSIT ABSOLUTE MONOTONY MON_INCREASE /end AXIS_DESCR
 /begin AXIS_DESCR STD_AXIS zff_atsys._.iSignale._.obj.sig_n_mot UMR_U_MIN_1_1_0_S6_S3 4 0 8160 DEPOSIT ABSOLUTE MONOTONY MON_INCREASE /end AXIS_DESCR
/end CHARACTERISTIC
/begin CHARACTERISTIC KF_ZWME46 "Zwangsmotoreingriff Schaltablauf" MAP 0x22F138 kf_si16_S6_S3 870 UMR_NM__6_1_M145_S6_S3 -870 0
 /begin AXIS_DESCR STD_AXIS NO_INPUT_QUANTITY UMR_U_MIN_1_1_0_S6_S3 6 -8000 8000 DEPOSIT ABSOLUTE MONOTONY MON_INCREASE /end AXIS_DESCR
 /begin AXIS_DESCR STD_AXIS zff_atsys._.iSignale._.obj.sig_m_t UMR_NM__1_1_0_S6_S3 6 -400 1640 DEPOSIT ABSOLUTE MONOTONY MON_INCREASE /end AXIS_DESCR
/end CHARACTERISTIC
/begin CHARACTERISTIC T_FMEHAUPTPOSA46 "Filterzeit Start Hauptmotoreingriff" VALUE 0x26D858 kw_si16_S6_S3 508 UMR_MSEC__1_1_0_S6_S3 -254 254 /end CHARACTERISTIC
/begin CHARACTERISTIC K_FMEHAUPTPOSA46 "Filterkonstante (aehnl INPT) Start Hauptmotoreingriff" VALUE 0x26D85A kw_si16_S6_S3 65.535 UMR___1_1000_0_S6_S3 -32.768 32.767 /end CHARACTERISTIC
/begin CHARACTERISTIC KL_FMEHAUPTPOSE46 "Faktor fuer Ruecknahmerampe bei Momentenerhoehung" CURVE 0x22F1A0 kl_ui8_S6_S3 1 UMR___1_100_0_S6_S3 0 1
 /begin AXIS_DESCR STD_AXIS iMoeMesaf.timer_zmes UMR_MSEC__10_1_0_S6_S3 6 0 2550 DEPOSIT ABSOLUTE MONOTONY MON_INCREASE /end AXIS_DESCR
/end CHARACTERISTIC
/begin CHARACTERISTIC KL_TSYNMEHAUPTPOSE46 "Zeitkriterium fuer Ende Haupt-ME bei Momentenerhoehung" CURVE 0x22F1B0 kl_ui8_S6_S3 2550 UMR_MSEC__10_1_M128_S6_S3 -1280 1270
 /begin AXIS_DESCR STD_AXIS iSasZentr.iSchaltend.n_tkf UMR_U_MIN_32_1_0_S6_S3 6 0 8160 DEPOSIT ABSOLUTE MONOTONY MON_INCREASE /end AXIS_DESCR
/end CHARACTERISTIC
/begin CHARACTERISTIC KF_TSYNMTNMOTMEHAUPTA46 "Zeitkriterium Start Haupt-ME bei Momentenerhoehung" MAP 0x22F1C0 kf_si16_S6_S3 5000 UMR_MSEC__10_1_0_S6_S3 -5000 0
 /begin AXIS_DESCR STD_AXIS zff_atsys._.iSignale._.obj.sig_m_t UMR_NM__1_1_0_S6_S3 4 -400 1640 DEPOSIT ABSOLUTE MONOTONY MON_INCREASE /end AXIS_DESCR
 /begin AXIS_DESCR STD_AXIS zff_atsys._.iSignale._.obj.sig_n_mot UMR_U_MIN_1_1_0_S6_S3 4 0 8160 DEPOSIT ABSOLUTE MONOTONY MON_INCREASE /end AXIS_DESCR
/end CHARACTERISTIC
/begin CHARACTERISTIC KL_MEKPOSCM46 "Erhoehungsfaktor ME f(Mot.temp)" CURVE 0x22F1F8 kl_ui8_S6_S3 100 UMR_PROZENT__20_51_0_S6_S3 0 100
 /begin AXIS_DESCR STD_AXIS zff_atsys._.iSignale._.obj.sig_c_mot UMR_GRADC__1_1_M48_S6_S3 4 -48 144 DEPOSIT ABSOLUTE MONOTONY MON_INCREASE /end AXIS_DESCR
/end CHARACTERISTIC
/begin CHARACTERISTIC KF_MEKREDCMMT46 "Reduzierfaktor ME f(Mot.temp)" MAP 0x22F204 kf_ui8_S6_S3 100 UMR_PROZENT__20_51_0_S6_S3 0 100
 /begin AXIS_DESCR STD_AXIS zff_atsys._.iSignale._.obj.sig_c_mot UMR_GRADC__1_1_M48_S6_S3 4 -48 144 DEPOSIT ABSOLUTE MONOTONY MON_INCREASE /end AXIS_DESCR
 /begin AXIS_DESCR STD_AXIS zff_atsys._.iSignale._.obj.sig_m_t8 UMR_NM__8_1_M50_S6_S3 4 -400 1640 DEPOSIT ABSOLUTE MONOTONY MON_INCREASE /end AXIS_DESCR
/end CHARACTERISTIC
/begin CHARACTERISTIC KF_MEKREDCMMT46_EL "Reduzierfaktor ME f(Mot.temp)" MAP 0x22F224 kf_ui8_S6_S3 100 UMR_PROZENT__20_51_0_S6_S3 0 100
 /begin AXIS_DESCR STD_AXIS zff_atsys._.iSignale._.obj.sig_c_mot UMR_GRADC__1_1_M48_S6_S3 4 -48 144 DEPOSIT ABSOLUTE MONOTONY MON_INCREASE /end AXIS_DESCR
 /begin AXIS_DESCR STD_AXIS zff_atsys._.iSignale._.obj.sig_m_t8 UMR_NM__8_1_M50_S6_S3 4 -400 1640 DEPOSIT ABSOLUTE MONOTONY MON_INCREASE /end AXIS_DESCR
/end CHARACTERISTIC
/begin CHARACTERISTIC T_RAMEE46 "Dauer Rampe ME bei Schaltungsende" VALUE 0x26E590 kw_ui8_S6_S3 2540 UMR_MSEC__10_1_0_S6_S3 0 2540 /end CHARACTERISTIC
/begin CHARACTERISTIC MS_TSSCHR46 "Turbinenmomentschwelle Schrittschaltungsmotoreingriff" VALUE 0x26D85C kw_si16_S6_S3 2040 UMR_NM__1_1_0_S6_S3 -400 1640 /end CHARACTERISTIC
/begin CHARACTERISTIC KF_TSYNMTNMOTMEHAUPTA_LRHS46 "Zeitkriterium für Start Hauptmotoreingriff bei Momentenerhöhung bei Lastrücknahme Funktion" MAP 0x22F244 kf_si16_S6_S3 5000 UMR_MSEC__10_1_0_S6_S3 -5000 0
 /begin AXIS_DESCR STD_AXIS zff_atsys._.iSignale._.obj.sig_m_t UMR_NM__1_1_0_S6_S3 4 -400 1640 DEPOSIT ABSOLUTE MONOTONY MON_INCREASE /end AXIS_DESCR
 /begin AXIS_DESCR STD_AXIS zff_atsys._.iSignale._.obj.sig_n_mot UMR_U_MIN_1_1_0_S6_S3 4 0 8160 DEPOSIT ABSOLUTE MONOTONY MON_INCREASE /end AXIS_DESCR
/end CHARACTERISTIC
/begin CHARACTERISTIC KF_ZWME57 "Zwangsmotoreingriff Schaltablauf" MAP 0x22F27C kf_si16_S6_S3 870 UMR_NM__6_1_M145_S6_S3 -870 0
 /begin AXIS_DESCR STD_AXIS NO_INPUT_QUANTITY UMR_U_MIN_1_1_0_S6_S3 6 -8000 8000 DEPOSIT ABSOLUTE MONOTONY MON_INCREASE /end AXIS_DESCR
 /begin AXIS_DESCR STD_AXIS zff_atsys._.iSignale._.obj.sig_m_t UMR_NM__1_1_0_S6_S3 6 -400 1640 DEPOSIT ABSOLUTE MONOTONY MON_INCREASE /end AXIS_DESCR
/end CHARACTERISTIC
/begin CHARACTERISTIC T_FMEHAUPTPOSA57 "Filterzeit Start Hauptmotoreingriff" VALUE 0x26D85E kw_si16_S6_S3 508 UMR_MSEC__1_1_0_S6_S3 -254 254 /end CHARACTERISTIC
/begin CHARACTERISTIC K_FMEHAUPTPOSA57 "Filterkonstante (aehnl INPT) Start Hauptmotoreingriff" VALUE 0x26D860 kw_si16_S6_S3 65.535 UMR___1_1000_0_S6_S3 -32.768 32.767 /end CHARACTERISTIC
/begin CHARACTERISTIC KL_FMEHAUPTPOSE57 "Faktor fuer Ruecknahmerampe bei Momentenerhoehung" CURVE 0x22F2E4 kl_ui8_S6_S3 1 UMR___1_100_0_S6_S3 0 1
 /begin AXIS_DESCR STD_AXIS iMoeMesaf.timer_zmes UMR_MSEC__10_1_0_S6_S3 6 0 2550 DEPOSIT ABSOLUTE MONOTONY MON_INCREASE /end AXIS_DESCR
/end CHARACTERISTIC
/begin CHARACTERISTIC KL_TSYNMEHAUPTPOSE57 "Zeitkriterium fuer Ende Haupt-ME bei Momentenerhoehung" CURVE 0x22F2F4 kl_ui8_S6_S3 2550 UMR_MSEC__10_1_M128_S6_S3 -1280 1270
 /begin AXIS_DESCR STD_AXIS iSasZentr.iSchaltend.n_tkf UMR_U_MIN_32_1_0_S6_S3 6 0 8160 DEPOSIT ABSOLUTE MONOTONY MON_INCREASE /end AXIS_DESCR
/end CHARACTERISTIC
/begin CHARACTERISTIC KF_TSYNMTNMOTMEHAUPTA57 "Zeitkriterium Start Haupt-ME bei Momentenerhoehung" MAP 0x22F304 kf_si16_S6_S3 5000 UMR_MSEC__10_1_0_S6_S3 -5000 0
 /begin AXIS_DESCR STD_AXIS zff_atsys._.iSignale._.obj.sig_m_t UMR_NM__1_1_0_S6_S3 4 -400 1640 DEPOSIT ABSOLUTE MONOTONY MON_INCREASE /end AXIS_DESCR
 /begin AXIS_DESCR STD_AXIS zff_atsys._.iSignale._.obj.sig_n_mot UMR_U_MIN_1_1_0_S6_S3 4 0 8160 DEPOSIT ABSOLUTE MONOTONY MON_INCREASE /end AXIS_DESCR
/end CHARACTERISTIC
/begin CHARACTERISTIC KL_MEKPOSCM57 "Erhoehungsfaktor ME f(Mot.temp)" CURVE 0x22F33C kl_ui8_S6_S3 100 UMR_PROZENT__20_51_0_S6_S3 0 100
 /begin AXIS_DESCR STD_AXIS zff_atsys._.iSignale._.obj.sig_c_mot UMR_GRADC__1_1_M48_S6_S3 4 -48 144 DEPOSIT ABSOLUTE MONOTONY MON_INCREASE /end AXIS_DESCR
/end CHARACTERISTIC
/begin CHARACTERISTIC KF_MEKREDCMMT57 "Reduzierfaktor ME f(Mot.temp)" MAP 0x22F348 kf_ui8_S6_S3 100 UMR_PROZENT__20_51_0_S6_S3 0 100
 /begin AXIS_DESCR STD_AXIS zff_atsys._.iSignale._.obj.sig_c_mot UMR_GRADC__1_1_M48_S6_S3 4 -48 144 DEPOSIT ABSOLUTE MONOTONY MON_INCREASE /end AXIS_DESCR
 /begin AXIS_DESCR STD_AXIS zff_atsys._.iSignale._.obj.sig_m_t8 UMR_NM__8_1_M50_S6_S3 4 -400 1640 DEPOSIT ABSOLUTE MONOTONY MON_INCREASE /end AXIS_DESCR
/end CHARACTERISTIC
/begin CHARACTERISTIC KF_MEKREDCMMT57_EL "Reduzierfaktor ME f(Mot.temp)" MAP 0x22F368 kf_ui8_S6_S3 100 UMR_PROZENT__20_51_0_S6_S3 0 100
 /begin AXIS_DESCR STD_AXIS zff_atsys._.iSignale._.obj.sig_c_mot UMR_GRADC__1_1_M48_S6_S3 4 -48 144 DEPOSIT ABSOLUTE MONOTONY MON_INCREASE /end AXIS_DESCR
 /begin AXIS_DESCR STD_AXIS zff_atsys._.iSignale._.obj.sig_m_t8 UMR_NM__8_1_M50_S6_S3 4 -400 1640 DEPOSIT ABSOLUTE MONOTONY MON_INCREASE /end AXIS_DESCR
/end CHARACTERISTIC
/begin CHARACTERISTIC T_RAMEE57 "Dauer Rampe ME bei Schaltungsende" VALUE 0x26E591 kw_ui8_S6_S3 2540 UMR_MSEC__10_1_0_S6_S3 0 2540 /end CHARACTERISTIC
/begin CHARACTERISTIC MS_TSSCHR57 "Turbinenmomentschwelle Schrittschaltungsmotoreingriff" VALUE 0x26D862 kw_si16_S6_S3 2040 UMR_NM__1_1_0_S6_S3 -400 1640 /end CHARACTERISTIC
/begin CHARACTERISTIC KF_TSYNMTNMOTMEHAUPTA_LRHS57 "Zeitkriterium für Start Hauptmotoreingriff bei Momentenerhöhung bei Lastrücknahme Funktion" MAP 0x22F388 kf_si16_S6_S3 5000 UMR_MSEC__10_1_0_S6_S3 -5000 0
 /begin AXIS_DESCR STD_AXIS zff_atsys._.iSignale._.obj.sig_m_t UMR_NM__1_1_0_S6_S3 4 -400 1640 DEPOSIT ABSOLUTE MONOTONY MON_INCREASE /end AXIS_DESCR
 /begin AXIS_DESCR STD_AXIS zff_atsys._.iSignale._.obj.sig_n_mot UMR_U_MIN_1_1_0_S6_S3 4 0 8160 DEPOSIT ABSOLUTE MONOTONY MON_INCREASE /end AXIS_DESCR
/end CHARACTERISTIC
/begin CHARACTERISTIC KF_ZWME68 "Zwangsmotoreingriff Schaltablauf" MAP 0x22F3C0 kf_si16_S6_S3 870 UMR_NM__6_1_M145_S6_S3 -870 0
 /begin AXIS_DESCR STD_AXIS NO_INPUT_QUANTITY UMR_U_MIN_1_1_0_S6_S3 6 -8000 8000 DEPOSIT ABSOLUTE MONOTONY MON_INCREASE /end AXIS_DESCR
 /begin AXIS_DESCR STD_AXIS zff_atsys._.iSignale._.obj.sig_m_t UMR_NM__1_1_0_S6_S3 6 -400 1640 DEPOSIT ABSOLUTE MONOTONY MON_INCREASE /end AXIS_DESCR
/end CHARACTERISTIC
/begin CHARACTERISTIC T_FMEHAUPTPOSA68 "Filterzeit Start Hauptmotoreingriff" VALUE 0x26D864 kw_si16_S6_S3 508 UMR_MSEC__1_1_0_S6_S3 -254 254 /end CHARACTERISTIC
/begin CHARACTERISTIC K_FMEHAUPTPOSA68 "Filterkonstante (aehnl INPT) Start Hauptmotoreingriff" VALUE 0x26D866 kw_si16_S6_S3 65.535 UMR___1_1000_0_S6_S3 -32.768 32.767 /end CHARACTERISTIC
/begin CHARACTERISTIC KL_FMEHAUPTPOSE68 "Faktor fuer Ruecknahmerampe bei Momentenerhoehung" CURVE 0x22F428 kl_ui8_S6_S3 1 UMR___1_100_0_S6_S3 0 1
 /begin AXIS_DESCR STD_AXIS iMoeMesaf.timer_zmes UMR_MSEC__10_1_0_S6_S3 6 0 2550 DEPOSIT ABSOLUTE MONOTONY MON_INCREASE /end AXIS_DESCR
/end CHARACTERISTIC
/begin CHARACTERISTIC KL_TSYNMEHAUPTPOSE68 "Zeitkriterium fuer Ende Haupt-ME bei Momentenerhoehung" CURVE 0x22F438 kl_ui8_S6_S3 2550 UMR_MSEC__10_1_M128_S6_S3 -1280 1270
 /begin AXIS_DESCR STD_AXIS iSasZentr.iSchaltend.n_tkf UMR_U_MIN_32_1_0_S6_S3 6 0 8160 DEPOSIT ABSOLUTE MONOTONY MON_INCREASE /end AXIS_DESCR
/end CHARACTERISTIC
/begin CHARACTERISTIC KF_TSYNMTNMOTMEHAUPTA68 "Zeitkriterium Start Haupt-ME bei Momentenerhoehung" MAP 0x22F448 kf_si16_S6_S3 5000 UMR_MSEC__10_1_0_S6_S3 -5000 0
 /begin AXIS_DESCR STD_AXIS zff_atsys._.iSignale._.obj.sig_m_t UMR_NM__1_1_0_S6_S3 4 -400 1640 DEPOSIT ABSOLUTE MONOTONY MON_INCREASE /end AXIS_DESCR
 /begin AXIS_DESCR STD_AXIS zff_atsys._.iSignale._.obj.sig_n_mot UMR_U_MIN_1_1_0_S6_S3 4 0 8160 DEPOSIT ABSOLUTE MONOTONY MON_INCREASE /end AXIS_DESCR
/end CHARACTERISTIC
/begin CHARACTERISTIC KL_MEKPOSCM68 "Erhoehungsfaktor ME f(Mot.temp)" CURVE 0x22F480 kl_ui8_S6_S3 100 UMR_PROZENT__20_51_0_S6_S3 0 100
 /begin AXIS_DESCR STD_AXIS zff_atsys._.iSignale._.obj.sig_c_mot UMR_GRADC__1_1_M48_S6_S3 4 -48 144 DEPOSIT ABSOLUTE MONOTONY MON_INCREASE /end AXIS_DESCR
/end CHARACTERISTIC
/begin CHARACTERISTIC KF_MEKREDCMMT68 "Reduzierfaktor ME f(Mot.temp)" MAP 0x22F48C kf_ui8_S6_S3 100 UMR_PROZENT__20_51_0_S6_S3 0 100
 /begin AXIS_DESCR STD_AXIS zff_atsys._.iSignale._.obj.sig_c_mot UMR_GRADC__1_1_M48_S6_S3 4 -48 144 DEPOSIT ABSOLUTE MONOTONY MON_INCREASE /end AXIS_DESCR
 /begin AXIS_DESCR STD_AXIS zff_atsys._.iSignale._.obj.sig_m_t8 UMR_NM__8_1_M50_S6_S3 4 -400 1640 DEPOSIT ABSOLUTE MONOTONY MON_INCREASE /end AXIS_DESCR
/end CHARACTERISTIC
/begin CHARACTERISTIC KF_MEKREDCMMT68_EL "Reduzierfaktor ME f(Mot.temp)" MAP 0x22F4AC kf_ui8_S6_S3 100 UMR_PROZENT__20_51_0_S6_S3 0 100
 /begin AXIS_DESCR STD_AXIS zff_atsys._.iSignale._.obj.sig_c_mot UMR_GRADC__1_1_M48_S6_S3 4 -48 144 DEPOSIT ABSOLUTE MONOTONY MON_INCREASE /end AXIS_DESCR
 /begin AXIS_DESCR STD_AXIS zff_atsys._.iSignale._.obj.sig_m_t8 UMR_NM__8_1_M50_S6_S3 4 -400 1640 DEPOSIT ABSOLUTE MONOTONY MON_INCREASE /end AXIS_DESCR
/end CHARACTERISTIC
/begin CHARACTERISTIC T_RAMEE68 "Dauer Rampe ME bei Schaltungsende" VALUE 0x26E592 kw_ui8_S6_S3 2540 UMR_MSEC__10_1_0_S6_S3 0 2540 /end CHARACTERISTIC
/begin CHARACTERISTIC MS_TSSCHR68 "Turbinenmomentschwelle Schrittschaltungsmotoreingriff" VALUE 0x26D868 kw_si16_S6_S3 2040 UMR_NM__1_1_0_S6_S3 -400 1640 /end CHARACTERISTIC
/begin CHARACTERISTIC KF_TSYNMTNMOTMEHAUPTA_LRHS68 "Zeitkriterium für Start Hauptmotoreingriff bei Momentenerhöhung bei Lastrücknahme Funktion" MAP 0x22F4CC kf_si16_S6_S3 5000 UMR_MSEC__10_1_0_S6_S3 -5000 0
 /begin AXIS_DESCR STD_AXIS zff_atsys._.iSignale._.obj.sig_m_t UMR_NM__1_1_0_S6_S3 4 -400 1640 DEPOSIT ABSOLUTE MONOTONY MON_INCREASE /end AXIS_DESCR
 /begin AXIS_DESCR STD_AXIS zff_atsys._.iSignale._.obj.sig_n_mot UMR_U_MIN_1_1_0_S6_S3 4 0 8160 DEPOSIT ABSOLUTE MONOTONY MON_INCREASE /end AXIS_DESCR
/end CHARACTERISTIC
/begin CHARACTERISTIC T_RAMEE21 "Dauer Rampe ME bei Schaltungsende" VALUE 0x26E593 kw_ui8_S6_S3 2540 UMR_MSEC__10_1_0_S6_S3 0 2540 /end CHARACTERISTIC
/begin CHARACTERISTIC T_RAMEE21_EL "Dauer Rampe ME bei Schaltungsende" VALUE 0x26E594 kw_ui8_S6_S3 2540 UMR_MSEC__10_1_0_S6_S3 0 2540 /end CHARACTERISTIC
/begin CHARACTERISTIC KL_FMENACHE21 "Faktor fuer Rampe Ende Nach-ME bei RS" CURVE 0x22F504 kl_ui8_S6_S3 1 UMR___1_100_0_S6_S3 0 1
 /begin AXIS_DESCR STD_AXIS iMoeMesaf.timer_zmes UMR_MSEC__10_1_0_S6_S3 4 0 2550 DEPOSIT ABSOLUTE MONOTONY MON_INCREASE /end AXIS_DESCR
/end CHARACTERISTIC
/begin CHARACTERISTIC T_SYNMENACHE21 "Zeit vor/nach Erkennen synchron fuer Ende Nach-ME" VALUE 0x26E595 kw_ui8_S6_S3 2550 UMR_MSEC__10_1_M128_S6_S3 -1280 1270 /end CHARACTERISTIC
/begin CHARACTERISTIC T_SYNMENACHE21_EL "Zeit vor/nach Erkennen synchron fuer Ende Nach-ME" VALUE 0x26E596 kw_ui8_S6_S3 2550 UMR_MSEC__10_1_M128_S6_S3 -1280 1270 /end CHARACTERISTIC
/begin CHARACTERISTIC KF_TSYNMENACHA21 "Zeit vor Erkennen synchron fuer Ende Haupt-ME und Start Nach-ME" MAP 0x22F510 kf_ui8_S6_S3 1280 UMR_MSEC__10_1_M128_S6_S3 -1280 0
 /begin AXIS_DESCR STD_AXIS zff_atsys._.iSignale._.obj.sig_n_mot8 UMR_U_MIN_32_1_0_S6_S3 4 0 8160 DEPOSIT ABSOLUTE MONOTONY MON_INCREASE /end AXIS_DESCR
 /begin AXIS_DESCR STD_AXIS zff_atsys._.iSignale._.obj.sig_m_t8 UMR_NM__8_1_M50_S6_S3 3 -400 1640 DEPOSIT ABSOLUTE MONOTONY MON_INCREASE /end AXIS_DESCR
/end CHARACTERISTIC
/begin CHARACTERISTIC KF_TSYNMENACHA21_EL "Zeit vor Erkennen synchron fuer Ende Haupt-ME und Start Nach-ME" MAP 0x22F52C kf_ui8_S6_S3 1280 UMR_MSEC__10_1_M128_S6_S3 -1280 0
 /begin AXIS_DESCR STD_AXIS zff_atsys._.iSignale._.obj.sig_n_mot8 UMR_U_MIN_32_1_0_S6_S3 4 0 8160 DEPOSIT ABSOLUTE MONOTONY MON_INCREASE /end AXIS_DESCR
 /begin AXIS_DESCR STD_AXIS zff_atsys._.iSignale._.obj.sig_m_t8 UMR_NM__8_1_M50_S6_S3 3 -400 1640 DEPOSIT ABSOLUTE MONOTONY MON_INCREASE /end AXIS_DESCR
/end CHARACTERISTIC
/begin CHARACTERISTIC KF_MENACH21 "Nachmotoreingriff Schaltablauf" MAP 0x22F548 kf_ui8_S6_S3 870 UMR_NM__6_1_M145_S6_S3 -870 0
 /begin AXIS_DESCR STD_AXIS iSasZentr.iSchaltend.n_tkf UMR_U_MIN_32_1_0_S6_S3 6 0 8160 DEPOSIT ABSOLUTE MONOTONY MON_INCREASE /end AXIS_DESCR
 /begin AXIS_DESCR STD_AXIS zff_atsys._.iSignale._.obj.sig_m_t8 UMR_NM__8_1_M50_S6_S3 6 -400 1640 DEPOSIT ABSOLUTE MONOTONY MON_INCREASE /end AXIS_DESCR
/end CHARACTERISTIC
/begin CHARACTERISTIC KF_MENACH21_EL "Nachmotoreingriff Schaltablauf" MAP 0x22F580 kf_ui8_S6_S3 870 UMR_NM__6_1_M145_S6_S3 -870 0
 /begin AXIS_DESCR STD_AXIS iSasZentr.iSchaltend.n_tkf UMR_U_MIN_32_1_0_S6_S3 6 0 8160 DEPOSIT ABSOLUTE MONOTONY MON_INCREASE /end AXIS_DESCR
 /begin AXIS_DESCR STD_AXIS zff_atsys._.iSignale._.obj.sig_m_t8 UMR_NM__8_1_M50_S6_S3 6 -400 1640 DEPOSIT ABSOLUTE MONOTONY MON_INCREASE /end AXIS_DESCR
/end CHARACTERISTIC
/begin CHARACTERISTIC KF_FMTMEHAUPTA21 "Faktor fuer Rampe auf HME bei RS" MAP 0x22F5B8 kf_ui8_S6_S3 1 UMR___1_100_0_S6_S3 0 1
 /begin AXIS_DESCR STD_AXIS iMoeMesaf.timer_zmes UMR_MSEC__10_1_0_S6_S3 4 0 2550 DEPOSIT ABSOLUTE MONOTONY MON_INCREASE /end AXIS_DESCR
 /begin AXIS_DESCR STD_AXIS zff_atsys._.iSignale._.obj.sig_m_t8 UMR_NM__8_1_M50_S6_S3 4 -400 1640 DEPOSIT ABSOLUTE MONOTONY MON_INCREASE /end AXIS_DESCR
/end CHARACTERISTIC
/begin CHARACTERISTIC KF_MEHAUPT21 "Wert Hauptmotoreingriff" MAP 0x22F5D8 kf_ui8_S6_S3 1530 UMR_NM__6_1_M145_S6_S3 -870 660
 /begin AXIS_DESCR STD_AXIS NO_INPUT_QUANTITY UMR_U_MIN_32_1_0_S6_S3 6 0 8160 DEPOSIT ABSOLUTE MONOTONY MON_INCREASE /end AXIS_DESCR
 /begin AXIS_DESCR STD_AXIS zff_atsys._.iSignale._.obj.sig_m_t8 UMR_NM__8_1_M50_S6_S3 10 -400 1640 DEPOSIT ABSOLUTE MONOTONY MON_INCREASE /end AXIS_DESCR
/end CHARACTERISTIC
/begin CHARACTERISTIC KF_MEHAUPT21_EL "Wert Hauptmotoreingriff" MAP 0x22F62C kf_ui8_S6_S3 1530 UMR_NM__6_1_M145_S6_S3 -870 660
 /begin AXIS_DESCR STD_AXIS NO_INPUT_QUANTITY UMR_U_MIN_32_1_0_S6_S3 6 0 8160 DEPOSIT ABSOLUTE MONOTONY MON_INCREASE /end AXIS_DESCR
 /begin AXIS_DESCR STD_AXIS zff_atsys._.iSignale._.obj.sig_m_t8 UMR_NM__8_1_M50_S6_S3 10 -400 1640 DEPOSIT ABSOLUTE MONOTONY MON_INCREASE /end AXIS_DESCR
/end CHARACTERISTIC
/begin CHARACTERISTIC KF_TVMTNMOTMEHAUPT21 "Verzoegerungszeit Start Haupt-ME bei Momentenerhoehung" MAP 0x22F680 kf_ui8_S6_S3 2540 UMR_MSEC__10_1_0_S6_S3 0 2540
 /begin AXIS_DESCR STD_AXIS zff_atsys._.iSignale._.obj.sig_m_t8 UMR_NM__8_1_M50_S6_S3 4 -400 1640 DEPOSIT ABSOLUTE MONOTONY MON_INCREASE /end AXIS_DESCR
 /begin AXIS_DESCR STD_AXIS zff_atsys._.iSignale._.obj.sig_n_mot8 UMR_U_MIN_32_1_0_S6_S3 4 0 8160 DEPOSIT ABSOLUTE MONOTONY MON_INCREASE /end AXIS_DESCR
/end CHARACTERISTIC
/begin CHARACTERISTIC KF_TVMTNMOTMEHAUPT21_EL "Verzoegerungszeit Start Haupt-ME bei Momentenerhoehung" MAP 0x22F6A0 kf_ui8_S6_S3 2540 UMR_MSEC__10_1_0_S6_S3 0 2540
 /begin AXIS_DESCR STD_AXIS zff_atsys._.iSignale._.obj.sig_m_t8 UMR_NM__8_1_M50_S6_S3 4 -400 1640 DEPOSIT ABSOLUTE MONOTONY MON_INCREASE /end AXIS_DESCR
 /begin AXIS_DESCR STD_AXIS zff_atsys._.iSignale._.obj.sig_n_mot8 UMR_U_MIN_32_1_0_S6_S3 4 0 8160 DEPOSIT ABSOLUTE MONOTONY MON_INCREASE /end AXIS_DESCR
/end CHARACTERISTIC
/begin CHARACTERISTIC KL_FMEPOSNGAB21 "Faktor zur Gewichtung pos. ME" CURVE 0x22F6C0 kl_si16_S6_S3 1 UMR___1_100_0_S6_S3 0 1
 /begin AXIS_DESCR STD_AXIS iMoeMesaf.ng_abmesas UMR_U_MINSEC_1_1_0_S6_S3 6 -1000 1000 DEPOSIT ABSOLUTE MONOTONY MON_INCREASE /end AXIS_DESCR
/end CHARACTERISTIC
/begin CHARACTERISTIC KF_TSYNNTKFMTMEHAUPTE21 "Zeitkriterium Ende Haupt-ME bei Momentenerhoehung" MAP 0x22F6DC kf_ui8_S6_S3 1280 UMR_MSEC__10_1_M128_S6_S3 -1280 0
 /begin AXIS_DESCR STD_AXIS iSasZentr.iSchaltend.n_tkf UMR_U_MIN_32_1_0_S6_S3 4 0 8160 DEPOSIT ABSOLUTE MONOTONY MON_INCREASE /end AXIS_DESCR
 /begin AXIS_DESCR STD_AXIS zff_atsys._.iSignale._.obj.sig_m_t8 UMR_NM__8_1_M50_S6_S3 4 -400 1640 DEPOSIT ABSOLUTE MONOTONY MON_INCREASE /end AXIS_DESCR
/end CHARACTERISTIC
/begin CHARACTERISTIC KF_TSYNNTKFMTMEHAUPTE21_EL "Zeitkriterium Ende Haupt-ME bei Momentenerhoehung" MAP 0x22F6FC kf_ui8_S6_S3 1280 UMR_MSEC__10_1_M128_S6_S3 -1280 0
 /begin AXIS_DESCR STD_AXIS iSasZentr.iSchaltend.n_tkf UMR_U_MIN_32_1_0_S6_S3 4 0 8160 DEPOSIT ABSOLUTE MONOTONY MON_INCREASE /end AXIS_DESCR
 /begin AXIS_DESCR STD_AXIS zff_atsys._.iSignale._.obj.sig_m_t8 UMR_NM__8_1_M50_S6_S3 4 -400 1640 DEPOSIT ABSOLUTE MONOTONY MON_INCREASE /end AXIS_DESCR
/end CHARACTERISTIC
/begin CHARACTERISTIC KF_FMESASMEHAUPTPOSE21 "Faktor fuer Reduzierung pos ME bei RS" MAP 0x22F71C kf_si16_S6_S3 1 UMR___1_100_0_S6_S3 0 1
 /begin AXIS_DESCR STD_AXIS iSasZentr.iSchaltend.t_syn UMR_MSEC__10_1_0_S6_S3 4 -327680 327670 DEPOSIT ABSOLUTE MONOTONY MON_INCREASE /end AXIS_DESCR
 /begin AXIS_DESCR STD_AXIS iMoeMesaf.me_sas_gesp UMR_NM__1_1_0_S6_S3 4 0 2000 DEPOSIT ABSOLUTE MONOTONY MON_INCREASE /end AXIS_DESCR
/end CHARACTERISTIC
/begin CHARACTERISTIC KF_FMENACHPOSE21 "Faktor fuer Reduzierung pos ME bei RS" MAP 0x22F754 kf_si16_S6_S3 1 UMR___1_100_0_S6_S3 0 1
 /begin AXIS_DESCR STD_AXIS iMoeMesaf.timer_tsyn_rampe_pos UMR_MSEC__10_1_0_S6_S3 4 -50000 50000 DEPOSIT ABSOLUTE MONOTONY MON_INCREASE /end AXIS_DESCR
 /begin AXIS_DESCR STD_AXIS iMoeMesaf.me_sas_gesp UMR_NM__1_1_0_S6_S3 4 0 2000 DEPOSIT ABSOLUTE MONOTONY MON_INCREASE /end AXIS_DESCR
/end CHARACTERISTIC
/begin CHARACTERISTIC T_RAMEE32 "Dauer Rampe ME bei Schaltungsende" VALUE 0x26E597 kw_ui8_S6_S3 2540 UMR_MSEC__10_1_0_S6_S3 0 2540 /end CHARACTERISTIC
/begin CHARACTERISTIC T_RAMEE32_EL "Dauer Rampe ME bei Schaltungsende" VALUE 0x26E598 kw_ui8_S6_S3 2540 UMR_MSEC__10_1_0_S6_S3 0 2540 /end CHARACTERISTIC
/begin CHARACTERISTIC KL_FMENACHE32 "Faktor fuer Rampe Ende Nach-ME bei RS" CURVE 0x22F78C kl_ui8_S6_S3 1 UMR___1_100_0_S6_S3 0 1
 /begin AXIS_DESCR STD_AXIS iMoeMesaf.timer_zmes UMR_MSEC__10_1_0_S6_S3 4 0 2550 DEPOSIT ABSOLUTE MONOTONY MON_INCREASE /end AXIS_DESCR
/end CHARACTERISTIC
/begin CHARACTERISTIC T_SYNMENACHE32 "Zeit vor/nach Erkennen synchron fuer Ende Nach-ME" VALUE 0x26E599 kw_ui8_S6_S3 2550 UMR_MSEC__10_1_M128_S6_S3 -1280 1270 /end CHARACTERISTIC
/begin CHARACTERISTIC T_SYNMENACHE32_EL "Zeit vor/nach Erkennen synchron fuer Ende Nach-ME" VALUE 0x26E59A kw_ui8_S6_S3 2550 UMR_MSEC__10_1_M128_S6_S3 -1280 1270 /end CHARACTERISTIC
/begin CHARACTERISTIC KF_TSYNMENACHA32 "Zeit vor Erkennen synchron fuer Ende Haupt-ME und Start Nach-ME" MAP 0x22F798 kf_ui8_S6_S3 1280 UMR_MSEC__10_1_M128_S6_S3 -1280 0
 /begin AXIS_DESCR STD_AXIS zff_atsys._.iSignale._.obj.sig_n_mot8 UMR_U_MIN_32_1_0_S6_S3 4 0 8160 DEPOSIT ABSOLUTE MONOTONY MON_INCREASE /end AXIS_DESCR
 /begin AXIS_DESCR STD_AXIS zff_atsys._.iSignale._.obj.sig_m_t8 UMR_NM__8_1_M50_S6_S3 3 -400 1640 DEPOSIT ABSOLUTE MONOTONY MON_INCREASE /end AXIS_DESCR
/end CHARACTERISTIC
/begin CHARACTERISTIC KF_TSYNMENACHA32_EL "Zeit vor Erkennen synchron fuer Ende Haupt-ME und Start Nach-ME" MAP 0x22F7B4 kf_ui8_S6_S3 1280 UMR_MSEC__10_1_M128_S6_S3 -1280 0
 /begin AXIS_DESCR STD_AXIS zff_atsys._.iSignale._.obj.sig_n_mot8 UMR_U_MIN_32_1_0_S6_S3 4 0 8160 DEPOSIT ABSOLUTE MONOTONY MON_INCREASE /end AXIS_DESCR
 /begin AXIS_DESCR STD_AXIS zff_atsys._.iSignale._.obj.sig_m_t8 UMR_NM__8_1_M50_S6_S3 3 -400 1640 DEPOSIT ABSOLUTE MONOTONY MON_INCREASE /end AXIS_DESCR
/end CHARACTERISTIC
/begin CHARACTERISTIC KF_MENACH32 "Nachmotoreingriff Schaltablauf" MAP 0x22F7D0 kf_ui8_S6_S3 870 UMR_NM__6_1_M145_S6_S3 -870 0
 /begin AXIS_DESCR STD_AXIS iSasZentr.iSchaltend.n_tkf UMR_U_MIN_32_1_0_S6_S3 6 0 8160 DEPOSIT ABSOLUTE MONOTONY MON_INCREASE /end AXIS_DESCR
 /begin AXIS_DESCR STD_AXIS zff_atsys._.iSignale._.obj.sig_m_t8 UMR_NM__8_1_M50_S6_S3 6 -400 1640 DEPOSIT ABSOLUTE MONOTONY MON_INCREASE /end AXIS_DESCR
/end CHARACTERISTIC
/begin CHARACTERISTIC KF_MENACH32_EL "Nachmotoreingriff Schaltablauf" MAP 0x22F808 kf_ui8_S6_S3 870 UMR_NM__6_1_M145_S6_S3 -870 0
 /begin AXIS_DESCR STD_AXIS iSasZentr.iSchaltend.n_tkf UMR_U_MIN_32_1_0_S6_S3 6 0 8160 DEPOSIT ABSOLUTE MONOTONY MON_INCREASE /end AXIS_DESCR
 /begin AXIS_DESCR STD_AXIS zff_atsys._.iSignale._.obj.sig_m_t8 UMR_NM__8_1_M50_S6_S3 6 -400 1640 DEPOSIT ABSOLUTE MONOTONY MON_INCREASE /end AXIS_DESCR
/end CHARACTERISTIC
/begin CHARACTERISTIC KF_FMTMEHAUPTA32 "Faktor fuer Rampe auf HME bei RS" MAP 0x22F840 kf_ui8_S6_S3 1 UMR___1_100_0_S6_S3 0 1
 /begin AXIS_DESCR STD_AXIS iMoeMesaf.timer_zmes UMR_MSEC__10_1_0_S6_S3 4 0 2550 DEPOSIT ABSOLUTE MONOTONY MON_INCREASE /end AXIS_DESCR
 /begin AXIS_DESCR STD_AXIS zff_atsys._.iSignale._.obj.sig_m_t8 UMR_NM__8_1_M50_S6_S3 4 -400 1640 DEPOSIT ABSOLUTE MONOTONY MON_INCREASE /end AXIS_DESCR
/end CHARACTERISTIC
/begin CHARACTERISTIC KF_MEHAUPT32 "Wert Hauptmotoreingriff" MAP 0x22F860 kf_ui8_S6_S3 1530 UMR_NM__6_1_M145_S6_S3 -870 660
 /begin AXIS_DESCR STD_AXIS NO_INPUT_QUANTITY UMR_U_MIN_32_1_0_S6_S3 6 0 8160 DEPOSIT ABSOLUTE MONOTONY MON_INCREASE /end AXIS_DESCR
 /begin AXIS_DESCR STD_AXIS zff_atsys._.iSignale._.obj.sig_m_t8 UMR_NM__8_1_M50_S6_S3 10 -400 1640 DEPOSIT ABSOLUTE MONOTONY MON_INCREASE /end AXIS_DESCR
/end CHARACTERISTIC
/begin CHARACTERISTIC KF_MEHAUPT32_EL "Wert Hauptmotoreingriff" MAP 0x22F8B4 kf_ui8_S6_S3 1530 UMR_NM__6_1_M145_S6_S3 -870 660
 /begin AXIS_DESCR STD_AXIS NO_INPUT_QUANTITY UMR_U_MIN_32_1_0_S6_S3 6 0 8160 DEPOSIT ABSOLUTE MONOTONY MON_INCREASE /end AXIS_DESCR
 /begin AXIS_DESCR STD_AXIS zff_atsys._.iSignale._.obj.sig_m_t8 UMR_NM__8_1_M50_S6_S3 10 -400 1640 DEPOSIT ABSOLUTE MONOTONY MON_INCREASE /end AXIS_DESCR
/end CHARACTERISTIC
/begin CHARACTERISTIC KF_TVMTNMOTMEHAUPT32 "Verzoegerungszeit Start Haupt-ME bei Momentenerhoehung" MAP 0x22F908 kf_ui8_S6_S3 2540 UMR_MSEC__10_1_0_S6_S3 0 2540
 /begin AXIS_DESCR STD_AXIS zff_atsys._.iSignale._.obj.sig_m_t8 UMR_NM__8_1_M50_S6_S3 4 -400 1640 DEPOSIT ABSOLUTE MONOTONY MON_INCREASE /end AXIS_DESCR
 /begin AXIS_DESCR STD_AXIS zff_atsys._.iSignale._.obj.sig_n_mot8 UMR_U_MIN_32_1_0_S6_S3 4 0 8160 DEPOSIT ABSOLUTE MONOTONY MON_INCREASE /end AXIS_DESCR
/end CHARACTERISTIC
/begin CHARACTERISTIC KF_TVMTNMOTMEHAUPT32_EL "Verzoegerungszeit Start Haupt-ME bei Momentenerhoehung" MAP 0x22F928 kf_ui8_S6_S3 2540 UMR_MSEC__10_1_0_S6_S3 0 2540
 /begin AXIS_DESCR STD_AXIS zff_atsys._.iSignale._.obj.sig_m_t8 UMR_NM__8_1_M50_S6_S3 4 -400 1640 DEPOSIT ABSOLUTE MONOTONY MON_INCREASE /end AXIS_DESCR
 /begin AXIS_DESCR STD_AXIS zff_atsys._.iSignale._.obj.sig_n_mot8 UMR_U_MIN_32_1_0_S6_S3 4 0 8160 DEPOSIT ABSOLUTE MONOTONY MON_INCREASE /end AXIS_DESCR
/end CHARACTERISTIC
/begin CHARACTERISTIC KL_FMEPOSNGAB32 "Faktor zur Gewichtung pos. ME" CURVE 0x22F948 kl_si16_S6_S3 1 UMR___1_100_0_S6_S3 0 1
 /begin AXIS_DESCR STD_AXIS iMoeMesaf.ng_abmesas UMR_U_MINSEC_1_1_0_S6_S3 6 -1000 1000 DEPOSIT ABSOLUTE MONOTONY MON_INCREASE /end AXIS_DESCR
/end CHARACTERISTIC
/begin CHARACTERISTIC KF_TSYNNTKFMTMEHAUPTE32 "Zeitkriterium Ende Haupt-ME bei Momentenerhoehung" MAP 0x22F964 kf_ui8_S6_S3 1280 UMR_MSEC__10_1_M128_S6_S3 -1280 0
 /begin AXIS_DESCR STD_AXIS iSasZentr.iSchaltend.n_tkf UMR_U_MIN_32_1_0_S6_S3 4 0 8160 DEPOSIT ABSOLUTE MONOTONY MON_INCREASE /end AXIS_DESCR
 /begin AXIS_DESCR STD_AXIS zff_atsys._.iSignale._.obj.sig_m_t8 UMR_NM__8_1_M50_S6_S3 4 -400 1640 DEPOSIT ABSOLUTE MONOTONY MON_INCREASE /end AXIS_DESCR
/end CHARACTERISTIC
/begin CHARACTERISTIC KF_TSYNNTKFMTMEHAUPTE32_EL "Zeitkriterium Ende Haupt-ME bei Momentenerhoehung" MAP 0x22F984 kf_ui8_S6_S3 1280 UMR_MSEC__10_1_M128_S6_S3 -1280 0
 /begin AXIS_DESCR STD_AXIS iSasZentr.iSchaltend.n_tkf UMR_U_MIN_32_1_0_S6_S3 4 0 8160 DEPOSIT ABSOLUTE MONOTONY MON_INCREASE /end AXIS_DESCR
 /begin AXIS_DESCR STD_AXIS zff_atsys._.iSignale._.obj.sig_m_t8 UMR_NM__8_1_M50_S6_S3 4 -400 1640 DEPOSIT ABSOLUTE MONOTONY MON_INCREASE /end AXIS_DESCR
/end CHARACTERISTIC
/begin CHARACTERISTIC KF_FMESASMEHAUPTPOSE32 "Faktor fuer Reduzierung pos ME bei RS" MAP 0x22F9A4 kf_si16_S6_S3 1 UMR___1_100_0_S6_S3 0 1
 /begin AXIS_DESCR STD_AXIS iSasZentr.iSchaltend.t_syn UMR_MSEC__10_1_0_S6_S3 4 -327680 327670 DEPOSIT ABSOLUTE MONOTONY MON_INCREASE /end AXIS_DESCR
 /begin AXIS_DESCR STD_AXIS iMoeMesaf.me_sas_gesp UMR_NM__1_1_0_S6_S3 4 0 2000 DEPOSIT ABSOLUTE MONOTONY MON_INCREASE /end AXIS_DESCR
/end CHARACTERISTIC
/begin CHARACTERISTIC KF_FMENACHPOSE32 "Faktor fuer Reduzierung pos ME bei RS" MAP 0x22F9DC kf_si16_S6_S3 1 UMR___1_100_0_S6_S3 0 1
 /begin AXIS_DESCR STD_AXIS iMoeMesaf.timer_tsyn_rampe_pos UMR_MSEC__10_1_0_S6_S3 4 -50000 50000 DEPOSIT ABSOLUTE MONOTONY MON_INCREASE /end AXIS_DESCR
 /begin AXIS_DESCR STD_AXIS iMoeMesaf.me_sas_gesp UMR_NM__1_1_0_S6_S3 4 0 2000 DEPOSIT ABSOLUTE MONOTONY MON_INCREASE /end AXIS_DESCR
/end CHARACTERISTIC
/begin CHARACTERISTIC T_RAMEE43 "Dauer Rampe ME bei Schaltungsende" VALUE 0x26E59B kw_ui8_S6_S3 2540 UMR_MSEC__10_1_0_S6_S3 0 2540 /end CHARACTERISTIC
/begin CHARACTERISTIC T_RAMEE43_EL "Dauer Rampe ME bei Schaltungsende" VALUE 0x26E59C kw_ui8_S6_S3 2540 UMR_MSEC__10_1_0_S6_S3 0 2540 /end CHARACTERISTIC
/begin CHARACTERISTIC KL_FMENACHE43 "Faktor fuer Rampe Ende Nach-ME bei RS" CURVE 0x22FA14 kl_ui8_S6_S3 1 UMR___1_100_0_S6_S3 0 1
 /begin AXIS_DESCR STD_AXIS iMoeMesaf.timer_zmes UMR_MSEC__10_1_0_S6_S3 4 0 2550 DEPOSIT ABSOLUTE MONOTONY MON_INCREASE /end AXIS_DESCR
/end CHARACTERISTIC
/begin CHARACTERISTIC T_SYNMENACHE43 "Zeit vor/nach Erkennen synchron fuer Ende Nach-ME" VALUE 0x26E59D kw_ui8_S6_S3 2550 UMR_MSEC__10_1_M128_S6_S3 -1280 1270 /end CHARACTERISTIC
/begin CHARACTERISTIC T_SYNMENACHE43_EL "Zeit vor/nach Erkennen synchron fuer Ende Nach-ME" VALUE 0x26E59E kw_ui8_S6_S3 2550 UMR_MSEC__10_1_M128_S6_S3 -1280 1270 /end CHARACTERISTIC
/begin CHARACTERISTIC KF_TSYNMENACHA43 "Zeit vor Erkennen synchron fuer Ende Haupt-ME und Start Nach-ME" MAP 0x22FA20 kf_ui8_S6_S3 1280 UMR_MSEC__10_1_M128_S6_S3 -1280 0
 /begin AXIS_DESCR STD_AXIS zff_atsys._.iSignale._.obj.sig_n_mot8 UMR_U_MIN_32_1_0_S6_S3 4 0 8160 DEPOSIT ABSOLUTE MONOTONY MON_INCREASE /end AXIS_DESCR
 /begin AXIS_DESCR STD_AXIS zff_atsys._.iSignale._.obj.sig_m_t8 UMR_NM__8_1_M50_S6_S3 3 -400 1640 DEPOSIT ABSOLUTE MONOTONY MON_INCREASE /end AXIS_DESCR
/end CHARACTERISTIC
/begin CHARACTERISTIC KF_TSYNMENACHA43_EL "Zeit vor Erkennen synchron fuer Ende Haupt-ME und Start Nach-ME" MAP 0x22FA3C kf_ui8_S6_S3 1280 UMR_MSEC__10_1_M128_S6_S3 -1280 0
 /begin AXIS_DESCR STD_AXIS zff_atsys._.iSignale._.obj.sig_n_mot8 UMR_U_MIN_32_1_0_S6_S3 4 0 8160 DEPOSIT ABSOLUTE MONOTONY MON_INCREASE /end AXIS_DESCR
 /begin AXIS_DESCR STD_AXIS zff_atsys._.iSignale._.obj.sig_m_t8 UMR_NM__8_1_M50_S6_S3 3 -400 1640 DEPOSIT ABSOLUTE MONOTONY MON_INCREASE /end AXIS_DESCR
/end CHARACTERISTIC
/begin CHARACTERISTIC KF_MENACH43 "Nachmotoreingriff Schaltablauf" MAP 0x22FA58 kf_ui8_S6_S3 870 UMR_NM__6_1_M145_S6_S3 -870 0
 /begin AXIS_DESCR STD_AXIS iSasZentr.iSchaltend.n_tkf UMR_U_MIN_32_1_0_S6_S3 6 0 8160 DEPOSIT ABSOLUTE MONOTONY MON_INCREASE /end AXIS_DESCR
 /begin AXIS_DESCR STD_AXIS zff_atsys._.iSignale._.obj.sig_m_t8 UMR_NM__8_1_M50_S6_S3 6 -400 1640 DEPOSIT ABSOLUTE MONOTONY MON_INCREASE /end AXIS_DESCR
/end CHARACTERISTIC
/begin CHARACTERISTIC KF_MENACH43_EL "Nachmotoreingriff Schaltablauf" MAP 0x22FA90 kf_ui8_S6_S3 870 UMR_NM__6_1_M145_S6_S3 -870 0
 /begin AXIS_DESCR STD_AXIS iSasZentr.iSchaltend.n_tkf UMR_U_MIN_32_1_0_S6_S3 6 0 8160 DEPOSIT ABSOLUTE MONOTONY MON_INCREASE /end AXIS_DESCR
 /begin AXIS_DESCR STD_AXIS zff_atsys._.iSignale._.obj.sig_m_t8 UMR_NM__8_1_M50_S6_S3 6 -400 1640 DEPOSIT ABSOLUTE MONOTONY MON_INCREASE /end AXIS_DESCR
/end CHARACTERISTIC
/begin CHARACTERISTIC KF_FMTMEHAUPTA43 "Faktor fuer Rampe auf HME bei RS" MAP 0x22FAC8 kf_ui8_S6_S3 1 UMR___1_100_0_S6_S3 0 1
 /begin AXIS_DESCR STD_AXIS iMoeMesaf.timer_zmes UMR_MSEC__10_1_0_S6_S3 4 0 2550 DEPOSIT ABSOLUTE MONOTONY MON_INCREASE /end AXIS_DESCR
 /begin AXIS_DESCR STD_AXIS zff_atsys._.iSignale._.obj.sig_m_t8 UMR_NM__8_1_M50_S6_S3 4 -400 1640 DEPOSIT ABSOLUTE MONOTONY MON_INCREASE /end AXIS_DESCR
/end CHARACTERISTIC
/begin CHARACTERISTIC KF_MEHAUPT43 "Wert Hauptmotoreingriff" MAP 0x22FAE8 kf_ui8_S6_S3 1530 UMR_NM__6_1_M145_S6_S3 -870 660
 /begin AXIS_DESCR STD_AXIS NO_INPUT_QUANTITY UMR_U_MIN_32_1_0_S6_S3 6 0 8160 DEPOSIT ABSOLUTE MONOTONY MON_INCREASE /end AXIS_DESCR
 /begin AXIS_DESCR STD_AXIS zff_atsys._.iSignale._.obj.sig_m_t8 UMR_NM__8_1_M50_S6_S3 10 -400 1640 DEPOSIT ABSOLUTE MONOTONY MON_INCREASE /end AXIS_DESCR
/end CHARACTERISTIC
/begin CHARACTERISTIC KF_MEHAUPT43_EL "Wert Hauptmotoreingriff" MAP 0x22FB3C kf_ui8_S6_S3 1530 UMR_NM__6_1_M145_S6_S3 -870 660
 /begin AXIS_DESCR STD_AXIS NO_INPUT_QUANTITY UMR_U_MIN_32_1_0_S6_S3 6 0 8160 DEPOSIT ABSOLUTE MONOTONY MON_INCREASE /end AXIS_DESCR
 /begin AXIS_DESCR STD_AXIS zff_atsys._.iSignale._.obj.sig_m_t8 UMR_NM__8_1_M50_S6_S3 10 -400 1640 DEPOSIT ABSOLUTE MONOTONY MON_INCREASE /end AXIS_DESCR
/end CHARACTERISTIC
/begin CHARACTERISTIC KF_TVMTNMOTMEHAUPT43 "Verzoegerungszeit Start Haupt-ME bei Momentenerhoehung" MAP 0x22FB90 kf_ui8_S6_S3 2540 UMR_MSEC__10_1_0_S6_S3 0 2540
 /begin AXIS_DESCR STD_AXIS zff_atsys._.iSignale._.obj.sig_m_t8 UMR_NM__8_1_M50_S6_S3 4 -400 1640 DEPOSIT ABSOLUTE MONOTONY MON_INCREASE /end AXIS_DESCR
 /begin AXIS_DESCR STD_AXIS zff_atsys._.iSignale._.obj.sig_n_mot8 UMR_U_MIN_32_1_0_S6_S3 4 0 8160 DEPOSIT ABSOLUTE MONOTONY MON_INCREASE /end AXIS_DESCR
/end CHARACTERISTIC
/begin CHARACTERISTIC KF_TVMTNMOTMEHAUPT43_EL "Verzoegerungszeit Start Haupt-ME bei Momentenerhoehung" MAP 0x22FBB0 kf_ui8_S6_S3 2540 UMR_MSEC__10_1_0_S6_S3 0 2540
 /begin AXIS_DESCR STD_AXIS zff_atsys._.iSignale._.obj.sig_m_t8 UMR_NM__8_1_M50_S6_S3 4 -400 1640 DEPOSIT ABSOLUTE MONOTONY MON_INCREASE /end AXIS_DESCR
 /begin AXIS_DESCR STD_AXIS zff_atsys._.iSignale._.obj.sig_n_mot8 UMR_U_MIN_32_1_0_S6_S3 4 0 8160 DEPOSIT ABSOLUTE MONOTONY MON_INCREASE /end AXIS_DESCR
/end CHARACTERISTIC
/begin CHARACTERISTIC KL_FMEPOSNGAB43 "Faktor zur Gewichtung pos. ME" CURVE 0x22FBD0 kl_si16_S6_S3 1 UMR___1_100_0_S6_S3 0 1
 /begin AXIS_DESCR STD_AXIS iMoeMesaf.ng_abmesas UMR_U_MINSEC_1_1_0_S6_S3 6 -1000 1000 DEPOSIT ABSOLUTE MONOTONY MON_INCREASE /end AXIS_DESCR
/end CHARACTERISTIC
/begin CHARACTERISTIC KF_TSYNNTKFMTMEHAUPTE43 "Zeitkriterium Ende Haupt-ME bei Momentenerhoehung" MAP 0x22FBEC kf_ui8_S6_S3 1280 UMR_MSEC__10_1_M128_S6_S3 -1280 0
 /begin AXIS_DESCR STD_AXIS iSasZentr.iSchaltend.n_tkf UMR_U_MIN_32_1_0_S6_S3 4 0 8160 DEPOSIT ABSOLUTE MONOTONY MON_INCREASE /end AXIS_DESCR
 /begin AXIS_DESCR STD_AXIS zff_atsys._.iSignale._.obj.sig_m_t8 UMR_NM__8_1_M50_S6_S3 4 -400 1640 DEPOSIT ABSOLUTE MONOTONY MON_INCREASE /end AXIS_DESCR
/end CHARACTERISTIC
/begin CHARACTERISTIC KF_TSYNNTKFMTMEHAUPTE43_EL "Zeitkriterium Ende Haupt-ME bei Momentenerhoehung" MAP 0x22FC0C kf_ui8_S6_S3 1280 UMR_MSEC__10_1_M128_S6_S3 -1280 0
 /begin AXIS_DESCR STD_AXIS iSasZentr.iSchaltend.n_tkf UMR_U_MIN_32_1_0_S6_S3 4 0 8160 DEPOSIT ABSOLUTE MONOTONY MON_INCREASE /end AXIS_DESCR
 /begin AXIS_DESCR STD_AXIS zff_atsys._.iSignale._.obj.sig_m_t8 UMR_NM__8_1_M50_S6_S3 4 -400 1640 DEPOSIT ABSOLUTE MONOTONY MON_INCREASE /end AXIS_DESCR
/end CHARACTERISTIC
/begin CHARACTERISTIC KF_FMESASMEHAUPTPOSE43 "Faktor fuer Reduzierung pos ME bei RS" MAP 0x22FC2C kf_si16_S6_S3 1 UMR___1_100_0_S6_S3 0 1
 /begin AXIS_DESCR STD_AXIS iSasZentr.iSchaltend.t_syn UMR_MSEC__10_1_0_S6_S3 4 -327680 327670 DEPOSIT ABSOLUTE MONOTONY MON_INCREASE /end AXIS_DESCR
 /begin AXIS_DESCR STD_AXIS iMoeMesaf.me_sas_gesp UMR_NM__1_1_0_S6_S3 4 0 2000 DEPOSIT ABSOLUTE MONOTONY MON_INCREASE /end AXIS_DESCR
/end CHARACTERISTIC
/begin CHARACTERISTIC KF_FMENACHPOSE43 "Faktor fuer Reduzierung pos ME bei RS" MAP 0x22FC64 kf_si16_S6_S3 1 UMR___1_100_0_S6_S3 0 1
 /begin AXIS_DESCR STD_AXIS iMoeMesaf.timer_tsyn_rampe_pos UMR_MSEC__10_1_0_S6_S3 4 -50000 50000 DEPOSIT ABSOLUTE MONOTONY MON_INCREASE /end AXIS_DESCR
 /begin AXIS_DESCR STD_AXIS iMoeMesaf.me_sas_gesp UMR_NM__1_1_0_S6_S3 4 0 2000 DEPOSIT ABSOLUTE MONOTONY MON_INCREASE /end AXIS_DESCR
/end CHARACTERISTIC
/begin CHARACTERISTIC T_RAMEE54 "Dauer Rampe ME bei Schaltungsende" VALUE 0x26E59F kw_ui8_S6_S3 2540 UMR_MSEC__10_1_0_S6_S3 0 2540 /end CHARACTERISTIC
/begin CHARACTERISTIC T_RAMEE54_EL "Dauer Rampe ME bei Schaltungsende" VALUE 0x26E5A0 kw_ui8_S6_S3 2540 UMR_MSEC__10_1_0_S6_S3 0 2540 /end CHARACTERISTIC
/begin CHARACTERISTIC KL_FMENACHE54 "Faktor fuer Rampe Ende Nach-ME bei RS" CURVE 0x22FC9C kl_ui8_S6_S3 1 UMR___1_100_0_S6_S3 0 1
 /begin AXIS_DESCR STD_AXIS iMoeMesaf.timer_zmes UMR_MSEC__10_1_0_S6_S3 4 0 2550 DEPOSIT ABSOLUTE MONOTONY MON_INCREASE /end AXIS_DESCR
/end CHARACTERISTIC
/begin CHARACTERISTIC T_SYNMENACHE54 "Zeit vor/nach Erkennen synchron fuer Ende Nach-ME" VALUE 0x26E5A1 kw_ui8_S6_S3 2550 UMR_MSEC__10_1_M128_S6_S3 -1280 1270 /end CHARACTERISTIC
/begin CHARACTERISTIC T_SYNMENACHE54_EL "Zeit vor/nach Erkennen synchron fuer Ende Nach-ME" VALUE 0x26E5A2 kw_ui8_S6_S3 2550 UMR_MSEC__10_1_M128_S6_S3 -1280 1270 /end CHARACTERISTIC
/begin CHARACTERISTIC KF_TSYNMENACHA54 "Zeit vor Erkennen synchron fuer Ende Haupt-ME und Start Nach-ME" MAP 0x22FCA8 kf_ui8_S6_S3 1280 UMR_MSEC__10_1_M128_S6_S3 -1280 0
 /begin AXIS_DESCR STD_AXIS zff_atsys._.iSignale._.obj.sig_n_mot8 UMR_U_MIN_32_1_0_S6_S3 4 0 8160 DEPOSIT ABSOLUTE MONOTONY MON_INCREASE /end AXIS_DESCR
 /begin AXIS_DESCR STD_AXIS zff_atsys._.iSignale._.obj.sig_m_t8 UMR_NM__8_1_M50_S6_S3 3 -400 1640 DEPOSIT ABSOLUTE MONOTONY MON_INCREASE /end AXIS_DESCR
/end CHARACTERISTIC
/begin CHARACTERISTIC KF_TSYNMENACHA54_EL "Zeit vor Erkennen synchron fuer Ende Haupt-ME und Start Nach-ME" MAP 0x22FCC4 kf_ui8_S6_S3 1280 UMR_MSEC__10_1_M128_S6_S3 -1280 0
 /begin AXIS_DESCR STD_AXIS zff_atsys._.iSignale._.obj.sig_n_mot8 UMR_U_MIN_32_1_0_S6_S3 4 0 8160 DEPOSIT ABSOLUTE MONOTONY MON_INCREASE /end AXIS_DESCR
 /begin AXIS_DESCR STD_AXIS zff_atsys._.iSignale._.obj.sig_m_t8 UMR_NM__8_1_M50_S6_S3 3 -400 1640 DEPOSIT ABSOLUTE MONOTONY MON_INCREASE /end AXIS_DESCR
/end CHARACTERISTIC
/begin CHARACTERISTIC KF_MENACH54 "Nachmotoreingriff Schaltablauf" MAP 0x22FCE0 kf_ui8_S6_S3 870 UMR_NM__6_1_M145_S6_S3 -870 0
 /begin AXIS_DESCR STD_AXIS iSasZentr.iSchaltend.n_tkf UMR_U_MIN_32_1_0_S6_S3 6 0 8160 DEPOSIT ABSOLUTE MONOTONY MON_INCREASE /end AXIS_DESCR
 /begin AXIS_DESCR STD_AXIS zff_atsys._.iSignale._.obj.sig_m_t8 UMR_NM__8_1_M50_S6_S3 6 -400 1640 DEPOSIT ABSOLUTE MONOTONY MON_INCREASE /end AXIS_DESCR
/end CHARACTERISTIC
/begin CHARACTERISTIC KF_MENACH54_EL "Nachmotoreingriff Schaltablauf" MAP 0x22FD18 kf_ui8_S6_S3 870 UMR_NM__6_1_M145_S6_S3 -870 0
 /begin AXIS_DESCR STD_AXIS iSasZentr.iSchaltend.n_tkf UMR_U_MIN_32_1_0_S6_S3 6 0 8160 DEPOSIT ABSOLUTE MONOTONY MON_INCREASE /end AXIS_DESCR
 /begin AXIS_DESCR STD_AXIS zff_atsys._.iSignale._.obj.sig_m_t8 UMR_NM__8_1_M50_S6_S3 6 -400 1640 DEPOSIT ABSOLUTE MONOTONY MON_INCREASE /end AXIS_DESCR
/end CHARACTERISTIC
/begin CHARACTERISTIC KF_FMTMEHAUPTA54 "Faktor fuer Rampe auf HME bei RS" MAP 0x22FD50 kf_ui8_S6_S3 1 UMR___1_100_0_S6_S3 0 1
 /begin AXIS_DESCR STD_AXIS iMoeMesaf.timer_zmes UMR_MSEC__10_1_0_S6_S3 4 0 2550 DEPOSIT ABSOLUTE MONOTONY MON_INCREASE /end AXIS_DESCR
 /begin AXIS_DESCR STD_AXIS zff_atsys._.iSignale._.obj.sig_m_t8 UMR_NM__8_1_M50_S6_S3 4 -400 1640 DEPOSIT ABSOLUTE MONOTONY MON_INCREASE /end AXIS_DESCR
/end CHARACTERISTIC
/begin CHARACTERISTIC KF_MEHAUPT54 "Wert Hauptmotoreingriff" MAP 0x22FD70 kf_ui8_S6_S3 1530 UMR_NM__6_1_M145_S6_S3 -870 660
 /begin AXIS_DESCR STD_AXIS NO_INPUT_QUANTITY UMR_U_MIN_32_1_0_S6_S3 6 0 8160 DEPOSIT ABSOLUTE MONOTONY MON_INCREASE /end AXIS_DESCR
 /begin AXIS_DESCR STD_AXIS zff_atsys._.iSignale._.obj.sig_m_t8 UMR_NM__8_1_M50_S6_S3 10 -400 1640 DEPOSIT ABSOLUTE MONOTONY MON_INCREASE /end AXIS_DESCR
/end CHARACTERISTIC
/begin CHARACTERISTIC KF_MEHAUPT54_EL "Wert Hauptmotoreingriff" MAP 0x22FDC4 kf_ui8_S6_S3 1530 UMR_NM__6_1_M145_S6_S3 -870 660
 /begin AXIS_DESCR STD_AXIS NO_INPUT_QUANTITY UMR_U_MIN_32_1_0_S6_S3 6 0 8160 DEPOSIT ABSOLUTE MONOTONY MON_INCREASE /end AXIS_DESCR
 /begin AXIS_DESCR STD_AXIS zff_atsys._.iSignale._.obj.sig_m_t8 UMR_NM__8_1_M50_S6_S3 10 -400 1640 DEPOSIT ABSOLUTE MONOTONY MON_INCREASE /end AXIS_DESCR
/end CHARACTERISTIC
/begin CHARACTERISTIC KF_TVMTNMOTMEHAUPT54 "Verzoegerungszeit Start Haupt-ME bei Momentenerhoehung" MAP 0x22FE18 kf_ui8_S6_S3 2540 UMR_MSEC__10_1_0_S6_S3 0 2540
 /begin AXIS_DESCR STD_AXIS zff_atsys._.iSignale._.obj.sig_m_t8 UMR_NM__8_1_M50_S6_S3 4 -400 1640 DEPOSIT ABSOLUTE MONOTONY MON_INCREASE /end AXIS_DESCR
 /begin AXIS_DESCR STD_AXIS zff_atsys._.iSignale._.obj.sig_n_mot8 UMR_U_MIN_32_1_0_S6_S3 4 0 8160 DEPOSIT ABSOLUTE MONOTONY MON_INCREASE /end AXIS_DESCR
/end CHARACTERISTIC
/begin CHARACTERISTIC KF_TVMTNMOTMEHAUPT54_EL "Verzoegerungszeit Start Haupt-ME bei Momentenerhoehung" MAP 0x22FE38 kf_ui8_S6_S3 2540 UMR_MSEC__10_1_0_S6_S3 0 2540
 /begin AXIS_DESCR STD_AXIS zff_atsys._.iSignale._.obj.sig_m_t8 UMR_NM__8_1_M50_S6_S3 4 -400 1640 DEPOSIT ABSOLUTE MONOTONY MON_INCREASE /end AXIS_DESCR
 /begin AXIS_DESCR STD_AXIS zff_atsys._.iSignale._.obj.sig_n_mot8 UMR_U_MIN_32_1_0_S6_S3 4 0 8160 DEPOSIT ABSOLUTE MONOTONY MON_INCREASE /end AXIS_DESCR
/end CHARACTERISTIC
/begin CHARACTERISTIC KL_FMEPOSNGAB54 "Faktor zur Gewichtung pos. ME" CURVE 0x22FE58 kl_si16_S6_S3 1 UMR___1_100_0_S6_S3 0 1
 /begin AXIS_DESCR STD_AXIS iMoeMesaf.ng_abmesas UMR_U_MINSEC_1_1_0_S6_S3 6 -1000 1000 DEPOSIT ABSOLUTE MONOTONY MON_INCREASE /end AXIS_DESCR
/end CHARACTERISTIC
/begin CHARACTERISTIC KF_TSYNNTKFMTMEHAUPTE54 "Zeitkriterium Ende Haupt-ME bei Momentenerhoehung" MAP 0x22FE74 kf_ui8_S6_S3 1280 UMR_MSEC__10_1_M128_S6_S3 -1280 0
 /begin AXIS_DESCR STD_AXIS iSasZentr.iSchaltend.n_tkf UMR_U_MIN_32_1_0_S6_S3 4 0 8160 DEPOSIT ABSOLUTE MONOTONY MON_INCREASE /end AXIS_DESCR
 /begin AXIS_DESCR STD_AXIS zff_atsys._.iSignale._.obj.sig_m_t8 UMR_NM__8_1_M50_S6_S3 4 -400 1640 DEPOSIT ABSOLUTE MONOTONY MON_INCREASE /end AXIS_DESCR
/end CHARACTERISTIC
/begin CHARACTERISTIC KF_TSYNNTKFMTMEHAUPTE54_EL "Zeitkriterium Ende Haupt-ME bei Momentenerhoehung" MAP 0x22FE94 kf_ui8_S6_S3 1280 UMR_MSEC__10_1_M128_S6_S3 -1280 0
 /begin AXIS_DESCR STD_AXIS iSasZentr.iSchaltend.n_tkf UMR_U_MIN_32_1_0_S6_S3 4 0 8160 DEPOSIT ABSOLUTE MONOTONY MON_INCREASE /end AXIS_DESCR
 /begin AXIS_DESCR STD_AXIS zff_atsys._.iSignale._.obj.sig_m_t8 UMR_NM__8_1_M50_S6_S3 4 -400 1640 DEPOSIT ABSOLUTE MONOTONY MON_INCREASE /end AXIS_DESCR
/end CHARACTERISTIC
/begin CHARACTERISTIC KF_FMESASMEHAUPTPOSE54 "Faktor fuer Reduzierung pos ME bei RS" MAP 0x22FEB4 kf_si16_S6_S3 1 UMR___1_100_0_S6_S3 0 1
 /begin AXIS_DESCR STD_AXIS iSasZentr.iSchaltend.t_syn UMR_MSEC__10_1_0_S6_S3 4 -327680 327670 DEPOSIT ABSOLUTE MONOTONY MON_INCREASE /end AXIS_DESCR
 /begin AXIS_DESCR STD_AXIS iMoeMesaf.me_sas_gesp UMR_NM__1_1_0_S6_S3 4 0 2000 DEPOSIT ABSOLUTE MONOTONY MON_INCREASE /end AXIS_DESCR
/end CHARACTERISTIC
/begin CHARACTERISTIC KF_FMENACHPOSE54 "Faktor fuer Reduzierung pos ME bei RS" MAP 0x22FEEC kf_si16_S6_S3 1 UMR___1_100_0_S6_S3 0 1
 /begin AXIS_DESCR STD_AXIS iMoeMesaf.timer_tsyn_rampe_pos UMR_MSEC__10_1_0_S6_S3 4 -50000 50000 DEPOSIT ABSOLUTE MONOTONY MON_INCREASE /end AXIS_DESCR
 /begin AXIS_DESCR STD_AXIS iMoeMesaf.me_sas_gesp UMR_NM__1_1_0_S6_S3 4 0 2000 DEPOSIT ABSOLUTE MONOTONY MON_INCREASE /end AXIS_DESCR
/end CHARACTERISTIC
/begin CHARACTERISTIC T_RAMEE65 "Dauer Rampe ME bei Schaltungsende" VALUE 0x26E5A3 kw_ui8_S6_S3 2540 UMR_MSEC__10_1_0_S6_S3 0 2540 /end CHARACTERISTIC
/begin CHARACTERISTIC T_RAMEE65_EL "Dauer Rampe ME bei Schaltungsende" VALUE 0x26E5A4 kw_ui8_S6_S3 2540 UMR_MSEC__10_1_0_S6_S3 0 2540 /end CHARACTERISTIC
/begin CHARACTERISTIC KL_FMENACHE65 "Faktor fuer Rampe Ende Nach-ME bei RS" CURVE 0x22FF24 kl_ui8_S6_S3 1 UMR___1_100_0_S6_S3 0 1
 /begin AXIS_DESCR STD_AXIS iMoeMesaf.timer_zmes UMR_MSEC__10_1_0_S6_S3 4 0 2550 DEPOSIT ABSOLUTE MONOTONY MON_INCREASE /end AXIS_DESCR
/end CHARACTERISTIC
/begin CHARACTERISTIC T_SYNMENACHE65 "Zeit vor/nach Erkennen synchron fuer Ende Nach-ME" VALUE 0x26E5A5 kw_ui8_S6_S3 2550 UMR_MSEC__10_1_M128_S6_S3 -1280 1270 /end CHARACTERISTIC
/begin CHARACTERISTIC T_SYNMENACHE65_EL "Zeit vor/nach Erkennen synchron fuer Ende Nach-ME" VALUE 0x26E5A6 kw_ui8_S6_S3 2550 UMR_MSEC__10_1_M128_S6_S3 -1280 1270 /end CHARACTERISTIC
/begin CHARACTERISTIC KF_TSYNMENACHA65 "Zeit vor Erkennen synchron fuer Ende Haupt-ME und Start Nach-ME" MAP 0x22FF30 kf_ui8_S6_S3 1280 UMR_MSEC__10_1_M128_S6_S3 -1280 0
 /begin AXIS_DESCR STD_AXIS zff_atsys._.iSignale._.obj.sig_n_mot8 UMR_U_MIN_32_1_0_S6_S3 4 0 8160 DEPOSIT ABSOLUTE MONOTONY MON_INCREASE /end AXIS_DESCR
 /begin AXIS_DESCR STD_AXIS zff_atsys._.iSignale._.obj.sig_m_t8 UMR_NM__8_1_M50_S6_S3 3 -400 1640 DEPOSIT ABSOLUTE MONOTONY MON_INCREASE /end AXIS_DESCR
/end CHARACTERISTIC
/begin CHARACTERISTIC KF_TSYNMENACHA65_EL "Zeit vor Erkennen synchron fuer Ende Haupt-ME und Start Nach-ME" MAP 0x22FF4C kf_ui8_S6_S3 1280 UMR_MSEC__10_1_M128_S6_S3 -1280 0
 /begin AXIS_DESCR STD_AXIS zff_atsys._.iSignale._.obj.sig_n_mot8 UMR_U_MIN_32_1_0_S6_S3 4 0 8160 DEPOSIT ABSOLUTE MONOTONY MON_INCREASE /end AXIS_DESCR
 /begin AXIS_DESCR STD_AXIS zff_atsys._.iSignale._.obj.sig_m_t8 UMR_NM__8_1_M50_S6_S3 3 -400 1640 DEPOSIT ABSOLUTE MONOTONY MON_INCREASE /end AXIS_DESCR
/end CHARACTERISTIC
/begin CHARACTERISTIC KF_MENACH65 "Nachmotoreingriff Schaltablauf" MAP 0x22FF68 kf_ui8_S6_S3 870 UMR_NM__6_1_M145_S6_S3 -870 0
 /begin AXIS_DESCR STD_AXIS iSasZentr.iSchaltend.n_tkf UMR_U_MIN_32_1_0_S6_S3 6 0 8160 DEPOSIT ABSOLUTE MONOTONY MON_INCREASE /end AXIS_DESCR
 /begin AXIS_DESCR STD_AXIS zff_atsys._.iSignale._.obj.sig_m_t8 UMR_NM__8_1_M50_S6_S3 6 -400 1640 DEPOSIT ABSOLUTE MONOTONY MON_INCREASE /end AXIS_DESCR
/end CHARACTERISTIC
/begin CHARACTERISTIC KF_MENACH65_EL "Nachmotoreingriff Schaltablauf" MAP 0x22FFA0 kf_ui8_S6_S3 870 UMR_NM__6_1_M145_S6_S3 -870 0
 /begin AXIS_DESCR STD_AXIS iSasZentr.iSchaltend.n_tkf UMR_U_MIN_32_1_0_S6_S3 6 0 8160 DEPOSIT ABSOLUTE MONOTONY MON_INCREASE /end AXIS_DESCR
 /begin AXIS_DESCR STD_AXIS zff_atsys._.iSignale._.obj.sig_m_t8 UMR_NM__8_1_M50_S6_S3 6 -400 1640 DEPOSIT ABSOLUTE MONOTONY MON_INCREASE /end AXIS_DESCR
/end CHARACTERISTIC
/begin CHARACTERISTIC KF_FMTMEHAUPTA65 "Faktor fuer Rampe auf HME bei RS" MAP 0x22FFD8 kf_ui8_S6_S3 1 UMR___1_100_0_S6_S3 0 1
 /begin AXIS_DESCR STD_AXIS iMoeMesaf.timer_zmes UMR_MSEC__10_1_0_S6_S3 4 0 2550 DEPOSIT ABSOLUTE MONOTONY MON_INCREASE /end AXIS_DESCR
 /begin AXIS_DESCR STD_AXIS zff_atsys._.iSignale._.obj.sig_m_t8 UMR_NM__8_1_M50_S6_S3 4 -400 1640 DEPOSIT ABSOLUTE MONOTONY MON_INCREASE /end AXIS_DESCR
/end CHARACTERISTIC
/begin CHARACTERISTIC KF_MEHAUPT65 "Wert Hauptmotoreingriff" MAP 0x22FFF8 kf_ui8_S6_S3 1530 UMR_NM__6_1_M145_S6_S3 -870 660
 /begin AXIS_DESCR STD_AXIS NO_INPUT_QUANTITY UMR_U_MIN_32_1_0_S6_S3 6 0 8160 DEPOSIT ABSOLUTE MONOTONY MON_INCREASE /end AXIS_DESCR
 /begin AXIS_DESCR STD_AXIS zff_atsys._.iSignale._.obj.sig_m_t8 UMR_NM__8_1_M50_S6_S3 10 -400 1640 DEPOSIT ABSOLUTE MONOTONY MON_INCREASE /end AXIS_DESCR
/end CHARACTERISTIC
/begin CHARACTERISTIC KF_MEHAUPT65_EL "Wert Hauptmotoreingriff" MAP 0x23004C kf_ui8_S6_S3 1530 UMR_NM__6_1_M145_S6_S3 -870 660
 /begin AXIS_DESCR STD_AXIS NO_INPUT_QUANTITY UMR_U_MIN_32_1_0_S6_S3 6 0 8160 DEPOSIT ABSOLUTE MONOTONY MON_INCREASE /end AXIS_DESCR
 /begin AXIS_DESCR STD_AXIS zff_atsys._.iSignale._.obj.sig_m_t8 UMR_NM__8_1_M50_S6_S3 10 -400 1640 DEPOSIT ABSOLUTE MONOTONY MON_INCREASE /end AXIS_DESCR
/end CHARACTERISTIC
/begin CHARACTERISTIC KF_TVMTNMOTMEHAUPT65 "Verzoegerungszeit Start Haupt-ME bei Momentenerhoehung" MAP 0x2300A0 kf_ui8_S6_S3 2540 UMR_MSEC__10_1_0_S6_S3 0 2540
 /begin AXIS_DESCR STD_AXIS zff_atsys._.iSignale._.obj.sig_m_t8 UMR_NM__8_1_M50_S6_S3 4 -400 1640 DEPOSIT ABSOLUTE MONOTONY MON_INCREASE /end AXIS_DESCR
 /begin AXIS_DESCR STD_AXIS zff_atsys._.iSignale._.obj.sig_n_mot8 UMR_U_MIN_32_1_0_S6_S3 4 0 8160 DEPOSIT ABSOLUTE MONOTONY MON_INCREASE /end AXIS_DESCR
/end CHARACTERISTIC
/begin CHARACTERISTIC KF_TVMTNMOTMEHAUPT65_EL "Verzoegerungszeit Start Haupt-ME bei Momentenerhoehung" MAP 0x2300C0 kf_ui8_S6_S3 2540 UMR_MSEC__10_1_0_S6_S3 0 2540
 /begin AXIS_DESCR STD_AXIS zff_atsys._.iSignale._.obj.sig_m_t8 UMR_NM__8_1_M50_S6_S3 4 -400 1640 DEPOSIT ABSOLUTE MONOTONY MON_INCREASE /end AXIS_DESCR
 /begin AXIS_DESCR STD_AXIS zff_atsys._.iSignale._.obj.sig_n_mot8 UMR_U_MIN_32_1_0_S6_S3 4 0 8160 DEPOSIT ABSOLUTE MONOTONY MON_INCREASE /end AXIS_DESCR
/end CHARACTERISTIC
/begin CHARACTERISTIC KL_FMEPOSNGAB65 "Faktor zur Gewichtung pos. ME" CURVE 0x2300E0 kl_si16_S6_S3 1 UMR___1_100_0_S6_S3 0 1
 /begin AXIS_DESCR STD_AXIS iMoeMesaf.ng_abmesas UMR_U_MINSEC_1_1_0_S6_S3 6 -1000 1000 DEPOSIT ABSOLUTE MONOTONY MON_INCREASE /end AXIS_DESCR
/end CHARACTERISTIC
/begin CHARACTERISTIC KF_TSYNNTKFMTMEHAUPTE65 "Zeitkriterium Ende Haupt-ME bei Momentenerhoehung" MAP 0x2300FC kf_ui8_S6_S3 1280 UMR_MSEC__10_1_M128_S6_S3 -1280 0
 /begin AXIS_DESCR STD_AXIS iSasZentr.iSchaltend.n_tkf UMR_U_MIN_32_1_0_S6_S3 4 0 8160 DEPOSIT ABSOLUTE MONOTONY MON_INCREASE /end AXIS_DESCR
 /begin AXIS_DESCR STD_AXIS zff_atsys._.iSignale._.obj.sig_m_t8 UMR_NM__8_1_M50_S6_S3 4 -400 1640 DEPOSIT ABSOLUTE MONOTONY MON_INCREASE /end AXIS_DESCR
/end CHARACTERISTIC
/begin CHARACTERISTIC KF_TSYNNTKFMTMEHAUPTE65_EL "Zeitkriterium Ende Haupt-ME bei Momentenerhoehung" MAP 0x23011C kf_ui8_S6_S3 1280 UMR_MSEC__10_1_M128_S6_S3 -1280 0
 /begin AXIS_DESCR STD_AXIS iSasZentr.iSchaltend.n_tkf UMR_U_MIN_32_1_0_S6_S3 4 0 8160 DEPOSIT ABSOLUTE MONOTONY MON_INCREASE /end AXIS_DESCR
 /begin AXIS_DESCR STD_AXIS zff_atsys._.iSignale._.obj.sig_m_t8 UMR_NM__8_1_M50_S6_S3 4 -400 1640 DEPOSIT ABSOLUTE MONOTONY MON_INCREASE /end AXIS_DESCR
/end CHARACTERISTIC
/begin CHARACTERISTIC KF_FMESASMEHAUPTPOSE65 "Faktor fuer Reduzierung pos ME bei RS" MAP 0x23013C kf_si16_S6_S3 1 UMR___1_100_0_S6_S3 0 1
 /begin AXIS_DESCR STD_AXIS iSasZentr.iSchaltend.t_syn UMR_MSEC__10_1_0_S6_S3 4 -327680 327670 DEPOSIT ABSOLUTE MONOTONY MON_INCREASE /end AXIS_DESCR
 /begin AXIS_DESCR STD_AXIS iMoeMesaf.me_sas_gesp UMR_NM__1_1_0_S6_S3 4 0 2000 DEPOSIT ABSOLUTE MONOTONY MON_INCREASE /end AXIS_DESCR
/end CHARACTERISTIC
/begin CHARACTERISTIC KF_FMENACHPOSE65 "Faktor fuer Reduzierung pos ME bei RS" MAP 0x230174 kf_si16_S6_S3 1 UMR___1_100_0_S6_S3 0 1
 /begin AXIS_DESCR STD_AXIS iMoeMesaf.timer_tsyn_rampe_pos UMR_MSEC__10_1_0_S6_S3 4 -50000 50000 DEPOSIT ABSOLUTE MONOTONY MON_INCREASE /end AXIS_DESCR
 /begin AXIS_DESCR STD_AXIS iMoeMesaf.me_sas_gesp UMR_NM__1_1_0_S6_S3 4 0 2000 DEPOSIT ABSOLUTE MONOTONY MON_INCREASE /end AXIS_DESCR
/end CHARACTERISTIC
/begin CHARACTERISTIC T_RAMEE76 "Dauer Rampe ME bei Schaltungsende" VALUE 0x26E5A7 kw_ui8_S6_S3 2540 UMR_MSEC__10_1_0_S6_S3 0 2540 /end CHARACTERISTIC
/begin CHARACTERISTIC T_RAMEE76_EL "Dauer Rampe ME bei Schaltungsende" VALUE 0x26E5A8 kw_ui8_S6_S3 2540 UMR_MSEC__10_1_0_S6_S3 0 2540 /end CHARACTERISTIC
/begin CHARACTERISTIC KL_FMENACHE76 "Faktor fuer Rampe Ende Nach-ME bei RS" CURVE 0x2301AC kl_ui8_S6_S3 1 UMR___1_100_0_S6_S3 0 1
 /begin AXIS_DESCR STD_AXIS iMoeMesaf.timer_zmes UMR_MSEC__10_1_0_S6_S3 4 0 2550 DEPOSIT ABSOLUTE MONOTONY MON_INCREASE /end AXIS_DESCR
/end CHARACTERISTIC
/begin CHARACTERISTIC T_SYNMENACHE76 "Zeit vor/nach Erkennen synchron fuer Ende Nach-ME" VALUE 0x26E5A9 kw_ui8_S6_S3 2550 UMR_MSEC__10_1_M128_S6_S3 -1280 1270 /end CHARACTERISTIC
/begin CHARACTERISTIC T_SYNMENACHE76_EL "Zeit vor/nach Erkennen synchron fuer Ende Nach-ME" VALUE 0x26E5AA kw_ui8_S6_S3 2550 UMR_MSEC__10_1_M128_S6_S3 -1280 1270 /end CHARACTERISTIC
/begin CHARACTERISTIC KF_TSYNMENACHA76 "Zeit vor Erkennen synchron fuer Ende Haupt-ME und Start Nach-ME" MAP 0x2301B8 kf_ui8_S6_S3 1280 UMR_MSEC__10_1_M128_S6_S3 -1280 0
 /begin AXIS_DESCR STD_AXIS zff_atsys._.iSignale._.obj.sig_n_mot8 UMR_U_MIN_32_1_0_S6_S3 4 0 8160 DEPOSIT ABSOLUTE MONOTONY MON_INCREASE /end AXIS_DESCR
 /begin AXIS_DESCR STD_AXIS zff_atsys._.iSignale._.obj.sig_m_t8 UMR_NM__8_1_M50_S6_S3 3 -400 1640 DEPOSIT ABSOLUTE MONOTONY MON_INCREASE /end AXIS_DESCR
/end CHARACTERISTIC
/begin CHARACTERISTIC KF_TSYNMENACHA76_EL "Zeit vor Erkennen synchron fuer Ende Haupt-ME und Start Nach-ME" MAP 0x2301D4 kf_ui8_S6_S3 1280 UMR_MSEC__10_1_M128_S6_S3 -1280 0
 /begin AXIS_DESCR STD_AXIS zff_atsys._.iSignale._.obj.sig_n_mot8 UMR_U_MIN_32_1_0_S6_S3 4 0 8160 DEPOSIT ABSOLUTE MONOTONY MON_INCREASE /end AXIS_DESCR
 /begin AXIS_DESCR STD_AXIS zff_atsys._.iSignale._.obj.sig_m_t8 UMR_NM__8_1_M50_S6_S3 3 -400 1640 DEPOSIT ABSOLUTE MONOTONY MON_INCREASE /end AXIS_DESCR
/end CHARACTERISTIC
/begin CHARACTERISTIC KF_MENACH76 "Nachmotoreingriff Schaltablauf" MAP 0x2301F0 kf_ui8_S6_S3 870 UMR_NM__6_1_M145_S6_S3 -870 0
 /begin AXIS_DESCR STD_AXIS iSasZentr.iSchaltend.n_tkf UMR_U_MIN_32_1_0_S6_S3 6 0 8160 DEPOSIT ABSOLUTE MONOTONY MON_INCREASE /end AXIS_DESCR
 /begin AXIS_DESCR STD_AXIS zff_atsys._.iSignale._.obj.sig_m_t8 UMR_NM__8_1_M50_S6_S3 6 -400 1640 DEPOSIT ABSOLUTE MONOTONY MON_INCREASE /end AXIS_DESCR
/end CHARACTERISTIC
/begin CHARACTERISTIC KF_MENACH76_EL "Nachmotoreingriff Schaltablauf" MAP 0x230228 kf_ui8_S6_S3 870 UMR_NM__6_1_M145_S6_S3 -870 0
 /begin AXIS_DESCR STD_AXIS iSasZentr.iSchaltend.n_tkf UMR_U_MIN_32_1_0_S6_S3 6 0 8160 DEPOSIT ABSOLUTE MONOTONY MON_INCREASE /end AXIS_DESCR
 /begin AXIS_DESCR STD_AXIS zff_atsys._.iSignale._.obj.sig_m_t8 UMR_NM__8_1_M50_S6_S3 6 -400 1640 DEPOSIT ABSOLUTE MONOTONY MON_INCREASE /end AXIS_DESCR
/end CHARACTERISTIC
/begin CHARACTERISTIC KF_FMTMEHAUPTA76 "Faktor fuer Rampe auf HME bei RS" MAP 0x230260 kf_ui8_S6_S3 1 UMR___1_100_0_S6_S3 0 1
 /begin AXIS_DESCR STD_AXIS iMoeMesaf.timer_zmes UMR_MSEC__10_1_0_S6_S3 4 0 2550 DEPOSIT ABSOLUTE MONOTONY MON_INCREASE /end AXIS_DESCR
 /begin AXIS_DESCR STD_AXIS zff_atsys._.iSignale._.obj.sig_m_t8 UMR_NM__8_1_M50_S6_S3 4 -400 1640 DEPOSIT ABSOLUTE MONOTONY MON_INCREASE /end AXIS_DESCR
/end CHARACTERISTIC
/begin CHARACTERISTIC KF_MEHAUPT76 "Wert Hauptmotoreingriff" MAP 0x230280 kf_ui8_S6_S3 1530 UMR_NM__6_1_M145_S6_S3 -870 660
 /begin AXIS_DESCR STD_AXIS NO_INPUT_QUANTITY UMR_U_MIN_32_1_0_S6_S3 6 0 8160 DEPOSIT ABSOLUTE MONOTONY MON_INCREASE /end AXIS_DESCR
 /begin AXIS_DESCR STD_AXIS zff_atsys._.iSignale._.obj.sig_m_t8 UMR_NM__8_1_M50_S6_S3 10 -400 1640 DEPOSIT ABSOLUTE MONOTONY MON_INCREASE /end AXIS_DESCR
/end CHARACTERISTIC
/begin CHARACTERISTIC KF_MEHAUPT76_EL "Wert Hauptmotoreingriff" MAP 0x2302D4 kf_ui8_S6_S3 1530 UMR_NM__6_1_M145_S6_S3 -870 660
 /begin AXIS_DESCR STD_AXIS NO_INPUT_QUANTITY UMR_U_MIN_32_1_0_S6_S3 6 0 8160 DEPOSIT ABSOLUTE MONOTONY MON_INCREASE /end AXIS_DESCR
 /begin AXIS_DESCR STD_AXIS zff_atsys._.iSignale._.obj.sig_m_t8 UMR_NM__8_1_M50_S6_S3 10 -400 1640 DEPOSIT ABSOLUTE MONOTONY MON_INCREASE /end AXIS_DESCR
/end CHARACTERISTIC
/begin CHARACTERISTIC KF_TVMTNMOTMEHAUPT76 "Verzoegerungszeit Start Haupt-ME bei Momentenerhoehung" MAP 0x230328 kf_ui8_S6_S3 2540 UMR_MSEC__10_1_0_S6_S3 0 2540
 /begin AXIS_DESCR STD_AXIS zff_atsys._.iSignale._.obj.sig_m_t8 UMR_NM__8_1_M50_S6_S3 4 -400 1640 DEPOSIT ABSOLUTE MONOTONY MON_INCREASE /end AXIS_DESCR
 /begin AXIS_DESCR STD_AXIS zff_atsys._.iSignale._.obj.sig_n_mot8 UMR_U_MIN_32_1_0_S6_S3 4 0 8160 DEPOSIT ABSOLUTE MONOTONY MON_INCREASE /end AXIS_DESCR
/end CHARACTERISTIC
/begin CHARACTERISTIC KF_TVMTNMOTMEHAUPT76_EL "Verzoegerungszeit Start Haupt-ME bei Momentenerhoehung" MAP 0x230348 kf_ui8_S6_S3 2540 UMR_MSEC__10_1_0_S6_S3 0 2540
 /begin AXIS_DESCR STD_AXIS zff_atsys._.iSignale._.obj.sig_m_t8 UMR_NM__8_1_M50_S6_S3 4 -400 1640 DEPOSIT ABSOLUTE MONOTONY MON_INCREASE /end AXIS_DESCR
 /begin AXIS_DESCR STD_AXIS zff_atsys._.iSignale._.obj.sig_n_mot8 UMR_U_MIN_32_1_0_S6_S3 4 0 8160 DEPOSIT ABSOLUTE MONOTONY MON_INCREASE /end AXIS_DESCR
/end CHARACTERISTIC
/begin CHARACTERISTIC KL_FMEPOSNGAB76 "Faktor zur Gewichtung pos. ME" CURVE 0x230368 kl_si16_S6_S3 1 UMR___1_100_0_S6_S3 0 1
 /begin AXIS_DESCR STD_AXIS iMoeMesaf.ng_abmesas UMR_U_MINSEC_1_1_0_S6_S3 6 -1000 1000 DEPOSIT ABSOLUTE MONOTONY MON_INCREASE /end AXIS_DESCR
/end CHARACTERISTIC
/begin CHARACTERISTIC KF_TSYNNTKFMTMEHAUPTE76 "Zeitkriterium Ende Haupt-ME bei Momentenerhoehung" MAP 0x230384 kf_ui8_S6_S3 1280 UMR_MSEC__10_1_M128_S6_S3 -1280 0
 /begin AXIS_DESCR STD_AXIS iSasZentr.iSchaltend.n_tkf UMR_U_MIN_32_1_0_S6_S3 4 0 8160 DEPOSIT ABSOLUTE MONOTONY MON_INCREASE /end AXIS_DESCR
 /begin AXIS_DESCR STD_AXIS zff_atsys._.iSignale._.obj.sig_m_t8 UMR_NM__8_1_M50_S6_S3 4 -400 1640 DEPOSIT ABSOLUTE MONOTONY MON_INCREASE /end AXIS_DESCR
/end CHARACTERISTIC
/begin CHARACTERISTIC KF_TSYNNTKFMTMEHAUPTE76_EL "Zeitkriterium Ende Haupt-ME bei Momentenerhoehung" MAP 0x2303A4 kf_ui8_S6_S3 1280 UMR_MSEC__10_1_M128_S6_S3 -1280 0
 /begin AXIS_DESCR STD_AXIS iSasZentr.iSchaltend.n_tkf UMR_U_MIN_32_1_0_S6_S3 4 0 8160 DEPOSIT ABSOLUTE MONOTONY MON_INCREASE /end AXIS_DESCR
 /begin AXIS_DESCR STD_AXIS zff_atsys._.iSignale._.obj.sig_m_t8 UMR_NM__8_1_M50_S6_S3 4 -400 1640 DEPOSIT ABSOLUTE MONOTONY MON_INCREASE /end AXIS_DESCR
/end CHARACTERISTIC
/begin CHARACTERISTIC KF_FMESASMEHAUPTPOSE76 "Faktor fuer Reduzierung pos ME bei RS" MAP 0x2303C4 kf_si16_S6_S3 1 UMR___1_100_0_S6_S3 0 1
 /begin AXIS_DESCR STD_AXIS iSasZentr.iSchaltend.t_syn UMR_MSEC__10_1_0_S6_S3 4 -327680 327670 DEPOSIT ABSOLUTE MONOTONY MON_INCREASE /end AXIS_DESCR
 /begin AXIS_DESCR STD_AXIS iMoeMesaf.me_sas_gesp UMR_NM__1_1_0_S6_S3 4 0 2000 DEPOSIT ABSOLUTE MONOTONY MON_INCREASE /end AXIS_DESCR
/end CHARACTERISTIC
/begin CHARACTERISTIC KF_FMENACHPOSE76 "Faktor fuer Reduzierung pos ME bei RS" MAP 0x2303FC kf_si16_S6_S3 1 UMR___1_100_0_S6_S3 0 1
 /begin AXIS_DESCR STD_AXIS iMoeMesaf.timer_tsyn_rampe_pos UMR_MSEC__10_1_0_S6_S3 4 -50000 50000 DEPOSIT ABSOLUTE MONOTONY MON_INCREASE /end AXIS_DESCR
 /begin AXIS_DESCR STD_AXIS iMoeMesaf.me_sas_gesp UMR_NM__1_1_0_S6_S3 4 0 2000 DEPOSIT ABSOLUTE MONOTONY MON_INCREASE /end AXIS_DESCR
/end CHARACTERISTIC
/begin CHARACTERISTIC T_RAMEE87 "Dauer Rampe ME bei Schaltungsende" VALUE 0x26E5AB kw_ui8_S6_S3 2540 UMR_MSEC__10_1_0_S6_S3 0 2540 /end CHARACTERISTIC
/begin CHARACTERISTIC T_RAMEE87_EL "Dauer Rampe ME bei Schaltungsende" VALUE 0x26E5AC kw_ui8_S6_S3 2540 UMR_MSEC__10_1_0_S6_S3 0 2540 /end CHARACTERISTIC
/begin CHARACTERISTIC KL_FMENACHE87 "Faktor fuer Rampe Ende Nach-ME bei RS" CURVE 0x230434 kl_ui8_S6_S3 1 UMR___1_100_0_S6_S3 0 1
 /begin AXIS_DESCR STD_AXIS iMoeMesaf.timer_zmes UMR_MSEC__10_1_0_S6_S3 4 0 2550 DEPOSIT ABSOLUTE MONOTONY MON_INCREASE /end AXIS_DESCR
/end CHARACTERISTIC
/begin CHARACTERISTIC T_SYNMENACHE87 "Zeit vor/nach Erkennen synchron fuer Ende Nach-ME" VALUE 0x26E5AD kw_ui8_S6_S3 2550 UMR_MSEC__10_1_M128_S6_S3 -1280 1270 /end CHARACTERISTIC
/begin CHARACTERISTIC T_SYNMENACHE87_EL "Zeit vor/nach Erkennen synchron fuer Ende Nach-ME" VALUE 0x26E5AE kw_ui8_S6_S3 2550 UMR_MSEC__10_1_M128_S6_S3 -1280 1270 /end CHARACTERISTIC
/begin CHARACTERISTIC KF_TSYNMENACHA87 "Zeit vor Erkennen synchron fuer Ende Haupt-ME und Start Nach-ME" MAP 0x230440 kf_ui8_S6_S3 1280 UMR_MSEC__10_1_M128_S6_S3 -1280 0
 /begin AXIS_DESCR STD_AXIS zff_atsys._.iSignale._.obj.sig_n_mot8 UMR_U_MIN_32_1_0_S6_S3 4 0 8160 DEPOSIT ABSOLUTE MONOTONY MON_INCREASE /end AXIS_DESCR
 /begin AXIS_DESCR STD_AXIS zff_atsys._.iSignale._.obj.sig_m_t8 UMR_NM__8_1_M50_S6_S3 3 -400 1640 DEPOSIT ABSOLUTE MONOTONY MON_INCREASE /end AXIS_DESCR
/end CHARACTERISTIC
/begin CHARACTERISTIC KF_TSYNMENACHA87_EL "Zeit vor Erkennen synchron fuer Ende Haupt-ME und Start Nach-ME" MAP 0x23045C kf_ui8_S6_S3 1280 UMR_MSEC__10_1_M128_S6_S3 -1280 0
 /begin AXIS_DESCR STD_AXIS zff_atsys._.iSignale._.obj.sig_n_mot8 UMR_U_MIN_32_1_0_S6_S3 4 0 8160 DEPOSIT ABSOLUTE MONOTONY MON_INCREASE /end AXIS_DESCR
 /begin AXIS_DESCR STD_AXIS zff_atsys._.iSignale._.obj.sig_m_t8 UMR_NM__8_1_M50_S6_S3 3 -400 1640 DEPOSIT ABSOLUTE MONOTONY MON_INCREASE /end AXIS_DESCR
/end CHARACTERISTIC
/begin CHARACTERISTIC KF_MENACH87 "Nachmotoreingriff Schaltablauf" MAP 0x230478 kf_ui8_S6_S3 870 UMR_NM__6_1_M145_S6_S3 -870 0
 /begin AXIS_DESCR STD_AXIS iSasZentr.iSchaltend.n_tkf UMR_U_MIN_32_1_0_S6_S3 6 0 8160 DEPOSIT ABSOLUTE MONOTONY MON_INCREASE /end AXIS_DESCR
 /begin AXIS_DESCR STD_AXIS zff_atsys._.iSignale._.obj.sig_m_t8 UMR_NM__8_1_M50_S6_S3 6 -400 1640 DEPOSIT ABSOLUTE MONOTONY MON_INCREASE /end AXIS_DESCR
/end CHARACTERISTIC
/begin CHARACTERISTIC KF_MENACH87_EL "Nachmotoreingriff Schaltablauf" MAP 0x2304B0 kf_ui8_S6_S3 870 UMR_NM__6_1_M145_S6_S3 -870 0
 /begin AXIS_DESCR STD_AXIS iSasZentr.iSchaltend.n_tkf UMR_U_MIN_32_1_0_S6_S3 6 0 8160 DEPOSIT ABSOLUTE MONOTONY MON_INCREASE /end AXIS_DESCR
 /begin AXIS_DESCR STD_AXIS zff_atsys._.iSignale._.obj.sig_m_t8 UMR_NM__8_1_M50_S6_S3 6 -400 1640 DEPOSIT ABSOLUTE MONOTONY MON_INCREASE /end AXIS_DESCR
/end CHARACTERISTIC
/begin CHARACTERISTIC KF_FMTMEHAUPTA87 "Faktor fuer Rampe auf HME bei RS" MAP 0x2304E8 kf_ui8_S6_S3 1 UMR___1_100_0_S6_S3 0 1
 /begin AXIS_DESCR STD_AXIS iMoeMesaf.timer_zmes UMR_MSEC__10_1_0_S6_S3 4 0 2550 DEPOSIT ABSOLUTE MONOTONY MON_INCREASE /end AXIS_DESCR
 /begin AXIS_DESCR STD_AXIS zff_atsys._.iSignale._.obj.sig_m_t8 UMR_NM__8_1_M50_S6_S3 4 -400 1640 DEPOSIT ABSOLUTE MONOTONY MON_INCREASE /end AXIS_DESCR
/end CHARACTERISTIC
/begin CHARACTERISTIC KF_MEHAUPT87 "Wert Hauptmotoreingriff" MAP 0x230508 kf_ui8_S6_S3 1530 UMR_NM__6_1_M145_S6_S3 -870 660
 /begin AXIS_DESCR STD_AXIS NO_INPUT_QUANTITY UMR_U_MIN_32_1_0_S6_S3 6 0 8160 DEPOSIT ABSOLUTE MONOTONY MON_INCREASE /end AXIS_DESCR
 /begin AXIS_DESCR STD_AXIS zff_atsys._.iSignale._.obj.sig_m_t8 UMR_NM__8_1_M50_S6_S3 10 -400 1640 DEPOSIT ABSOLUTE MONOTONY MON_INCREASE /end AXIS_DESCR
/end CHARACTERISTIC
/begin CHARACTERISTIC KF_MEHAUPT87_EL "Wert Hauptmotoreingriff" MAP 0x23055C kf_ui8_S6_S3 1530 UMR_NM__6_1_M145_S6_S3 -870 660
 /begin AXIS_DESCR STD_AXIS NO_INPUT_QUANTITY UMR_U_MIN_32_1_0_S6_S3 6 0 8160 DEPOSIT ABSOLUTE MONOTONY MON_INCREASE /end AXIS_DESCR
 /begin AXIS_DESCR STD_AXIS zff_atsys._.iSignale._.obj.sig_m_t8 UMR_NM__8_1_M50_S6_S3 10 -400 1640 DEPOSIT ABSOLUTE MONOTONY MON_INCREASE /end AXIS_DESCR
/end CHARACTERISTIC
/begin CHARACTERISTIC KF_TVMTNMOTMEHAUPT87 "Verzoegerungszeit Start Haupt-ME bei Momentenerhoehung" MAP 0x2305B0 kf_ui8_S6_S3 2540 UMR_MSEC__10_1_0_S6_S3 0 2540
 /begin AXIS_DESCR STD_AXIS zff_atsys._.iSignale._.obj.sig_m_t8 UMR_NM__8_1_M50_S6_S3 4 -400 1640 DEPOSIT ABSOLUTE MONOTONY MON_INCREASE /end AXIS_DESCR
 /begin AXIS_DESCR STD_AXIS zff_atsys._.iSignale._.obj.sig_n_mot8 UMR_U_MIN_32_1_0_S6_S3 4 0 8160 DEPOSIT ABSOLUTE MONOTONY MON_INCREASE /end AXIS_DESCR
/end CHARACTERISTIC
/begin CHARACTERISTIC KF_TVMTNMOTMEHAUPT87_EL "Verzoegerungszeit Start Haupt-ME bei Momentenerhoehung" MAP 0x2305D0 kf_ui8_S6_S3 2540 UMR_MSEC__10_1_0_S6_S3 0 2540
 /begin AXIS_DESCR STD_AXIS zff_atsys._.iSignale._.obj.sig_m_t8 UMR_NM__8_1_M50_S6_S3 4 -400 1640 DEPOSIT ABSOLUTE MONOTONY MON_INCREASE /end AXIS_DESCR
 /begin AXIS_DESCR STD_AXIS zff_atsys._.iSignale._.obj.sig_n_mot8 UMR_U_MIN_32_1_0_S6_S3 4 0 8160 DEPOSIT ABSOLUTE MONOTONY MON_INCREASE /end AXIS_DESCR
/end CHARACTERISTIC
/begin CHARACTERISTIC KL_FMEPOSNGAB87 "Faktor zur Gewichtung pos. ME" CURVE 0x2305F0 kl_si16_S6_S3 1 UMR___1_100_0_S6_S3 0 1
 /begin AXIS_DESCR STD_AXIS iMoeMesaf.ng_abmesas UMR_U_MINSEC_1_1_0_S6_S3 6 -1000 1000 DEPOSIT ABSOLUTE MONOTONY MON_INCREASE /end AXIS_DESCR
/end CHARACTERISTIC
/begin CHARACTERISTIC KF_TSYNNTKFMTMEHAUPTE87 "Zeitkriterium Ende Haupt-ME bei Momentenerhoehung" MAP 0x23060C kf_ui8_S6_S3 1280 UMR_MSEC__10_1_M128_S6_S3 -1280 0
 /begin AXIS_DESCR STD_AXIS iSasZentr.iSchaltend.n_tkf UMR_U_MIN_32_1_0_S6_S3 4 0 8160 DEPOSIT ABSOLUTE MONOTONY MON_INCREASE /end AXIS_DESCR
 /begin AXIS_DESCR STD_AXIS zff_atsys._.iSignale._.obj.sig_m_t8 UMR_NM__8_1_M50_S6_S3 4 -400 1640 DEPOSIT ABSOLUTE MONOTONY MON_INCREASE /end AXIS_DESCR
/end CHARACTERISTIC
/begin CHARACTERISTIC KF_TSYNNTKFMTMEHAUPTE87_EL "Zeitkriterium Ende Haupt-ME bei Momentenerhoehung" MAP 0x23062C kf_ui8_S6_S3 1280 UMR_MSEC__10_1_M128_S6_S3 -1280 0
 /begin AXIS_DESCR STD_AXIS iSasZentr.iSchaltend.n_tkf UMR_U_MIN_32_1_0_S6_S3 4 0 8160 DEPOSIT ABSOLUTE MONOTONY MON_INCREASE /end AXIS_DESCR
 /begin AXIS_DESCR STD_AXIS zff_atsys._.iSignale._.obj.sig_m_t8 UMR_NM__8_1_M50_S6_S3 4 -400 1640 DEPOSIT ABSOLUTE MONOTONY MON_INCREASE /end AXIS_DESCR
/end CHARACTERISTIC
/begin CHARACTERISTIC KF_FMESASMEHAUPTPOSE87 "Faktor fuer Reduzierung pos ME bei RS" MAP 0x23064C kf_si16_S6_S3 1 UMR___1_100_0_S6_S3 0 1
 /begin AXIS_DESCR STD_AXIS iSasZentr.iSchaltend.t_syn UMR_MSEC__10_1_0_S6_S3 4 -327680 327670 DEPOSIT ABSOLUTE MONOTONY MON_INCREASE /end AXIS_DESCR
 /begin AXIS_DESCR STD_AXIS iMoeMesaf.me_sas_gesp UMR_NM__1_1_0_S6_S3 4 0 2000 DEPOSIT ABSOLUTE MONOTONY MON_INCREASE /end AXIS_DESCR
/end CHARACTERISTIC
/begin CHARACTERISTIC KF_FMENACHPOSE87 "Faktor fuer Reduzierung pos ME bei RS" MAP 0x230684 kf_si16_S6_S3 1 UMR___1_100_0_S6_S3 0 1
 /begin AXIS_DESCR STD_AXIS iMoeMesaf.timer_tsyn_rampe_pos UMR_MSEC__10_1_0_S6_S3 4 -50000 50000 DEPOSIT ABSOLUTE MONOTONY MON_INCREASE /end AXIS_DESCR
 /begin AXIS_DESCR STD_AXIS iMoeMesaf.me_sas_gesp UMR_NM__1_1_0_S6_S3 4 0 2000 DEPOSIT ABSOLUTE MONOTONY MON_INCREASE /end AXIS_DESCR
/end CHARACTERISTIC
/begin CHARACTERISTIC T_RAMEESP21 "Dauer Rampe ME bei Schaltungsende" VALUE 0x26E5AF kw_ui8_S6_S3 2540 UMR_MSEC__10_1_0_S6_S3 0 2540 /end CHARACTERISTIC
/begin CHARACTERISTIC KL_FMENACHESP21 "Faktor fuer Rampe Ende Nach-ME bei RS" CURVE 0x2306BC kl_ui8_S6_S3 1 UMR___1_100_0_S6_S3 0 1
 /begin AXIS_DESCR STD_AXIS iMoeMesaf.timer_zmes UMR_MSEC__10_1_0_S6_S3 4 0 2550 DEPOSIT ABSOLUTE MONOTONY MON_INCREASE /end AXIS_DESCR
/end CHARACTERISTIC
/begin CHARACTERISTIC T_SYNMENACHESP21 "Zeit vor/nach Erkennen synchron fuer Ende Nach-ME" VALUE 0x26E5B0 kw_ui8_S6_S3 2550 UMR_MSEC__10_1_M128_S6_S3 -1280 1270 /end CHARACTERISTIC
/begin CHARACTERISTIC KF_TSYNMENACHASP21 "Zeit vor Erkennen synchron fuer Ende Haupt-ME und Start Nach-ME" MAP 0x2306C8 kf_ui8_S6_S3 1280 UMR_MSEC__10_1_M128_S6_S3 -1280 0
 /begin AXIS_DESCR STD_AXIS zff_atsys._.iSignale._.obj.sig_n_mot8 UMR_U_MIN_32_1_0_S6_S3 4 0 8160 DEPOSIT ABSOLUTE MONOTONY MON_INCREASE /end AXIS_DESCR
 /begin AXIS_DESCR STD_AXIS zff_atsys._.iSignale._.obj.sig_m_t8 UMR_NM__8_1_M50_S6_S3 3 -400 1640 DEPOSIT ABSOLUTE MONOTONY MON_INCREASE /end AXIS_DESCR
/end CHARACTERISTIC
/begin CHARACTERISTIC KF_MENACHSP21 "Nachmotoreingriff Schaltablauf" MAP 0x2306E4 kf_ui8_S6_S3 870 UMR_NM__6_1_M145_S6_S3 -870 0
 /begin AXIS_DESCR STD_AXIS iSasZentr.iSchaltend.n_tkf UMR_U_MIN_32_1_0_S6_S3 6 0 8160 DEPOSIT ABSOLUTE MONOTONY MON_INCREASE /end AXIS_DESCR
 /begin AXIS_DESCR STD_AXIS zff_atsys._.iSignale._.obj.sig_m_t8 UMR_NM__8_1_M50_S6_S3 6 -400 1640 DEPOSIT ABSOLUTE MONOTONY MON_INCREASE /end AXIS_DESCR
/end CHARACTERISTIC
/begin CHARACTERISTIC KF_FMTMEHAUPTASP21 "Faktor fuer Rampe auf HME bei RS" MAP 0x23071C kf_ui8_S6_S3 1 UMR___1_100_0_S6_S3 0 1
 /begin AXIS_DESCR STD_AXIS iMoeMesaf.timer_zmes UMR_MSEC__10_1_0_S6_S3 4 0 2550 DEPOSIT ABSOLUTE MONOTONY MON_INCREASE /end AXIS_DESCR
 /begin AXIS_DESCR STD_AXIS zff_atsys._.iSignale._.obj.sig_m_t8 UMR_NM__8_1_M50_S6_S3 4 -400 1640 DEPOSIT ABSOLUTE MONOTONY MON_INCREASE /end AXIS_DESCR
/end CHARACTERISTIC
/begin CHARACTERISTIC KF_MEHAUPTSP21 "Wert Hauptmotoreingriff" MAP 0x23073C kf_ui8_S6_S3 1530 UMR_NM__6_1_M145_S6_S3 -870 660
 /begin AXIS_DESCR STD_AXIS NO_INPUT_QUANTITY UMR_U_MIN_32_1_0_S6_S3 6 0 8160 DEPOSIT ABSOLUTE MONOTONY MON_INCREASE /end AXIS_DESCR
 /begin AXIS_DESCR STD_AXIS zff_atsys._.iSignale._.obj.sig_m_t8 UMR_NM__8_1_M50_S6_S3 10 -400 1640 DEPOSIT ABSOLUTE MONOTONY MON_INCREASE /end AXIS_DESCR
/end CHARACTERISTIC
/begin CHARACTERISTIC KF_TVMTNMOTMEHAUPTSP21 "Verzoegerungszeit Start Haupt-ME bei Momentenerhoehung" MAP 0x230790 kf_ui8_S6_S3 2540 UMR_MSEC__10_1_0_S6_S3 0 2540
 /begin AXIS_DESCR STD_AXIS zff_atsys._.iSignale._.obj.sig_m_t8 UMR_NM__8_1_M50_S6_S3 4 -400 1640 DEPOSIT ABSOLUTE MONOTONY MON_INCREASE /end AXIS_DESCR
 /begin AXIS_DESCR STD_AXIS zff_atsys._.iSignale._.obj.sig_n_mot8 UMR_U_MIN_32_1_0_S6_S3 4 0 8160 DEPOSIT ABSOLUTE MONOTONY MON_INCREASE /end AXIS_DESCR
/end CHARACTERISTIC
/begin CHARACTERISTIC KL_FMEPOSNGABSP21 "Faktor zur Gewichtung pos. ME" CURVE 0x2307B0 kl_si16_S6_S3 1 UMR___1_100_0_S6_S3 0 1
 /begin AXIS_DESCR STD_AXIS iMoeMesaf.ng_abmesas UMR_U_MINSEC_1_1_0_S6_S3 6 -1000 1000 DEPOSIT ABSOLUTE MONOTONY MON_INCREASE /end AXIS_DESCR
/end CHARACTERISTIC
/begin CHARACTERISTIC KF_TSYNNTKFMTMEHAUPTESP21 "Zeitkriterium Ende Haupt-ME bei Momentenerhoehung" MAP 0x2307CC kf_ui8_S6_S3 1280 UMR_MSEC__10_1_M128_S6_S3 -1280 0
 /begin AXIS_DESCR STD_AXIS iSasZentr.iSchaltend.n_tkf UMR_U_MIN_32_1_0_S6_S3 4 0 8160 DEPOSIT ABSOLUTE MONOTONY MON_INCREASE /end AXIS_DESCR
 /begin AXIS_DESCR STD_AXIS zff_atsys._.iSignale._.obj.sig_m_t8 UMR_NM__8_1_M50_S6_S3 4 -400 1640 DEPOSIT ABSOLUTE MONOTONY MON_INCREASE /end AXIS_DESCR
/end CHARACTERISTIC
/begin CHARACTERISTIC KF_FMESASMEHAUPTPOSESP21 "Faktor fuer Reduzierung pos ME bei RS" MAP 0x2307EC kf_si16_S6_S3 1 UMR___1_100_0_S6_S3 0 1
 /begin AXIS_DESCR STD_AXIS iSasZentr.iSchaltend.t_syn UMR_MSEC__10_1_0_S6_S3 4 -327680 327670 DEPOSIT ABSOLUTE MONOTONY MON_INCREASE /end AXIS_DESCR
 /begin AXIS_DESCR STD_AXIS iMoeMesaf.me_sas_gesp UMR_NM__1_1_0_S6_S3 4 0 2000 DEPOSIT ABSOLUTE MONOTONY MON_INCREASE /end AXIS_DESCR
/end CHARACTERISTIC
/begin CHARACTERISTIC KF_FMENACHPOSESP21 "Faktor fuer Reduzierung pos ME bei RS" MAP 0x230824 kf_si16_S6_S3 1 UMR___1_100_0_S6_S3 0 1
 /begin AXIS_DESCR STD_AXIS iMoeMesaf.timer_tsyn_rampe_pos UMR_MSEC__10_1_0_S6_S3 4 -50000 50000 DEPOSIT ABSOLUTE MONOTONY MON_INCREASE /end AXIS_DESCR
 /begin AXIS_DESCR STD_AXIS iMoeMesaf.me_sas_gesp UMR_NM__1_1_0_S6_S3 4 0 2000 DEPOSIT ABSOLUTE MONOTONY MON_INCREASE /end AXIS_DESCR
/end CHARACTERISTIC
/begin CHARACTERISTIC T_RAMEESP32 "Dauer Rampe ME bei Schaltungsende" VALUE 0x26E5B1 kw_ui8_S6_S3 2540 UMR_MSEC__10_1_0_S6_S3 0 2540 /end CHARACTERISTIC
/begin CHARACTERISTIC KL_FMENACHESP32 "Faktor fuer Rampe Ende Nach-ME bei RS" CURVE 0x23085C kl_ui8_S6_S3 1 UMR___1_100_0_S6_S3 0 1
 /begin AXIS_DESCR STD_AXIS iMoeMesaf.timer_zmes UMR_MSEC__10_1_0_S6_S3 4 0 2550 DEPOSIT ABSOLUTE MONOTONY MON_INCREASE /end AXIS_DESCR
/end CHARACTERISTIC
/begin CHARACTERISTIC T_SYNMENACHESP32 "Zeit vor/nach Erkennen synchron fuer Ende Nach-ME" VALUE 0x26E5B2 kw_ui8_S6_S3 2550 UMR_MSEC__10_1_M128_S6_S3 -1280 1270 /end CHARACTERISTIC
/begin CHARACTERISTIC KF_TSYNMENACHASP32 "Zeit vor Erkennen synchron fuer Ende Haupt-ME und Start Nach-ME" MAP 0x230868 kf_ui8_S6_S3 1280 UMR_MSEC__10_1_M128_S6_S3 -1280 0
 /begin AXIS_DESCR STD_AXIS zff_atsys._.iSignale._.obj.sig_n_mot8 UMR_U_MIN_32_1_0_S6_S3 4 0 8160 DEPOSIT ABSOLUTE MONOTONY MON_INCREASE /end AXIS_DESCR
 /begin AXIS_DESCR STD_AXIS zff_atsys._.iSignale._.obj.sig_m_t8 UMR_NM__8_1_M50_S6_S3 3 -400 1640 DEPOSIT ABSOLUTE MONOTONY MON_INCREASE /end AXIS_DESCR
/end CHARACTERISTIC
/begin CHARACTERISTIC KF_MENACHSP32 "Nachmotoreingriff Schaltablauf" MAP 0x230884 kf_ui8_S6_S3 870 UMR_NM__6_1_M145_S6_S3 -870 0
 /begin AXIS_DESCR STD_AXIS iSasZentr.iSchaltend.n_tkf UMR_U_MIN_32_1_0_S6_S3 6 0 8160 DEPOSIT ABSOLUTE MONOTONY MON_INCREASE /end AXIS_DESCR
 /begin AXIS_DESCR STD_AXIS zff_atsys._.iSignale._.obj.sig_m_t8 UMR_NM__8_1_M50_S6_S3 6 -400 1640 DEPOSIT ABSOLUTE MONOTONY MON_INCREASE /end AXIS_DESCR
/end CHARACTERISTIC
/begin CHARACTERISTIC KF_FMTMEHAUPTASP32 "Faktor fuer Rampe auf HME bei RS" MAP 0x2308BC kf_ui8_S6_S3 1 UMR___1_100_0_S6_S3 0 1
 /begin AXIS_DESCR STD_AXIS iMoeMesaf.timer_zmes UMR_MSEC__10_1_0_S6_S3 4 0 2550 DEPOSIT ABSOLUTE MONOTONY MON_INCREASE /end AXIS_DESCR
 /begin AXIS_DESCR STD_AXIS zff_atsys._.iSignale._.obj.sig_m_t8 UMR_NM__8_1_M50_S6_S3 4 -400 1640 DEPOSIT ABSOLUTE MONOTONY MON_INCREASE /end AXIS_DESCR
/end CHARACTERISTIC
/begin CHARACTERISTIC KF_MEHAUPTSP32 "Wert Hauptmotoreingriff" MAP 0x2308DC kf_ui8_S6_S3 1530 UMR_NM__6_1_M145_S6_S3 -870 660
 /begin AXIS_DESCR STD_AXIS NO_INPUT_QUANTITY UMR_U_MIN_32_1_0_S6_S3 6 0 8160 DEPOSIT ABSOLUTE MONOTONY MON_INCREASE /end AXIS_DESCR
 /begin AXIS_DESCR STD_AXIS zff_atsys._.iSignale._.obj.sig_m_t8 UMR_NM__8_1_M50_S6_S3 10 -400 1640 DEPOSIT ABSOLUTE MONOTONY MON_INCREASE /end AXIS_DESCR
/end CHARACTERISTIC
/begin CHARACTERISTIC KF_TVMTNMOTMEHAUPTSP32 "Verzoegerungszeit Start Haupt-ME bei Momentenerhoehung" MAP 0x230930 kf_ui8_S6_S3 2540 UMR_MSEC__10_1_0_S6_S3 0 2540
 /begin AXIS_DESCR STD_AXIS zff_atsys._.iSignale._.obj.sig_m_t8 UMR_NM__8_1_M50_S6_S3 4 -400 1640 DEPOSIT ABSOLUTE MONOTONY MON_INCREASE /end AXIS_DESCR
 /begin AXIS_DESCR STD_AXIS zff_atsys._.iSignale._.obj.sig_n_mot8 UMR_U_MIN_32_1_0_S6_S3 4 0 8160 DEPOSIT ABSOLUTE MONOTONY MON_INCREASE /end AXIS_DESCR
/end CHARACTERISTIC
/begin CHARACTERISTIC KL_FMEPOSNGABSP32 "Faktor zur Gewichtung pos. ME" CURVE 0x230950 kl_si16_S6_S3 1 UMR___1_100_0_S6_S3 0 1
 /begin AXIS_DESCR STD_AXIS iMoeMesaf.ng_abmesas UMR_U_MINSEC_1_1_0_S6_S3 6 -1000 1000 DEPOSIT ABSOLUTE MONOTONY MON_INCREASE /end AXIS_DESCR
/end CHARACTERISTIC
/begin CHARACTERISTIC KF_TSYNNTKFMTMEHAUPTESP32 "Zeitkriterium Ende Haupt-ME bei Momentenerhoehung" MAP 0x23096C kf_ui8_S6_S3 1280 UMR_MSEC__10_1_M128_S6_S3 -1280 0
 /begin AXIS_DESCR STD_AXIS iSasZentr.iSchaltend.n_tkf UMR_U_MIN_32_1_0_S6_S3 4 0 8160 DEPOSIT ABSOLUTE MONOTONY MON_INCREASE /end AXIS_DESCR
 /begin AXIS_DESCR STD_AXIS zff_atsys._.iSignale._.obj.sig_m_t8 UMR_NM__8_1_M50_S6_S3 4 -400 1640 DEPOSIT ABSOLUTE MONOTONY MON_INCREASE /end AXIS_DESCR
/end CHARACTERISTIC
/begin CHARACTERISTIC KF_FMESASMEHAUPTPOSESP32 "Faktor fuer Reduzierung pos ME bei RS" MAP 0x23098C kf_si16_S6_S3 1 UMR___1_100_0_S6_S3 0 1
 /begin AXIS_DESCR STD_AXIS iSasZentr.iSchaltend.t_syn UMR_MSEC__10_1_0_S6_S3 4 -327680 327670 DEPOSIT ABSOLUTE MONOTONY MON_INCREASE /end AXIS_DESCR
 /begin AXIS_DESCR STD_AXIS iMoeMesaf.me_sas_gesp UMR_NM__1_1_0_S6_S3 4 0 2000 DEPOSIT ABSOLUTE MONOTONY MON_INCREASE /end AXIS_DESCR
/end CHARACTERISTIC
/begin CHARACTERISTIC KF_FMENACHPOSESP32 "Faktor fuer Reduzierung pos ME bei RS" MAP 0x2309C4 kf_si16_S6_S3 1 UMR___1_100_0_S6_S3 0 1
 /begin AXIS_DESCR STD_AXIS iMoeMesaf.timer_tsyn_rampe_pos UMR_MSEC__10_1_0_S6_S3 4 -50000 50000 DEPOSIT ABSOLUTE MONOTONY MON_INCREASE /end AXIS_DESCR
 /begin AXIS_DESCR STD_AXIS iMoeMesaf.me_sas_gesp UMR_NM__1_1_0_S6_S3 4 0 2000 DEPOSIT ABSOLUTE MONOTONY MON_INCREASE /end AXIS_DESCR
/end CHARACTERISTIC
/begin CHARACTERISTIC T_RAMEESP43 "Dauer Rampe ME bei Schaltungsende" VALUE 0x26E5B3 kw_ui8_S6_S3 2540 UMR_MSEC__10_1_0_S6_S3 0 2540 /end CHARACTERISTIC
/begin CHARACTERISTIC KL_FMENACHESP43 "Faktor fuer Rampe Ende Nach-ME bei RS" CURVE 0x2309FC kl_ui8_S6_S3 1 UMR___1_100_0_S6_S3 0 1
 /begin AXIS_DESCR STD_AXIS iMoeMesaf.timer_zmes UMR_MSEC__10_1_0_S6_S3 4 0 2550 DEPOSIT ABSOLUTE MONOTONY MON_INCREASE /end AXIS_DESCR
/end CHARACTERISTIC
/begin CHARACTERISTIC T_SYNMENACHESP43 "Zeit vor/nach Erkennen synchron fuer Ende Nach-ME" VALUE 0x26E5B4 kw_ui8_S6_S3 2550 UMR_MSEC__10_1_M128_S6_S3 -1280 1270 /end CHARACTERISTIC
/begin CHARACTERISTIC KF_TSYNMENACHASP43 "Zeit vor Erkennen synchron fuer Ende Haupt-ME und Start Nach-ME" MAP 0x230A08 kf_ui8_S6_S3 1280 UMR_MSEC__10_1_M128_S6_S3 -1280 0
 /begin AXIS_DESCR STD_AXIS zff_atsys._.iSignale._.obj.sig_n_mot8 UMR_U_MIN_32_1_0_S6_S3 4 0 8160 DEPOSIT ABSOLUTE MONOTONY MON_INCREASE /end AXIS_DESCR
 /begin AXIS_DESCR STD_AXIS zff_atsys._.iSignale._.obj.sig_m_t8 UMR_NM__8_1_M50_S6_S3 3 -400 1640 DEPOSIT ABSOLUTE MONOTONY MON_INCREASE /end AXIS_DESCR
/end CHARACTERISTIC
/begin CHARACTERISTIC KF_MENACHSP43 "Nachmotoreingriff Schaltablauf" MAP 0x230A24 kf_ui8_S6_S3 870 UMR_NM__6_1_M145_S6_S3 -870 0
 /begin AXIS_DESCR STD_AXIS iSasZentr.iSchaltend.n_tkf UMR_U_MIN_32_1_0_S6_S3 6 0 8160 DEPOSIT ABSOLUTE MONOTONY MON_INCREASE /end AXIS_DESCR
 /begin AXIS_DESCR STD_AXIS zff_atsys._.iSignale._.obj.sig_m_t8 UMR_NM__8_1_M50_S6_S3 6 -400 1640 DEPOSIT ABSOLUTE MONOTONY MON_INCREASE /end AXIS_DESCR
/end CHARACTERISTIC
/begin CHARACTERISTIC KF_FMTMEHAUPTASP43 "Faktor fuer Rampe auf HME bei RS" MAP 0x230A5C kf_ui8_S6_S3 1 UMR___1_100_0_S6_S3 0 1
 /begin AXIS_DESCR STD_AXIS iMoeMesaf.timer_zmes UMR_MSEC__10_1_0_S6_S3 4 0 2550 DEPOSIT ABSOLUTE MONOTONY MON_INCREASE /end AXIS_DESCR
 /begin AXIS_DESCR STD_AXIS zff_atsys._.iSignale._.obj.sig_m_t8 UMR_NM__8_1_M50_S6_S3 4 -400 1640 DEPOSIT ABSOLUTE MONOTONY MON_INCREASE /end AXIS_DESCR
/end CHARACTERISTIC
/begin CHARACTERISTIC KF_MEHAUPTSP43 "Wert Hauptmotoreingriff" MAP 0x230A7C kf_ui8_S6_S3 1530 UMR_NM__6_1_M145_S6_S3 -870 660
 /begin AXIS_DESCR STD_AXIS NO_INPUT_QUANTITY UMR_U_MIN_32_1_0_S6_S3 6 0 8160 DEPOSIT ABSOLUTE MONOTONY MON_INCREASE /end AXIS_DESCR
 /begin AXIS_DESCR STD_AXIS zff_atsys._.iSignale._.obj.sig_m_t8 UMR_NM__8_1_M50_S6_S3 10 -400 1640 DEPOSIT ABSOLUTE MONOTONY MON_INCREASE /end AXIS_DESCR
/end CHARACTERISTIC
/begin CHARACTERISTIC KF_TVMTNMOTMEHAUPTSP43 "Verzoegerungszeit Start Haupt-ME bei Momentenerhoehung" MAP 0x230AD0 kf_ui8_S6_S3 2540 UMR_MSEC__10_1_0_S6_S3 0 2540
 /begin AXIS_DESCR STD_AXIS zff_atsys._.iSignale._.obj.sig_m_t8 UMR_NM__8_1_M50_S6_S3 4 -400 1640 DEPOSIT ABSOLUTE MONOTONY MON_INCREASE /end AXIS_DESCR
 /begin AXIS_DESCR STD_AXIS zff_atsys._.iSignale._.obj.sig_n_mot8 UMR_U_MIN_32_1_0_S6_S3 4 0 8160 DEPOSIT ABSOLUTE MONOTONY MON_INCREASE /end AXIS_DESCR
/end CHARACTERISTIC
/begin CHARACTERISTIC KL_FMEPOSNGABSP43 "Faktor zur Gewichtung pos. ME" CURVE 0x230AF0 kl_si16_S6_S3 1 UMR___1_100_0_S6_S3 0 1
 /begin AXIS_DESCR STD_AXIS iMoeMesaf.ng_abmesas UMR_U_MINSEC_1_1_0_S6_S3 6 -1000 1000 DEPOSIT ABSOLUTE MONOTONY MON_INCREASE /end AXIS_DESCR
/end CHARACTERISTIC
/begin CHARACTERISTIC KF_TSYNNTKFMTMEHAUPTESP43 "Zeitkriterium Ende Haupt-ME bei Momentenerhoehung" MAP 0x230B0C kf_ui8_S6_S3 1280 UMR_MSEC__10_1_M128_S6_S3 -1280 0
 /begin AXIS_DESCR STD_AXIS iSasZentr.iSchaltend.n_tkf UMR_U_MIN_32_1_0_S6_S3 4 0 8160 DEPOSIT ABSOLUTE MONOTONY MON_INCREASE /end AXIS_DESCR
 /begin AXIS_DESCR STD_AXIS zff_atsys._.iSignale._.obj.sig_m_t8 UMR_NM__8_1_M50_S6_S3 4 -400 1640 DEPOSIT ABSOLUTE MONOTONY MON_INCREASE /end AXIS_DESCR
/end CHARACTERISTIC
/begin CHARACTERISTIC KF_FMESASMEHAUPTPOSESP43 "Faktor fuer Reduzierung pos ME bei RS" MAP 0x230B2C kf_si16_S6_S3 1 UMR___1_100_0_S6_S3 0 1
 /begin AXIS_DESCR STD_AXIS iSasZentr.iSchaltend.t_syn UMR_MSEC__10_1_0_S6_S3 4 -327680 327670 DEPOSIT ABSOLUTE MONOTONY MON_INCREASE /end AXIS_DESCR
 /begin AXIS_DESCR STD_AXIS iMoeMesaf.me_sas_gesp UMR_NM__1_1_0_S6_S3 4 0 2000 DEPOSIT ABSOLUTE MONOTONY MON_INCREASE /end AXIS_DESCR
/end CHARACTERISTIC
/begin CHARACTERISTIC KF_FMENACHPOSESP43 "Faktor fuer Reduzierung pos ME bei RS" MAP 0x230B64 kf_si16_S6_S3 1 UMR___1_100_0_S6_S3 0 1
 /begin AXIS_DESCR STD_AXIS iMoeMesaf.timer_tsyn_rampe_pos UMR_MSEC__10_1_0_S6_S3 4 -50000 50000 DEPOSIT ABSOLUTE MONOTONY MON_INCREASE /end AXIS_DESCR
 /begin AXIS_DESCR STD_AXIS iMoeMesaf.me_sas_gesp UMR_NM__1_1_0_S6_S3 4 0 2000 DEPOSIT ABSOLUTE MONOTONY MON_INCREASE /end AXIS_DESCR
/end CHARACTERISTIC
/begin CHARACTERISTIC T_RAMEESP54 "Dauer Rampe ME bei Schaltungsende" VALUE 0x26E5B5 kw_ui8_S6_S3 2540 UMR_MSEC__10_1_0_S6_S3 0 2540 /end CHARACTERISTIC
/begin CHARACTERISTIC KL_FMENACHESP54 "Faktor fuer Rampe Ende Nach-ME bei RS" CURVE 0x230B9C kl_ui8_S6_S3 1 UMR___1_100_0_S6_S3 0 1
 /begin AXIS_DESCR STD_AXIS iMoeMesaf.timer_zmes UMR_MSEC__10_1_0_S6_S3 4 0 2550 DEPOSIT ABSOLUTE MONOTONY MON_INCREASE /end AXIS_DESCR
/end CHARACTERISTIC
/begin CHARACTERISTIC T_SYNMENACHESP54 "Zeit vor/nach Erkennen synchron fuer Ende Nach-ME" VALUE 0x26E5B6 kw_ui8_S6_S3 2550 UMR_MSEC__10_1_M128_S6_S3 -1280 1270 /end CHARACTERISTIC
/begin CHARACTERISTIC KF_TSYNMENACHASP54 "Zeit vor Erkennen synchron fuer Ende Haupt-ME und Start Nach-ME" MAP 0x230BA8 kf_ui8_S6_S3 1280 UMR_MSEC__10_1_M128_S6_S3 -1280 0
 /begin AXIS_DESCR STD_AXIS zff_atsys._.iSignale._.obj.sig_n_mot8 UMR_U_MIN_32_1_0_S6_S3 4 0 8160 DEPOSIT ABSOLUTE MONOTONY MON_INCREASE /end AXIS_DESCR
 /begin AXIS_DESCR STD_AXIS zff_atsys._.iSignale._.obj.sig_m_t8 UMR_NM__8_1_M50_S6_S3 3 -400 1640 DEPOSIT ABSOLUTE MONOTONY MON_INCREASE /end AXIS_DESCR
/end CHARACTERISTIC
/begin CHARACTERISTIC KF_MENACHSP54 "Nachmotoreingriff Schaltablauf" MAP 0x230BC4 kf_ui8_S6_S3 870 UMR_NM__6_1_M145_S6_S3 -870 0
 /begin AXIS_DESCR STD_AXIS iSasZentr.iSchaltend.n_tkf UMR_U_MIN_32_1_0_S6_S3 6 0 8160 DEPOSIT ABSOLUTE MONOTONY MON_INCREASE /end AXIS_DESCR
 /begin AXIS_DESCR STD_AXIS zff_atsys._.iSignale._.obj.sig_m_t8 UMR_NM__8_1_M50_S6_S3 6 -400 1640 DEPOSIT ABSOLUTE MONOTONY MON_INCREASE /end AXIS_DESCR
/end CHARACTERISTIC
/begin CHARACTERISTIC KF_FMTMEHAUPTASP54 "Faktor fuer Rampe auf HME bei RS" MAP 0x230BFC kf_ui8_S6_S3 1 UMR___1_100_0_S6_S3 0 1
 /begin AXIS_DESCR STD_AXIS iMoeMesaf.timer_zmes UMR_MSEC__10_1_0_S6_S3 4 0 2550 DEPOSIT ABSOLUTE MONOTONY MON_INCREASE /end AXIS_DESCR
 /begin AXIS_DESCR STD_AXIS zff_atsys._.iSignale._.obj.sig_m_t8 UMR_NM__8_1_M50_S6_S3 4 -400 1640 DEPOSIT ABSOLUTE MONOTONY MON_INCREASE /end AXIS_DESCR
/end CHARACTERISTIC
/begin CHARACTERISTIC KF_MEHAUPTSP54 "Wert Hauptmotoreingriff" MAP 0x230C1C kf_ui8_S6_S3 1530 UMR_NM__6_1_M145_S6_S3 -870 660
 /begin AXIS_DESCR STD_AXIS NO_INPUT_QUANTITY UMR_U_MIN_32_1_0_S6_S3 6 0 8160 DEPOSIT ABSOLUTE MONOTONY MON_INCREASE /end AXIS_DESCR
 /begin AXIS_DESCR STD_AXIS zff_atsys._.iSignale._.obj.sig_m_t8 UMR_NM__8_1_M50_S6_S3 10 -400 1640 DEPOSIT ABSOLUTE MONOTONY MON_INCREASE /end AXIS_DESCR
/end CHARACTERISTIC
/begin CHARACTERISTIC KF_TVMTNMOTMEHAUPTSP54 "Verzoegerungszeit Start Haupt-ME bei Momentenerhoehung" MAP 0x230C70 kf_ui8_S6_S3 2540 UMR_MSEC__10_1_0_S6_S3 0 2540
 /begin AXIS_DESCR STD_AXIS zff_atsys._.iSignale._.obj.sig_m_t8 UMR_NM__8_1_M50_S6_S3 4 -400 1640 DEPOSIT ABSOLUTE MONOTONY MON_INCREASE /end AXIS_DESCR
 /begin AXIS_DESCR STD_AXIS zff_atsys._.iSignale._.obj.sig_n_mot8 UMR_U_MIN_32_1_0_S6_S3 4 0 8160 DEPOSIT ABSOLUTE MONOTONY MON_INCREASE /end AXIS_DESCR
/end CHARACTERISTIC
/begin CHARACTERISTIC KL_FMEPOSNGABSP54 "Faktor zur Gewichtung pos. ME" CURVE 0x230C90 kl_si16_S6_S3 1 UMR___1_100_0_S6_S3 0 1
 /begin AXIS_DESCR STD_AXIS iMoeMesaf.ng_abmesas UMR_U_MINSEC_1_1_0_S6_S3 6 -1000 1000 DEPOSIT ABSOLUTE MONOTONY MON_INCREASE /end AXIS_DESCR
/end CHARACTERISTIC
/begin CHARACTERISTIC KF_TSYNNTKFMTMEHAUPTESP54 "Zeitkriterium Ende Haupt-ME bei Momentenerhoehung" MAP 0x230CAC kf_ui8_S6_S3 1280 UMR_MSEC__10_1_M128_S6_S3 -1280 0
 /begin AXIS_DESCR STD_AXIS iSasZentr.iSchaltend.n_tkf UMR_U_MIN_32_1_0_S6_S3 4 0 8160 DEPOSIT ABSOLUTE MONOTONY MON_INCREASE /end AXIS_DESCR
 /begin AXIS_DESCR STD_AXIS zff_atsys._.iSignale._.obj.sig_m_t8 UMR_NM__8_1_M50_S6_S3 4 -400 1640 DEPOSIT ABSOLUTE MONOTONY MON_INCREASE /end AXIS_DESCR
/end CHARACTERISTIC
/begin CHARACTERISTIC KF_FMESASMEHAUPTPOSESP54 "Faktor fuer Reduzierung pos ME bei RS" MAP 0x230CCC kf_si16_S6_S3 1 UMR___1_100_0_S6_S3 0 1
 /begin AXIS_DESCR STD_AXIS iSasZentr.iSchaltend.t_syn UMR_MSEC__10_1_0_S6_S3 4 -327680 327670 DEPOSIT ABSOLUTE MONOTONY MON_INCREASE /end AXIS_DESCR
 /begin AXIS_DESCR STD_AXIS iMoeMesaf.me_sas_gesp UMR_NM__1_1_0_S6_S3 4 0 2000 DEPOSIT ABSOLUTE MONOTONY MON_INCREASE /end AXIS_DESCR
/end CHARACTERISTIC
/begin CHARACTERISTIC KF_FMENACHPOSESP54 "Faktor fuer Reduzierung pos ME bei RS" MAP 0x230D04 kf_si16_S6_S3 1 UMR___1_100_0_S6_S3 0 1
 /begin AXIS_DESCR STD_AXIS iMoeMesaf.timer_tsyn_rampe_pos UMR_MSEC__10_1_0_S6_S3 4 -50000 50000 DEPOSIT ABSOLUTE MONOTONY MON_INCREASE /end AXIS_DESCR
 /begin AXIS_DESCR STD_AXIS iMoeMesaf.me_sas_gesp UMR_NM__1_1_0_S6_S3 4 0 2000 DEPOSIT ABSOLUTE MONOTONY MON_INCREASE /end AXIS_DESCR
/end CHARACTERISTIC
/begin CHARACTERISTIC T_RAMEESP65 "Dauer Rampe ME bei Schaltungsende" VALUE 0x26E5B7 kw_ui8_S6_S3 2540 UMR_MSEC__10_1_0_S6_S3 0 2540 /end CHARACTERISTIC
/begin CHARACTERISTIC KL_FMENACHESP65 "Faktor fuer Rampe Ende Nach-ME bei RS" CURVE 0x230D3C kl_ui8_S6_S3 1 UMR___1_100_0_S6_S3 0 1
 /begin AXIS_DESCR STD_AXIS iMoeMesaf.timer_zmes UMR_MSEC__10_1_0_S6_S3 4 0 2550 DEPOSIT ABSOLUTE MONOTONY MON_INCREASE /end AXIS_DESCR
/end CHARACTERISTIC
/begin CHARACTERISTIC T_SYNMENACHESP65 "Zeit vor/nach Erkennen synchron fuer Ende Nach-ME" VALUE 0x26E5B8 kw_ui8_S6_S3 2550 UMR_MSEC__10_1_M128_S6_S3 -1280 1270 /end CHARACTERISTIC
/begin CHARACTERISTIC KF_TSYNMENACHASP65 "Zeit vor Erkennen synchron fuer Ende Haupt-ME und Start Nach-ME" MAP 0x230D48 kf_ui8_S6_S3 1280 UMR_MSEC__10_1_M128_S6_S3 -1280 0
 /begin AXIS_DESCR STD_AXIS zff_atsys._.iSignale._.obj.sig_n_mot8 UMR_U_MIN_32_1_0_S6_S3 4 0 8160 DEPOSIT ABSOLUTE MONOTONY MON_INCREASE /end AXIS_DESCR
 /begin AXIS_DESCR STD_AXIS zff_atsys._.iSignale._.obj.sig_m_t8 UMR_NM__8_1_M50_S6_S3 3 -400 1640 DEPOSIT ABSOLUTE MONOTONY MON_INCREASE /end AXIS_DESCR
/end CHARACTERISTIC
/begin CHARACTERISTIC KF_MENACHSP65 "Nachmotoreingriff Schaltablauf" MAP 0x230D64 kf_ui8_S6_S3 870 UMR_NM__6_1_M145_S6_S3 -870 0
 /begin AXIS_DESCR STD_AXIS iSasZentr.iSchaltend.n_tkf UMR_U_MIN_32_1_0_S6_S3 6 0 8160 DEPOSIT ABSOLUTE MONOTONY MON_INCREASE /end AXIS_DESCR
 /begin AXIS_DESCR STD_AXIS zff_atsys._.iSignale._.obj.sig_m_t8 UMR_NM__8_1_M50_S6_S3 6 -400 1640 DEPOSIT ABSOLUTE MONOTONY MON_INCREASE /end AXIS_DESCR
/end CHARACTERISTIC
/begin CHARACTERISTIC KF_FMTMEHAUPTASP65 "Faktor fuer Rampe auf HME bei RS" MAP 0x230D9C kf_ui8_S6_S3 1 UMR___1_100_0_S6_S3 0 1
 /begin AXIS_DESCR STD_AXIS iMoeMesaf.timer_zmes UMR_MSEC__10_1_0_S6_S3 4 0 2550 DEPOSIT ABSOLUTE MONOTONY MON_INCREASE /end AXIS_DESCR
 /begin AXIS_DESCR STD_AXIS zff_atsys._.iSignale._.obj.sig_m_t8 UMR_NM__8_1_M50_S6_S3 4 -400 1640 DEPOSIT ABSOLUTE MONOTONY MON_INCREASE /end AXIS_DESCR
/end CHARACTERISTIC
/begin CHARACTERISTIC KF_MEHAUPTSP65 "Wert Hauptmotoreingriff" MAP 0x230DBC kf_ui8_S6_S3 1530 UMR_NM__6_1_M145_S6_S3 -870 660
 /begin AXIS_DESCR STD_AXIS NO_INPUT_QUANTITY UMR_U_MIN_32_1_0_S6_S3 6 0 8160 DEPOSIT ABSOLUTE MONOTONY MON_INCREASE /end AXIS_DESCR
 /begin AXIS_DESCR STD_AXIS zff_atsys._.iSignale._.obj.sig_m_t8 UMR_NM__8_1_M50_S6_S3 10 -400 1640 DEPOSIT ABSOLUTE MONOTONY MON_INCREASE /end AXIS_DESCR
/end CHARACTERISTIC
/begin CHARACTERISTIC KF_TVMTNMOTMEHAUPTSP65 "Verzoegerungszeit Start Haupt-ME bei Momentenerhoehung" MAP 0x230E10 kf_ui8_S6_S3 2540 UMR_MSEC__10_1_0_S6_S3 0 2540
 /begin AXIS_DESCR STD_AXIS zff_atsys._.iSignale._.obj.sig_m_t8 UMR_NM__8_1_M50_S6_S3 4 -400 1640 DEPOSIT ABSOLUTE MONOTONY MON_INCREASE /end AXIS_DESCR
 /begin AXIS_DESCR STD_AXIS zff_atsys._.iSignale._.obj.sig_n_mot8 UMR_U_MIN_32_1_0_S6_S3 4 0 8160 DEPOSIT ABSOLUTE MONOTONY MON_INCREASE /end AXIS_DESCR
/end CHARACTERISTIC
/begin CHARACTERISTIC KL_FMEPOSNGABSP65 "Faktor zur Gewichtung pos. ME" CURVE 0x230E30 kl_si16_S6_S3 1 UMR___1_100_0_S6_S3 0 1
 /begin AXIS_DESCR STD_AXIS iMoeMesaf.ng_abmesas UMR_U_MINSEC_1_1_0_S6_S3 6 -1000 1000 DEPOSIT ABSOLUTE MONOTONY MON_INCREASE /end AXIS_DESCR
/end CHARACTERISTIC
/begin CHARACTERISTIC KF_TSYNNTKFMTMEHAUPTESP65 "Zeitkriterium Ende Haupt-ME bei Momentenerhoehung" MAP 0x230E4C kf_ui8_S6_S3 1280 UMR_MSEC__10_1_M128_S6_S3 -1280 0
 /begin AXIS_DESCR STD_AXIS iSasZentr.iSchaltend.n_tkf UMR_U_MIN_32_1_0_S6_S3 4 0 8160 DEPOSIT ABSOLUTE MONOTONY MON_INCREASE /end AXIS_DESCR
 /begin AXIS_DESCR STD_AXIS zff_atsys._.iSignale._.obj.sig_m_t8 UMR_NM__8_1_M50_S6_S3 4 -400 1640 DEPOSIT ABSOLUTE MONOTONY MON_INCREASE /end AXIS_DESCR
/end CHARACTERISTIC
/begin CHARACTERISTIC KF_FMESASMEHAUPTPOSESP65 "Faktor fuer Reduzierung pos ME bei RS" MAP 0x230E6C kf_si16_S6_S3 1 UMR___1_100_0_S6_S3 0 1
 /begin AXIS_DESCR STD_AXIS iSasZentr.iSchaltend.t_syn UMR_MSEC__10_1_0_S6_S3 4 -327680 327670 DEPOSIT ABSOLUTE MONOTONY MON_INCREASE /end AXIS_DESCR
 /begin AXIS_DESCR STD_AXIS iMoeMesaf.me_sas_gesp UMR_NM__1_1_0_S6_S3 4 0 2000 DEPOSIT ABSOLUTE MONOTONY MON_INCREASE /end AXIS_DESCR
/end CHARACTERISTIC
/begin CHARACTERISTIC KF_FMENACHPOSESP65 "Faktor fuer Reduzierung pos ME bei RS" MAP 0x230EA4 kf_si16_S6_S3 1 UMR___1_100_0_S6_S3 0 1
 /begin AXIS_DESCR STD_AXIS iMoeMesaf.timer_tsyn_rampe_pos UMR_MSEC__10_1_0_S6_S3 4 -50000 50000 DEPOSIT ABSOLUTE MONOTONY MON_INCREASE /end AXIS_DESCR
 /begin AXIS_DESCR STD_AXIS iMoeMesaf.me_sas_gesp UMR_NM__1_1_0_S6_S3 4 0 2000 DEPOSIT ABSOLUTE MONOTONY MON_INCREASE /end AXIS_DESCR
/end CHARACTERISTIC
/begin CHARACTERISTIC T_RAMEESP76 "Dauer Rampe ME bei Schaltungsende" VALUE 0x26E5B9 kw_ui8_S6_S3 2540 UMR_MSEC__10_1_0_S6_S3 0 2540 /end CHARACTERISTIC
/begin CHARACTERISTIC KL_FMENACHESP76 "Faktor fuer Rampe Ende Nach-ME bei RS" CURVE 0x230EDC kl_ui8_S6_S3 1 UMR___1_100_0_S6_S3 0 1
 /begin AXIS_DESCR STD_AXIS iMoeMesaf.timer_zmes UMR_MSEC__10_1_0_S6_S3 4 0 2550 DEPOSIT ABSOLUTE MONOTONY MON_INCREASE /end AXIS_DESCR
/end CHARACTERISTIC
/begin CHARACTERISTIC T_SYNMENACHESP76 "Zeit vor/nach Erkennen synchron fuer Ende Nach-ME" VALUE 0x26E5BA kw_ui8_S6_S3 2550 UMR_MSEC__10_1_M128_S6_S3 -1280 1270 /end CHARACTERISTIC
/begin CHARACTERISTIC KF_TSYNMENACHASP76 "Zeit vor Erkennen synchron fuer Ende Haupt-ME und Start Nach-ME" MAP 0x230EE8 kf_ui8_S6_S3 1280 UMR_MSEC__10_1_M128_S6_S3 -1280 0
 /begin AXIS_DESCR STD_AXIS zff_atsys._.iSignale._.obj.sig_n_mot8 UMR_U_MIN_32_1_0_S6_S3 4 0 8160 DEPOSIT ABSOLUTE MONOTONY MON_INCREASE /end AXIS_DESCR
 /begin AXIS_DESCR STD_AXIS zff_atsys._.iSignale._.obj.sig_m_t8 UMR_NM__8_1_M50_S6_S3 3 -400 1640 DEPOSIT ABSOLUTE MONOTONY MON_INCREASE /end AXIS_DESCR
/end CHARACTERISTIC
/begin CHARACTERISTIC KF_MENACHSP76 "Nachmotoreingriff Schaltablauf" MAP 0x230F04 kf_ui8_S6_S3 870 UMR_NM__6_1_M145_S6_S3 -870 0
 /begin AXIS_DESCR STD_AXIS iSasZentr.iSchaltend.n_tkf UMR_U_MIN_32_1_0_S6_S3 6 0 8160 DEPOSIT ABSOLUTE MONOTONY MON_INCREASE /end AXIS_DESCR
 /begin AXIS_DESCR STD_AXIS zff_atsys._.iSignale._.obj.sig_m_t8 UMR_NM__8_1_M50_S6_S3 6 -400 1640 DEPOSIT ABSOLUTE MONOTONY MON_INCREASE /end AXIS_DESCR
/end CHARACTERISTIC
/begin CHARACTERISTIC KF_FMTMEHAUPTASP76 "Faktor fuer Rampe auf HME bei RS" MAP 0x230F3C kf_ui8_S6_S3 1 UMR___1_100_0_S6_S3 0 1
 /begin AXIS_DESCR STD_AXIS iMoeMesaf.timer_zmes UMR_MSEC__10_1_0_S6_S3 4 0 2550 DEPOSIT ABSOLUTE MONOTONY MON_INCREASE /end AXIS_DESCR
 /begin AXIS_DESCR STD_AXIS zff_atsys._.iSignale._.obj.sig_m_t8 UMR_NM__8_1_M50_S6_S3 4 -400 1640 DEPOSIT ABSOLUTE MONOTONY MON_INCREASE /end AXIS_DESCR
/end CHARACTERISTIC
/begin CHARACTERISTIC KF_MEHAUPTSP76 "Wert Hauptmotoreingriff" MAP 0x230F5C kf_ui8_S6_S3 1530 UMR_NM__6_1_M145_S6_S3 -870 660
 /begin AXIS_DESCR STD_AXIS NO_INPUT_QUANTITY UMR_U_MIN_32_1_0_S6_S3 6 0 8160 DEPOSIT ABSOLUTE MONOTONY MON_INCREASE /end AXIS_DESCR
 /begin AXIS_DESCR STD_AXIS zff_atsys._.iSignale._.obj.sig_m_t8 UMR_NM__8_1_M50_S6_S3 10 -400 1640 DEPOSIT ABSOLUTE MONOTONY MON_INCREASE /end AXIS_DESCR
/end CHARACTERISTIC
/begin CHARACTERISTIC KF_TVMTNMOTMEHAUPTSP76 "Verzoegerungszeit Start Haupt-ME bei Momentenerhoehung" MAP 0x230FB0 kf_ui8_S6_S3 2540 UMR_MSEC__10_1_0_S6_S3 0 2540
 /begin AXIS_DESCR STD_AXIS zff_atsys._.iSignale._.obj.sig_m_t8 UMR_NM__8_1_M50_S6_S3 4 -400 1640 DEPOSIT ABSOLUTE MONOTONY MON_INCREASE /end AXIS_DESCR
 /begin AXIS_DESCR STD_AXIS zff_atsys._.iSignale._.obj.sig_n_mot8 UMR_U_MIN_32_1_0_S6_S3 4 0 8160 DEPOSIT ABSOLUTE MONOTONY MON_INCREASE /end AXIS_DESCR
/end CHARACTERISTIC
/begin CHARACTERISTIC KL_FMEPOSNGABSP76 "Faktor zur Gewichtung pos. ME" CURVE 0x230FD0 kl_si16_S6_S3 1 UMR___1_100_0_S6_S3 0 1
 /begin AXIS_DESCR STD_AXIS iMoeMesaf.ng_abmesas UMR_U_MINSEC_1_1_0_S6_S3 6 -1000 1000 DEPOSIT ABSOLUTE MONOTONY MON_INCREASE /end AXIS_DESCR
/end CHARACTERISTIC
/begin CHARACTERISTIC KF_TSYNNTKFMTMEHAUPTESP76 "Zeitkriterium Ende Haupt-ME bei Momentenerhoehung" MAP 0x230FEC kf_ui8_S6_S3 1280 UMR_MSEC__10_1_M128_S6_S3 -1280 0
 /begin AXIS_DESCR STD_AXIS iSasZentr.iSchaltend.n_tkf UMR_U_MIN_32_1_0_S6_S3 4 0 8160 DEPOSIT ABSOLUTE MONOTONY MON_INCREASE /end AXIS_DESCR
 /begin AXIS_DESCR STD_AXIS zff_atsys._.iSignale._.obj.sig_m_t8 UMR_NM__8_1_M50_S6_S3 4 -400 1640 DEPOSIT ABSOLUTE MONOTONY MON_INCREASE /end AXIS_DESCR
/end CHARACTERISTIC
/begin CHARACTERISTIC KF_FMESASMEHAUPTPOSESP76 "Faktor fuer Reduzierung pos ME bei RS" MAP 0x23100C kf_si16_S6_S3 1 UMR___1_100_0_S6_S3 0 1
 /begin AXIS_DESCR STD_AXIS iSasZentr.iSchaltend.t_syn UMR_MSEC__10_1_0_S6_S3 4 -327680 327670 DEPOSIT ABSOLUTE MONOTONY MON_INCREASE /end AXIS_DESCR
 /begin AXIS_DESCR STD_AXIS iMoeMesaf.me_sas_gesp UMR_NM__1_1_0_S6_S3 4 0 2000 DEPOSIT ABSOLUTE MONOTONY MON_INCREASE /end AXIS_DESCR
/end CHARACTERISTIC
/begin CHARACTERISTIC KF_FMENACHPOSESP76 "Faktor fuer Reduzierung pos ME bei RS" MAP 0x231044 kf_si16_S6_S3 1 UMR___1_100_0_S6_S3 0 1
 /begin AXIS_DESCR STD_AXIS iMoeMesaf.timer_tsyn_rampe_pos UMR_MSEC__10_1_0_S6_S3 4 -50000 50000 DEPOSIT ABSOLUTE MONOTONY MON_INCREASE /end AXIS_DESCR
 /begin AXIS_DESCR STD_AXIS iMoeMesaf.me_sas_gesp UMR_NM__1_1_0_S6_S3 4 0 2000 DEPOSIT ABSOLUTE MONOTONY MON_INCREASE /end AXIS_DESCR
/end CHARACTERISTIC
/begin CHARACTERISTIC T_RAMEESP87 "Dauer Rampe ME bei Schaltungsende" VALUE 0x26E5BB kw_ui8_S6_S3 2540 UMR_MSEC__10_1_0_S6_S3 0 2540 /end CHARACTERISTIC
/begin CHARACTERISTIC KL_FMENACHESP87 "Faktor fuer Rampe Ende Nach-ME bei RS" CURVE 0x23107C kl_ui8_S6_S3 1 UMR___1_100_0_S6_S3 0 1
 /begin AXIS_DESCR STD_AXIS iMoeMesaf.timer_zmes UMR_MSEC__10_1_0_S6_S3 4 0 2550 DEPOSIT ABSOLUTE MONOTONY MON_INCREASE /end AXIS_DESCR
/end CHARACTERISTIC
/begin CHARACTERISTIC T_SYNMENACHESP87 "Zeit vor/nach Erkennen synchron fuer Ende Nach-ME" VALUE 0x26E5BC kw_ui8_S6_S3 2550 UMR_MSEC__10_1_M128_S6_S3 -1280 1270 /end CHARACTERISTIC
/begin CHARACTERISTIC KF_TSYNMENACHASP87 "Zeit vor Erkennen synchron fuer Ende Haupt-ME und Start Nach-ME" MAP 0x231088 kf_ui8_S6_S3 1280 UMR_MSEC__10_1_M128_S6_S3 -1280 0
 /begin AXIS_DESCR STD_AXIS zff_atsys._.iSignale._.obj.sig_n_mot8 UMR_U_MIN_32_1_0_S6_S3 4 0 8160 DEPOSIT ABSOLUTE MONOTONY MON_INCREASE /end AXIS_DESCR
 /begin AXIS_DESCR STD_AXIS zff_atsys._.iSignale._.obj.sig_m_t8 UMR_NM__8_1_M50_S6_S3 3 -400 1640 DEPOSIT ABSOLUTE MONOTONY MON_INCREASE /end AXIS_DESCR
/end CHARACTERISTIC
/begin CHARACTERISTIC KF_MENACHSP87 "Nachmotoreingriff Schaltablauf" MAP 0x2310A4 kf_ui8_S6_S3 870 UMR_NM__6_1_M145_S6_S3 -870 0
 /begin AXIS_DESCR STD_AXIS iSasZentr.iSchaltend.n_tkf UMR_U_MIN_32_1_0_S6_S3 6 0 8160 DEPOSIT ABSOLUTE MONOTONY MON_INCREASE /end AXIS_DESCR
 /begin AXIS_DESCR STD_AXIS zff_atsys._.iSignale._.obj.sig_m_t8 UMR_NM__8_1_M50_S6_S3 6 -400 1640 DEPOSIT ABSOLUTE MONOTONY MON_INCREASE /end AXIS_DESCR
/end CHARACTERISTIC
/begin CHARACTERISTIC KF_FMTMEHAUPTASP87 "Faktor fuer Rampe auf HME bei RS" MAP 0x2310DC kf_ui8_S6_S3 1 UMR___1_100_0_S6_S3 0 1
 /begin AXIS_DESCR STD_AXIS iMoeMesaf.timer_zmes UMR_MSEC__10_1_0_S6_S3 4 0 2550 DEPOSIT ABSOLUTE MONOTONY MON_INCREASE /end AXIS_DESCR
 /begin AXIS_DESCR STD_AXIS zff_atsys._.iSignale._.obj.sig_m_t8 UMR_NM__8_1_M50_S6_S3 4 -400 1640 DEPOSIT ABSOLUTE MONOTONY MON_INCREASE /end AXIS_DESCR
/end CHARACTERISTIC
/begin CHARACTERISTIC KF_MEHAUPTSP87 "Wert Hauptmotoreingriff" MAP 0x2310FC kf_ui8_S6_S3 1530 UMR_NM__6_1_M145_S6_S3 -870 660
 /begin AXIS_DESCR STD_AXIS NO_INPUT_QUANTITY UMR_U_MIN_32_1_0_S6_S3 6 0 8160 DEPOSIT ABSOLUTE MONOTONY MON_INCREASE /end AXIS_DESCR
 /begin AXIS_DESCR STD_AXIS zff_atsys._.iSignale._.obj.sig_m_t8 UMR_NM__8_1_M50_S6_S3 10 -400 1640 DEPOSIT ABSOLUTE MONOTONY MON_INCREASE /end AXIS_DESCR
/end CHARACTERISTIC
/begin CHARACTERISTIC KF_TVMTNMOTMEHAUPTSP87 "Verzoegerungszeit Start Haupt-ME bei Momentenerhoehung" MAP 0x231150 kf_ui8_S6_S3 2540 UMR_MSEC__10_1_0_S6_S3 0 2540
 /begin AXIS_DESCR STD_AXIS zff_atsys._.iSignale._.obj.sig_m_t8 UMR_NM__8_1_M50_S6_S3 4 -400 1640 DEPOSIT ABSOLUTE MONOTONY MON_INCREASE /end AXIS_DESCR
 /begin AXIS_DESCR STD_AXIS zff_atsys._.iSignale._.obj.sig_n_mot8 UMR_U_MIN_32_1_0_S6_S3 4 0 8160 DEPOSIT ABSOLUTE MONOTONY MON_INCREASE /end AXIS_DESCR
/end CHARACTERISTIC
/begin CHARACTERISTIC KL_FMEPOSNGABSP87 "Faktor zur Gewichtung pos. ME" CURVE 0x231170 kl_si16_S6_S3 1 UMR___1_100_0_S6_S3 0 1
 /begin AXIS_DESCR STD_AXIS iMoeMesaf.ng_abmesas UMR_U_MINSEC_1_1_0_S6_S3 6 -1000 1000 DEPOSIT ABSOLUTE MONOTONY MON_INCREASE /end AXIS_DESCR
/end CHARACTERISTIC
/begin CHARACTERISTIC KF_TSYNNTKFMTMEHAUPTESP87 "Zeitkriterium Ende Haupt-ME bei Momentenerhoehung" MAP 0x23118C kf_ui8_S6_S3 1280 UMR_MSEC__10_1_M128_S6_S3 -1280 0
 /begin AXIS_DESCR STD_AXIS iSasZentr.iSchaltend.n_tkf UMR_U_MIN_32_1_0_S6_S3 4 0 8160 DEPOSIT ABSOLUTE MONOTONY MON_INCREASE /end AXIS_DESCR
 /begin AXIS_DESCR STD_AXIS zff_atsys._.iSignale._.obj.sig_m_t8 UMR_NM__8_1_M50_S6_S3 4 -400 1640 DEPOSIT ABSOLUTE MONOTONY MON_INCREASE /end AXIS_DESCR
/end CHARACTERISTIC
/begin CHARACTERISTIC KF_FMESASMEHAUPTPOSESP87 "Faktor fuer Reduzierung pos ME bei RS" MAP 0x2311AC kf_si16_S6_S3 1 UMR___1_100_0_S6_S3 0 1
 /begin AXIS_DESCR STD_AXIS iSasZentr.iSchaltend.t_syn UMR_MSEC__10_1_0_S6_S3 4 -327680 327670 DEPOSIT ABSOLUTE MONOTONY MON_INCREASE /end AXIS_DESCR
 /begin AXIS_DESCR STD_AXIS iMoeMesaf.me_sas_gesp UMR_NM__1_1_0_S6_S3 4 0 2000 DEPOSIT ABSOLUTE MONOTONY MON_INCREASE /end AXIS_DESCR
/end CHARACTERISTIC
/begin CHARACTERISTIC KF_FMENACHPOSESP87 "Faktor fuer Reduzierung pos ME bei RS" MAP 0x2311E4 kf_si16_S6_S3 1 UMR___1_100_0_S6_S3 0 1
 /begin AXIS_DESCR STD_AXIS iMoeMesaf.timer_tsyn_rampe_pos UMR_MSEC__10_1_0_S6_S3 4 -50000 50000 DEPOSIT ABSOLUTE MONOTONY MON_INCREASE /end AXIS_DESCR
 /begin AXIS_DESCR STD_AXIS iMoeMesaf.me_sas_gesp UMR_NM__1_1_0_S6_S3 4 0 2000 DEPOSIT ABSOLUTE MONOTONY MON_INCREASE /end AXIS_DESCR
/end CHARACTERISTIC
/begin CHARACTERISTIC T_RAMEESP31 "Dauer Rampe ME bei Schaltungsende" VALUE 0x26E5BD kw_ui8_S6_S3 2540 UMR_MSEC__10_1_0_S6_S3 0 2540 /end CHARACTERISTIC
/begin CHARACTERISTIC KL_FMENACHESP31 "Faktor fuer Rampe Ende Nach-ME bei RS" CURVE 0x23121C kl_ui8_S6_S3 1 UMR___1_100_0_S6_S3 0 1
 /begin AXIS_DESCR STD_AXIS iMoeMesaf.timer_zmes UMR_MSEC__10_1_0_S6_S3 4 0 2550 DEPOSIT ABSOLUTE MONOTONY MON_INCREASE /end AXIS_DESCR
/end CHARACTERISTIC
/begin CHARACTERISTIC T_SYNMENACHESP31 "Zeit vor/nach Erkennen synchron fuer Ende Nach-ME" VALUE 0x26E5BE kw_ui8_S6_S3 2550 UMR_MSEC__10_1_M128_S6_S3 -1280 1270 /end CHARACTERISTIC
/begin CHARACTERISTIC KF_TSYNMENACHASP31 "Zeit vor Erkennen synchron fuer Ende Haupt-ME und Start Nach-ME" MAP 0x231228 kf_ui8_S6_S3 1280 UMR_MSEC__10_1_M128_S6_S3 -1280 0
 /begin AXIS_DESCR STD_AXIS zff_atsys._.iSignale._.obj.sig_n_mot8 UMR_U_MIN_32_1_0_S6_S3 4 0 8160 DEPOSIT ABSOLUTE MONOTONY MON_INCREASE /end AXIS_DESCR
 /begin AXIS_DESCR STD_AXIS zff_atsys._.iSignale._.obj.sig_m_t8 UMR_NM__8_1_M50_S6_S3 3 -400 1640 DEPOSIT ABSOLUTE MONOTONY MON_INCREASE /end AXIS_DESCR
/end CHARACTERISTIC
/begin CHARACTERISTIC KF_MENACHSP31 "Nachmotoreingriff Schaltablauf" MAP 0x231244 kf_ui8_S6_S3 870 UMR_NM__6_1_M145_S6_S3 -870 0
 /begin AXIS_DESCR STD_AXIS iSasZentr.iSchaltend.n_tkf UMR_U_MIN_32_1_0_S6_S3 6 0 8160 DEPOSIT ABSOLUTE MONOTONY MON_INCREASE /end AXIS_DESCR
 /begin AXIS_DESCR STD_AXIS zff_atsys._.iSignale._.obj.sig_m_t8 UMR_NM__8_1_M50_S6_S3 6 -400 1640 DEPOSIT ABSOLUTE MONOTONY MON_INCREASE /end AXIS_DESCR
/end CHARACTERISTIC
/begin CHARACTERISTIC KF_FMTMEHAUPTASP31 "Faktor fuer Rampe auf HME bei RS" MAP 0x23127C kf_ui8_S6_S3 1 UMR___1_100_0_S6_S3 0 1
 /begin AXIS_DESCR STD_AXIS iMoeMesaf.timer_zmes UMR_MSEC__10_1_0_S6_S3 4 0 2550 DEPOSIT ABSOLUTE MONOTONY MON_INCREASE /end AXIS_DESCR
 /begin AXIS_DESCR STD_AXIS zff_atsys._.iSignale._.obj.sig_m_t8 UMR_NM__8_1_M50_S6_S3 4 -400 1640 DEPOSIT ABSOLUTE MONOTONY MON_INCREASE /end AXIS_DESCR
/end CHARACTERISTIC
/begin CHARACTERISTIC KF_MEHAUPTSP31 "Wert Hauptmotoreingriff" MAP 0x23129C kf_ui8_S6_S3 1530 UMR_NM__6_1_M145_S6_S3 -870 660
 /begin AXIS_DESCR STD_AXIS NO_INPUT_QUANTITY UMR_U_MIN_32_1_0_S6_S3 6 0 8160 DEPOSIT ABSOLUTE MONOTONY MON_INCREASE /end AXIS_DESCR
 /begin AXIS_DESCR STD_AXIS zff_atsys._.iSignale._.obj.sig_m_t8 UMR_NM__8_1_M50_S6_S3 10 -400 1640 DEPOSIT ABSOLUTE MONOTONY MON_INCREASE /end AXIS_DESCR
/end CHARACTERISTIC
/begin CHARACTERISTIC KF_TVMTNMOTMEHAUPTSP31 "Verzoegerungszeit Start Haupt-ME bei Momentenerhoehung" MAP 0x2312F0 kf_ui8_S6_S3 2540 UMR_MSEC__10_1_0_S6_S3 0 2540
 /begin AXIS_DESCR STD_AXIS zff_atsys._.iSignale._.obj.sig_m_t8 UMR_NM__8_1_M50_S6_S3 4 -400 1640 DEPOSIT ABSOLUTE MONOTONY MON_INCREASE /end AXIS_DESCR
 /begin AXIS_DESCR STD_AXIS zff_atsys._.iSignale._.obj.sig_n_mot8 UMR_U_MIN_32_1_0_S6_S3 4 0 8160 DEPOSIT ABSOLUTE MONOTONY MON_INCREASE /end AXIS_DESCR
/end CHARACTERISTIC
/begin CHARACTERISTIC KL_FMEPOSNGABSP31 "Faktor zur Gewichtung pos. ME" CURVE 0x231310 kl_si16_S6_S3 1 UMR___1_100_0_S6_S3 0 1
 /begin AXIS_DESCR STD_AXIS iMoeMesaf.ng_abmesas UMR_U_MINSEC_1_1_0_S6_S3 6 -1000 1000 DEPOSIT ABSOLUTE MONOTONY MON_INCREASE /end AXIS_DESCR
/end CHARACTERISTIC
/begin CHARACTERISTIC KF_TSYNNTKFMTMEHAUPTESP31 "Zeitkriterium Ende Haupt-ME bei Momentenerhoehung" MAP 0x23132C kf_ui8_S6_S3 1280 UMR_MSEC__10_1_M128_S6_S3 -1280 0
 /begin AXIS_DESCR STD_AXIS iSasZentr.iSchaltend.n_tkf UMR_U_MIN_32_1_0_S6_S3 4 0 8160 DEPOSIT ABSOLUTE MONOTONY MON_INCREASE /end AXIS_DESCR
 /begin AXIS_DESCR STD_AXIS zff_atsys._.iSignale._.obj.sig_m_t8 UMR_NM__8_1_M50_S6_S3 4 -400 1640 DEPOSIT ABSOLUTE MONOTONY MON_INCREASE /end AXIS_DESCR
/end CHARACTERISTIC
/begin CHARACTERISTIC KF_FMESASMEHAUPTPOSESP31 "Faktor fuer Reduzierung pos ME bei RS" MAP 0x23134C kf_si16_S6_S3 1 UMR___1_100_0_S6_S3 0 1
 /begin AXIS_DESCR STD_AXIS iSasZentr.iSchaltend.t_syn UMR_MSEC__10_1_0_S6_S3 4 -327680 327670 DEPOSIT ABSOLUTE MONOTONY MON_INCREASE /end AXIS_DESCR
 /begin AXIS_DESCR STD_AXIS iMoeMesaf.me_sas_gesp UMR_NM__1_1_0_S6_S3 4 0 2000 DEPOSIT ABSOLUTE MONOTONY MON_INCREASE /end AXIS_DESCR
/end CHARACTERISTIC
/begin CHARACTERISTIC KF_FMENACHPOSESP31 "Faktor fuer Reduzierung pos ME bei RS" MAP 0x231384 kf_si16_S6_S3 1 UMR___1_100_0_S6_S3 0 1
 /begin AXIS_DESCR STD_AXIS iMoeMesaf.timer_tsyn_rampe_pos UMR_MSEC__10_1_0_S6_S3 4 -50000 50000 DEPOSIT ABSOLUTE MONOTONY MON_INCREASE /end AXIS_DESCR
 /begin AXIS_DESCR STD_AXIS iMoeMesaf.me_sas_gesp UMR_NM__1_1_0_S6_S3 4 0 2000 DEPOSIT ABSOLUTE MONOTONY MON_INCREASE /end AXIS_DESCR
/end CHARACTERISTIC
/begin CHARACTERISTIC T_RAMEESP42 "Dauer Rampe ME bei Schaltungsende" VALUE 0x26E5BF kw_ui8_S6_S3 2540 UMR_MSEC__10_1_0_S6_S3 0 2540 /end CHARACTERISTIC
/begin CHARACTERISTIC T_RAMEESP42_EL "Dauer Rampe ME bei Schaltungsende" VALUE 0x26E5C0 kw_ui8_S6_S3 2540 UMR_MSEC__10_1_0_S6_S3 0 2540 /end CHARACTERISTIC
/begin CHARACTERISTIC KL_FMENACHESP42 "Faktor fuer Rampe Ende Nach-ME bei RS" CURVE 0x2313BC kl_ui8_S6_S3 1 UMR___1_100_0_S6_S3 0 1
 /begin AXIS_DESCR STD_AXIS iMoeMesaf.timer_zmes UMR_MSEC__10_1_0_S6_S3 4 0 2550 DEPOSIT ABSOLUTE MONOTONY MON_INCREASE /end AXIS_DESCR
/end CHARACTERISTIC
/begin CHARACTERISTIC T_SYNMENACHESP42 "Zeit vor/nach Erkennen synchron fuer Ende Nach-ME" VALUE 0x26E5C1 kw_ui8_S6_S3 2550 UMR_MSEC__10_1_M128_S6_S3 -1280 1270 /end CHARACTERISTIC
/begin CHARACTERISTIC T_SYNMENACHESP42_EL "Zeit vor/nach Erkennen synchron fuer Ende Nach-ME" VALUE 0x26E5C2 kw_ui8_S6_S3 2550 UMR_MSEC__10_1_M128_S6_S3 -1280 1270 /end CHARACTERISTIC
/begin CHARACTERISTIC KF_TSYNMENACHASP42 "Zeit vor Erkennen synchron fuer Ende Haupt-ME und Start Nach-ME" MAP 0x2313C8 kf_ui8_S6_S3 1280 UMR_MSEC__10_1_M128_S6_S3 -1280 0
 /begin AXIS_DESCR STD_AXIS zff_atsys._.iSignale._.obj.sig_n_mot8 UMR_U_MIN_32_1_0_S6_S3 4 0 8160 DEPOSIT ABSOLUTE MONOTONY MON_INCREASE /end AXIS_DESCR
 /begin AXIS_DESCR STD_AXIS zff_atsys._.iSignale._.obj.sig_m_t8 UMR_NM__8_1_M50_S6_S3 3 -400 1640 DEPOSIT ABSOLUTE MONOTONY MON_INCREASE /end AXIS_DESCR
/end CHARACTERISTIC
/begin CHARACTERISTIC KF_TSYNMENACHASP42_EL "Zeit vor Erkennen synchron fuer Ende Haupt-ME und Start Nach-ME" MAP 0x2313E4 kf_ui8_S6_S3 1280 UMR_MSEC__10_1_M128_S6_S3 -1280 0
 /begin AXIS_DESCR STD_AXIS zff_atsys._.iSignale._.obj.sig_n_mot8 UMR_U_MIN_32_1_0_S6_S3 4 0 8160 DEPOSIT ABSOLUTE MONOTONY MON_INCREASE /end AXIS_DESCR
 /begin AXIS_DESCR STD_AXIS zff_atsys._.iSignale._.obj.sig_m_t8 UMR_NM__8_1_M50_S6_S3 3 -400 1640 DEPOSIT ABSOLUTE MONOTONY MON_INCREASE /end AXIS_DESCR
/end CHARACTERISTIC
/begin CHARACTERISTIC KF_MENACHSP42 "Nachmotoreingriff Schaltablauf" MAP 0x231400 kf_ui8_S6_S3 870 UMR_NM__6_1_M145_S6_S3 -870 0
 /begin AXIS_DESCR STD_AXIS iSasZentr.iSchaltend.n_tkf UMR_U_MIN_32_1_0_S6_S3 6 0 8160 DEPOSIT ABSOLUTE MONOTONY MON_INCREASE /end AXIS_DESCR
 /begin AXIS_DESCR STD_AXIS zff_atsys._.iSignale._.obj.sig_m_t8 UMR_NM__8_1_M50_S6_S3 6 -400 1640 DEPOSIT ABSOLUTE MONOTONY MON_INCREASE /end AXIS_DESCR
/end CHARACTERISTIC
/begin CHARACTERISTIC KF_MENACHSP42_EL "Nachmotoreingriff Schaltablauf" MAP 0x231438 kf_ui8_S6_S3 870 UMR_NM__6_1_M145_S6_S3 -870 0
 /begin AXIS_DESCR STD_AXIS iSasZentr.iSchaltend.n_tkf UMR_U_MIN_32_1_0_S6_S3 6 0 8160 DEPOSIT ABSOLUTE MONOTONY MON_INCREASE /end AXIS_DESCR
 /begin AXIS_DESCR STD_AXIS zff_atsys._.iSignale._.obj.sig_m_t8 UMR_NM__8_1_M50_S6_S3 6 -400 1640 DEPOSIT ABSOLUTE MONOTONY MON_INCREASE /end AXIS_DESCR
/end CHARACTERISTIC
/begin CHARACTERISTIC KF_FMTMEHAUPTASP42 "Faktor fuer Rampe auf HME bei RS" MAP 0x231470 kf_ui8_S6_S3 1 UMR___1_100_0_S6_S3 0 1
 /begin AXIS_DESCR STD_AXIS iMoeMesaf.timer_zmes UMR_MSEC__10_1_0_S6_S3 4 0 2550 DEPOSIT ABSOLUTE MONOTONY MON_INCREASE /end AXIS_DESCR
 /begin AXIS_DESCR STD_AXIS zff_atsys._.iSignale._.obj.sig_m_t8 UMR_NM__8_1_M50_S6_S3 4 -400 1640 DEPOSIT ABSOLUTE MONOTONY MON_INCREASE /end AXIS_DESCR
/end CHARACTERISTIC
/begin CHARACTERISTIC KF_MEHAUPTSP42 "Wert Hauptmotoreingriff" MAP 0x231490 kf_ui8_S6_S3 1530 UMR_NM__6_1_M145_S6_S3 -870 660
 /begin AXIS_DESCR STD_AXIS NO_INPUT_QUANTITY UMR_U_MIN_32_1_0_S6_S3 6 0 8160 DEPOSIT ABSOLUTE MONOTONY MON_INCREASE /end AXIS_DESCR
 /begin AXIS_DESCR STD_AXIS zff_atsys._.iSignale._.obj.sig_m_t8 UMR_NM__8_1_M50_S6_S3 10 -400 1640 DEPOSIT ABSOLUTE MONOTONY MON_INCREASE /end AXIS_DESCR
/end CHARACTERISTIC
/begin CHARACTERISTIC KF_MEHAUPTSP42_EL "Wert Hauptmotoreingriff" MAP 0x2314E4 kf_ui8_S6_S3 1530 UMR_NM__6_1_M145_S6_S3 -870 660
 /begin AXIS_DESCR STD_AXIS NO_INPUT_QUANTITY UMR_U_MIN_32_1_0_S6_S3 6 0 8160 DEPOSIT ABSOLUTE MONOTONY MON_INCREASE /end AXIS_DESCR
 /begin AXIS_DESCR STD_AXIS zff_atsys._.iSignale._.obj.sig_m_t8 UMR_NM__8_1_M50_S6_S3 10 -400 1640 DEPOSIT ABSOLUTE MONOTONY MON_INCREASE /end AXIS_DESCR
/end CHARACTERISTIC
/begin CHARACTERISTIC KF_TVMTNMOTMEHAUPTSP42 "Verzoegerungszeit Start Haupt-ME bei Momentenerhoehung" MAP 0x231538 kf_ui8_S6_S3 2540 UMR_MSEC__10_1_0_S6_S3 0 2540
 /begin AXIS_DESCR STD_AXIS zff_atsys._.iSignale._.obj.sig_m_t8 UMR_NM__8_1_M50_S6_S3 4 -400 1640 DEPOSIT ABSOLUTE MONOTONY MON_INCREASE /end AXIS_DESCR
 /begin AXIS_DESCR STD_AXIS zff_atsys._.iSignale._.obj.sig_n_mot8 UMR_U_MIN_32_1_0_S6_S3 4 0 8160 DEPOSIT ABSOLUTE MONOTONY MON_INCREASE /end AXIS_DESCR
/end CHARACTERISTIC
/begin CHARACTERISTIC KL_FMEPOSNGABSP42 "Faktor zur Gewichtung pos. ME" CURVE 0x231558 kl_si16_S6_S3 1 UMR___1_100_0_S6_S3 0 1
 /begin AXIS_DESCR STD_AXIS iMoeMesaf.ng_abmesas UMR_U_MINSEC_1_1_0_S6_S3 6 -1000 1000 DEPOSIT ABSOLUTE MONOTONY MON_INCREASE /end AXIS_DESCR
/end CHARACTERISTIC
/begin CHARACTERISTIC KF_TSYNNTKFMTMEHAUPTESP42 "Zeitkriterium Ende Haupt-ME bei Momentenerhoehung" MAP 0x231574 kf_ui8_S6_S3 1280 UMR_MSEC__10_1_M128_S6_S3 -1280 0
 /begin AXIS_DESCR STD_AXIS iSasZentr.iSchaltend.n_tkf UMR_U_MIN_32_1_0_S6_S3 4 0 8160 DEPOSIT ABSOLUTE MONOTONY MON_INCREASE /end AXIS_DESCR
 /begin AXIS_DESCR STD_AXIS zff_atsys._.iSignale._.obj.sig_m_t8 UMR_NM__8_1_M50_S6_S3 4 -400 1640 DEPOSIT ABSOLUTE MONOTONY MON_INCREASE /end AXIS_DESCR
/end CHARACTERISTIC
/begin CHARACTERISTIC KF_FMESASMEHAUPTPOSESP42 "Faktor fuer Reduzierung pos ME bei RS" MAP 0x231594 kf_si16_S6_S3 1 UMR___1_100_0_S6_S3 0 1
 /begin AXIS_DESCR STD_AXIS iSasZentr.iSchaltend.t_syn UMR_MSEC__10_1_0_S6_S3 4 -327680 327670 DEPOSIT ABSOLUTE MONOTONY MON_INCREASE /end AXIS_DESCR
 /begin AXIS_DESCR STD_AXIS iMoeMesaf.me_sas_gesp UMR_NM__1_1_0_S6_S3 4 0 2000 DEPOSIT ABSOLUTE MONOTONY MON_INCREASE /end AXIS_DESCR
/end CHARACTERISTIC
/begin CHARACTERISTIC KF_FMENACHPOSESP42 "Faktor fuer Reduzierung pos ME bei RS" MAP 0x2315CC kf_si16_S6_S3 1 UMR___1_100_0_S6_S3 0 1
 /begin AXIS_DESCR STD_AXIS iMoeMesaf.timer_tsyn_rampe_pos UMR_MSEC__10_1_0_S6_S3 4 -50000 50000 DEPOSIT ABSOLUTE MONOTONY MON_INCREASE /end AXIS_DESCR
 /begin AXIS_DESCR STD_AXIS iMoeMesaf.me_sas_gesp UMR_NM__1_1_0_S6_S3 4 0 2000 DEPOSIT ABSOLUTE MONOTONY MON_INCREASE /end AXIS_DESCR
/end CHARACTERISTIC
/begin CHARACTERISTIC T_RAMEESP51 "Dauer Rampe ME bei Schaltungsende" VALUE 0x26E5C3 kw_ui8_S6_S3 2540 UMR_MSEC__10_1_0_S6_S3 0 2540 /end CHARACTERISTIC
/begin CHARACTERISTIC KL_FMENACHESP51 "Faktor fuer Rampe Ende Nach-ME bei RS" CURVE 0x231604 kl_ui8_S6_S3 1 UMR___1_100_0_S6_S3 0 1
 /begin AXIS_DESCR STD_AXIS iMoeMesaf.timer_zmes UMR_MSEC__10_1_0_S6_S3 4 0 2550 DEPOSIT ABSOLUTE MONOTONY MON_INCREASE /end AXIS_DESCR
/end CHARACTERISTIC
/begin CHARACTERISTIC T_SYNMENACHESP51 "Zeit vor/nach Erkennen synchron fuer Ende Nach-ME" VALUE 0x26E5C4 kw_ui8_S6_S3 2550 UMR_MSEC__10_1_M128_S6_S3 -1280 1270 /end CHARACTERISTIC
/begin CHARACTERISTIC KF_TSYNMENACHASP51 "Zeit vor Erkennen synchron fuer Ende Haupt-ME und Start Nach-ME" MAP 0x231610 kf_ui8_S6_S3 1280 UMR_MSEC__10_1_M128_S6_S3 -1280 0
 /begin AXIS_DESCR STD_AXIS zff_atsys._.iSignale._.obj.sig_n_mot8 UMR_U_MIN_32_1_0_S6_S3 4 0 8160 DEPOSIT ABSOLUTE MONOTONY MON_INCREASE /end AXIS_DESCR
 /begin AXIS_DESCR STD_AXIS zff_atsys._.iSignale._.obj.sig_m_t8 UMR_NM__8_1_M50_S6_S3 3 -400 1640 DEPOSIT ABSOLUTE MONOTONY MON_INCREASE /end AXIS_DESCR
/end CHARACTERISTIC
/begin CHARACTERISTIC KF_MENACHSP51 "Nachmotoreingriff Schaltablauf" MAP 0x23162C kf_ui8_S6_S3 870 UMR_NM__6_1_M145_S6_S3 -870 0
 /begin AXIS_DESCR STD_AXIS iSasZentr.iSchaltend.n_tkf UMR_U_MIN_32_1_0_S6_S3 6 0 8160 DEPOSIT ABSOLUTE MONOTONY MON_INCREASE /end AXIS_DESCR
 /begin AXIS_DESCR STD_AXIS zff_atsys._.iSignale._.obj.sig_m_t8 UMR_NM__8_1_M50_S6_S3 6 -400 1640 DEPOSIT ABSOLUTE MONOTONY MON_INCREASE /end AXIS_DESCR
/end CHARACTERISTIC
/begin CHARACTERISTIC KF_FMTMEHAUPTASP51 "Faktor fuer Rampe auf HME bei RS" MAP 0x231664 kf_ui8_S6_S3 1 UMR___1_100_0_S6_S3 0 1
 /begin AXIS_DESCR STD_AXIS iMoeMesaf.timer_zmes UMR_MSEC__10_1_0_S6_S3 4 0 2550 DEPOSIT ABSOLUTE MONOTONY MON_INCREASE /end AXIS_DESCR
 /begin AXIS_DESCR STD_AXIS zff_atsys._.iSignale._.obj.sig_m_t8 UMR_NM__8_1_M50_S6_S3 4 -400 1640 DEPOSIT ABSOLUTE MONOTONY MON_INCREASE /end AXIS_DESCR
/end CHARACTERISTIC
/begin CHARACTERISTIC KF_MEHAUPTSP51 "Wert Hauptmotoreingriff" MAP 0x231684 kf_ui8_S6_S3 1530 UMR_NM__6_1_M145_S6_S3 -870 660
 /begin AXIS_DESCR STD_AXIS NO_INPUT_QUANTITY UMR_U_MIN_32_1_0_S6_S3 6 0 8160 DEPOSIT ABSOLUTE MONOTONY MON_INCREASE /end AXIS_DESCR
 /begin AXIS_DESCR STD_AXIS zff_atsys._.iSignale._.obj.sig_m_t8 UMR_NM__8_1_M50_S6_S3 10 -400 1640 DEPOSIT ABSOLUTE MONOTONY MON_INCREASE /end AXIS_DESCR
/end CHARACTERISTIC
/begin CHARACTERISTIC KF_TVMTNMOTMEHAUPTSP51 "Verzoegerungszeit Start Haupt-ME bei Momentenerhoehung" MAP 0x2316D8 kf_ui8_S6_S3 2540 UMR_MSEC__10_1_0_S6_S3 0 2540
 /begin AXIS_DESCR STD_AXIS zff_atsys._.iSignale._.obj.sig_m_t8 UMR_NM__8_1_M50_S6_S3 4 -400 1640 DEPOSIT ABSOLUTE MONOTONY MON_INCREASE /end AXIS_DESCR
 /begin AXIS_DESCR STD_AXIS zff_atsys._.iSignale._.obj.sig_n_mot8 UMR_U_MIN_32_1_0_S6_S3 4 0 8160 DEPOSIT ABSOLUTE MONOTONY MON_INCREASE /end AXIS_DESCR
/end CHARACTERISTIC
/begin CHARACTERISTIC KL_FMEPOSNGABSP51 "Faktor zur Gewichtung pos. ME" CURVE 0x2316F8 kl_si16_S6_S3 1 UMR___1_100_0_S6_S3 0 1
 /begin AXIS_DESCR STD_AXIS iMoeMesaf.ng_abmesas UMR_U_MINSEC_1_1_0_S6_S3 6 -1000 1000 DEPOSIT ABSOLUTE MONOTONY MON_INCREASE /end AXIS_DESCR
/end CHARACTERISTIC
/begin CHARACTERISTIC KF_TSYNNTKFMTMEHAUPTESP51 "Zeitkriterium Ende Haupt-ME bei Momentenerhoehung" MAP 0x231714 kf_ui8_S6_S3 1280 UMR_MSEC__10_1_M128_S6_S3 -1280 0
 /begin AXIS_DESCR STD_AXIS iSasZentr.iSchaltend.n_tkf UMR_U_MIN_32_1_0_S6_S3 4 0 8160 DEPOSIT ABSOLUTE MONOTONY MON_INCREASE /end AXIS_DESCR
 /begin AXIS_DESCR STD_AXIS zff_atsys._.iSignale._.obj.sig_m_t8 UMR_NM__8_1_M50_S6_S3 4 -400 1640 DEPOSIT ABSOLUTE MONOTONY MON_INCREASE /end AXIS_DESCR
/end CHARACTERISTIC
/begin CHARACTERISTIC KF_FMESASMEHAUPTPOSESP51 "Faktor fuer Reduzierung pos ME bei RS" MAP 0x231734 kf_si16_S6_S3 1 UMR___1_100_0_S6_S3 0 1
 /begin AXIS_DESCR STD_AXIS iSasZentr.iSchaltend.t_syn UMR_MSEC__10_1_0_S6_S3 4 -327680 327670 DEPOSIT ABSOLUTE MONOTONY MON_INCREASE /end AXIS_DESCR
 /begin AXIS_DESCR STD_AXIS iMoeMesaf.me_sas_gesp UMR_NM__1_1_0_S6_S3 4 0 2000 DEPOSIT ABSOLUTE MONOTONY MON_INCREASE /end AXIS_DESCR
/end CHARACTERISTIC
/begin CHARACTERISTIC KF_FMENACHPOSESP51 "Faktor fuer Reduzierung pos ME bei RS" MAP 0x23176C kf_si16_S6_S3 1 UMR___1_100_0_S6_S3 0 1
 /begin AXIS_DESCR STD_AXIS iMoeMesaf.timer_tsyn_rampe_pos UMR_MSEC__10_1_0_S6_S3 4 -50000 50000 DEPOSIT ABSOLUTE MONOTONY MON_INCREASE /end AXIS_DESCR
 /begin AXIS_DESCR STD_AXIS iMoeMesaf.me_sas_gesp UMR_NM__1_1_0_S6_S3 4 0 2000 DEPOSIT ABSOLUTE MONOTONY MON_INCREASE /end AXIS_DESCR
/end CHARACTERISTIC
/begin CHARACTERISTIC T_RAMEESP53 "Dauer Rampe ME bei Schaltungsende" VALUE 0x26E5C5 kw_ui8_S6_S3 2540 UMR_MSEC__10_1_0_S6_S3 0 2540 /end CHARACTERISTIC
/begin CHARACTERISTIC T_RAMEESP53_EL "Dauer Rampe ME bei Schaltungsende" VALUE 0x26E5C6 kw_ui8_S6_S3 2540 UMR_MSEC__10_1_0_S6_S3 0 2540 /end CHARACTERISTIC
/begin CHARACTERISTIC KL_FMENACHESP53 "Faktor fuer Rampe Ende Nach-ME bei RS" CURVE 0x2317A4 kl_ui8_S6_S3 1 UMR___1_100_0_S6_S3 0 1
 /begin AXIS_DESCR STD_AXIS iMoeMesaf.timer_zmes UMR_MSEC__10_1_0_S6_S3 4 0 2550 DEPOSIT ABSOLUTE MONOTONY MON_INCREASE /end AXIS_DESCR
/end CHARACTERISTIC
/begin CHARACTERISTIC T_SYNMENACHESP53 "Zeit vor/nach Erkennen synchron fuer Ende Nach-ME" VALUE 0x26E5C7 kw_ui8_S6_S3 2550 UMR_MSEC__10_1_M128_S6_S3 -1280 1270 /end CHARACTERISTIC
/begin CHARACTERISTIC T_SYNMENACHESP53_EL "Zeit vor/nach Erkennen synchron fuer Ende Nach-ME" VALUE 0x26E5C8 kw_ui8_S6_S3 2550 UMR_MSEC__10_1_M128_S6_S3 -1280 1270 /end CHARACTERISTIC
/begin CHARACTERISTIC KF_TSYNMENACHASP53 "Zeit vor Erkennen synchron fuer Ende Haupt-ME und Start Nach-ME" MAP 0x2317B0 kf_ui8_S6_S3 1280 UMR_MSEC__10_1_M128_S6_S3 -1280 0
 /begin AXIS_DESCR STD_AXIS zff_atsys._.iSignale._.obj.sig_n_mot8 UMR_U_MIN_32_1_0_S6_S3 4 0 8160 DEPOSIT ABSOLUTE MONOTONY MON_INCREASE /end AXIS_DESCR
 /begin AXIS_DESCR STD_AXIS zff_atsys._.iSignale._.obj.sig_m_t8 UMR_NM__8_1_M50_S6_S3 3 -400 1640 DEPOSIT ABSOLUTE MONOTONY MON_INCREASE /end AXIS_DESCR
/end CHARACTERISTIC
/begin CHARACTERISTIC KF_TSYNMENACHASP53_EL "Zeit vor Erkennen synchron fuer Ende Haupt-ME und Start Nach-ME" MAP 0x2317CC kf_ui8_S6_S3 1280 UMR_MSEC__10_1_M128_S6_S3 -1280 0
 /begin AXIS_DESCR STD_AXIS zff_atsys._.iSignale._.obj.sig_n_mot8 UMR_U_MIN_32_1_0_S6_S3 4 0 8160 DEPOSIT ABSOLUTE MONOTONY MON_INCREASE /end AXIS_DESCR
 /begin AXIS_DESCR STD_AXIS zff_atsys._.iSignale._.obj.sig_m_t8 UMR_NM__8_1_M50_S6_S3 3 -400 1640 DEPOSIT ABSOLUTE MONOTONY MON_INCREASE /end AXIS_DESCR
/end CHARACTERISTIC
/begin CHARACTERISTIC KF_MENACHSP53 "Nachmotoreingriff Schaltablauf" MAP 0x2317E8 kf_ui8_S6_S3 870 UMR_NM__6_1_M145_S6_S3 -870 0
 /begin AXIS_DESCR STD_AXIS iSasZentr.iSchaltend.n_tkf UMR_U_MIN_32_1_0_S6_S3 6 0 8160 DEPOSIT ABSOLUTE MONOTONY MON_INCREASE /end AXIS_DESCR
 /begin AXIS_DESCR STD_AXIS zff_atsys._.iSignale._.obj.sig_m_t8 UMR_NM__8_1_M50_S6_S3 6 -400 1640 DEPOSIT ABSOLUTE MONOTONY MON_INCREASE /end AXIS_DESCR
/end CHARACTERISTIC
/begin CHARACTERISTIC KF_MENACHSP53_EL "Nachmotoreingriff Schaltablauf" MAP 0x231820 kf_ui8_S6_S3 870 UMR_NM__6_1_M145_S6_S3 -870 0
 /begin AXIS_DESCR STD_AXIS iSasZentr.iSchaltend.n_tkf UMR_U_MIN_32_1_0_S6_S3 6 0 8160 DEPOSIT ABSOLUTE MONOTONY MON_INCREASE /end AXIS_DESCR
 /begin AXIS_DESCR STD_AXIS zff_atsys._.iSignale._.obj.sig_m_t8 UMR_NM__8_1_M50_S6_S3 6 -400 1640 DEPOSIT ABSOLUTE MONOTONY MON_INCREASE /end AXIS_DESCR
/end CHARACTERISTIC
/begin CHARACTERISTIC KF_FMTMEHAUPTASP53 "Faktor fuer Rampe auf HME bei RS" MAP 0x231858 kf_ui8_S6_S3 1 UMR___1_100_0_S6_S3 0 1
 /begin AXIS_DESCR STD_AXIS iMoeMesaf.timer_zmes UMR_MSEC__10_1_0_S6_S3 4 0 2550 DEPOSIT ABSOLUTE MONOTONY MON_INCREASE /end AXIS_DESCR
 /begin AXIS_DESCR STD_AXIS zff_atsys._.iSignale._.obj.sig_m_t8 UMR_NM__8_1_M50_S6_S3 4 -400 1640 DEPOSIT ABSOLUTE MONOTONY MON_INCREASE /end AXIS_DESCR
/end CHARACTERISTIC
/begin CHARACTERISTIC KF_MEHAUPTSP53 "Wert Hauptmotoreingriff" MAP 0x231878 kf_ui8_S6_S3 1530 UMR_NM__6_1_M145_S6_S3 -870 660
 /begin AXIS_DESCR STD_AXIS NO_INPUT_QUANTITY UMR_U_MIN_32_1_0_S6_S3 6 0 8160 DEPOSIT ABSOLUTE MONOTONY MON_INCREASE /end AXIS_DESCR
 /begin AXIS_DESCR STD_AXIS zff_atsys._.iSignale._.obj.sig_m_t8 UMR_NM__8_1_M50_S6_S3 10 -400 1640 DEPOSIT ABSOLUTE MONOTONY MON_INCREASE /end AXIS_DESCR
/end CHARACTERISTIC
/begin CHARACTERISTIC KF_MEHAUPTSP53_EL "Wert Hauptmotoreingriff" MAP 0x2318CC kf_ui8_S6_S3 1530 UMR_NM__6_1_M145_S6_S3 -870 660
 /begin AXIS_DESCR STD_AXIS NO_INPUT_QUANTITY UMR_U_MIN_32_1_0_S6_S3 6 0 8160 DEPOSIT ABSOLUTE MONOTONY MON_INCREASE /end AXIS_DESCR
 /begin AXIS_DESCR STD_AXIS zff_atsys._.iSignale._.obj.sig_m_t8 UMR_NM__8_1_M50_S6_S3 10 -400 1640 DEPOSIT ABSOLUTE MONOTONY MON_INCREASE /end AXIS_DESCR
/end CHARACTERISTIC
/begin CHARACTERISTIC KF_TVMTNMOTMEHAUPTSP53 "Verzoegerungszeit Start Haupt-ME bei Momentenerhoehung" MAP 0x231920 kf_ui8_S6_S3 2540 UMR_MSEC__10_1_0_S6_S3 0 2540
 /begin AXIS_DESCR STD_AXIS zff_atsys._.iSignale._.obj.sig_m_t8 UMR_NM__8_1_M50_S6_S3 4 -400 1640 DEPOSIT ABSOLUTE MONOTONY MON_INCREASE /end AXIS_DESCR
 /begin AXIS_DESCR STD_AXIS zff_atsys._.iSignale._.obj.sig_n_mot8 UMR_U_MIN_32_1_0_S6_S3 4 0 8160 DEPOSIT ABSOLUTE MONOTONY MON_INCREASE /end AXIS_DESCR
/end CHARACTERISTIC
/begin CHARACTERISTIC KL_FMEPOSNGABSP53 "Faktor zur Gewichtung pos. ME" CURVE 0x231940 kl_si16_S6_S3 1 UMR___1_100_0_S6_S3 0 1
 /begin AXIS_DESCR STD_AXIS iMoeMesaf.ng_abmesas UMR_U_MINSEC_1_1_0_S6_S3 6 -1000 1000 DEPOSIT ABSOLUTE MONOTONY MON_INCREASE /end AXIS_DESCR
/end CHARACTERISTIC
/begin CHARACTERISTIC KF_TSYNNTKFMTMEHAUPTESP53 "Zeitkriterium Ende Haupt-ME bei Momentenerhoehung" MAP 0x23195C kf_ui8_S6_S3 1280 UMR_MSEC__10_1_M128_S6_S3 -1280 0
 /begin AXIS_DESCR STD_AXIS iSasZentr.iSchaltend.n_tkf UMR_U_MIN_32_1_0_S6_S3 4 0 8160 DEPOSIT ABSOLUTE MONOTONY MON_INCREASE /end AXIS_DESCR
 /begin AXIS_DESCR STD_AXIS zff_atsys._.iSignale._.obj.sig_m_t8 UMR_NM__8_1_M50_S6_S3 4 -400 1640 DEPOSIT ABSOLUTE MONOTONY MON_INCREASE /end AXIS_DESCR
/end CHARACTERISTIC
/begin CHARACTERISTIC KF_FMESASMEHAUPTPOSESP53 "Faktor fuer Reduzierung pos ME bei RS" MAP 0x23197C kf_si16_S6_S3 1 UMR___1_100_0_S6_S3 0 1
 /begin AXIS_DESCR STD_AXIS iSasZentr.iSchaltend.t_syn UMR_MSEC__10_1_0_S6_S3 4 -327680 327670 DEPOSIT ABSOLUTE MONOTONY MON_INCREASE /end AXIS_DESCR
 /begin AXIS_DESCR STD_AXIS iMoeMesaf.me_sas_gesp UMR_NM__1_1_0_S6_S3 4 0 2000 DEPOSIT ABSOLUTE MONOTONY MON_INCREASE /end AXIS_DESCR
/end CHARACTERISTIC
/begin CHARACTERISTIC KF_FMENACHPOSESP53 "Faktor fuer Reduzierung pos ME bei RS" MAP 0x2319B4 kf_si16_S6_S3 1 UMR___1_100_0_S6_S3 0 1
 /begin AXIS_DESCR STD_AXIS iMoeMesaf.timer_tsyn_rampe_pos UMR_MSEC__10_1_0_S6_S3 4 -50000 50000 DEPOSIT ABSOLUTE MONOTONY MON_INCREASE /end AXIS_DESCR
 /begin AXIS_DESCR STD_AXIS iMoeMesaf.me_sas_gesp UMR_NM__1_1_0_S6_S3 4 0 2000 DEPOSIT ABSOLUTE MONOTONY MON_INCREASE /end AXIS_DESCR
/end CHARACTERISTIC
/begin CHARACTERISTIC T_RAMEESP63 "Dauer Rampe ME bei Schaltungsende" VALUE 0x26E5C9 kw_ui8_S6_S3 2540 UMR_MSEC__10_1_0_S6_S3 0 2540 /end CHARACTERISTIC
/begin CHARACTERISTIC T_RAMEESP63_EL "Dauer Rampe ME bei Schaltungsende" VALUE 0x26E5CA kw_ui8_S6_S3 2540 UMR_MSEC__10_1_0_S6_S3 0 2540 /end CHARACTERISTIC
/begin CHARACTERISTIC KL_FMENACHESP63 "Faktor fuer Rampe Ende Nach-ME bei RS" CURVE 0x2319EC kl_ui8_S6_S3 1 UMR___1_100_0_S6_S3 0 1
 /begin AXIS_DESCR STD_AXIS iMoeMesaf.timer_zmes UMR_MSEC__10_1_0_S6_S3 4 0 2550 DEPOSIT ABSOLUTE MONOTONY MON_INCREASE /end AXIS_DESCR
/end CHARACTERISTIC
/begin CHARACTERISTIC T_SYNMENACHESP63 "Zeit vor/nach Erkennen synchron fuer Ende Nach-ME" VALUE 0x26E5CB kw_ui8_S6_S3 2550 UMR_MSEC__10_1_M128_S6_S3 -1280 1270 /end CHARACTERISTIC
/begin CHARACTERISTIC T_SYNMENACHESP63_EL "Zeit vor/nach Erkennen synchron fuer Ende Nach-ME" VALUE 0x26E5CC kw_ui8_S6_S3 2550 UMR_MSEC__10_1_M128_S6_S3 -1280 1270 /end CHARACTERISTIC
/begin CHARACTERISTIC KF_TSYNMENACHASP63 "Zeit vor Erkennen synchron fuer Ende Haupt-ME und Start Nach-ME" MAP 0x2319F8 kf_ui8_S6_S3 1280 UMR_MSEC__10_1_M128_S6_S3 -1280 0
 /begin AXIS_DESCR STD_AXIS zff_atsys._.iSignale._.obj.sig_n_mot8 UMR_U_MIN_32_1_0_S6_S3 4 0 8160 DEPOSIT ABSOLUTE MONOTONY MON_INCREASE /end AXIS_DESCR
 /begin AXIS_DESCR STD_AXIS zff_atsys._.iSignale._.obj.sig_m_t8 UMR_NM__8_1_M50_S6_S3 3 -400 1640 DEPOSIT ABSOLUTE MONOTONY MON_INCREASE /end AXIS_DESCR
/end CHARACTERISTIC
/begin CHARACTERISTIC KF_TSYNMENACHASP63_EL "Zeit vor Erkennen synchron fuer Ende Haupt-ME und Start Nach-ME" MAP 0x231A14 kf_ui8_S6_S3 1280 UMR_MSEC__10_1_M128_S6_S3 -1280 0
 /begin AXIS_DESCR STD_AXIS zff_atsys._.iSignale._.obj.sig_n_mot8 UMR_U_MIN_32_1_0_S6_S3 4 0 8160 DEPOSIT ABSOLUTE MONOTONY MON_INCREASE /end AXIS_DESCR
 /begin AXIS_DESCR STD_AXIS zff_atsys._.iSignale._.obj.sig_m_t8 UMR_NM__8_1_M50_S6_S3 3 -400 1640 DEPOSIT ABSOLUTE MONOTONY MON_INCREASE /end AXIS_DESCR
/end CHARACTERISTIC
/begin CHARACTERISTIC KF_MENACHSP63 "Nachmotoreingriff Schaltablauf" MAP 0x231A30 kf_ui8_S6_S3 870 UMR_NM__6_1_M145_S6_S3 -870 0
 /begin AXIS_DESCR STD_AXIS iSasZentr.iSchaltend.n_tkf UMR_U_MIN_32_1_0_S6_S3 6 0 8160 DEPOSIT ABSOLUTE MONOTONY MON_INCREASE /end AXIS_DESCR
 /begin AXIS_DESCR STD_AXIS zff_atsys._.iSignale._.obj.sig_m_t8 UMR_NM__8_1_M50_S6_S3 6 -400 1640 DEPOSIT ABSOLUTE MONOTONY MON_INCREASE /end AXIS_DESCR
/end CHARACTERISTIC
/begin CHARACTERISTIC KF_MENACHSP63_EL "Nachmotoreingriff Schaltablauf" MAP 0x231A68 kf_ui8_S6_S3 870 UMR_NM__6_1_M145_S6_S3 -870 0
 /begin AXIS_DESCR STD_AXIS iSasZentr.iSchaltend.n_tkf UMR_U_MIN_32_1_0_S6_S3 6 0 8160 DEPOSIT ABSOLUTE MONOTONY MON_INCREASE /end AXIS_DESCR
 /begin AXIS_DESCR STD_AXIS zff_atsys._.iSignale._.obj.sig_m_t8 UMR_NM__8_1_M50_S6_S3 6 -400 1640 DEPOSIT ABSOLUTE MONOTONY MON_INCREASE /end AXIS_DESCR
/end CHARACTERISTIC
/begin CHARACTERISTIC KF_FMTMEHAUPTASP63 "Faktor fuer Rampe auf HME bei RS" MAP 0x231AA0 kf_ui8_S6_S3 1 UMR___1_100_0_S6_S3 0 1
 /begin AXIS_DESCR STD_AXIS iMoeMesaf.timer_zmes UMR_MSEC__10_1_0_S6_S3 4 0 2550 DEPOSIT ABSOLUTE MONOTONY MON_INCREASE /end AXIS_DESCR
 /begin AXIS_DESCR STD_AXIS zff_atsys._.iSignale._.obj.sig_m_t8 UMR_NM__8_1_M50_S6_S3 4 -400 1640 DEPOSIT ABSOLUTE MONOTONY MON_INCREASE /end AXIS_DESCR
/end CHARACTERISTIC
/begin CHARACTERISTIC KF_MEHAUPTSP63 "Wert Hauptmotoreingriff" MAP 0x231AC0 kf_ui8_S6_S3 1530 UMR_NM__6_1_M145_S6_S3 -870 660
 /begin AXIS_DESCR STD_AXIS NO_INPUT_QUANTITY UMR_U_MIN_32_1_0_S6_S3 6 0 8160 DEPOSIT ABSOLUTE MONOTONY MON_INCREASE /end AXIS_DESCR
 /begin AXIS_DESCR STD_AXIS zff_atsys._.iSignale._.obj.sig_m_t8 UMR_NM__8_1_M50_S6_S3 10 -400 1640 DEPOSIT ABSOLUTE MONOTONY MON_INCREASE /end AXIS_DESCR
/end CHARACTERISTIC
/begin CHARACTERISTIC KF_MEHAUPTSP63_EL "Wert Hauptmotoreingriff" MAP 0x231B14 kf_ui8_S6_S3 1530 UMR_NM__6_1_M145_S6_S3 -870 660
 /begin AXIS_DESCR STD_AXIS NO_INPUT_QUANTITY UMR_U_MIN_32_1_0_S6_S3 6 0 8160 DEPOSIT ABSOLUTE MONOTONY MON_INCREASE /end AXIS_DESCR
 /begin AXIS_DESCR STD_AXIS zff_atsys._.iSignale._.obj.sig_m_t8 UMR_NM__8_1_M50_S6_S3 10 -400 1640 DEPOSIT ABSOLUTE MONOTONY MON_INCREASE /end AXIS_DESCR
/end CHARACTERISTIC
/begin CHARACTERISTIC KF_TVMTNMOTMEHAUPTSP63 "Verzoegerungszeit Start Haupt-ME bei Momentenerhoehung" MAP 0x231B68 kf_ui8_S6_S3 2540 UMR_MSEC__10_1_0_S6_S3 0 2540
 /begin AXIS_DESCR STD_AXIS zff_atsys._.iSignale._.obj.sig_m_t8 UMR_NM__8_1_M50_S6_S3 4 -400 1640 DEPOSIT ABSOLUTE MONOTONY MON_INCREASE /end AXIS_DESCR
 /begin AXIS_DESCR STD_AXIS zff_atsys._.iSignale._.obj.sig_n_mot8 UMR_U_MIN_32_1_0_S6_S3 4 0 8160 DEPOSIT ABSOLUTE MONOTONY MON_INCREASE /end AXIS_DESCR
/end CHARACTERISTIC
/begin CHARACTERISTIC KL_FMEPOSNGABSP63 "Faktor zur Gewichtung pos. ME" CURVE 0x231B88 kl_si16_S6_S3 1 UMR___1_100_0_S6_S3 0 1
 /begin AXIS_DESCR STD_AXIS iMoeMesaf.ng_abmesas UMR_U_MINSEC_1_1_0_S6_S3 6 -1000 1000 DEPOSIT ABSOLUTE MONOTONY MON_INCREASE /end AXIS_DESCR
/end CHARACTERISTIC
/begin CHARACTERISTIC KF_TSYNNTKFMTMEHAUPTESP63 "Zeitkriterium Ende Haupt-ME bei Momentenerhoehung" MAP 0x231BA4 kf_ui8_S6_S3 1280 UMR_MSEC__10_1_M128_S6_S3 -1280 0
 /begin AXIS_DESCR STD_AXIS iSasZentr.iSchaltend.n_tkf UMR_U_MIN_32_1_0_S6_S3 4 0 8160 DEPOSIT ABSOLUTE MONOTONY MON_INCREASE /end AXIS_DESCR
 /begin AXIS_DESCR STD_AXIS zff_atsys._.iSignale._.obj.sig_m_t8 UMR_NM__8_1_M50_S6_S3 4 -400 1640 DEPOSIT ABSOLUTE MONOTONY MON_INCREASE /end AXIS_DESCR
/end CHARACTERISTIC
/begin CHARACTERISTIC KF_FMESASMEHAUPTPOSESP63 "Faktor fuer Reduzierung pos ME bei RS" MAP 0x231BC4 kf_si16_S6_S3 1 UMR___1_100_0_S6_S3 0 1
 /begin AXIS_DESCR STD_AXIS iSasZentr.iSchaltend.t_syn UMR_MSEC__10_1_0_S6_S3 4 -327680 327670 DEPOSIT ABSOLUTE MONOTONY MON_INCREASE /end AXIS_DESCR
 /begin AXIS_DESCR STD_AXIS iMoeMesaf.me_sas_gesp UMR_NM__1_1_0_S6_S3 4 0 2000 DEPOSIT ABSOLUTE MONOTONY MON_INCREASE /end AXIS_DESCR
/end CHARACTERISTIC
/begin CHARACTERISTIC KF_FMENACHPOSESP63 "Faktor fuer Reduzierung pos ME bei RS" MAP 0x231BFC kf_si16_S6_S3 1 UMR___1_100_0_S6_S3 0 1
 /begin AXIS_DESCR STD_AXIS iMoeMesaf.timer_tsyn_rampe_pos UMR_MSEC__10_1_0_S6_S3 4 -50000 50000 DEPOSIT ABSOLUTE MONOTONY MON_INCREASE /end AXIS_DESCR
 /begin AXIS_DESCR STD_AXIS iMoeMesaf.me_sas_gesp UMR_NM__1_1_0_S6_S3 4 0 2000 DEPOSIT ABSOLUTE MONOTONY MON_INCREASE /end AXIS_DESCR
/end CHARACTERISTIC
/begin COMPU_METHOD SAB_PROZENT_S2_S3 "int = ((phys * 1) / 1) - (0) %" RAT_FUNC "%2.0" "%" COEFFS 0 1 -0 0 0 1 /end COMPU_METHOD
/begin COMPU_METHOD SAB_255PROZENT800_S2_S3 "int = ((phys * 255) / 800) - (0) %" RAT_FUNC "%5.3" "%" COEFFS 0 255 -0 0 0 800 /end COMPU_METHOD
/begin COMPU_METHOD SAB_39PROZENT100_S2_S3 "int = ((phys * 100) / 39) - (0) %" RAT_FUNC "%5.3" "%" COEFFS 0 100 -0 0 0 39 /end COMPU_METHOD
/begin COMPU_METHOD SAB_12PROZENT100_S2_S3 "int = ((phys * 100) / 12) - (0) %" RAT_FUNC "%5.3" "%" COEFFS 0 100 -0 0 0 12 /end COMPU_METHOD
/begin COMPU_METHOD SAB_16PROZENT10_S2_S3 "int = ((phys * 10) / 16) - (0) %" RAT_FUNC "%5.3" "%" COEFFS 0 10 -0 0 0 16 /end COMPU_METHOD
/begin COMPU_METHOD SAB_16PROZENT10000_S2_S3 "int = ((phys * 10000) / 16) - (0) %" RAT_FUNC "%5.3" "%" COEFFS 0 10000 -0 0 0 16 /end COMPU_METHOD
/begin COMPU_METHOD UMR___1_1000_0_S6_S3 "int = ((phys * 1000) / 1) - (0) [-]" RAT_FUNC "%5.3" "[-]" COEFFS 0 1000 -0 0 0 1 /end COMPU_METHOD
/begin COMPU_METHOD UMR___1_100_0_S6_S3 "int = ((phys * 100) / 1) - (0) [-]" RAT_FUNC "%4.2" "[-]" COEFFS 0 100 -0 0 0 1 /end COMPU_METHOD
/begin COMPU_METHOD UMR_NM__1_1_0_S6_S3 "int = ((phys * 1) / 1) - (0) [Nm]" RAT_FUNC "%2.0" "[Nm]" COEFFS 0 1 -0 0 0 1 /end COMPU_METHOD
/begin COMPU_METHOD UMR_NM__6_1_M145_S6_S3 "int = ((phys * 1) / 6) - (-145) [Nm]" RAT_FUNC "%2.0" "[Nm]" COEFFS 0 1 870 0 0 6 /end COMPU_METHOD
/begin COMPU_METHOD UMR_NM__8_1_M50_S6_S3 "int = ((phys * 1) / 8) - (-50) [Nm]" RAT_FUNC "%2.0" "[Nm]" COEFFS 0 1 400 0 0 8 /end COMPU_METHOD
/begin COMPU_METHOD UMR_U_MIN_1_1_0_S6_S3 "int = ((phys * 1) / 1) - (0) [U/min]" RAT_FUNC "%2.0" "[U/min]" COEFFS 0 1 -0 0 0 1 /end COMPU_METHOD
/begin COMPU_METHOD UMR_U_MIN_32_1_0_S6_S3 "int = ((phys * 1) / 32) - (0) [U/min]" RAT_FUNC "%2.0" "[U/min]" COEFFS 0 1 -0 0 0 32 /end COMPU_METHOD
/begin COMPU_METHOD UMR_U_MINSEC_1_1_0_S6_S3 "int = ((phys * 1) / 1) - (0) [U/(min*s)]" RAT_FUNC "%2.0" "[U/(min*s)]" COEFFS 0 1 -0 0 0 1 /end COMPU_METHOD
/begin COMPU_METHOD UMR_MSEC__1_1_0_S6_S3 "int = ((phys * 1) / 1) - (0) [ms]" RAT_FUNC "%2.0" "[ms]" COEFFS 0 1 -0 0 0 1 /end COMPU_METHOD
/begin COMPU_METHOD UMR_MSEC__10_1_0_S6_S3 "int = ((phys * 1) / 10) - (0) [ms]" RAT_FUNC "%2.0" "[ms]" COEFFS 0 1 -0 0 0 10 /end COMPU_METHOD
/begin COMPU_METHOD UMR_MSEC__10_1_M128_S6_S3 "int = ((phys * 1) / 10) - (-128) [ms]" RAT_FUNC "%2.0" "[ms]" COEFFS 0 1 1280 0 0 10 /end COMPU_METHOD
/begin COMPU_METHOD UMR_MSEC__10_1_M255_S6_S3 "int = ((phys * 1) / 10) - (-255) [ms]" RAT_FUNC "%2.0" "[ms]" COEFFS 0 1 2550 0 0 10 /end COMPU_METHOD
/begin COMPU_METHOD UMR_GRADC__1_1_M40_S6_S3 "int = ((phys * 1) / 1) - (-40) [°C]" RAT_FUNC "%2.0" "[°C]" COEFFS 0 1 40 0 0 1 /end COMPU_METHOD
/begin COMPU_METHOD UMR_GRADC__1_1_M48_S6_S3 "int = ((phys * 1) / 1) - (-48) [°C]" RAT_FUNC "%2.0" "[°C]" COEFFS 0 1 48 0 0 1 /end COMPU_METHOD
/begin COMPU_METHOD UMR_PROZENT__20_51_0_S6_S3 "int = ((phys * 51) / 20) - (0) [%]" RAT_FUNC "%6.4" "[%]" COEFFS 0 51 -0 0 0 20 /end COMPU_METHOD
/begin FUNCTION jSasGloRSP331_Fktn "Applikationesgroessen Instanz jSasGloRSP331" /begin DEF_CHARACTERISTIC KF_TSYNCGMTHINSYNRASPORT31 KF_TSYNCGMTHINSYNSPORT31 /end DEF_CHARACTERISTIC /end FUNCTION
/begin FUNCTION jSasGloRSP342_Fktn "Applikationesgroessen Instanz jSasGloRSP342" /begin DEF_CHARACTERISTIC KF_TSYNCGMTHINSYNRASPORT42 KF_TSYNCGMTHINSYNSPORT42 /end DEF_CHARACTERISTIC /end FUNCTION
/begin FUNCTION jSasGloRSP351_Fktn "Applikationesgroessen Instanz jSasGloRSP351" /begin DEF_CHARACTERISTIC KF_TSYNCGMTHINSYNRASPORT51 KF_TSYNCGMTHINSYNSPORT51 /end DEF_CHARACTERISTIC /end FUNCTION
/begin FUNCTION jSasGloRSP353_Fktn "Applikationesgroessen Instanz jSasGloRSP353" /begin DEF_CHARACTERISTIC KF_TSYNCGMTHINSYNRASPORT53 KF_TSYNCGMTHINSYNSPORT53 /end DEF_CHARACTERISTIC /end FUNCTION
/begin FUNCTION jSasGloRSP363_Fktn "Applikationesgroessen Instanz jSasGloRSP363" /begin DEF_CHARACTERISTIC KF_TSYNCGMTHINSYNRASPORT63 KF_TSYNCGMTHINSYNSPORT63 /end DEF_CHARACTERISTIC /end FUNCTION
/begin FUNCTION jSasGloRSP364_Fktn "Applikationesgroessen Instanz jSasGloRSP364" /begin DEF_CHARACTERISTIC KF_TSYNCGMTHINSYNRASPORT64 KF_TSYNCGMTHINSYNSPORT64 /end DEF_CHARACTERISTIC /end FUNCTION
/begin FUNCTION jSasGloRSP371_Fktn "Applikationesgroessen Instanz jSasGloRSP371" /begin DEF_CHARACTERISTIC KF_TSYNCGMTHINSYNRASPORT71 KF_TSYNCGMTHINSYNSPORT71 /end DEF_CHARACTERISTIC /end FUNCTION
/begin FUNCTION jSasGloRSP375_Fktn "Applikationesgroessen Instanz jSasGloRSP375" /begin DEF_CHARACTERISTIC KF_TSYNCGMTHINSYNRASPORT75 KF_TSYNCGMTHINSYNSPORT75 /end DEF_CHARACTERISTIC /end FUNCTION
/begin FUNCTION jSasGloRSP382_Fktn "Applikationesgroessen Instanz jSasGloRSP382" /begin DEF_CHARACTERISTIC KF_TSYNCGMTHINSYNRASPORT82 KF_TSYNCGMTHINSYNSPORT82 /end DEF_CHARACTERISTIC /end FUNCTION
/begin FUNCTION jSasGloRSP384_Fktn "Applikationesgroessen Instanz jSasGloRSP384" /begin DEF_CHARACTERISTIC KF_TSYNCGMTHINSYNRASPORT84 KF_TSYNCGMTHINSYNSPORT84 /end DEF_CHARACTERISTIC /end FUNCTION
/begin FUNCTION jSasGloRSP386_Fktn "Applikationesgroessen Instanz jSasGloRSP386" /begin DEF_CHARACTERISTIC KF_TSYNCGMTHINSYNRASPORT86 KF_TSYNCGMTHINSYNSPORT86 /end DEF_CHARACTERISTIC /end FUNCTION
/begin FUNCTION dMoeSasHSS_Fktn "Applikationesgroessen der Komponente dMoeSasHSS"
 /begin SUB_FUNCTION jMoeSasHSS12_Fktn jMoeSasHSS23_Fktn jMoeSasHSS34_Fktn jMoeSasHSS45_Fktn jMoeSasHSS56_Fktn jMoeSasHSS67_Fktn jMoeSasHSS78_Fktn jMoeSasHSS13_Fktn jMoeSasHSS24_Fktn jMoeSasHSS35_Fktn jMoeSasHSS46_Fktn jMoeSasHSS57_Fktn jMoeSasHSS68_Fktn /end SUB_FUNCTION
/end FUNCTION
/begin FUNCTION jMoeSasHSS12_Fktn "Applikationesgroessen Instanz jMoeSasHSS12"
 /begin DEF_CHARACTERISTIC KF_MEKREDCMMT12 KF_MEKREDCMMT12_EL KF_TSYNMTNMOTMEHAUPTA12 KF_TSYNMTNMOTMEHAUPTA_LRHS12 KF_ZWME12 KL_FMEHAUPTPOSE12 KL_MEKPOSCM12 KL_TSYNMEHAUPTPOSE12 K_FMEHAUPTPOSA12 MS_TSSCHR12 T_FMEHAUPTPOSA12 T_RAMEE12 /end DEF_CHARACTERISTIC
/end FUNCTION
/begin FUNCTION jMoeSasHSS23_Fktn "Applikationesgroessen Instanz jMoeSasHSS23"
 /begin DEF_CHARACTERISTIC KF_MEKREDCMMT23 KF_MEKREDCMMT23_EL KF_TSYNMTNMOTMEHAUPTA23 KF_TSYNMTNMOTMEHAUPTA_LRHS23 KF_ZWME23 KL_FMEHAUPTPOSE23 KL_MEKPOSCM23 KL_TSYNMEHAUPTPOSE23 K_FMEHAUPTPOSA23 MS_TSSCHR23 T_FMEHAUPTPOSA23 T_RAMEE23 /end DEF_CHARACTERISTIC
/end FUNCTION
/begin FUNCTION jMoeSasHSS34_Fktn "Applikationesgroessen Instanz jMoeSasHSS34"
 /begin DEF_CHARACTERISTIC KF_MEKREDCMMT34 KF_MEKREDCMMT34_EL KF_TSYNMTNMOTMEHAUPTA34 KF_TSYNMTNMOTMEHAUPTA_LRHS34 KF_ZWME34 KL_FMEHAUPTPOSE34 KL_MEKPOSCM34 KL_TSYNMEHAUPTPOSE34 K_FMEHAUPTPOSA34 MS_TSSCHR34 T_FMEHAUPTPOSA34 T_RAMEE34 /end DEF_CHARACTERISTIC
/end FUNCTION
/begin FUNCTION jMoeSasHSS45_Fktn "Applikationesgroessen Instanz jMoeSasHSS45"
 /begin DEF_CHARACTERISTIC KF_MEKREDCMMT45 KF_MEKREDCMMT45_EL KF_TSYNMTNMOTMEHAUPTA45 KF_TSYNMTNMOTMEHAUPTA_LRHS45 KF_ZWME45 KL_FMEHAUPTPOSE45 KL_MEKPOSCM45 KL_TSYNMEHAUPTPOSE45 K_FMEHAUPTPOSA45 MS_TSSCHR45 T_FMEHAUPTPOSA45 T_RAMEE45 /end DEF_CHARACTERISTIC
/end FUNCTION
/begin FUNCTION jMoeSasHSS56_Fktn "Applikationesgroessen Instanz jMoeSasHSS56"
 /begin DEF_CHARACTERISTIC KF_MEKREDCMMT56 KF_MEKREDCMMT56_EL KF_TSYNMTNMOTMEHAUPTA56 KF_TSYNMTNMOTMEHAUPTA_LRHS56 KF_ZWME56 KL_FMEHAUPTPOSE56 KL_MEKPOSCM56 KL_TSYNMEHAUPTPOSE56 K_FMEHAUPTPOSA56 MS_TSSCHR56 T_FMEHAUPTPOSA56 T_RAMEE56 /end DEF_CHARACTERISTIC
/end FUNCTION
/begin FUNCTION jMoeSasHSS67_Fktn "Applikationesgroessen Instanz jMoeSasHSS67"
 /begin DEF_CHARACTERISTIC KF_MEKREDCMMT67 KF_MEKREDCMMT67_EL KF_TSYNMTNMOTMEHAUPTA67 KF_TSYNMTNMOTMEHAUPTA_LRHS67 KF_ZWME67 KL_FMEHAUPTPOSE67 KL_MEKPOSCM67 KL_TSYNMEHAUPTPOSE67 K_FMEHAUPTPOSA67 MS_TSSCHR67 T_FMEHAUPTPOSA67 T_RAMEE67 /end DEF_CHARACTERISTIC
/end FUNCTION
/begin FUNCTION jMoeSasHSS78_Fktn "Applikationesgroessen Instanz jMoeSasHSS78"
 /begin DEF_CHARACTERISTIC KF_MEKREDCMMT78 KF_MEKREDCMMT78_EL KF_TSYNMTNMOTMEHAUPTA78 KF_TSYNMTNMOTMEHAUPTA_LRHS78 KF_ZWME78 KL_FMEHAUPTPOSE78 KL_MEKPOSCM78 KL_TSYNMEHAUPTPOSE78 K_FMEHAUPTPOSA78 MS_TSSCHR78 T_FMEHAUPTPOSA78 T_RAMEE78 /end DEF_CHARACTERISTIC
/end FUNCTION
/begin FUNCTION jMoeSasHSS13_Fktn "Applikationesgroessen Instanz jMoeSasHSS13"
 /begin DEF_CHARACTERISTIC KF_MEKREDCMMT13 KF_MEKREDCMMT13_EL KF_TSYNMTNMOTMEHAUPTA13 KF_TSYNMTNMOTMEHAUPTA_LRHS13 KF_ZWME13 KL_FMEHAUPTPOSE13 KL_MEKPOSCM13 KL_TSYNMEHAUPTPOSE13 K_FMEHAUPTPOSA13 MS_TSSCHR13 T_FMEHAUPTPOSA13 T_RAMEE13 /end DEF_CHARACTERISTIC
/end FUNCTION
/begin FUNCTION jMoeSasHSS24_Fktn "Applikationesgroessen Instanz jMoeSasHSS24"
 /begin DEF_CHARACTERISTIC KF_MEKREDCMMT24 KF_MEKREDCMMT24_EL KF_TSYNMTNMOTMEHAUPTA24 KF_TSYNMTNMOTMEHAUPTA_LRHS24 KF_ZWME24 KL_FMEHAUPTPOSE24 KL_MEKPOSCM24 KL_TSYNMEHAUPTPOSE24 K_FMEHAUPTPOSA24 MS_TSSCHR24 T_FMEHAUPTPOSA24 T_RAMEE24 /end DEF_CHARACTERISTIC
/end FUNCTION
/begin FUNCTION jMoeSasHSS35_Fktn "Applikationesgroessen Instanz jMoeSasHSS35"
 /begin DEF_CHARACTERISTIC KF_MEKREDCMMT35 KF_MEKREDCMMT35_EL KF_TSYNMTNMOTMEHAUPTA35 KF_TSYNMTNMOTMEHAUPTA_LRHS35 KF_ZWME35 KL_FMEHAUPTPOSE35 KL_MEKPOSCM35 KL_TSYNMEHAUPTPOSE35 K_FMEHAUPTPOSA35 MS_TSSCHR35 T_FMEHAUPTPOSA35 T_RAMEE35 /end DEF_CHARACTERISTIC
/end FUNCTION
/begin FUNCTION jMoeSasHSS46_Fktn "Applikationesgroessen Instanz jMoeSasHSS46"
 /begin DEF_CHARACTERISTIC KF_MEKREDCMMT46 KF_MEKREDCMMT46_EL KF_TSYNMTNMOTMEHAUPTA46 KF_TSYNMTNMOTMEHAUPTA_LRHS46 KF_ZWME46 KL_FMEHAUPTPOSE46 KL_MEKPOSCM46 KL_TSYNMEHAUPTPOSE46 K_FMEHAUPTPOSA46 MS_TSSCHR46 T_FMEHAUPTPOSA46 T_RAMEE46 /end DEF_CHARACTERISTIC
/end FUNCTION
/begin FUNCTION jMoeSasHSS57_Fktn "Applikationesgroessen Instanz jMoeSasHSS57"
 /begin DEF_CHARACTERISTIC KF_MEKREDCMMT57 KF_MEKREDCMMT57_EL KF_TSYNMTNMOTMEHAUPTA57 KF_TSYNMTNMOTMEHAUPTA_LRHS57 KF_ZWME57 KL_FMEHAUPTPOSE57 KL_MEKPOSCM57 KL_TSYNMEHAUPTPOSE57 K_FMEHAUPTPOSA57 MS_TSSCHR57 T_FMEHAUPTPOSA57 T_RAMEE57 /end DEF_CHARACTERISTIC
/end FUNCTION
/begin FUNCTION jMoeSasHSS68_Fktn "Applikationesgroessen Instanz jMoeSasHSS68"
 /begin DEF_CHARACTERISTIC KF_MEKREDCMMT68 KF_MEKREDCMMT68_EL KF_TSYNMTNMOTMEHAUPTA68 KF_TSYNMTNMOTMEHAUPTA_LRHS68 KF_ZWME68 KL_FMEHAUPTPOSE68 KL_MEKPOSCM68 KL_TSYNMEHAUPTPOSE68 K_FMEHAUPTPOSA68 MS_TSSCHR68 T_FMEHAUPTPOSA68 T_RAMEE68 /end DEF_CHARACTERISTIC
/end FUNCTION
/begin FUNCTION dMoeSasRSP_Fktn "Applikationesgroessen der Komponente dMoeSasRSP"
 /begin SUB_FUNCTION jMoeSasRSP121_Fktn jMoeSasRSP132_Fktn jMoeSasRSP143_Fktn jMoeSasRSP154_Fktn jMoeSasRSP165_Fktn jMoeSasRSP176_Fktn jMoeSasRSP187_Fktn jMoeSasRSP221_Fktn jMoeSasRSP232_Fktn jMoeSasRSP243_Fktn jMoeSasRSP254_Fktn jMoeSasRSP265_Fktn jMoeSasRSP276_Fktn jMoeSasRSP287_Fktn jMoeSasRSP231_Fktn jMoeSasRSP242_Fktn jMoeSasRSP251_Fktn jMoeSasRSP253_Fktn jMoeSasRSP263_Fktn jMoeSasRSP264_Fktn jMoeSasRSP271_Fktn jMoeSasRSP275_Fktn jMoeSasRSP282_Fktn jMoeSasRSP284_Fktn jMoeSasRSP286_Fktn jMoeSasRSP321_Fktn jMoeSasRSP332_Fktn jMoeSasRSP343_Fktn jMoeSasRSP354_Fktn jMoeSasRSP365_Fktn jMoeSasRSP376_Fktn jMoeSasRSP387_Fktn jMoeSasRSP331_Fktn jMoeSasRSP342_Fktn jMoeSasRSP351_Fktn jMoeSasRSP353_Fktn jMoeSasRSP363_Fktn jMoeSasRSP364_Fktn jMoeSasRSP371_Fktn jMoeSasRSP375_Fktn jMoeSasRSP382_Fktn jMoeSasRSP384_Fktn jMoeSasRSP386_Fktn /end SUB_FUNCTION
/end FUNCTION
/begin FUNCTION jMoeSasRSP121_Fktn "Applikationesgroessen Instanz jMoeSasRSP121"
 /begin DEF_CHARACTERISTIC KF_FMENACHPOSE21 KF_FMESASMEHAUPTPOSE21 KF_FMTMEHAUPTA21 KF_MEHAUPT21 KF_MEHAUPT21_EL KF_MENACH21 KF_MENACH21_EL KF_TSYNMENACHA21 KF_TSYNMENACHA21_EL KF_TSYNNTKFMTMEHAUPTE21 KF_TSYNNTKFMTMEHAUPTE21_EL KF_TVMTNMOTMEHAUPT21 KF_TVMTNMOTMEHAUPT21_EL KL_FMENACHE21 KL_FMEPOSNGAB21 T_RAMEE21 T_RAMEE21_EL T_SYNMENACHE21 T_SYNMENACHE21_EL /end DEF_CHARACTERISTIC
/end FUNCTION
/begin FUNCTION jMoeSasRSP132_Fktn "Applikationesgroessen Instanz jMoeSasRSP132"
 /begin DEF_CHARACTERISTIC KF_FMENACHPOSE32 KF_FMESASMEHAUPTPOSE32 KF_FMTMEHAUPTA32 KF_MEHAUPT32 KF_MEHAUPT32_EL KF_MENACH32 KF_MENACH32_EL KF_TSYNMENACHA32 KF_TSYNMENACHA32_EL KF_TSYNNTKFMTMEHAUPTE32 KF_TSYNNTKFMTMEHAUPTE32_EL KF_TVMTNMOTMEHAUPT32 KF_TVMTNMOTMEHAUPT32_EL KL_FMENACHE32 KL_FMEPOSNGAB32 T_RAMEE32 T_RAMEE32_EL T_SYNMENACHE32 T_SYNMENACHE32_EL /end DEF_CHARACTERISTIC
/end FUNCTION
/begin FUNCTION jMoeSasRSP143_Fktn "Applikationesgroessen Instanz jMoeSasRSP143"
 /begin DEF_CHARACTERISTIC KF_FMENACHPOSE43 KF_FMESASMEHAUPTPOSE43 KF_FMTMEHAUPTA43 KF_MEHAUPT43 KF_MEHAUPT43_EL KF_MENACH43 KF_MENACH43_EL KF_TSYNMENACHA43 KF_TSYNMENACHA43_EL KF_TSYNNTKFMTMEHAUPTE43 KF_TSYNNTKFMTMEHAUPTE43_EL KF_TVMTNMOTMEHAUPT43 KF_TVMTNMOTMEHAUPT43_EL KL_FMENACHE43 KL_FMEPOSNGAB43 T_RAMEE43 T_RAMEE43_EL T_SYNMENACHE43 T_SYNMENACHE43_EL /end DEF_CHARACTERISTIC
/end FUNCTION
/begin FUNCTION jMoeSasRSP154_Fktn "Applikationesgroessen Instanz jMoeSasRSP154"
 /begin DEF_CHARACTERISTIC KF_FMENACHPOSE54 KF_FMESASMEHAUPTPOSE54 KF_FMTMEHAUPTA54 KF_MEHAUPT54 KF_MEHAUPT54_EL KF_MENACH54 KF_MENACH54_EL KF_TSYNMENACHA54 KF_TSYNMENACHA54_EL KF_TSYNNTKFMTMEHAUPTE54 KF_TSYNNTKFMTMEHAUPTE54_EL KF_TVMTNMOTMEHAUPT54 KF_TVMTNMOTMEHAUPT54_EL KL_FMENACHE54 KL_FMEPOSNGAB54 T_RAMEE54 T_RAMEE54_EL T_SYNMENACHE54 T_SYNMENACHE54_EL /end DEF_CHARACTERISTIC
/end FUNCTION
/begin FUNCTION jMoeSasRSP165_Fktn "Applikationesgroessen Instanz jMoeSasRSP165"
 /begin DEF_CHARACTERISTIC KF_FMENACHPOSE65 KF_FMESASMEHAUPTPOSE65 KF_FMTMEHAUPTA65 KF_MEHAUPT65 KF_MEHAUPT65_EL KF_MENACH65 KF_MENACH65_EL KF_TSYNMENACHA65 KF_TSYNMENACHA65_EL KF_TSYNNTKFMTMEHAUPTE65 KF_TSYNNTKFMTMEHAUPTE65_EL KF_TVMTNMOTMEHAUPT65 KF_TVMTNMOTMEHAUPT65_EL KL_FMENACHE65 KL_FMEPOSNGAB65 T_RAMEE65 T_RAMEE65_EL T_SYNMENACHE65 T_SYNMENACHE65_EL /end DEF_CHARACTERISTIC
/end FUNCTION
/begin FUNCTION jMoeSasRSP176_Fktn "Applikationesgroessen Instanz jMoeSasRSP176"
 /begin DEF_CHARACTERISTIC KF_FMENACHPOSE76 KF_FMESASMEHAUPTPOSE76 KF_FMTMEHAUPTA76 KF_MEHAUPT76 KF_MEHAUPT76_EL KF_MENACH76 KF_MENACH76_EL KF_TSYNMENACHA76 KF_TSYNMENACHA76_EL KF_TSYNNTKFMTMEHAUPTE76 KF_TSYNNTKFMTMEHAUPTE76_EL KF_TVMTNMOTMEHAUPT76 KF_TVMTNMOTMEHAUPT76_EL KL_FMENACHE76 KL_FMEPOSNGAB76 T_RAMEE76 T_RAMEE76_EL T_SYNMENACHE76 T_SYNMENACHE76_EL /end DEF_CHARACTERISTIC
/end FUNCTION
/begin FUNCTION jMoeSasRSP187_Fktn "Applikationesgroessen Instanz jMoeSasRSP187"
 /begin DEF_CHARACTERISTIC KF_FMENACHPOSE87 KF_FMESASMEHAUPTPOSE87 KF_FMTMEHAUPTA87 KF_MEHAUPT87 KF_MEHAUPT87_EL KF_MENACH87 KF_MENACH87_EL KF_TSYNMENACHA87 KF_TSYNMENACHA87_EL KF_TSYNNTKFMTMEHAUPTE87 KF_TSYNNTKFMTMEHAUPTE87_EL KF_TVMTNMOTMEHAUPT87 KF_TVMTNMOTMEHAUPT87_EL KL_FMENACHE87 KL_FMEPOSNGAB87 T_RAMEE87 T_RAMEE87_EL T_SYNMENACHE87 T_SYNMENACHE87_EL /end DEF_CHARACTERISTIC
/end FUNCTION
/begin FUNCTION jMoeSasRSP221_Fktn "Applikationesgroessen Instanz jMoeSasRSP221"
 /begin DEF_CHARACTERISTIC KF_FMENACHPOSESP21 KF_FMESASMEHAUPTPOSESP21 KF_FMTMEHAUPTASP21 KF_MEHAUPTSP21 KF_MENACHSP21 KF_TSYNMENACHASP21 KF_TSYNNTKFMTMEHAUPTESP21 KF_TVMTNMOTMEHAUPTSP21 KL_FMENACHESP21 KL_FMEPOSNGABSP21 T_RAMEESP21 T_SYNMENACHESP21 /end DEF_CHARACTERISTIC
/end FUNCTION
/begin FUNCTION jMoeSasRSP232_Fktn "Applikationesgroessen Instanz jMoeSasRSP232"
 /begin DEF_CHARACTERISTIC KF_FMENACHPOSESP32 KF_FMESASMEHAUPTPOSESP32 KF_FMTMEHAUPTASP32 KF_MEHAUPTSP32 KF_MENACHSP32 KF_TSYNMENACHASP32 KF_TSYNNTKFMTMEHAUPTESP32 KF_TVMTNMOTMEHAUPTSP32 KL_FMENACHESP32 KL_FMEPOSNGABSP32 T_RAMEESP32 T_SYNMENACHESP32 /end DEF_CHARACTERISTIC
/end FUNCTION
/begin FUNCTION jMoeSasRSP243_Fktn "Applikationesgroessen Instanz jMoeSasRSP243"
 /begin DEF_CHARACTERISTIC KF_FMENACHPOSESP43 KF_FMESASMEHAUPTPOSESP43 KF_FMTMEHAUPTASP43 KF_MEHAUPTSP43 KF_MENACHSP43 KF_TSYNMENACHASP43 KF_TSYNNTKFMTMEHAUPTESP43 KF_TVMTNMOTMEHAUPTSP43 KL_FMENACHESP43 KL_FMEPOSNGABSP43 T_RAMEESP43 T_SYNMENACHESP43 /end DEF_CHARACTERISTIC
/end FUNCTION
/begin FUNCTION jMoeSasRSP254_Fktn "Applikationesgroessen Instanz jMoeSasRSP254"
 /begin DEF_CHARACTERISTIC KF_FMENACHPOSESP54 KF_FMESASMEHAUPTPOSESP54 KF_FMTMEHAUPTASP54 KF_MEHAUPTSP54 KF_MENACHSP54 KF_TSYNMENACHASP54 KF_TSYNNTKFMTMEHAUPTESP54 KF_TVMTNMOTMEHAUPTSP54 KL_FMENACHESP54 KL_FMEPOSNGABSP54 T_RAMEESP54 T_SYNMENACHESP54 /end DEF_CHARACTERISTIC
/end FUNCTION
/begin FUNCTION jMoeSasRSP265_Fktn "Applikationesgroessen Instanz jMoeSasRSP265"
 /begin DEF_CHARACTERISTIC KF_FMENACHPOSESP65 KF_FMESASMEHAUPTPOSESP65 KF_FMTMEHAUPTASP65 KF_MEHAUPTSP65 KF_MENACHSP65 KF_TSYNMENACHASP65 KF_TSYNNTKFMTMEHAUPTESP65 KF_TVMTNMOTMEHAUPTSP65 KL_FMENACHESP65 KL_FMEPOSNGABSP65 T_RAMEESP65 T_SYNMENACHESP65 /end DEF_CHARACTERISTIC
/end FUNCTION
/begin FUNCTION jMoeSasRSP276_Fktn "Applikationesgroessen Instanz jMoeSasRSP276"
 /begin DEF_CHARACTERISTIC KF_FMENACHPOSESP76 KF_FMESASMEHAUPTPOSESP76 KF_FMTMEHAUPTASP76 KF_MEHAUPTSP76 KF_MENACHSP76 KF_TSYNMENACHASP76 KF_TSYNNTKFMTMEHAUPTESP76 KF_TVMTNMOTMEHAUPTSP76 KL_FMENACHESP76 KL_FMEPOSNGABSP76 T_RAMEESP76 T_SYNMENACHESP76 /end DEF_CHARACTERISTIC
/end FUNCTION
/begin FUNCTION jMoeSasRSP287_Fktn "Applikationesgroessen Instanz jMoeSasRSP287"
 /begin DEF_CHARACTERISTIC KF_FMENACHPOSESP87 KF_FMESASMEHAUPTPOSESP87 KF_FMTMEHAUPTASP87 KF_MEHAUPTSP87 KF_MENACHSP87 KF_TSYNMENACHASP87 KF_TSYNNTKFMTMEHAUPTESP87 KF_TVMTNMOTMEHAUPTSP87 KL_FMENACHESP87 KL_FMEPOSNGABSP87 T_RAMEESP87 T_SYNMENACHESP87 /end DEF_CHARACTERISTIC
/end FUNCTION
/begin FUNCTION jMoeSasRSP231_Fktn "Applikationesgroessen Instanz jMoeSasRSP231"
 /begin DEF_CHARACTERISTIC KF_FMENACHPOSESP31 KF_FMESASMEHAUPTPOSESP31 KF_FMTMEHAUPTASP31 KF_MEHAUPTSP31 KF_MENACHSP31 KF_TSYNMENACHASP31 KF_TSYNNTKFMTMEHAUPTESP31 KF_TVMTNMOTMEHAUPTSP31 KL_FMENACHESP31 KL_FMEPOSNGABSP31 T_RAMEESP31 T_SYNMENACHESP31 /end DEF_CHARACTERISTIC
/end FUNCTION
/begin FUNCTION jMoeSasRSP242_Fktn "Applikationesgroessen Instanz jMoeSasRSP242"
 /begin DEF_CHARACTERISTIC KF_FMENACHPOSESP42 KF_FMESASMEHAUPTPOSESP42 KF_FMTMEHAUPTASP42 KF_MEHAUPTSP42 KF_MEHAUPTSP42_EL KF_MENACHSP42 KF_MENACHSP42_EL KF_TSYNMENACHASP42 KF_TSYNMENACHASP42_EL KF_TSYNNTKFMTMEHAUPTESP42 KF_TVMTNMOTMEHAUPTSP42 KL_FMENACHESP42 KL_FMEPOSNGABSP42 T_RAMEESP42 T_RAMEESP42_EL T_SYNMENACHESP42 T_SYNMENACHESP42_EL /end DEF_CHARACTERISTIC
/end FUNCTION
/begin FUNCTION jMoeSasRSP251_Fktn "Applikationesgroessen Instanz jMoeSasRSP251"
 /begin DEF_CHARACTERISTIC KF_FMENACHPOSESP51 KF_FMESASMEHAUPTPOSESP51 KF_FMTMEHAUPTASP51 KF_MEHAUPTSP51 KF_MENACHSP51 KF_TSYNMENACHASP51 KF_TSYNNTKFMTMEHAUPTESP51 KF_TVMTNMOTMEHAUPTSP51 KL_FMENACHESP51 KL_FMEPOSNGABSP51 T_RAMEESP51 T_SYNMENACHESP51 /end DEF_CHARACTERISTIC
/end FUNCTION
/begin FUNCTION jMoeSasRSP253_Fktn "Applikationesgroessen Instanz jMoeSasRSP253"
 /begin DEF_CHARACTERISTIC KF_FMENACHPOSESP53 KF_FMESASMEHAUPTPOSESP53 KF_FMTMEHAUPTASP53 KF_MEHAUPTSP53 KF_MEHAUPTSP53_EL KF_MENACHSP53 KF_MENACHSP53_EL KF_TSYNMENACHASP53 KF_TSYNMENACHASP53_EL KF_TSYNNTKFMTMEHAUPTESP53 KF_TVMTNMOTMEHAUPTSP53 KL_FMENACHESP53 KL_FMEPOSNGABSP53 T_RAMEESP53 T_RAMEESP53_EL T_SYNMENACHESP53 T_SYNMENACHESP53_EL /end DEF_CHARACTERISTIC
/end FUNCTION
/begin FUNCTION jMoeSasRSP263_Fktn "Applikationesgroessen Instanz jMoeSasRSP263"
 /begin DEF_CHARACTERISTIC KF_FMENACHPOSESP63 KF_FMESASMEHAUPTPOSESP63 KF_FMTMEHAUPTASP63 KF_MEHAUPTSP63 KF_MEHAUPTSP63_EL KF_MENACHSP63 KF_MENACHSP63_EL KF_TSYNMENACHASP63 KF_TSYNMENACHASP63_EL KF_TSYNNTKFMTMEHAUPTESP63 KF_TVMTNMOTMEHAUPTSP63 KL_FMENACHESP63 KL_FMEPOSNGABSP63 T_RAMEESP63 T_RAMEESP63_EL T_SYNMENACHESP63 T_SYNMENACHESP63_EL /end DEF_CHARACTERISTIC
/end FUNCTION
/begin RECORD_LAYOUT kw_ui8_S6_S3 FNC_VALUES 1 UBYTE COLUMN_DIR DIRECT /end RECORD_LAYOUT
/begin RECORD_LAYOUT kw_si16_S6_S3 FNC_VALUES 1 SWORD COLUMN_DIR DIRECT /end RECORD_LAYOUT
/begin RECORD_LAYOUT kl_ui8_S6_S3 FNC_VALUES 3 UBYTE COLUMN_DIR DIRECT AXIS_PTS_X 2 UBYTE INDEX_INCR DIRECT NO_AXIS_PTS_X 1 ULONG /end RECORD_LAYOUT
/begin RECORD_LAYOUT kl_si16_S6_S3 FNC_VALUES 3 SWORD COLUMN_DIR DIRECT AXIS_PTS_X 2 SWORD INDEX_INCR DIRECT NO_AXIS_PTS_X 1 ULONG /end RECORD_LAYOUT
/begin RECORD_LAYOUT kf_ui8_S6_S3 FNC_VALUES 5 UBYTE ROW_DIR DIRECT AXIS_PTS_X 3 UBYTE INDEX_INCR DIRECT AXIS_PTS_Y 4 UBYTE INDEX_INCR DIRECT NO_AXIS_PTS_X 1 ULONG NO_AXIS_PTS_Y 2 ULONG /end RECORD_LAYOUT
/begin RECORD_LAYOUT kf_si16_S6_S3 FNC_VALUES 5 SWORD ROW_DIR DIRECT AXIS_PTS_X 3 SWORD INDEX_INCR DIRECT AXIS_PTS_Y 4 SWORD INDEX_INCR DIRECT NO_AXIS_PTS_X 1 ULONG NO_AXIS_PTS_Y 2 ULONG /end RECORD_LAYOUT
/end MODULE
/end PROJECT
