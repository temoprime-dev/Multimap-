ASAP2_VERSION 1 51
/begin PROJECT _929_929 "Gen2_BMW_System_Supplier_Lib"
/begin HEADER "" VERSION "C_03_03" PROJECT_NO _929_929 /end HEADER
/begin MODULE DIM ""
/begin MOD_COMMON "" BYTE_ORDER MSB_FIRST ALIGNMENT_BYTE 1 ALIGNMENT_WORD 2 ALIGNMENT_LONG 4 ALIGNMENT_FLOAT32_IEEE 4 /end MOD_COMMON
/begin CHARACTERISTIC FK_MGMOT_HAS "Filterkoeffizient zur Berechnung Gradient Motormoment" VALUE 0x2648B8 FLOAT32_IEEE_COL_DIRECT_M_S7_S3 0 void_fl_M_S7_S3 0 1 /end CHARACTERISTIC
/begin CHARACTERISTIC FK_MGWUNSCHFPW_HAS "Filterkoeffizient zur Berechnung Gradient Fahrsollmoment" VALUE 0x2648BC FLOAT32_IEEE_COL_DIRECT_M_S7_S3 0 void_fl_M_S7_S3 0 1 /end CHARACTERISTIC
/begin CHARACTERISTIC FK_NDGK0_HAS "Filterkoeffizient zu Berechnung Gradient Differenzdrehzahl K0" VALUE 0x2648C0 FLOAT32_IEEE_COL_DIRECT_M_S7_S3 0 void_fl_M_S7_S3 0 1 /end CHARACTERISTIC
/begin CHARACTERISTIC FK_NGEM_ZUS "Filterkonstante zur Berechnung des EM-Drehzahlgradienten beim Zustart" VALUE 0x26D050 FLOAT32_IEEE_COL_DIRECT_M_S7_S3 0 void_fl_M_S7_S3 0 1 /end CHARACTERISTIC
/begin CHARACTERISTIC FK_NGVM_HAS "Filterkoeffizient zu Berechnung Gradient Differenzdrehzahl VM" VALUE 0x2648C4 FLOAT32_IEEE_COL_DIRECT_M_S7_S3 0 void_fl_M_S7_S3 0 1 /end CHARACTERISTIC
/begin CHARACTERISTIC FK_VGF_HAS "Filterkoeffizient zur Berechnung des Fahrzeuggeschwindigkeitsgradienten in der Hybridablaufsteuerung" VALUE 0x2648C8 FLOAT32_IEEE_COL_DIRECT_M_S7_S3 0 void_fl_M_S7_S3 0 1 /end CHARACTERISTIC
/begin CHARACTERISTIC K_KOLBENPOSK0BEF_ZST_ZUS "Wert der Kolbenposition zur Erkennung K0 befuellt im Zustand Zustarten beim Zustart" VALUE 0x26D060 FLOAT32_IEEE_COL_DIRECT_M_S7_S3 0 rel_int_p_M_S7_S3 0 100 /end CHARACTERISTIC
/begin CHARACTERISTIC K_VF_HAS "Faktor zur Berechnung der Fahrzeuggeschwindigkeit aus der Getriebeabtriebsdrehzahl in der Hybridablaufsteuerung ( 3,6 * Pi * r_dyn / (30 * i_achse) ) " VALUE 0x2648CC FLOAT32_IEEE_COL_DIRECT_M_S7_S3 0 void_fl_M_S7_S3 0 0.5 /end CHARACTERISTIC
/begin CHARACTERISTIC KF_FKMSTOERK0EM_ZUS_W "Filterkonstante beider PT1-Glieder der PT2 Filterung des K0-Stoermoments der EM-Ansteuerung beim Zustart" MAP 0x26AC80 FLOAT32_IEEE_COL_DIRECT_M_S7_S3 0 void_fl_M_S7_S3 0 1
 /begin AXIS_DESCR COM_AXIS c_getriebe_egs_in c_fl_M_S7_S3 8 -3.40282E+038 3.40282E+038 AXIS_PTS_REF KF_FKMSTOERK0EM_ZUS_X /end AXIS_DESCR
 /begin AXIS_DESCR COM_AXIS NO_INPUT_QUANTITY trq_fl_a_M_S7_S3 8 -3.40282E+038 3.40282E+038 AXIS_PTS_REF KF_FKMSTOERK0EM_ZUS_Y /end AXIS_DESCR
/end CHARACTERISTIC
/begin CHARACTERISTIC KF_INITTVSTATUSIEP_SBE_W "Initialisierung der Verzoegerungszeit von status_psysem_has" MAP 0x26ED86 UBYTE_COL_DIRECT_M_S7_S3 0 st_int_M_S7_S3 0 1
 /begin AXIS_DESCR COM_AXIS status_iep_in sts_int_M_S7_S3 5 0 255 AXIS_PTS_REF KF_INITTVSTATUSIEP_SBE_X /end AXIS_DESCR
 /begin AXIS_DESCR COM_AXIS NO_INPUT_QUANTITY sts_int_M_S7_S3 5 0 4 AXIS_PTS_REF KF_INITTVSTATUSIEP_SBE_Y /end AXIS_DESCR
/end CHARACTERISTIC
/begin CHARACTERISTIC KF_KMSTOERK0EMMOD_ZUS_W "Faktor zur Modifikation des K0-Stoermoments der EM-Ansteuerung in Abhaengigkeit des K0 Differenzdrehzahl und der EM-Drehzahl beim Zustart" MAP 0x26ADC0 FLOAT32_IEEE_COL_DIRECT_M_S7_S3 0 st_fl_M_S7_S3 0 2
 /begin AXIS_DESCR COM_AXIS nd_k0_in n_fl_M_S7_S3 10 -3.40282E+038 3.40282E+038 AXIS_PTS_REF KF_KMSTOERK0EMMOD_ZUS_X /end AXIS_DESCR
 /begin AXIS_DESCR COM_AXIS n_em_in n_fl_M_S7_S3 8 -3.40282E+038 3.40282E+038 AXIS_PTS_REF KF_KMSTOERK0EMMOD_ZUS_Y /end AXIS_DESCR
/end CHARACTERISTIC
/begin CHARACTERISTIC KF_MO_K0BEFUELL_NORM_CGET_ZUS_W "Momentoffset fuer die K0-Stoermomentberechnung waehrend einer normalen K0-Befuellung beim Zustart
" MAP 0x26B838 FLOAT32_IEEE_COL_DIRECT_M_S7_S3 0 trq_fl_a_M_S7_S3 0 1000
 /begin AXIS_DESCR COM_AXIS NO_INPUT_QUANTITY rel_fl_M_S7_S3 11 0 200 AXIS_PTS_REF KF_MO_K0BEFUELL_NORM_CGET_ZUS_X /end AXIS_DESCR
 /begin AXIS_DESCR COM_AXIS c_getriebe_egs_in c_fl_M_S7_S3 8 -50 200 AXIS_PTS_REF KF_MO_K0BEFUELL_NORM_CGET_ZUS_Y /end AXIS_DESCR
/end CHARACTERISTIC
/begin CHARACTERISTIC KF_MO_K0BEFUELL_OPT_CGET_ZUS_W "Momentoffset fuer die K0-Stoermomentberechnung waehrend einer optimierten K0-Befuellung beim Zustart
" MAP 0x26B9E4 FLOAT32_IEEE_COL_DIRECT_M_S7_S3 0 trq_fl_a_M_S7_S3 0 1000
 /begin AXIS_DESCR COM_AXIS NO_INPUT_QUANTITY rel_fl_M_S7_S3 11 0 200 AXIS_PTS_REF KF_MO_K0BEFUELL_OPT_CGET_ZUS_X /end AXIS_DESCR
 /begin AXIS_DESCR COM_AXIS c_getriebe_egs_in c_fl_M_S7_S3 8 -50 200 AXIS_PTS_REF KF_MO_K0BEFUELL_OPT_CGET_ZUS_Y /end AXIS_DESCR
/end CHARACTERISTIC
/begin CHARACTERISTIC KF_MO_K0BEFUELL_RED_CGET_ZUS_W "Momentoffset fuer die K0-Stoermomentberechnung waehrend einer reduzierten K0-Befuellung beim Zustart
" MAP 0x26BB90 FLOAT32_IEEE_COL_DIRECT_M_S7_S3 0 trq_fl_a_M_S7_S3 0 1000
 /begin AXIS_DESCR COM_AXIS NO_INPUT_QUANTITY rel_fl_M_S7_S3 11 0 200 AXIS_PTS_REF KF_MO_K0BEFUELL_RED_CGET_ZUS_X /end AXIS_DESCR
 /begin AXIS_DESCR COM_AXIS c_getriebe_egs_in c_fl_M_S7_S3 8 -50 200 AXIS_PTS_REF KF_MO_K0BEFUELL_RED_CGET_ZUS_Y /end AXIS_DESCR
/end CHARACTERISTIC
/begin CHARACTERISTIC KF_SCHALTART_ZUL_SVH_HAS_W "Festlegung der zulaessigen Schaltart der Schaltverhinderung der HAS in Abhaengigkeit des aktiven Ablaufs (255 = alle Schaltarten zulaessig, 0 = keine Schaltart zulaessig) - Bit-Codierung -> siehe Handbuch bzw. Kommentar zu status_schaltart_zul_svh_has  " MAP 0x26ECB1 UBYTE_COL_DIRECT_M_S7_S3 0 sts_int_M_S7_S3 0 255
 /begin AXIS_DESCR COM_AXIS st_ist_bz_has_stg sts_int_M_S7_S3 9 0 8 AXIS_PTS_REF KF_SCHALTART_ZUL_SVH_HAS_X /end AXIS_DESCR
 /begin AXIS_DESCR COM_AXIS st_ziel_bz_has_stg sts_int_M_S7_S3 9 0 8 AXIS_PTS_REF KF_SCHALTART_ZUL_SVH_HAS_Y /end AXIS_DESCR
/end CHARACTERISTIC
/begin CHARACTERISTIC KF_TVSTATUSIEP_SBE_W "Verzoegerungszeit fuer status_psysem_has" MAP 0x26E158 UWORD_COL_DIRECT_M_S7_S3 0 t_int_n_M_S7_S3 0 10
 /begin AXIS_DESCR COM_AXIS status_iep_in sts_int_M_S7_S3 5 0 4 AXIS_PTS_REF KF_TVSTATUSIEP_SBE_X /end AXIS_DESCR
 /begin AXIS_DESCR COM_AXIS NO_INPUT_QUANTITY sts_int_M_S7_S3 5 0 4 AXIS_PTS_REF KF_TVSTATUSIEP_SBE_Y /end AXIS_DESCR
/end CHARACTERISTIC
/begin CHARACTERISTIC KF_TVSTATUSIEPSST_SBE_W "Verzoegerungszeit fuer status_psysem_has bei Erkennung Erststart" MAP 0x26E126 UWORD_COL_DIRECT_M_S7_S3 0 t_int_n_M_S7_S3 0 10
 /begin AXIS_DESCR COM_AXIS status_iep_in sts_int_M_S7_S3 5 0 4 AXIS_PTS_REF KF_TVSTATUSIEPSST_SBE_X /end AXIS_DESCR
 /begin AXIS_DESCR COM_AXIS NO_INPUT_QUANTITY sts_int_M_S7_S3 5 0 4 AXIS_PTS_REF KF_TVSTATUSIEPSST_SBE_Y /end AXIS_DESCR
/end CHARACTERISTIC
/begin CHARACTERISTIC KL_KSVHRESETAUSZST_LA_SAK_ZUS_Y "Bedingtes Ruecksetzen einer Schaltverhinderung waehrend VM-Zustart im E-Fahr-Modus \"Ladung abbauen\" in Abhaengigkeit des Istgangs im Zustand SAK (255 = alle Arten von Schaltungen zuruecksetzen, 0 = keine Schaltung zuruecksetzen) ->Kodierung siehe Handbuch" CURVE 0x26CF54 UBYTE_COL_DIRECT_M_S7_S3 0 b_int_b_M_S7_S3 0 255
 /begin AXIS_DESCR COM_AXIS istgang_egs_in void_int_M_S7_S3 8 -128 127 AXIS_PTS_REF KL_KSVHRESETAUSZST_LA_SAK_ZUS_X /end AXIS_DESCR
/end CHARACTERISTIC
/begin CHARACTERISTIC KL_KSVHRESETAUSZST_LE_SAK_ZUS_Y "Bedingtes Ruecksetzen einer Schaltverhinderung waehrend VM-Zustart im E-Fahr-Modus \"Ladung erhalten\" in Abhaengigkeit des Istgangs im Zustand SAK(255 = alle Arten von Schaltungen zuruecksetzen, 0 = keine Schaltung zuruecksetzen)->Kodierung siehe Handbuch" CURVE 0x26CF64 UBYTE_COL_DIRECT_M_S7_S3 0 b_int_b_M_S7_S3 0 255
 /begin AXIS_DESCR COM_AXIS istgang_egs_in void_int_M_S7_S3 8 -128 127 AXIS_PTS_REF KL_KSVHRESETAUSZST_LE_SAK_ZUS_X /end AXIS_DESCR
/end CHARACTERISTIC
/begin CHARACTERISTIC KL_MOMAXDYNEM_LASTANH_SVH_HAS_Y "Momentenoffset zur Erkennung Lastanhe-bung in Relation zum maximalen dynami-schen EM Moment des Status des Lastaen-derungszustands der Schaltverhinderung der HAS" CURVE 0x264770 FLOAT32_IEEE_COL_DIRECT_M_S7_S3 0 trq_fl_a_M_S7_S3 -1000 1000
 /begin AXIS_DESCR COM_AXIS mg_wunsch_fpw_in trqg_fl_k_M_S7_S3 8 -3.40282E+038 3.40282E+038 AXIS_PTS_REF KL_MOMAXDYNEM_LASTANH_SVH_HAS_X /end AXIS_DESCR
/end CHARACTERISTIC
/begin CHARACTERISTIC KL_MPTNT_SBE_Y "Filterkonstante fuer die Turbinendrehzahl abhaengig von Fahrsollmoment" CURVE 0x2647B0 FLOAT32_IEEE_COL_DIRECT_M_S7_S3 0 n_fl_M_S7_S3 0 5
 /begin AXIS_DESCR COM_AXIS m_wunsch_fpw_in trq_fl_a_M_S7_S3 8 -1000 1000 AXIS_PTS_REF KL_MPTNT_SBE_X /end AXIS_DESCR
/end CHARACTERISTIC
/begin CHARACTERISTIC KL_MSOLLK0MINBEFUVS_ZST_ZUS_Y "Minimalwert des K0 Sollmoment waehrend der K0 Befuellung bei Anforderung einer K0-Unterstuetzung des VM Startsystems durch die HAS Zustandssteuerung (OML) in Abhaengigkeit der VM Abstellposition im Zustand Zustarten beim VM Zustart" CURVE 0x26CA80 FLOAT32_IEEE_COL_DIRECT_M_S7_S3 0 trq_fl_a_M_S7_S3 0 100
 /begin AXIS_DESCR COM_AXIS abstellpos_vm_in phigrad_fl_M_S7_S3 7 0 360 AXIS_PTS_REF KL_MSOLLK0MINBEFUVS_ZST_ZUS_X /end AXIS_DESCR
/end CHARACTERISTIC
/begin CHARACTERISTIC KL_MSSOLLEMAKTIV_ZUS_Y "Schwelle des K0-Stoermoments bzw. des EM-Sollmoments zur Aktivierung der Maximalzeit der Ausgabe des EM-Vorsteuermoments beim Zustart in Abhaengigkeit des Istgangs" CURVE 0x26CAEC FLOAT32_IEEE_COL_DIRECT_M_S7_S3 0 trq_fl_a_M_S7_S3 0 1000
 /begin AXIS_DESCR COM_AXIS NO_INPUT_QUANTITY sts_fl_M_S7_S3 10 -3.40282E+038 3.40282E+038 AXIS_PTS_REF KL_MSSOLLEMAKTIV_ZUS_X /end AXIS_DESCR
/end CHARACTERISTIC
/begin CHARACTERISTIC KL_MSSOLLK0BED_SYN_ZUS_Y "Schwelle des Sollmoments der K0, aber der ins Schliessen uebergegangen werden darf" CURVE 0x26CB34 FLOAT32_IEEE_COL_DIRECT_M_S7_S3 0 trq_fl_a_M_S7_S3 0 1000
 /begin AXIS_DESCR COM_AXIS m_ziel_vm_has_zus trq_fl_a_M_S7_S3 8 -3.40282E+038 3.40282E+038 AXIS_PTS_REF KL_MSSOLLK0BED_SYN_ZUS_X /end AXIS_DESCR
/end CHARACTERISTIC
/begin CHARACTERISTIC KL_NDGSK0SYNCERK_SYN_ZUS_Y "Maximaler Betrag des K0-Differenzdrehzahlgradienten zur Erkennung Synchron im Zustand K0 Synchronisieren beim Zustart in Abhaengigkeit des VM Zielmoments beim Zustart" CURVE 0x26CC9C FLOAT32_IEEE_COL_DIRECT_M_S7_S3 0 ng_fl_M_S7_S3 -10000 10000
 /begin AXIS_DESCR COM_AXIS m_ziel_vm_has_zus trq_fl_a_M_S7_S3 10 -3.40282E+038 3.40282E+038 AXIS_PTS_REF KL_NDGSK0SYNCERK_SYN_ZUS_X /end AXIS_DESCR
/end CHARACTERISTIC
/begin CHARACTERISTIC KL_NDSK0MAXSCHLBED_SRT_ZUS_Y "Maximale K0-Differenzdrehzahl fuer direkten uebergang nach K0-Schliessen bei Abbruch Abstellen in Abhaengigkeit der EM Drehzahl im Zustand Start beim Zustart" CURVE 0x26CD00 FLOAT32_IEEE_COL_DIRECT_M_S7_S3 0 n_fl_M_S7_S3 0 10000
 /begin AXIS_DESCR COM_AXIS n_em_in n_fl_M_S7_S3 5 -3.40282E+038 3.40282E+038 AXIS_PTS_REF KL_NDSK0MAXSCHLBED_SRT_ZUS_X /end AXIS_DESCR
/end CHARACTERISTIC
/begin CHARACTERISTIC KL_NDSK0MINSCHLBED_SRT_ZUS_Y "Minimale K0-Differenzdrehzahl fuer direkten uebergang nach K0-Schliessen bei Abbruch Abstellen in Abhaengigkeit der EM Drehzahl im Zustand Start beim Zustart" CURVE 0x26CD28 FLOAT32_IEEE_COL_DIRECT_M_S7_S3 0 n_fl_M_S7_S3 -10000 0
 /begin AXIS_DESCR COM_AXIS n_em_in n_fl_M_S7_S3 5 -3.40282E+038 3.40282E+038 AXIS_PTS_REF KL_NDSK0MINSCHLBED_SRT_ZUS_X /end AXIS_DESCR
/end CHARACTERISTIC
/begin CHARACTERISTIC KL_NMINEM_PSYS_LP3_HAS_Y "Mindestdrehzahl der EM zur Sicherstellung des Leistungspunkt 3 der Bestimmung des Status Systemdruck der HAS in Abhaengigkeit der Getrieboeltemperatur" CURVE 0x2647F0 FLOAT32_IEEE_COL_DIRECT_M_S7_S3 0 n_fl_M_S7_S3 0 10000
 /begin AXIS_DESCR COM_AXIS c_getriebe_egs_in c_fl_M_S7_S3 8 -60 215 AXIS_PTS_REF KL_NMINEM_PSYS_LP3_HAS_X /end AXIS_DESCR
/end CHARACTERISTIC
/begin CHARACTERISTIC KL_TFC_K0_OPT_ZUS_Y "Fuellausgleichzeit einer Optimierten K0-Befuellung zur Bestimmung des K0-Stoermoments beim Zustart in Abhaengigkeit der Getriebeoeltemperatur" CURVE 0x26CDE0 FLOAT32_IEEE_COL_DIRECT_M_S7_S3 0 t_fl_M_S7_S3 0 5
 /begin AXIS_DESCR COM_AXIS c_getriebe_egs_in c_fl_M_S7_S3 9 -50 200 AXIS_PTS_REF KL_TFC_K0_OPT_ZUS_X /end AXIS_DESCR
/end CHARACTERISTIC
/begin CHARACTERISTIC KL_TFC_K0_RED_ZUS_Y "Fuellausgleichzeit einer Reduzierten K0-Befuellung zur Bestimmung des K0-Stoermoments beim Zustart in Abhaengigkeit der Getriebeoeltemperatur" CURVE 0x26CE28 FLOAT32_IEEE_COL_DIRECT_M_S7_S3 0 t_fl_M_S7_S3 0 5
 /begin AXIS_DESCR COM_AXIS c_getriebe_egs_in c_fl_M_S7_S3 9 -50 200 AXIS_PTS_REF KL_TFC_K0_RED_ZUS_X /end AXIS_DESCR
/end CHARACTERISTIC
/begin CHARACTERISTIC KL_TFC_K0_ZUS_Y "Fuellausgleichzeit einer Standard K0-Befuellung zur Bestimmung des K0-Stoermoments beim Zustart in Abhaengigkeit der Getriebeoeltemperatur" CURVE 0x26CE70 FLOAT32_IEEE_COL_DIRECT_M_S7_S3 0 t_fl_M_S7_S3 0 5
 /begin AXIS_DESCR COM_AXIS c_getriebe_egs_in c_fl_M_S7_S3 9 -50 200 AXIS_PTS_REF KL_TFC_K0_ZUS_X /end AXIS_DESCR
/end CHARACTERISTIC
/begin CHARACTERISTIC KL_TVMSTOERK0EMFIL_ZUS_Y "Verzoegerungszeit nach Beginn der K0 Befuellung zur Aktivierung der Filterung des K0-Stoermoments der EM-Ansteuerung beim Zustart in Abhaengigkeit der Getriebeoeltemperatur" CURVE 0x26CEDC FLOAT32_IEEE_COL_DIRECT_M_S7_S3 0 t_fl_M_S7_S3 0 10
 /begin AXIS_DESCR COM_AXIS c_getriebe_egs_in c_fl_M_S7_S3 8 -3.40282E+038 3.40282E+038 AXIS_PTS_REF KL_TVMSTOERK0EMFIL_ZUS_X /end AXIS_DESCR
/end CHARACTERISTIC
/begin CHARACTERISTIC KL_TVSTATUSPSYSEM_LP3_HAS_Y "Verzoegerungszeit zum Setzten des Leistungspunkts 2 der Oelversorgung aus EM-Drehzahl in Abhaengigkeit der Getrieboeltemperatur" CURVE 0x264880 UWORD_COL_DIRECT_M_S7_S3 0 t_int_n_M_S7_S3 0 10
 /begin AXIS_DESCR COM_AXIS c_getriebe_egs_in c_int_v_M_S7_S3 8 -40 215 AXIS_PTS_REF KL_TVSTATUSPSYSEM_LP3_HAS_X /end AXIS_DESCR
/end CHARACTERISTIC
/begin CHARACTERISTIC KL_VDSFDDAERK1_RSE_HAS_Y "Fahrzeuggeschwindigkeitsdifferenzschwelle zur Erkennung von durchdrehenden Antriebsraedern in Abhaengigkeit der Fahrzeuggeschwindigkeit ueber Grund der Radschlupferkennung (RSE) der HAS" CURVE 0x264828 FLOAT32_IEEE_COL_DIRECT_M_S7_S3 0 v_fl_M_S7_S3 0 500
 /begin AXIS_DESCR COM_AXIS v_f_ref_in v_fl_M_S7_S3 6 0 500 AXIS_PTS_REF KL_VDSFDDAERK1_RSE_HAS_X /end AXIS_DESCR
/end CHARACTERISTIC
/begin CHARACTERISTIC KL_VDSFDDAERK2_RSE_HAS_Y "Fahrzeuggeschwindigkeitsdifferenzschwelle zum Ruecksetzen der Erkennung von durchdrehenden Antriebsraedern in Abhaengigkeit der Fahrzeuggeschwindigkeit ueber Grund der Radschlupferkennung (RSE) der HAS" CURVE 0x264858 FLOAT32_IEEE_COL_DIRECT_M_S7_S3 0 v_fl_M_S7_S3 0 500
 /begin AXIS_DESCR COM_AXIS v_f_ref_in v_fl_M_S7_S3 6 0 500 AXIS_PTS_REF KL_VDSFDDAERK2_RSE_HAS_X /end AXIS_DESCR
/end CHARACTERISTIC
/begin CHARACTERISTIC KL_ZMSOLLEMAKTIVSTKFL_ZUS_Y "Festlegung der Bedingung zur Aktivierung der Maximalzeit der Ausgabe des EM-Sollmoments beim Zustart in Abhaengigkeit des Status Kraftfluss" CURVE 0x26F1A0 UBYTE_COL_DIRECT_M_S7_S3 0 void_int_M_S7_S3 0 1
 /begin AXIS_DESCR COM_AXIS status_kraftfluss_egs_in sts_int_M_S7_S3 7 0 255 AXIS_PTS_REF KL_ZMSOLLEMAKTIVSTKFL_ZUS_X /end AXIS_DESCR
/end CHARACTERISTIC
/begin CHARACTERISTIC KL_ZVMSTARTABLVAR_SST_BFI_HAS_Y "Festlegung der VM-Startanforderung in Abhaengigkeit der Ablaufvariante der HAS innerhalb der Funktion zur Beeinflussung der IEP durch die HAS bei SST-Betaetigung" CURVE 0x264394 UBYTE_COL_DIRECT_M_S7_S3 0 void_int_M_S7_S3 0 1
 /begin AXIS_DESCR COM_AXIS z_ablaufvariante_has_stg sts_int_M_S7_S3 8 0 99 AXIS_PTS_REF KL_ZVMSTARTABLVAR_SST_BFI_HAS_X /end AXIS_DESCR
/end CHARACTERISTIC
/begin CHARACTERISTIC KL_ZVMSTARTVOREIL_SST_BFI_HAS_Y "Festlegung der voreilenden VM-Startanforderung in Abhaengigkeit der Ablaufvariante der HST innerhalb der Funktion zur Beeinflussung der IEP durch die HAS bei SST-Betaetigung" CURVE 0x2643A4 UBYTE_COL_DIRECT_M_S7_S3 0 void_int_M_S7_S3 0 1
 /begin AXIS_DESCR COM_AXIS z_ablaufvariante_has_hst_in sts_int_M_S7_S3 8 0 99 AXIS_PTS_REF KL_ZVMSTARTVOREIL_SST_BFI_HAS_X /end AXIS_DESCR
/end CHARACTERISTIC
/begin CHARACTERISTIC M_K0MAX_HAS "Maximalwert des K0-Istmoments der HAS" VALUE 0x2645DC FLOAT32_IEEE_COL_DIRECT_M_S7_S3 0 trq_fl_a_M_S7_S3 0 1000 /end CHARACTERISTIC
/begin CHARACTERISTIC M_SOLLK0MAX_HAS "Maximalwert des K0-Sollmoments der HAS" VALUE 0x2645F4 FLOAT32_IEEE_COL_DIRECT_M_S7_S3 0 trq_fl_a_M_S7_S3 0 1000 /end CHARACTERISTIC
/begin CHARACTERISTIC M_SOLLK0MININITUVS_ZST_ZUS "Minimalwert zur Initialisierung des K0 Sollmoment bei Anforderung einer K0-Unterstuetzung des VM Startsystems durch die HAS Zustandssteuerung (OML) im Zustand Zustarten beim VM Zustart" VALUE 0x26D11C FLOAT32_IEEE_COL_DIRECT_M_S7_S3 0 trq_fl_a_M_S7_S3 0 1000 /end CHARACTERISTIC
/begin CHARACTERISTIC M_SOLLK0UVS_ZST_ZUS "K0 Sollmoment bei Anforderung einer K0-Unterstuetzung des VM Startsystems durch die HAS Zustandssteuerung (OML) im Zustand Zustarten beim VM Zustart" VALUE 0x26D120 FLOAT32_IEEE_COL_DIRECT_M_S7_S3 0 trq_fl_a_M_S7_S3 0 1000 /end CHARACTERISTIC
/begin CHARACTERISTIC MG_SOLLK0UVSNEG_ZST_ZUS "Negativer Gradient des K0 Sollmoments bei Anforderung einer K0-Unterstuetzung des VM Startsystems durch die HAS Zustandssteuerung (OML) im Zustand Zustarten beim VM Zustart" VALUE 0x26D0D0 FLOAT32_IEEE_COL_DIRECT_M_S7_S3 0 trqg_fl_k_M_S7_S3 -10000 0 /end CHARACTERISTIC
/begin CHARACTERISTIC MG_SOLLK0UVSPOS_ZST_ZUS "Positiver Gradient des K0 Sollmoments bei Anforderung einer K0-Unterstuetzung des VM Startsystems durch die HAS Zustandssteuerung (OML) im Zustand Zustarten beim VM Zustart" VALUE 0x26D0D4 FLOAT32_IEEE_COL_DIRECT_M_S7_S3 0 trqg_fl_k_M_S7_S3 0 10000 /end CHARACTERISTIC
/begin CHARACTERISTIC MGO_WUNSCHFPW_LASTANH_SVH_HAS "Gradientenschwelle zur Bestimmung des Status des Lastaenderungszustands der Schaltverhinderung der HAS" VALUE 0x2648D0 FLOAT32_IEEE_COL_DIRECT_M_S7_S3 0 trqg_fl_k_M_S7_S3 0 60000 /end CHARACTERISTIC
/begin CHARACTERISTIC MGS_WUNSCHFPW_LASTANH_SVH_HAS "Gradientenschwelle zur Bestimmung des Status des Lastaenderungszustands der Schaltverhinderung der HAS" VALUE 0x2648D4 FLOAT32_IEEE_COL_DIRECT_M_S7_S3 0 trqg_fl_k_M_S7_S3 -30000 30000 /end CHARACTERISTIC
/begin CHARACTERISTIC MO_SOLLVMHSTBED_SCL_ZUS "Offset auf das VM-Sollmoment der HST zum Vergleich mit dem modifizierten K0-Moment der HAS als uebergangsbedingung nach uebergabe im Zustand K0-Schliessen beim Zustart" VALUE 0x26D0DC FLOAT32_IEEE_COL_DIRECT_M_S7_S3 0 trq_fl_a_M_S7_S3 -1000 1000 /end CHARACTERISTIC
/begin CHARACTERISTIC MO_SOLLVMLHSTBED_SCL_ZUS "Offset auf das VM-Luftpfadsollmoment der HST zum Vergleich mit dem modifizierten K0-Moment der HAS als uebergangsbedingung nach uebergabe im Zustand K0-Schliessen beim Zustart" VALUE 0x26D0E4 FLOAT32_IEEE_COL_DIRECT_M_S7_S3 0 trq_fl_a_M_S7_S3 -1000 1000 /end CHARACTERISTIC
/begin CHARACTERISTIC MO_WUNSCHFPW_ZUG_SVH_HAS "Offset zur Momentenschwelle zur Bestimmung des Status des Lastzustands Zug der Schaltverhinderung der HAS" VALUE 0x2648D8 FLOAT32_IEEE_COL_DIRECT_M_S7_S3 0 trq_fl_a_M_S7_S3 0 2000 /end CHARACTERISTIC
/begin CHARACTERISTIC MPT_MWUNSCHFPWHST "Filterkoeffizient Fahrerwunschmoment" VALUE 0x2648DC FLOAT32_IEEE_COL_DIRECT_M_S7_S3 0 void_fl_M_S7_S3 0 1 /end CHARACTERISTIC
/begin CHARACTERISTIC MS_K0BED_ABB_ZUS "K0-Momentenschwelle fuer den uebergang von Abbruch nach uebergabe" VALUE 0x26D0F4 FLOAT32_IEEE_COL_DIRECT_M_S7_S3 0 trq_fl_a_M_S7_S3 -1000 1000 /end CHARACTERISTIC
/begin CHARACTERISTIC MS_K0MINFUWKALTBED_ANH_ZUS "K0-Momentenschwelle bei aktiver FUW oder bei Kaltstart mit abgesenkter EM-Drehzahl als uebergangsbedingung nach K0 Schliessen im Zustand VM Drehzahlanhebung beim Zustart" VALUE 0x26D0F8 FLOAT32_IEEE_COL_DIRECT_M_S7_S3 0 trq_fl_a_M_S7_S3 -1000 1000 /end CHARACTERISTIC
/begin CHARACTERISTIC MS_K0MSTOERK0EMFIL_ZUS "K0-Momentenschwelle zur Initialisierung der Filterung des K0-Stoermoments der EM-Ansteuerung beim Zustart" VALUE 0x26D0FC FLOAT32_IEEE_COL_DIRECT_M_S7_S3 0 trq_fl_a_M_S7_S3 -1000 1000 /end CHARACTERISTIC
/begin CHARACTERISTIC MS_K0SCHLBED_SRT_ZUS "Momentenschwelle fuer K0 fuer direkten uebergang nach K0 schliessen bei Abbruch Abstellen" VALUE 0x26D100 FLOAT32_IEEE_COL_DIRECT_M_S7_S3 0 trq_fl_a_M_S7_S3 -1000 1000 /end CHARACTERISTIC
/begin CHARACTERISTIC MS_WUNSCHFPW_ZUG_SVH_HAS "Momentenschwelle zur Bestimmung des Status des Lastzustands Zug der Schaltverhinderung der HAS" VALUE 0x2648E0 FLOAT32_IEEE_COL_DIRECT_M_S7_S3 0 trq_fl_a_M_S7_S3 -1000 1000 /end CHARACTERISTIC
/begin CHARACTERISTIC MS_ZIELK0HSTMZIELVM_ZUS "Momentenschwelle des K0-Zielmoments der HST zur Verwendung des K0-Zielmoments als VM-Zielmoment beim Zustart" VALUE 0x26D110 FLOAT32_IEEE_COL_DIRECT_M_S7_S3 0 trq_fl_a_M_S7_S3 -1000 1000 /end CHARACTERISTIC
/begin CHARACTERISTIC NDGS_K0SYNCERK_SYN_ZUS "Minimaler K0-Differenzdrehzahlgradient (negativer Wert!) zur Erkennung Synchron im Zustand K0 Synchronisieren beim Zustart" VALUE 0x26D128 FLOAT32_IEEE_COL_DIRECT_M_S7_S3 0 ng_fl_M_S7_S3 -10000 10000 /end CHARACTERISTIC
/begin CHARACTERISTIC NDS_EMNSOLLLLVMBED_ABF_ZUS "Schwellwert der Differenzdrehzahl zwischen EM Drehzahl und VM LL-Soll-Drehzahl als uebergangsbedingung nach K0 Synchronisieren im Zustand VM Abfangen beim Zustart" VALUE 0x26D12C FLOAT32_IEEE_COL_DIRECT_M_S7_S3 0 n_fl_M_S7_S3 -10000 10000 /end CHARACTERISTIC
/begin CHARACTERISTIC NDS_EMNSOLLLLVMBED_ANH_ZUS "Schwellwert der Differenzdrehzahl zwischen EM Drehzahl und VM LL-Soll-Drehzahl als uebergangsbedingung nach K0 Synchronisieren im Zustand VM Drehzahlanhebung beim Zustart" VALUE 0x26D130 FLOAT32_IEEE_COL_DIRECT_M_S7_S3 0 n_fl_M_S7_S3 -10000 10000 /end CHARACTERISTIC
/begin CHARACTERISTIC NDS_K0K0SCHL_FUW_ZUS "K0 Differenzdrehzahlschwelle fuer den uebergang nach K0 Schliessen bei EM Fehlfunktion der Funktionsueberwachung der EM Funktion beim Zustart" VALUE 0x26D138 FLOAT32_IEEE_COL_DIRECT_M_S7_S3 0 n_fl_M_S7_S3 0 10000 /end CHARACTERISTIC
/begin CHARACTERISTIC NDS_K0KALTNEMBED_ANH_ZUS "K0-Differenzdrehzahlschwelle beim Kaltstart mit abgesenkter EM-Drehzahl als uebergangsbedingung nach K0 Schliessen im Zustand VM Drehzahlanhebung beim Zustart" VALUE 0x26D13C FLOAT32_IEEE_COL_DIRECT_M_S7_S3 0 n_fl_M_S7_S3 0 10000 /end CHARACTERISTIC
/begin CHARACTERISTIC NDS_SOLLVMNVMBED_ANH_ZUS "Schwellwert der Differenzdrehzahl zwischen ungefilterter VM Solldrehzahl und VM Ist-Drehzahl als uebergangsbedingung nach K0 Synchronisieren im Zustand Drehzahlanhebung beim Zustart" VALUE 0x26D154 FLOAT32_IEEE_COL_DIRECT_M_S7_S3 0 n_fl_M_S7_S3 0 10000 /end CHARACTERISTIC
/begin CHARACTERISTIC NDS_SYNCHRON_HAS "Differenzdrehzahlschwelle zur Plausibilisierung der Erkennung ob synchron erreicht ist" VALUE 0x2648E4 FLOAT32_IEEE_COL_DIRECT_M_S7_S3 0 n_fl_M_S7_S3 0 10000 /end CHARACTERISTIC
/begin CHARACTERISTIC NDS_VMNEMBED_ABF_ZUS "Schwellwert der Differenzdrehzahl zwischen VM und EM Drehzahl als uebergangsbedingung nach K0 Synchronisieren im Zustand VM Abfangen beim Zustart" VALUE 0x26D158 FLOAT32_IEEE_COL_DIRECT_M_S7_S3 0 n_fl_M_S7_S3 -10000 10000 /end CHARACTERISTIC
/begin CHARACTERISTIC NDS_VMNEMBED_ANH_ZUS "Schwellwert der Differenzdrehzahl zwischen VM und EM Drehzahl als uebergangsbedingung nach K0 Synchronisieren im Zustand Drehzahlanhebung beim Zustart" VALUE 0x26D15C FLOAT32_IEEE_COL_DIRECT_M_S7_S3 0 n_fl_M_S7_S3 -10000 0 /end CHARACTERISTIC
/begin CHARACTERISTIC NGS_VMSYNCERK_SYN_ZUS "Maximaler VM Drehzahlgradient zur Erkennung Synchron im Zustand K0 Synchronisieren beim Zustart" VALUE 0x26D174 FLOAT32_IEEE_COL_DIRECT_M_S7_S3 0 ng_fl_M_S7_S3 -10000 10000 /end CHARACTERISTIC
/begin CHARACTERISTIC NO_NMIN_PSYS_EM_L1AUS "" VALUE 0x2648E8 FLOAT32_IEEE_COL_DIRECT_M_S7_S3 0 n_fl_M_S7_S3 0 1000 /end CHARACTERISTIC
/begin CHARACTERISTIC NO_NMIN_PSYS_EM_L1L3 "Drehzahloffset zur Umschaltung des Status Pumpendruck von LP1 nach LP3" VALUE 0x2648EC FLOAT32_IEEE_COL_DIRECT_M_S7_S3 0 n_fl_M_S7_S3 0 1000 /end CHARACTERISTIC
/begin CHARACTERISTIC NO_NMIN_PSYS_EM_L3L1 "Drehzahloffset zur Umschaltung des Status Pumpendruck von LP3 nach LP1" VALUE 0x2648F0 FLOAT32_IEEE_COL_DIRECT_M_S7_S3 0 n_fl_M_S7_S3 0 1000 /end CHARACTERISTIC
/begin CHARACTERISTIC NS_EMANF_KALTNEM_PVU_HAS "EM-Drehzahlschwelle des Timers der Maximalzeit der Aktivierung der Ueberwachung durch die Diagnose bei der Unterstuetzung der Positionsventil-Ueberwachung der HAS bei einem Kaltstart" VALUE 0x2648F4 FLOAT32_IEEE_COL_DIRECT_M_S7_S3 0 n_fl_M_S7_S3 0 10000 /end CHARACTERISTIC
/begin CHARACTERISTIC NS_EMANF_PVU_HAS "EM-Drehzahlschwelle des Timers der Maximal-zeit der Aktivierung der Ueberwachung durch die Diagnose bei der Unterstuetzung der Positions-ventil-Ueberwachung der HAS" VALUE 0x2648F8 FLOAT32_IEEE_COL_DIRECT_M_S7_S3 0 n_fl_M_S7_S3 0 10000 /end CHARACTERISTIC
/begin CHARACTERISTIC NS_EMMINBED_SCL_ZUS "EM-Drehzahlschwelle zur Erkennung 'EM laeuft noch' als uebergangsbedingung nach uebergabe im Zustand K0 Schliessen beim Zustart" VALUE 0x26D198 FLOAT32_IEEE_COL_DIRECT_M_S7_S3 0 n_fl_M_S7_S3 0 2000 /end CHARACTERISTIC
/begin CHARACTERISTIC NS_EMMINBED_SYN_ZUS "EM-Drehzahlschwelle zur Erkennung 'EM laeuft noch' als uebergangsbedingung nach K0-Schliessen im Zustand K0 Synchronisieren beim Zustart" VALUE 0x26D19C FLOAT32_IEEE_COL_DIRECT_M_S7_S3 0 n_fl_M_S7_S3 0 2000 /end CHARACTERISTIC
/begin CHARACTERISTIC NS_EMMINFUWKALTBED_ANH_ZUS "EM-Drehzahlschwelle zur Erkennung 'EM laeuft' bei aktiver FUW oder bei Kaltstart mit abgesenkter EM-Drehzahl als uebergangsbedingung nach K0 Schliessen im Zustand VM Drehzahlanhebung beim Zustart" VALUE 0x26D1A0 FLOAT32_IEEE_COL_DIRECT_M_S7_S3 0 n_fl_M_S7_S3 0 2000 /end CHARACTERISTIC
/begin CHARACTERISTIC NS_EMMINUVS_ZST_ZUS "EM-Drehzahlschwelle zur Erkennung -EM dreht schnell genug- bei der Aktivierung der K0-Unterstuetzung des VM Startsystems im Zustand Zustarten beim Zustart" VALUE 0x26D1A4 FLOAT32_IEEE_COL_DIRECT_M_S7_S3 0 n_fl_M_S7_S3 0 2000 /end CHARACTERISTIC
/begin CHARACTERISTIC NS_EMSAKBED_ZST_ZUS "EM-Drehzahlschwelle als uebergangsbedingung nach Schaltung aktiv im Zustand Zustarten beim Zustart" VALUE 0x26D1A8 FLOAT32_IEEE_COL_DIRECT_M_S7_S3 0 n_fl_M_S7_S3 0 10000 /end CHARACTERISTIC
/begin CHARACTERISTIC NS_NMIN_EM_L1_HAS "Minimale Drehzahl im Leistungsbereich 1 der Oelversorgung" VALUE 0x2648FC FLOAT32_IEEE_COL_DIRECT_M_S7_S3 0 n_fl_M_S7_S3 0 1000 /end CHARACTERISTIC
/begin CHARACTERISTIC NS_NT_SBE "Drehzahlschwelle definiert ein Bereich fuer die Umschaltung zwischen n_t_egs_in und n_ab_egs*I_istgang_egs wenn status_kraftfluss_egs_roh_in /= 2 oder 4 ist." VALUE 0x264900 FLOAT32_IEEE_COL_DIRECT_M_S7_S3 0 n_fl_M_S7_S3 -10000 10000 /end CHARACTERISTIC
/begin CHARACTERISTIC NS_VMAKTMAXUVS_ZST_ZUS "Maximale VM-Drehzahl zur Aktivierung der K0-Unterstuetzung des VM Startsystems im Zustand Zustarten beim Zustart" VALUE 0x26D1B4 FLOAT32_IEEE_COL_DIRECT_M_S7_S3 0 n_fl_M_S7_S3 0 2000 /end CHARACTERISTIC
/begin CHARACTERISTIC NS_VMEINBED_ZST_ZUS "VM-Drehzahlschwelle zur Erkennung VM laeuft als uebergangsbedingung nach VM-Drehzahlanhebung im Zustand Zustarten beim Zustart" VALUE 0x26D1B8 FLOAT32_IEEE_COL_DIRECT_M_S7_S3 0 n_fl_M_S7_S3 0 2000 /end CHARACTERISTIC
/begin CHARACTERISTIC NS_VMMAXUVS_ZST_ZUS "VM-Drehzahlschwelle zur Deaktivierung der K0-Unterstuetzung des VM Startsystems im Zustand Zustarten beim Zustart" VALUE 0x26D1BC FLOAT32_IEEE_COL_DIRECT_M_S7_S3 0 n_fl_M_S7_S3 0 2000 /end CHARACTERISTIC
/begin CHARACTERISTIC NS_VMMINNEMFEHLERBED_FUW_ZUS "VM-Drehzahlschwelle zur Absicherung VM laeuft bei Ablauf mit fehlerhafter EM-Drehzahl der Funktionsueberwachung der EM-Funktion beim Zustart" VALUE 0x26D1C0 FLOAT32_IEEE_COL_DIRECT_M_S7_S3 0 n_fl_M_S7_S3 0 2000 /end CHARACTERISTIC
/begin CHARACTERISTIC NS_VMMINUVS_ZST_ZUS "VM-Drehzahlschwelle zur Beruecksichtigung -VM Startsystem dreht- bei der Aktivierung der K0-Unterstuetzung des VM Startsystems im Zustand Zustarten beim Zustart" VALUE 0x26D1C4 FLOAT32_IEEE_COL_DIRECT_M_S7_S3 0 n_fl_M_S7_S3 0 2000 /end CHARACTERISTIC
/begin CHARACTERISTIC NS_VMSTART_BFI_HAS "VM Drehzahlschwelle zur Deaktivierung der Beeinflussung der IEP durch die HAS bei einem ZSE-Start" VALUE 0x264680 FLOAT32_IEEE_COL_DIRECT_M_S7_S3 0 n_fl_M_S7_S3 0 10000 /end CHARACTERISTIC
/begin CHARACTERISTIC PO_BREMSE_ZUG_SVH_HAS "Offset zur  Bremsdruckschwelle zur Bestimmung des Status des Lastzustands Zug der Schaltverhinderung der HAS" VALUE 0x264904 FLOAT32_IEEE_COL_DIRECT_M_S7_S3 0 p_fl_M_S7_S3 0 127 /end CHARACTERISTIC
/begin CHARACTERISTIC PS_BREMSE_ZUG_SVH_HAS "Bremsdruckschwelle zur Bestimmung des Status des Lastzustands Zug der Schaltverhinderung der HAS" VALUE 0x264908 FLOAT32_IEEE_COL_DIRECT_M_S7_S3 0 p_fl_M_S7_S3 0 127 /end CHARACTERISTIC
/begin CHARACTERISTIC SCHALTART_VMABFLAUSBED_SRT_ZUS "Festlegung der Schaltart der laufenden Schaltungen zur Freigabe des Zustandsuebergangs in den Zustand VM-Abfangen im Zustand Start beim Zustart" VALUE 0x26F1B6 UBYTE_COL_DIRECT_M_S7_S3 0 void_int_M_S7_S3 0 255 /end CHARACTERISTIC
/begin CHARACTERISTIC STATUS_ABLVM_ABF_ZUS "Projektspezifische Statusrueckmeldung der VM Selbstlauffaehigkeit als Uebergangsbedingung nach K0- Synchronisieren im Zustand VM-Abfangen beim Zustart" VALUE 0x26F1B7 UBYTE_COL_DIRECT_M_S7_S3 0 sts_int_M_S7_S3 0 15 /end CHARACTERISTIC
/begin CHARACTERISTIC STATUS_ABLVM_ANH_ZUS "Projektspezifische Statusrueckmeldung der VM Selbstlauffaehigkeit als Uebergangsbedingung nach K0- Synchronisieren im Zustand VM-Drehzahlanhebung beim Zustart" VALUE 0x26F1B8 UBYTE_COL_DIRECT_M_S7_S3 0 sts_int_M_S7_S3 0 15 /end CHARACTERISTIC
/begin CHARACTERISTIC SWI_ABBRUCH_AKTIV_ZUS "SWI fuer die Aktivierung des Abbruch Ablauf Zustart" VALUE 0x26F1C0 UBYTE_COL_DIRECT_M_S7_S3 0 swi_int_M_S7_S3 0 1 /end CHARACTERISTIC
/begin CHARACTERISTIC SWI_BFIFUWAKTIV_HAS "Schalter zur Aktivierung der Beeinflussung der IEP durch die HAS bei EM-Fehlfunktion beim Zustart" VALUE 0x26ED66 UBYTE_COL_DIRECT_M_S7_S3 0 swi_int_M_S7_S3 0 1 /end CHARACTERISTIC
/begin CHARACTERISTIC SWI_BFIPVU_BFI_HAS "Schalter zur Aktivierung der Beeinflussung der IEP zur Unterstuetzung der Positionsventil-Ueberwachung durch die HAS " VALUE 0x26ED67 UBYTE_COL_DIRECT_M_S7_S3 0 swi_int_M_S7_S3 0 1 /end CHARACTERISTIC
/begin CHARACTERISTIC SWI_K0SREGBASIS_SYN_ZUS "Aktivierung und Konfiguration der Aktivierung der K0 Schlupfregelung beim K0 Synchronisieren beim Zustart: bit0 = K0SREG aktiv, bit1 = Beruecksichtigung IAE, bit2 = Ber. Schaltung, bit3 = Ber. FST" VALUE 0x26F1C2 UBYTE_COL_DIRECT_M_S7_S3 0 swi_int_o_M_S7_S3 0 15 /end CHARACTERISTIC
/begin CHARACTERISTIC SWI_MK0BERZK0_HAS "Schalter zur Aktivierung der Beruecksichtigung des K0 Sollzustands bei der Bestimmung des Istmoments K0 der HAS" VALUE 0x26ED71 UBYTE_COL_DIRECT_M_S7_S3 0 swi_int_M_S7_S3 0 1 /end CHARACTERISTIC
/begin CHARACTERISTIC SWI_MK0MAXK0GEGSL_HAS "Schalter zur Ausgabe des maximalen K0 Moments als K0-Istmoment der HAS bei K0 Status GEREGELTGESCHLOSSEN ausserhalb eines Ablaufs" VALUE 0x26ED72 UBYTE_COL_DIRECT_M_S7_S3 0 swi_int_M_S7_S3 0 1 /end CHARACTERISTIC
/begin CHARACTERISTIC SWI_MK0MAXK0GSL_HAS "Schalter zur Ausgabe des maximalen K0 Moments als K0-Istmoment der HAS bei K0 Status GESCHLOSSEN ausserhalb eines Ablaufs" VALUE 0x26ED73 UBYTE_COL_DIRECT_M_S7_S3 0 swi_int_M_S7_S3 0 1 /end CHARACTERISTIC
/begin CHARACTERISTIC SWI_MK0MAXK0SREG_HAS "Schalter zur Ausgabe des maximalen K0 Moments als K0-Istmoment der HAS bei K0 Status SCHLUPFGEREGELT ausserhalb eines Ablaufs" VALUE 0x26ED74 UBYTE_COL_DIRECT_M_S7_S3 0 swi_int_M_S7_S3 0 1 /end CHARACTERISTIC
/begin CHARACTERISTIC SWI_MK0MODFKT_HAS "Schalter zur Ausgabe des modifizierten K0-Moments der Hybridfunktionen als K0-Istmoment der HAS waehrend eines Ablaufs" VALUE 0x26ED75 UBYTE_COL_DIRECT_M_S7_S3 0 swi_int_M_S7_S3 0 1 /end CHARACTERISTIC
/begin CHARACTERISTIC SWI_MODUS_LASTANH_SVH_HAS "Schalter zur Auswahl des Bestimmungsmodus zur Erkennung Lastanhebung des Status des Lastaenderungszustands der Schalt-verhinderung der HAS" VALUE 0x26EDC7 UBYTE_COL_DIRECT_M_S7_S3 0 swi_int_M_S7_S3 0 1 /end CHARACTERISTIC
/begin CHARACTERISTIC SWI_MZIELK0HSTMZIELVM_ZUS "Aktivierung der Verwendung des K0-Zielmoments der HST als VM-Zielmoment beim Zustart" VALUE 0x26F1CB UBYTE_COL_DIRECT_M_S7_S3 0 swi_int_M_S7_S3 0 1 /end CHARACTERISTIC
/begin CHARACTERISTIC SWI_NTVIRTNSECIAE_AKTIV_HAS "Berechnung n_sec_iae ohne Einfluss von Sta-tus_kraftfluss_egs_in" VALUE 0x26EDC8 UBYTE_COL_DIRECT_M_S7_S3 0 swi_int_M_S7_S3 0 1 /end CHARACTERISTIC
/begin CHARACTERISTIC SWI_POSP_ABFR_PVU_HAS "Schalter um bei der Aktivierung der PosV Unterstuetzung die Position P abfragen zu koennen" VALUE 0x26EDC9 UBYTE_COL_DIRECT_M_S7_S3 0 swi_int_M_S7_S3 0 1 /end CHARACTERISTIC
/begin CHARACTERISTIC SWI_PVU_STATUSPSYS_HAS "Schalter zur Beruecksichtigung der Aktivierung der Unterstuetzung der Positionsventil-Ueberwachung bei der Bestimmung des Pumpendruckstatus der HAS " VALUE 0x26EDCA UBYTE_COL_DIRECT_M_S7_S3 0 swi_int_M_S7_S3 0 1 /end CHARACTERISTIC
/begin CHARACTERISTIC SWI_RSE_AKTIV_HAS "Schalter zur Aktivierung der Radschlupferkennung (RSE) der HAS" VALUE 0x26EDCB UBYTE_COL_DIRECT_M_S7_S3 0 swi_int_M_S7_S3 0 1 /end CHARACTERISTIC
/begin CHARACTERISTIC SWI_SCHALTARTAKT_SVH_HAS "Schalter zur Aktivierung der stetigen Aktualisierung der Schaltart bei vorliegender Schaltanforderung im Modul Schaltverhinderung der HAS" VALUE 0x26EDCC UBYTE_COL_DIRECT_M_S7_S3 0 swi_int_M_S7_S3 0 1 /end CHARACTERISTIC
/begin CHARACTERISTIC SWI_STATUS_GETRBEREIT_HAS "Schalter, ob die Getriebebereitschaft der SAB zur Bestimmung des Pumpendrucks verwendet werden soll" VALUE 0x26EDCD UBYTE_COL_DIRECT_M_S7_S3 0 swi_int_M_S7_S3 0 1 /end CHARACTERISTIC
/begin CHARACTERISTIC SWI_SYNCDDA_ZUS "Schalter zur Aktivierung der Beeinflussung der K0-Synchronisation bei durchdrehenden Antriebsraedern beim Zustart" VALUE 0x26F1CC UBYTE_COL_DIRECT_M_S7_S3 0 swi_int_M_S7_S3 0 1 /end CHARACTERISTIC
/begin CHARACTERISTIC SWI_UVS_ZUS "Aktivierung und Konfiguration der K0-Unterstuetzung des VM Startsystems beim Zustart: 0 = keine UVS, 1 = UVS in ZST, 2 = UVS in ZST und SAK, 3 = UVS in ZST und ABF, 4 = UVS in ZST, SAK und ABF" VALUE 0x26F1CD UBYTE_COL_DIRECT_M_S7_S3 0 swi_int_o_M_S7_S3 0 4 /end CHARACTERISTIC
/begin CHARACTERISTIC SWI_VMABF_LP3BED_SRT_ZUS "Aktivierung der Abfrage der Druckversorgung des Getriebes entsprechend LP3 der Uebergangsbedingung in den Zustand VM-Abfangen im Zustand Start beim Zustart" VALUE 0x26F1CF UBYTE_COL_DIRECT_M_S7_S3 0 swi_int_M_S7_S3 0 1 /end CHARACTERISTIC
/begin CHARACTERISTIC SWI_VMABFANGEN_SRT_ZUS "Aktivierung des Zustands VM Abfangen beim VM Starten Variante VM Zustarten" VALUE 0x26F1CE UBYTE_COL_DIRECT_M_S7_S3 0 swi_int_M_S7_S3 0 1 /end CHARACTERISTIC
/begin CHARACTERISTIC SWI_VMSTARTANF_PVU_HAS "Schalter zur Aktivierung der Beruecksichtigung der Anforderung eines VM Starts bei der Unter-stuetzung der Positionsventil-Ueberwachung der HAS" VALUE 0x26EDCE UBYTE_COL_DIRECT_M_S7_S3 0 swi_int_M_S7_S3 0 1 /end CHARACTERISTIC
/begin CHARACTERISTIC SWI_ZABLVAR_SST_BFI_HAS "Schalter zur Aktivierung, ob die Ablaufvariante bei der Beeinflussung der IEP beim SST mit abgefragt warden soll" VALUE 0x26ED81 UBYTE_COL_DIRECT_M_S7_S3 0 sts_int_e_M_S7_S3 0 1 /end CHARACTERISTIC
/begin CHARACTERISTIC SWI_ZMODUSIEP_SST_BFI_HAS "Schalter, ob beim SST die IEP ausgeschalten werden soll, oder im LP3 kaufen soll" VALUE 0x26ED82 UBYTE_COL_DIRECT_M_S7_S3 0 swi_int_M_S7_S3 0 1 /end CHARACTERISTIC
/begin CHARACTERISTIC T_BETRIEBKALTSTARTMAX_PVU_HAS "Maximale Betriebsdauer im Falle einer Kalt-start-Anforderung zur Zwangsaktivierung der Unterstuetzung der Positionsventil-Ueberwachung der HAS" VALUE 0x26490C ULONG_COL_DIRECT_M_S7_S3 0 t_int_M_S7_S3 0 1000000 /end CHARACTERISTIC
/begin CHARACTERISTIC T_BETRIEBMAX_PVU_HAS "Maximale Betriebsdauer zur Zwangsaktivierung der Unterstuetzung der Positionsventil-Ueberwachung der HAS" VALUE 0x264910 ULONG_COL_DIRECT_M_S7_S3 0 t_int_M_S7_S3 0 1000000 /end CHARACTERISTIC
/begin CHARACTERISTIC T_MSOLLEMAKTIVMAX_ZUS "Maximalzeit der Ausgabe des K0-Stoermoments der EM-Ansteuerung beim Zustart" VALUE 0x26D1E4 FLOAT32_IEEE_COL_DIRECT_M_S7_S3 0 t_fl_M_S7_S3 0 10 /end CHARACTERISTIC
/begin CHARACTERISTIC T_VNEMNDK0_HAS "Verzoegerungszeit der EM-Drehzahl fuer die Berechnung der K0-Differenzdrehzahl" VALUE 0x26E192 UWORD_COL_DIRECT_M_S7_S3 0 t_int_n_M_S7_S3 0 0.1 /end CHARACTERISTIC
/begin CHARACTERISTIC T_VNVMNDK0_HAS "Verzoegerungszeit der VM-Drehzahl fuer die Berechnung der K0-Differenzdrehzahl" VALUE 0x26E194 UWORD_COL_DIRECT_M_S7_S3 0 t_int_n_M_S7_S3 0 0.1 /end CHARACTERISTIC
/begin CHARACTERISTIC T_VRUECKDDAERK_RSE_HAS "Verzoegerungszeit zum Ruecksetzen des Radschlupf- Status der Erkennung von durchdrehenden Antriebsraedern der Radschlupferkennung (RSE) der HAS" VALUE 0x26E196 UWORD_COL_DIRECT_M_S7_S3 0 t_int_n_M_S7_S3 0 5 /end CHARACTERISTIC
/begin CHARACTERISTIC T_VSCHALTUNGAKTIV_HAS "Timer zum Zuruecksetzen des status_schaltung_egs nach Schaltung bei anstehender Schaltungsanforderung durch fst" VALUE 0x26E198 UWORD_COL_DIRECT_M_S7_S3 0 t_int_n_M_S7_S3 0 10 /end CHARACTERISTIC
/begin CHARACTERISTIC T_ZIEPHASAKTIV_BFI_HAS "Zeitraum nach Erkennung der Betriebsbereitschaft des Hybridsystems in dem die Beeinflussung der IEP durch die HAS aktiv ist" VALUE 0x26E11C UWORD_COL_DIRECT_M_S7_S3 0 t_int_n_M_S7_S3 0 5 /end CHARACTERISTIC
/begin CHARACTERISTIC T_ZIEPHASMAX_BFI_HAS "Maximaler Zeitraum nach Erkennung der Betriebsbereitschaft des Hybridsystems in dem die Beeinflussung der IEP durch die HAS aktiv ist" VALUE 0x26E11E UWORD_COL_DIRECT_M_S7_S3 0 t_int_n_M_S7_S3 0 500 /end CHARACTERISTIC
/begin CHARACTERISTIC TAB_MOMZIELK0BED_SYN_ZUS "Drehmomentoffset auf das K0 Zielmoment in Abhaengigkeit des IAE Status als uebergangsbedingung nach K0-Schliessen im Zustand K0 Synchronisieren beim Zustart" VAL_BLK 0x26D02C FLOAT32_IEEE_COL_DIRECT_M_S7_S3 0 trq_fl_a_M_S7_S3 -1000 1000 NUMBER 9 /end CHARACTERISTIC
/begin CHARACTERISTIC TAB_STATUSIEP_HAS "Beeinflussung Start Timer mit der Zeit aus KL_TVSTATUSPSYSEM_LP3_HAS als =f(status_iep_in)" VAL_BLK 0x26EDBD UBYTE_COL_DIRECT_M_S7_S3 0 sts_int_M_S7_S3 0 1 NUMBER 5 /end CHARACTERISTIC
/begin CHARACTERISTIC TAB_STATUSPSYSEM_HAS "Beeinflussung Start Timer mit der Zeit aus KL_TVSTATUSPSYSEM_LP3_HAS als =f(status_psys_em_has)" VAL_BLK 0x26EDC2 UBYTE_COL_DIRECT_M_S7_S3 0 sts_int_M_S7_S3 0 1 NUMBER 5 /end CHARACTERISTIC
/begin CHARACTERISTIC TAB_TVSVHRESET_SVH_HAS "Verzoegerungszeit zum Ruecksetzen der Schaltverhinderung der HAS nach einem Ablauf in Abhaengigkeit des Ziel-Betriebszustands der HAS (st_ziel_bz_has_stg)" VAL_BLK 0x2644AC FLOAT32_IEEE_COL_DIRECT_M_S7_S3 0 t_fl_M_S7_S3 0 2.5 NUMBER 9 /end CHARACTERISTIC
/begin CHARACTERISTIC TAB_UEBERSETZUNGEN_EGS "Uebersetungen des 8P Zentralteils" VAL_BLK 0x264890 FLOAT32_IEEE_COL_DIRECT_M_S7_S3 0 ratio_fl_M_S7_S3 0 10 NUMBER 10 /end CHARACTERISTIC
/begin CHARACTERISTIC TS_AKTIV_PVU_HAS "Zeitraum nach Erkennung der Betriebsbereitschaft des Hybridsystems in dem die Unterstuetzung der Positionsventilueberwachung durch die HAS aktiv ist." VALUE 0x26E18A UWORD_COL_DIRECT_M_S7_S3 0 t_int_n_M_S7_S3 0 5 /end CHARACTERISTIC
/begin CHARACTERISTIC TS_ANFMAX_KALTNEM_PVU_HAS "Maximaler Zeitraum nach Ueberschreiten der EMDrehzahlschwelle zur Aktivierung der Ueberwachung durch die Diagnose bei der Unterstuetzung der Positionsventilueberwachung der HAS bei einem Kaltstart" VALUE 0x26E18C UWORD_COL_DIRECT_M_S7_S3 0 t_int_n_M_S7_S3 0 5 /end CHARACTERISTIC
/begin CHARACTERISTIC TS_ANFMAX_PVU_HAS "Maximaler Zeitraum nach Ueberschreiten der EM-Drehzahlschwelle zur Aktivierung der Ue-berwachung durch die Diagnose bei der Unter-stuetzung der Positionsventil-Ueberwachung der HAS" VALUE 0x26E18E UWORD_COL_DIRECT_M_S7_S3 0 t_int_n_M_S7_S3 0 5 /end CHARACTERISTIC
/begin CHARACTERISTIC TS_MAX_PVU_HAS "Maximaler Zeitraum nach Erkennung der Betriebsbereitschaft des Hybridsystems in dem die Unterstuetzung der Positionsventilueberwachung durch die HAS aktiv ist. - Wert 0 deaktiviert den Timer.
" VALUE 0x26E190 UWORD_COL_DIRECT_M_S7_S3 0 t_int_n_M_S7_S3 0 10 /end CHARACTERISTIC
/begin CHARACTERISTIC XP_MAX "" VALUE 0x264914 FLOAT32_IEEE_COL_DIRECT_M_S7_S3 0 void_fl_M_S7_S3 -3.40282E+038 3.40282E+038 /end CHARACTERISTIC
/begin CHARACTERISTIC Z_ABLAUF_ABBRUCH_ZUS "Anzeigen eines Abbruchs durch die HAS-Zustandssteuerung (OML) beim Zustart" VALUE 0x26F1E3 UBYTE_COL_DIRECT_M_S7_S3 0 void_int_M_S7_S3 0 255 /end CHARACTERISTIC
/begin CHARACTERISTIC Z_ABLAUFVAR_KALTNEM_PVU_HAS "Wert der Anforderung eines Kaltstart-Ablaufs mit abgesenkter EM-Drehzahl durch die HAS Zustandssteuerung der Funktion zur Unterstuet-zung der Positionsventil- Ueberwachung der HAS" VALUE 0x26EDCF UBYTE_COL_DIRECT_M_S7_S3 0 sts_int_M_S7_S3 0 100 /end CHARACTERISTIC
/begin CHARACTERISTIC Z_ABLAUFVARIANTE_SZA_ZUS "Anforderung eines Schnellen Zustartablaufs (SZA) durch die HAS Zustandssteuerung (OML) beim Zustart (z_ablaufvariante_has_stg)" VALUE 0x26F1E1 UBYTE_COL_DIRECT_M_S7_S3 0 void_int_M_S7_S3 0 100 /end CHARACTERISTIC
/begin CHARACTERISTIC Z_ABLAUFVARIANTE_UVS_ZUS "Anforderung einer K0-Unterstuetzung des VM Startsystems durch die HAS Zustandssteuerung (OML) beim Zustart (z_ablaufvariante_has_stg) " VALUE 0x26F1E2 UBYTE_COL_DIRECT_M_S7_S3 0 void_int_M_S7_S3 0 100 /end CHARACTERISTIC
/begin CHARACTERISTIC Z_PVU_BFI_HAS "Aktivierung der Beeinflussung der IEP durch die PosV Diagnose." VALUE 0x26ED85 UBYTE_COL_DIRECT_M_S7_S3 0 st_int_M_S7_S3 0 2 /end CHARACTERISTIC
/begin CHARACTERISTIC Z_ZSTNACHSAKMAX_ZST_ZUS "Maximale Anzahl der Rueckspruenge in den Zustand Schaltung aktiv zur Priorisierung der Schaltungsanforderung im Zustand Zustarten beim Zustart" VALUE 0x26F1E5 UBYTE_COL_DIRECT_M_S7_S3 0 void_int_M_S7_S3 0 100 /end CHARACTERISTIC
/begin AXIS_PTS KF_FKMSTOERK0EM_ZUS_X "Filterkonstante beider PT1-Glieder der PT2 Filterung des K0-Stoermoments der EM-Ansteuerung beim Zustart" 0x26AD80 c_getriebe_egs_in FLOAT32_IEEE_X_INCR_DIRECT_M_S7_S3 0 c_fl_M_S7_S3 8 -3.40282E+038 3.40282E+038 /end AXIS_PTS
/begin AXIS_PTS KF_FKMSTOERK0EM_ZUS_Y "Filterkonstante beider PT1-Glieder der PT2 Filterung des K0-Stoermoments der EM-Ansteuerung beim Zustart" 0x26ADA0 NO_INPUT_QUANTITY FLOAT32_IEEE_X_INCR_DIRECT_M_S7_S3 0 trq_fl_a_M_S7_S3 8 -3.40282E+038 3.40282E+038 /end AXIS_PTS
/begin AXIS_PTS KF_INITTVSTATUSIEP_SBE_X "X-Achse: status_iep" 0x26ED9F status_iep_in UBYTE_X_INCR_DIRECT_M_S7_S3 0 sts_int_M_S7_S3 5 0 255 /end AXIS_PTS
/begin AXIS_PTS KF_INITTVSTATUSIEP_SBE_Y "Y-Achse: status_iep_alt" 0x26EDA4 NO_INPUT_QUANTITY UBYTE_X_INCR_DIRECT_M_S7_S3 0 sts_int_M_S7_S3 5 0 4 /end AXIS_PTS
/begin AXIS_PTS KF_KMSTOERK0EMMOD_ZUS_X "Faktor zur Modifikation des K0-Stoermoments der EM-Ansteuerung in Abhaengigkeit des K0 Differenzdrehzahl und der EM-Drehzahl beim Zustart" 0x26AF00 nd_k0_in FLOAT32_IEEE_X_INCR_DIRECT_M_S7_S3 0 n_fl_M_S7_S3 10 -3.40282E+038 3.40282E+038 /end AXIS_PTS
/begin AXIS_PTS KF_KMSTOERK0EMMOD_ZUS_Y "Faktor zur Modifikation des K0-Stoermoments der EM-Ansteuerung in Abhaengigkeit des K0 Differenzdrehzahl und der EM-Drehzahl beim Zustart" 0x26AF28 n_em_in FLOAT32_IEEE_X_INCR_DIRECT_M_S7_S3 0 n_fl_M_S7_S3 8 -3.40282E+038 3.40282E+038 /end AXIS_PTS
/begin AXIS_PTS KF_MO_K0BEFUELL_NORM_CGET_ZUS_X "X-Achse: t_k0befuellnormiert_zus" 0x26B998 NO_INPUT_QUANTITY FLOAT32_IEEE_X_INCR_DIRECT_M_S7_S3 0 rel_fl_M_S7_S3 11 0 200 /end AXIS_PTS
/begin AXIS_PTS KF_MO_K0BEFUELL_NORM_CGET_ZUS_Y "Y-Achse: c_getriebe_egs_in" 0x26B9C4 c_getriebe_egs_in FLOAT32_IEEE_X_INCR_DIRECT_M_S7_S3 0 c_fl_M_S7_S3 8 -50 200 /end AXIS_PTS
/begin AXIS_PTS KF_MO_K0BEFUELL_OPT_CGET_ZUS_X "X-Achse: t_k0befuellnormiert_zus" 0x26BB44 NO_INPUT_QUANTITY FLOAT32_IEEE_X_INCR_DIRECT_M_S7_S3 0 rel_fl_M_S7_S3 11 0 200 /end AXIS_PTS
/begin AXIS_PTS KF_MO_K0BEFUELL_OPT_CGET_ZUS_Y "Y-Achse: c_getriebe_egs_in" 0x26BB70 c_getriebe_egs_in FLOAT32_IEEE_X_INCR_DIRECT_M_S7_S3 0 c_fl_M_S7_S3 8 -50 200 /end AXIS_PTS
/begin AXIS_PTS KF_MO_K0BEFUELL_RED_CGET_ZUS_X "X-Achse: t_k0befuellnormiert_zus" 0x26BCF0 NO_INPUT_QUANTITY FLOAT32_IEEE_X_INCR_DIRECT_M_S7_S3 0 rel_fl_M_S7_S3 11 0 200 /end AXIS_PTS
/begin AXIS_PTS KF_MO_K0BEFUELL_RED_CGET_ZUS_Y "Y-Achse: c_getriebe_egs_in" 0x26BD1C c_getriebe_egs_in FLOAT32_IEEE_X_INCR_DIRECT_M_S7_S3 0 c_fl_M_S7_S3 8 -50 200 /end AXIS_PTS
/begin AXIS_PTS KF_SCHALTART_ZUL_SVH_HAS_X "Festlegung der zulaessigen Schaltart der Schaltverhinderung der HAS in Abhaengigkeit des aktiven Ablaufs (255 = alle Schaltarten zulaessig, 0 = keine Schaltart zulaessig) - Bit-Codierung -> siehe Handbuch bzw. Kommentar zu status_schaltart_zul_svh_has  " 0x26ED02 st_ist_bz_has_stg UBYTE_X_INCR_DIRECT_M_S7_S3 0 sts_int_M_S7_S3 9 0 8 /end AXIS_PTS
/begin AXIS_PTS KF_SCHALTART_ZUL_SVH_HAS_Y "Festlegung der zulaessigen Schaltart der Schaltverhinderung der HAS in Abhaengigkeit des aktiven Ablaufs (255 = alle Schaltarten zulaessig, 0 = keine Schaltart zulaessig) - Bit-Codierung -> siehe Handbuch bzw. Kommentar zu status_schaltart_zul_svh_has  " 0x26ED0B st_ziel_bz_has_stg UBYTE_X_INCR_DIRECT_M_S7_S3 0 sts_int_M_S7_S3 9 0 8 /end AXIS_PTS
/begin AXIS_PTS KF_TVSTATUSIEP_SBE_X "X-Achse: status_iep" 0x26EDB3 status_iep_in UBYTE_X_INCR_DIRECT_M_S7_S3 0 sts_int_M_S7_S3 5 0 4 /end AXIS_PTS
/begin AXIS_PTS KF_TVSTATUSIEP_SBE_Y "Y-Achse: status_iep_alt" 0x26EDB8 NO_INPUT_QUANTITY UBYTE_X_INCR_DIRECT_M_S7_S3 0 sts_int_M_S7_S3 5 0 4 /end AXIS_PTS
/begin AXIS_PTS KF_TVSTATUSIEPSST_SBE_X "X-Achse: status_iep" 0x26EDA9 status_iep_in UBYTE_X_INCR_DIRECT_M_S7_S3 0 sts_int_M_S7_S3 5 0 4 /end AXIS_PTS
/begin AXIS_PTS KF_TVSTATUSIEPSST_SBE_Y "Y-Achse: status_iep_alt" 0x26EDAE NO_INPUT_QUANTITY UBYTE_X_INCR_DIRECT_M_S7_S3 0 sts_int_M_S7_S3 5 0 4 /end AXIS_PTS
/begin AXIS_PTS KL_KSVHRESETAUSZST_LA_SAK_ZUS_X "Bedingtes Ruecksetzen einer Schaltverhinderung waehrend VM-Zustart im E-Fahr-Modus \"Ladung abbauen\" in Abhaengigkeit des Istgangs im Zustand SAK (255 = alle Arten von Schaltungen zuruecksetzen, 0 = keine Schaltung zuruecksetzen) ->Kodierung siehe Handbuch" 0x26CF4C istgang_egs_in SBYTE_X_INCR_DIRECT_M_S7_S3 0 void_int_M_S7_S3 8 -128 127 /end AXIS_PTS
/begin AXIS_PTS KL_KSVHRESETAUSZST_LE_SAK_ZUS_X "Bedingtes Ruecksetzen einer Schaltverhinderung waehrend VM-Zustart im E-Fahr-Modus \"Ladung erhalten\" in Abhaengigkeit des Istgangs im Zustand SAK(255 = alle Arten von Schaltungen zuruecksetzen, 0 = keine Schaltung zuruecksetzen)->Kodierung siehe Handbuch" 0x26CF5C istgang_egs_in SBYTE_X_INCR_DIRECT_M_S7_S3 0 void_int_M_S7_S3 8 -128 127 /end AXIS_PTS
/begin AXIS_PTS KL_MOMAXDYNEM_LASTANH_SVH_HAS_X "Momentenoffset zur Erkennung Lastanhe-bung in Relation zum maximalen dynami-schen EM Moment des Status des Lastaen-derungszustands der Schaltverhinderung der HAS" 0x264750 mg_wunsch_fpw_in FLOAT32_IEEE_X_INCR_DIRECT_M_S7_S3 0 trqg_fl_k_M_S7_S3 8 -3.40282E+038 3.40282E+038 /end AXIS_PTS
/begin AXIS_PTS KL_MPTNT_SBE_X "Filterkonstante fuer die Turbinendrehzahl abhaengig von Fahrsollmoment" 0x264790 m_wunsch_fpw_in FLOAT32_IEEE_X_INCR_DIRECT_M_S7_S3 0 trq_fl_a_M_S7_S3 8 -1000 1000 /end AXIS_PTS
/begin AXIS_PTS KL_MSOLLK0MINBEFUVS_ZST_ZUS_X "" 0x26CA64 abstellpos_vm_in FLOAT32_IEEE_X_INCR_DIRECT_M_S7_S3 0 phigrad_fl_M_S7_S3 7 0 360 /end AXIS_PTS
/begin AXIS_PTS KL_MSSOLLEMAKTIV_ZUS_X "Schwelle des K0-Stoermoments bzw. des EM-Sollmoments zur Aktivierung der Maximalzeit der Ausgabe des EM-Vorsteuermoments beim Zustart in Abhaengigkeit des Istgangs" 0x26CAC4 NO_INPUT_QUANTITY FLOAT32_IEEE_X_INCR_DIRECT_M_S7_S3 0 sts_fl_M_S7_S3 10 -3.40282E+038 3.40282E+038 /end AXIS_PTS
/begin AXIS_PTS KL_MSSOLLK0BED_SYN_ZUS_X "Schwelle des Sollmoments der K0, aber der ins Schliessen uebergegangen werden darf" 0x26CB14 m_ziel_vm_has_zus FLOAT32_IEEE_X_INCR_DIRECT_M_S7_S3 0 trq_fl_a_M_S7_S3 8 -3.40282E+038 3.40282E+038 /end AXIS_PTS
/begin AXIS_PTS KL_NDGSK0SYNCERK_SYN_ZUS_X "Maximaler Betrag des K0-Differenzdrehzahlgradienten zur Erkennung Synchron im Zustand K0 Synchronisieren beim Zustart in Abhaengigkeit des VM Zielmoments beim Zustart" 0x26CC74 m_ziel_vm_has_zus FLOAT32_IEEE_X_INCR_DIRECT_M_S7_S3 0 trq_fl_a_M_S7_S3 10 -3.40282E+038 3.40282E+038 /end AXIS_PTS
/begin AXIS_PTS KL_NDSK0MAXSCHLBED_SRT_ZUS_X "Maximale K0-Differenzdrehzahl fuer direkten uebergang nach K0-Schliessen bei Abbruch Abstellen in Abhaengigkeit der EM Drehzahl im Zustand Start beim Zustart" 0x26CCEC n_em_in FLOAT32_IEEE_X_INCR_DIRECT_M_S7_S3 0 n_fl_M_S7_S3 5 -3.40282E+038 3.40282E+038 /end AXIS_PTS
/begin AXIS_PTS KL_NDSK0MINSCHLBED_SRT_ZUS_X "Minimale K0-Differenzdrehzahl fuer direkten uebergang nach K0-Schliessen bei Abbruch Abstellen in Abhaengigkeit der EM Drehzahl im Zustand Start beim Zustart" 0x26CD14 n_em_in FLOAT32_IEEE_X_INCR_DIRECT_M_S7_S3 0 n_fl_M_S7_S3 5 -3.40282E+038 3.40282E+038 /end AXIS_PTS
/begin AXIS_PTS KL_NMINEM_PSYS_LP3_HAS_X "Mindestdrehzahl der EM zur Sicherstellung des Leistungspunkt 3 der Bestimmung des Status Systemdruck der HAS in Abhaengigkeit der Getrieboeltemperatur" 0x2647D0 c_getriebe_egs_in FLOAT32_IEEE_X_INCR_DIRECT_M_S7_S3 0 c_fl_M_S7_S3 8 -60 215 /end AXIS_PTS
/begin AXIS_PTS KL_TFC_K0_OPT_ZUS_X "X-Achse: c_getriebe_egs_in" 0x26CDBC c_getriebe_egs_in FLOAT32_IEEE_X_INCR_DIRECT_M_S7_S3 0 c_fl_M_S7_S3 9 -50 200 /end AXIS_PTS
/begin AXIS_PTS KL_TFC_K0_RED_ZUS_X "X-Achse: c_getriebe_egs_in" 0x26CE04 c_getriebe_egs_in FLOAT32_IEEE_X_INCR_DIRECT_M_S7_S3 0 c_fl_M_S7_S3 9 -50 200 /end AXIS_PTS
/begin AXIS_PTS KL_TFC_K0_ZUS_X "X-Achse: c_getriebe_egs_in" 0x26CE4C c_getriebe_egs_in FLOAT32_IEEE_X_INCR_DIRECT_M_S7_S3 0 c_fl_M_S7_S3 9 -50 200 /end AXIS_PTS
/begin AXIS_PTS KL_TVMSTOERK0EMFIL_ZUS_X "Verzoegerungszeit nach Beginn der K0 Befuellung zur Aktivierung der Filterung des K0-Stoermoments der EM-Ansteuerung beim Zustart in Abhaengigkeit der Getriebeoeltemperatur" 0x26CEBC c_getriebe_egs_in FLOAT32_IEEE_X_INCR_DIRECT_M_S7_S3 0 c_fl_M_S7_S3 8 -3.40282E+038 3.40282E+038 /end AXIS_PTS
/begin AXIS_PTS KL_TVSTATUSPSYSEM_LP3_HAS_X "Verzoegerungszeit zum Setzten des Leistungspunkts 2 der Oelversorgung aus EM-Drehzahl in Abhaengigkeit der Getrieboeltemperatur" 0x264870 c_getriebe_egs_in SWORD_X_INCR_DIRECT_M_S7_S3 0 c_int_v_M_S7_S3 8 -40 215 /end AXIS_PTS
/begin AXIS_PTS KL_VDSFDDAERK1_RSE_HAS_X "Fzg-Geschwindigkeit ueber Grund" 0x264810 v_f_ref_in FLOAT32_IEEE_X_INCR_DIRECT_M_S7_S3 0 v_fl_M_S7_S3 6 0 500 /end AXIS_PTS
/begin AXIS_PTS KL_VDSFDDAERK2_RSE_HAS_X "Fzg-Geschwindigkeit ueber Grund" 0x264840 v_f_ref_in FLOAT32_IEEE_X_INCR_DIRECT_M_S7_S3 0 v_fl_M_S7_S3 6 0 500 /end AXIS_PTS
/begin AXIS_PTS KL_ZMSOLLEMAKTIVSTKFL_ZUS_X "Festlegung der Bedingung zur Aktivierung der Maximalzeit der Ausgabe des EM-Sollmoments beim Zustart in Abhaengigkeit des Status Kraftfluss" 0x26F199 status_kraftfluss_egs_in UBYTE_X_INCR_DIRECT_M_S7_S3 0 sts_int_M_S7_S3 7 0 255 /end AXIS_PTS
/begin AXIS_PTS KL_ZVMSTARTABLVAR_SST_BFI_HAS_X "Festlegung der VM-Startanforderung in Abhaengigkeit der Ablaufvariante der HAS innerhalb der Funktion zur Beeinflussung der IEP durch die HAS bei SST-Betaetigung" 0x26438C z_ablaufvariante_has_stg UBYTE_X_INCR_DIRECT_M_S7_S3 0 sts_int_M_S7_S3 8 0 99 /end AXIS_PTS
/begin AXIS_PTS KL_ZVMSTARTVOREIL_SST_BFI_HAS_X "Festlegung der voreilenden VM-Startanforderung in Abhaengigkeit der Ablaufvariante der HST innerhalb der Funktion zur Beeinflussung der IEP durch die HAS bei SST-Betaetigung" 0x26439C z_ablaufvariante_has_hst_in UBYTE_X_INCR_DIRECT_M_S7_S3 0 sts_int_M_S7_S3 8 0 99 /end AXIS_PTS
/begin MEASUREMENT abstellpos_vm_in "Abstellposition VM vor naechstem ZOT" UWORD void_int_c_M_S7_S3 1 100 0 360 ECU_ADDRESS 0xFFF86784 /end MEASUREMENT
/begin MEASUREMENT abstellpos_vm_status_in "Status Abstellposition VM" UBYTE void_int_M_S7_S3 1 100 0 2 ECU_ADDRESS 0xFFF86CC5 /end MEASUREMENT
/begin MEASUREMENT analyse_has_sbe "Bestimmung der Monitoring-Variante fuer die MVG VM-Start " UBYTE void_int_M_S7_S3 1 100 0 8 ECU_ADDRESS 0xFFF86C73 /end MEASUREMENT
/begin MEASUREMENT bErrorHybrid "Anforderung der Strategieanpassung, die Zustandssteuerung (OML) im Error-Modus zu betreiben" UBYTE sts_int_M_S7_S3 1 100 0 1 ECU_ADDRESS 0xFFF86C80 /end MEASUREMENT
/begin MEASUREMENT bExceptionHybrid "Anforderung der Strategieanpassung, die Zustandssteuerung (OML) im Exception-Modus zu betreiben" UBYTE sts_int_M_S7_S3 1 100 0 1 ECU_ADDRESS 0xFFF86C81 /end MEASUREMENT
/begin MEASUREMENT bremspedal_in "Signal Bremsschalter" UBYTE E_BREMSPED_M_S7_S3 1 100 0 1 ECU_ADDRESS 0xFFF86C9B /end MEASUREMENT
/begin MEASUREMENT c_getriebe_egs_in "" FLOAT32_IEEE c_int_M_S7_S3 1 100 -40 215 ECU_ADDRESS 0xFFF86214 /end MEASUREMENT
/begin MEASUREMENT c_umgebung_in "Aussentemperatur gefiltert" FLOAT32_IEEE c_fl_M_S7_S3 1 100 -40 85 ECU_ADDRESS 0xFFF86284 /end MEASUREMENT
/begin MEASUREMENT c_vm_in "" FLOAT32_IEEE c_fl_M_S7_S3 1 100 -3.40282E+038 3.40282E+038 ECU_ADDRESS 0xFFF86288 /end MEASUREMENT
/begin MEASUREMENT drehrichtung_nab_in "Drehrichtung Abtriebsdrehzahl" UBYTE E_DREHRICH_M_S7_S3 1 100 0 2 ECU_ADDRESS 0xFFF86C9C /end MEASUREMENT
/begin MEASUREMENT drehrichtung_nem_in "Drehrichtung der E-Maschine" UBYTE E_DREHRICH_M_S7_S3 1 100 0 2 ECU_ADDRESS 0xFFF86C9D /end MEASUREMENT
/begin MEASUREMENT fpw_in "Prozent Fahrpedalstellung" UBYTE rel_int_M_S7_S3 1 100 0 255 ECU_ADDRESS 0xFFF86C9E /end MEASUREMENT
/begin MEASUREMENT gangwechsel_egs_in "Flag waehrend laufender Schaltung, bei synchron verlassen bis synchron erreicht" UBYTE void_int_M_S7_S3 1 100 0 1 ECU_ADDRESS 0xFFF86C9F /end MEASUREMENT
/begin MEASUREMENT i_gang_lev2_egs_in "Uebergabe der aktuellen Ganguebersetzung i_gang nach ASILB ermittelt aus den Kupplungsstroemen" FLOAT32_IEEE void_fl_M_S7_S3 1 100 -3.40282E+038 3.40282E+038 ECU_ADDRESS 0xFFF86218 /end MEASUREMENT
/begin MEASUREMENT i_istgang_egs "Uebersetzung des aktuellen Gangs" FLOAT32_IEEE ratio_fl_M_S7_S3 1 100 0 8 ECU_ADDRESS 0xFFF861B4 /end MEASUREMENT
/begin MEASUREMENT i_zielgang_egs "Uebersetzung des Zielgangs" FLOAT32_IEEE ratio_fl_M_S7_S3 1 100 0 8 ECU_ADDRESS 0xFFF861B8 /end MEASUREMENT
/begin MEASUREMENT istgang_egs_begr_svh "Begrenzter Ist-Gang der Schaltverhinderung der HAS" SBYTE sts_int_M_S7_S3 1 100 -128 127 ECU_ADDRESS 0xFFF9841F /end MEASUREMENT
/begin MEASUREMENT istgang_egs_in "" SBYTE void_int_M_S7_S3 1 100 -128 127 ECU_ADDRESS 0xFFF86CA0 /end MEASUREMENT
/begin MEASUREMENT k_mstoerk0em_zus "Faktor zur Modifikation des K0-Stoermoments zur Bestimmung des EM-Vorsteuermoments beim Zustart" FLOAT32_IEEE void_fl_M_S7_S3 1 100 0 2 ECU_ADDRESS 0xFFF86084 /end MEASUREMENT
/begin MEASUREMENT kolbenpos_k0_in "" FLOAT32_IEEE sts_fl_M_S7_S3 1 100 -3.40282E+038 3.40282E+038 ECU_ADDRESS 0xFFF8621C /end MEASUREMENT
/begin MEASUREMENT m_em_in "" FLOAT32_IEEE trq_fl_a_M_S7_S3 1 100 -1024 1024 ECU_ADDRESS 0xFFF86220 /end MEASUREMENT
/begin MEASUREMENT m_iae_in "" FLOAT32_IEEE trq_fl_a_M_S7_S3 1 100 -32768 32767 ECU_ADDRESS 0xFFF86224 /end MEASUREMENT
/begin MEASUREMENT m_k0_has_sbe "K0 Istmoment der Funktion Bestimmung des K0 Istmoments der HAS" FLOAT32_IEEE trq_fl_a_M_S7_S3 1 100 -1000 1000 ECU_ADDRESS 0xFFF861EC /end MEASUREMENT
/begin MEASUREMENT m_k0_in "" FLOAT32_IEEE trq_fl_a_M_S7_S3 1 100 -32768 32767 ECU_ADDRESS 0xFFF86228 /end MEASUREMENT
/begin MEASUREMENT m_k0_mber_has_sbe "K0-Moment der HAS zur Motormomentbegrenzung in der SAB" FLOAT32_IEEE trq_fl_a_M_S7_S3 1 100 -3.40282E+038 3.40282E+038 ECU_ADDRESS 0xFFF861F0 /end MEASUREMENT
/begin MEASUREMENT m_k0_mod_has_fkt "" FLOAT32_IEEE trq_fl_a_M_S7_S3 1 100 -1200 1200 ECU_ADDRESS 0xFFF86184 /end MEASUREMENT
/begin MEASUREMENT m_max_dyn_em_in "" FLOAT32_IEEE trq_fl_a_M_S7_S3 1 100 -3.40282E+038 3.40282E+038 ECU_ADDRESS 0xFFF8622C /end MEASUREMENT
/begin MEASUREMENT m_max_em_has_fkt "" FLOAT32_IEEE trq_fl_a_M_S7_S3 1 100 -1200 1200 ECU_ADDRESS 0xFFF86188 /end MEASUREMENT
/begin MEASUREMENT m_max_iae_has_fkt "" FLOAT32_IEEE trq_fl_a_M_S7_S3 1 100 -1200 1200 ECU_ADDRESS 0xFFF8618C /end MEASUREMENT
/begin MEASUREMENT m_min_dyn_em_in "" FLOAT32_IEEE trq_fl_a_M_S7_S3 1 100 -3.40282E+038 3.40282E+038 ECU_ADDRESS 0xFFF86230 /end MEASUREMENT
/begin MEASUREMENT m_min_em_has_fkt "" FLOAT32_IEEE trq_fl_a_M_S7_S3 1 100 -1200 1200 ECU_ADDRESS 0xFFF86190 /end MEASUREMENT
/begin MEASUREMENT m_min_vm_in "" FLOAT32_IEEE trq_fl_a_M_S7_S3 1 100 -3.40282E+038 3.40282E+038 ECU_ADDRESS 0xFFF8628C /end MEASUREMENT
/begin MEASUREMENT m_mot_in "" FLOAT32_IEEE trq_fl_a_M_S7_S3 1 100 -1024 1024 ECU_ADDRESS 0xFFF86234 /end MEASUREMENT
/begin MEASUREMENT m_motmax_has_sbe "Maximal zulaessiges Motormoment des Gefuehrten Getriebeschutz der HAS" FLOAT32_IEEE trq_fl_a_M_S7_S3 1 100 -5000 5000 ECU_ADDRESS 0xFFF861F4 /end MEASUREMENT
/begin MEASUREMENT m_soll_em_has_fkt "" FLOAT32_IEEE trq_fl_a_M_S7_S3 1 100 -1200 1200 ECU_ADDRESS 0xFFF86194 /end MEASUREMENT
/begin MEASUREMENT m_soll_em_hst_in "" FLOAT32_IEEE trq_fl_a_M_S7_S3 1 100 -32768 32767 ECU_ADDRESS 0xFFF86238 /end MEASUREMENT
/begin MEASUREMENT m_soll_k0_has_fkt "" FLOAT32_IEEE trq_fl_a_M_S7_S3 1 100 -1200 1200 ECU_ADDRESS 0xFFF86198 /end MEASUREMENT
/begin MEASUREMENT m_soll_k0_has_sbe "K0 Sollmoment der Bestimmung des K0 Sollmoments der HAS" FLOAT32_IEEE trq_fl_a_M_S7_S3 1 100 -1000 1000 ECU_ADDRESS 0xFFF861F8 /end MEASUREMENT
/begin MEASUREMENT m_soll_k0_min_uvs_zus "Minimalwert des K0 Sollmoment bei Anforderung einer K0-Unterstuetzung des VM Startsystems durch die HAS Zustandssteuerung (OML) beim VM Zustart" FLOAT32_IEEE trq_fl_a_M_S7_S3 1 100 -1000 1000 ECU_ADDRESS 0xFFF8608C /end MEASUREMENT
/begin MEASUREMENT m_soll_k0_min_uvs_zus__int "Integer Messstelle von m_soll_k0_min_uvs_zus" SWORD trq_int_M_S7_S3 1 100 -1000 1000 ECU_ADDRESS 0xFFF866EC /end MEASUREMENT
/begin MEASUREMENT m_soll_res_em_bas_sbe "Basis-Reservemoment fuer den VM-Start" FLOAT32_IEEE trq_fl_a_M_S7_S3 1 100 -3.40282E+038 3.40282E+038 ECU_ADDRESS 0xFFF861FC /end MEASUREMENT
/begin MEASUREMENT m_soll_res_em_has_fkt "" FLOAT32_IEEE trq_fl_a_M_S7_S3 1 100 -1200 1200 ECU_ADDRESS 0xFFF8619C /end MEASUREMENT
/begin MEASUREMENT m_soll_res_em_has_sbe "Reservemoment fuer den VM-Start" FLOAT32_IEEE trq_fl_a_M_S7_S3 1 100 -3.40282E+038 3.40282E+038 ECU_ADDRESS 0xFFF86200 /end MEASUREMENT
/begin MEASUREMENT m_soll_vm_hst_in "" FLOAT32_IEEE trq_fl_a_M_S7_S3 1 100 -32768 32767 ECU_ADDRESS 0xFFF8623C /end MEASUREMENT
/begin MEASUREMENT m_soll_vm_l_hst_in "" FLOAT32_IEEE trq_fl_a_M_S7_S3 1 100 -3.40282E+038 3.40282E+038 ECU_ADDRESS 0xFFF86290 /end MEASUREMENT
/begin MEASUREMENT m_stoerk0em_fil_zus "Gefiltertes K0-Stoermoment zur Bestimmung des EM-Vorsteuermoments beim Zustart" FLOAT32_IEEE trq_fl_a_M_S7_S3 1 100 -1000 1000 ECU_ADDRESS 0xFFF86090 /end MEASUREMENT
/begin MEASUREMENT m_stoerk0em_fil_zus__int "Integer Messstelle von m_stoerk0em_fil_zus" SWORD trq_int_M_S7_S3 1 100 -1000 1000 ECU_ADDRESS 0xFFF866EE /end MEASUREMENT
/begin MEASUREMENT m_stoerk0em_zus "Ungefiltertes K0-Stoermoments zur Bestimmung des EM-Vorsteuermoments beim Zustart" FLOAT32_IEEE trq_fl_a_M_S7_S3 1 100 -1000 1000 ECU_ADDRESS 0xFFF86094 /end MEASUREMENT
/begin MEASUREMENT m_vm_in "" FLOAT32_IEEE trq_fl_a_M_S7_S3 1 100 -1024 1023.5 ECU_ADDRESS 0xFFF86240 /end MEASUREMENT
/begin MEASUREMENT m_vm_start_in "" FLOAT32_IEEE trq_fl_a_M_S7_S3 1 100 -1024 1023.5 ECU_ADDRESS 0xFFF86244 /end MEASUREMENT
/begin MEASUREMENT m_wunsch_fpw_hst_fil "Gefiltertes Wunschmoment" FLOAT32_IEEE trqg_fl_k_M_S7_S3 1 100 -2000 2000 ECU_ADDRESS 0xFFF861BC /end MEASUREMENT
/begin MEASUREMENT m_wunsch_fpw_hst_fil_azg "AZG-Groesse fuer m_wunsch_fpw_hst_fil" SWORD trq_int_M_S7_S3 1 100 -32768 32767 ECU_ADDRESS 0xFFF984E4 /end MEASUREMENT
/begin MEASUREMENT m_wunsch_fpw_hst_in "" FLOAT32_IEEE trq_fl_a_M_S7_S3 1 100 -3.40282E+038 3.40282E+038 ECU_ADDRESS 0xFFF86294 /end MEASUREMENT
/begin MEASUREMENT m_wunsch_fpw_in "" FLOAT32_IEEE trq_fl_a_M_S7_S3 1 100 -32768 32767 ECU_ADDRESS 0xFFF86248 /end MEASUREMENT
/begin MEASUREMENT m_ziel_k0_hst_in "Target torque of K0 sent by ECU" FLOAT32_IEEE trq_fl_a_M_S7_S3 1 100 -1000 2000 ECU_ADDRESS 0xFFF8624C /end MEASUREMENT
/begin MEASUREMENT m_ziel_k0_min_syn_zus "Minimalwert des  Zielmoment der Trennkupplung K0 zur Realisierung des Fahrerwunschmoments beim K0 Synchronisieren beim Zustart" FLOAT32_IEEE trq_fl_a_M_S7_S3 1 100 -1000 1000 ECU_ADDRESS 0xFFF86098 /end MEASUREMENT
/begin MEASUREMENT m_ziel_k0_zus "Zielmoment der Trennkupplung K0 beim Zustart" FLOAT32_IEEE trq_fl_a_M_S7_S3 1 100 -1000 1000 ECU_ADDRESS 0xFFF8609C /end MEASUREMENT
/begin MEASUREMENT m_ziel_vm_has_zus "Zielmoment des VM bei Zustart" FLOAT32_IEEE trq_fl_a_M_S7_S3 1 100 -1000 1000 ECU_ADDRESS 0xFFF860A0 /end MEASUREMENT
/begin MEASUREMENT m_ziel_vm_has_zus__int "Integer Messstelle von m_ziel_vm_has_zus" SWORD trq_int_M_S7_S3 1 100 -1000 1000 ECU_ADDRESS 0xFFF866F2 /end MEASUREMENT
/begin MEASUREMENT mg_mot_in "Gradient des Getriebeeingangsmoment" FLOAT32_IEEE trqg_fl_k_M_S7_S3 1 100 -2000 2000 ECU_ADDRESS 0xFFF861C0 /end MEASUREMENT
/begin MEASUREMENT mg_soll_k0_has_fkt "" FLOAT32_IEEE trqg_fl_k_M_S7_S3 1 100 -3000 3000 ECU_ADDRESS 0xFFF861A0 /end MEASUREMENT
/begin MEASUREMENT mg_wunsch_fpw_hst_in "Gradient des gefilterten oder koordinierten Fahrerwunschmoments aus Fahrpedalinterpretation" FLOAT32_IEEE trqg_fl_k_M_S7_S3 1 100 -2000 2000 ECU_ADDRESS 0xFFF861C4 /end MEASUREMENT
/begin MEASUREMENT mg_wunsch_fpw_in "Gradient des Fahrerwunschmoments aus Fahrpedalinterpretation" FLOAT32_IEEE trqg_fl_k_M_S7_S3 1 100 -2000 2000 ECU_ADDRESS 0xFFF861C8 /end MEASUREMENT
/begin MEASUREMENT mo_k0befuell_zus "Momentoffset aus der K0-Erfuellung" FLOAT32_IEEE trq_fl_a_M_S7_S3 1 100 -1000 1000 ECU_ADDRESS 0xFFF860B0 /end MEASUREMENT
/begin MEASUREMENT mo_k0befuell_zus__int "Integer Messstelle von mo_k0befuell_zus" SWORD trq_int_M_S7_S3 1 100 -1000 1000 ECU_ADDRESS 0xFFF866F4 /end MEASUREMENT
/begin MEASUREMENT modus_e_fahren_hst_in "Electric driving mode concerning state of charging mode of high voltage battery" UBYTE E_MODUSEFAH_M_S7_S3 1 100 0 1 ECU_ADDRESS 0xFFF86CC6 /end MEASUREMENT
/begin MEASUREMENT modus_e_fahren_zus "Anzeige des E-Fahr-Modus des Hybridsystems beim Zustart" UBYTE E_MODUSEFAH_M_S7_S3 1 100 0 1 ECU_ADDRESS 0xFFF86B68 /end MEASUREMENT
/begin MEASUREMENT ms_wunschfpw_lastanh_svh "Schwellwert des Fahrerwunschmoments zur Bestimmung des Zustands Lastanhebung der Schaltverhinderung der HAS" FLOAT32_IEEE trq_fl_a_M_S7_S3 1 100 -3.40282E+038 3.40282E+038 ECU_ADDRESS 0xFFF9832C /end MEASUREMENT
/begin MEASUREMENT n_ab_egs_in "" FLOAT32_IEEE n_fl_M_S7_S3 1 100 0 65535 ECU_ADDRESS 0xFFF86250 /end MEASUREMENT
/begin MEASUREMENT n_em_in "" FLOAT32_IEEE n_fl_M_S7_S3 1 100 -3.40282E+038 3.40282E+038 ECU_ADDRESS 0xFFF86254 /end MEASUREMENT
/begin MEASUREMENT n_em_verz "Verzoegerte EM-Drehzahl zur Bestimmung der K0_Differenzdrehlzahl" FLOAT32_IEEE n_fl_M_S7_S3 1 100 0 10000 ECU_ADDRESS 0xFFF98330 /end MEASUREMENT
/begin MEASUREMENT n_min_em_has_sbe "Minimale EM Drehzahl der Leerlaufsimulation der HAS (LLS)" FLOAT32_IEEE n_fl_M_S7_S3 1 100 -32767 32767 ECU_ADDRESS 0xFFF86204 /end MEASUREMENT
/begin MEASUREMENT n_min_em_psys_lp3_has_sbe "Mindestdrehzahl der EM zur Sicherstellung des Leistungspunkt 3 der Bestimmung des Status Systemdruck der HAS" FLOAT32_IEEE n_fl_M_S7_S3 1 100 0 10000 ECU_ADDRESS 0xFFF861CC /end MEASUREMENT
/begin MEASUREMENT n_mot_soll_iae_in "" FLOAT32_IEEE n_fl_M_S7_S3 1 100 -3.40282E+038 3.40282E+038 ECU_ADDRESS 0xFFF86258 /end MEASUREMENT
/begin MEASUREMENT n_sec_iae "Sekundaere IAE-Drehzahl" FLOAT32_IEEE n_fl_M_S7_S3 1 100 -10000 10000 ECU_ADDRESS 0xFFF861D0 /end MEASUREMENT
/begin MEASUREMENT n_sec_iae_ist_zus "Abtriebsseitige IAE-Drehzahl bezogen auf den Getriebeeeingang und den aktuellen  Istgang waehrend einer Schaltung beim Zustart" FLOAT32_IEEE n_fl_M_S7_S3 1 100 0 10000 ECU_ADDRESS 0xFFF860C0 /end MEASUREMENT
/begin MEASUREMENT n_sec_iae_ist_zus__int "Integer Messstelle von n_sec_iae_ist_zus" SWORD n_int_M_S7_S3 1 100 0 10000 ECU_ADDRESS 0xFFF866F6 /end MEASUREMENT
/begin MEASUREMENT n_sec_iae_mod "Sekundaerdrehzahl IAE" FLOAT32_IEEE n_fl_M_S7_S3 1 100 -3.40282E+038 3.40282E+038 ECU_ADDRESS 0xFFF98334 /end MEASUREMENT
/begin MEASUREMENT n_sec_iae_ziel_zus "Abtriebsseitige IAE Zieldrehzahl bezogen auf den Getriebeeingang waehrend einer Schaltung beim Zustart" FLOAT32_IEEE n_fl_M_S7_S3 1 100 0 10000 ECU_ADDRESS 0xFFF860C4 /end MEASUREMENT
/begin MEASUREMENT n_sec_iae_ziel_zus__int "Integer Messstelle von n_sec_iae_ziel_zus" SWORD n_int_M_S7_S3 1 100 0 10000 ECU_ADDRESS 0xFFF866F8 /end MEASUREMENT
/begin MEASUREMENT n_soll_em_has_fkt "" FLOAT32_IEEE n_fl_M_S7_S3 1 100 0 8000 ECU_ADDRESS 0xFFF861A4 /end MEASUREMENT
/begin MEASUREMENT n_soll_em_hst_in "" FLOAT32_IEEE n_fl_M_S7_S3 1 100 -3.40282E+038 3.40282E+038 ECU_ADDRESS 0xFFF86298 /end MEASUREMENT
/begin MEASUREMENT n_soll_ll_vm_in "" FLOAT32_IEEE n_fl_M_S7_S3 1 100 0 2540 ECU_ADDRESS 0xFFF8625C /end MEASUREMENT
/begin MEASUREMENT n_soll_vm_has_fkt "" FLOAT32_IEEE n_fl_M_S7_S3 1 100 0 8000 ECU_ADDRESS 0xFFF861A8 /end MEASUREMENT
/begin MEASUREMENT n_t_egs_in "" FLOAT32_IEEE n_fl_M_S7_S3 1 100 0 65535 ECU_ADDRESS 0xFFF86260 /end MEASUREMENT
/begin MEASUREMENT n_vm_in "" FLOAT32_IEEE n_fl_M_S7_S3 1 100 0 65535 ECU_ADDRESS 0xFFF86264 /end MEASUREMENT
/begin MEASUREMENT n_vm_verz "Verzoegerte VM-Drehzahl zur Bestimmung der K0_Differenzdrehlzahl" FLOAT32_IEEE n_fl_M_S7_S3 1 100 0 10000 ECU_ADDRESS 0xFFF98338 /end MEASUREMENT
/begin MEASUREMENT nd_k0_in "Differenzdrehzahl der Trennkupplung" FLOAT32_IEEE n_fl_M_S7_S3 1 100 -10000 10000 ECU_ADDRESS 0xFFF861D4 /end MEASUREMENT
/begin MEASUREMENT nd_min_saf_has_fkt "Anforderung min. Drehzahlsprung an ASIS" FLOAT32_IEEE n_fl_M_S7_S3 1 100 0 8000 ECU_ADDRESS 0xFFF861AC /end MEASUREMENT
/begin MEASUREMENT nd_soll_iae_fkt "Differenzdrehzahl der Anfahrkupplung" FLOAT32_IEEE ng_fl_M_S7_S3 1 100 -8000 8000 ECU_ADDRESS 0xFFF861B0 /end MEASUREMENT
/begin MEASUREMENT ndg_k0_in "Gradienten der Differenzdrehzahl der Trennkupplung" FLOAT32_IEEE ng_fl_M_S7_S3 1 100 -10000 10000 ECU_ADDRESS 0xFFF861D8 /end MEASUREMENT
/begin MEASUREMENT ng_em_zus "EM-Drehzahlgradient beim Zustart" FLOAT32_IEEE ng_fl_M_S7_S3 1 100 -10000 10000 ECU_ADDRESS 0xFFF860D0 /end MEASUREMENT
/begin MEASUREMENT ng_em_zus__int "Integer Messstelle von ng_em_zus" SWORD ng_int_M_S7_S3 1 100 -10000 10000 ECU_ADDRESS 0xFFF866FA /end MEASUREMENT
/begin MEASUREMENT ng_vm_in "Gradient der VM Drehzahl" FLOAT32_IEEE ng_fl_M_S7_S3 1 100 -10000 10000 ECU_ADDRESS 0xFFF861DC /end MEASUREMENT
/begin MEASUREMENT osmode_next_in "" UBYTE sts_int_M_S7_S3 1 100 0 255 ECU_ADDRESS 0xFFF86CA1 /end MEASUREMENT
/begin MEASUREMENT p_bremse_fzg_in "" FLOAT32_IEEE p_fl_M_S7_S3 1 100 0 127 ECU_ADDRESS 0xFFF86268 /end MEASUREMENT
/begin MEASUREMENT phi_neigung_in "" FLOAT32_IEEE phigrad_fl_M_S7_S3 1 100 -3.40282E+038 3.40282E+038 ECU_ADDRESS 0xFFF8626C /end MEASUREMENT
/begin MEASUREMENT pos_egs_in "Waehlhebelposition" UBYTE E_POS_M_S7_S3 1 100 0 8 ECU_ADDRESS 0xFFF86CA2 /end MEASUREMENT
/begin MEASUREMENT schalt_mode_egs_in "" UWORD void_int_c_M_S7_S3 1 100 0 65535 ECU_ADDRESS 0xFFF86780 /end MEASUREMENT
/begin MEASUREMENT soc_in "Interface provides state of charge of high-voltage battery" UBYTE rel_int_M_S7_S3 1 100 0 100 ECU_ADDRESS 0xFFF86CC7 /end MEASUREMENT
/begin MEASUREMENT sollgang_egs_in "" SBYTE void_int_M_S7_S3 1 100 -128 127 ECU_ADDRESS 0xFFF86CA3 /end MEASUREMENT
/begin MEASUREMENT st_ablauf_fkt "Phase des Ablauf" UWORD st_int_g_M_S7_S3 1 100 0 65535 ECU_ADDRESS 0xFFF86774 /end MEASUREMENT
/begin MEASUREMENT st_ist_bz_has_stg "Istzustand OML" UBYTE E_STBZHAS_M_S7_S3 1 100 0 15 ECU_ADDRESS 0xFFF86C55 /end MEASUREMENT
/begin MEASUREMENT st_ist_bz_hst_sta "Ist-Betriebszustand aus der Startegieanpassung als Eingangsgroesse der Hybridzustandssteuerung (OML)" UBYTE E_STBZHAS_M_S7_S3 1 100 0 15 ECU_ADDRESS 0xFFF86C82 /end MEASUREMENT
/begin MEASUREMENT st_ist_hcomd_has_stg "Innere Zustaende der OML" UWORD st_int_g_M_S7_S3 1 100 0 4999 ECU_ADDRESS 0xFFF86772 /end MEASUREMENT
/begin MEASUREMENT st_soll_bz_has_hst "interner HST Soll-Betriebszustand der Strategieanpassung (variantenunabhaengig)" UBYTE sts_int_M_S7_S3 1 100 0 15 ECU_ADDRESS 0xFFF86C83 /end MEASUREMENT
/begin MEASUREMENT st_soll_bz_hst_sta "Soll-Betriebszustand aus der Strategieanpassung als Eingangsgroesse der Hybrid-Zustandssteuerung (OML)" UBYTE E_STBZHAS_M_S7_S3 1 100 0 15 ECU_ADDRESS 0xFFF86C84 /end MEASUREMENT
/begin MEASUREMENT st_ziel_bz_has_stg "Zielzustand OML" UBYTE E_STBZHAS_M_S7_S3 1 100 0 15 ECU_ADDRESS 0xFFF86C56 /end MEASUREMENT
/begin MEASUREMENT status_ablauf_has_fkt "" UBYTE sts_int_M_S7_S3 1 100 0 50 ECU_ADDRESS 0xFFF86C5A /end MEASUREMENT
/begin MEASUREMENT status_abs_in "Information, ob aktuell ein Eingriff durch das ABS System vorgenommen wird" UBYTE E_STATUSABS_M_S7_S3 1 100 0 2 ECU_ADDRESS 0xFFF86CC8 /end MEASUREMENT
/begin MEASUREMENT status_alaengs_adaoff_in "Information, ob die Adaptionen aufgrund erkannter Laengsbeschleunigung deaktiviert wird. 0 = Adaption aktiv aufgrund erkannter Laengsbeschleunigung
1 = Adaption inaktiv aufgrund nicht erkannter Laengsbeschleunigung" UBYTE sts_int_M_S7_S3 1 100 0 1 ECU_ADDRESS 0xFFF86CA4 /end MEASUREMENT
/begin MEASUREMENT status_asr_in "Information, ob ein Regeleingriff durch ein Assistenzsystem (ESP, ASR) vorliegt" UBYTE E_STATUSASR_M_S7_S3 1 100 0 1 ECU_ADDRESS 0xFFF86CC9 /end MEASUREMENT
/begin MEASUREMENT status_autohold_in "Status der Systeme zur Fahrzeug- Rollverhinderung" UBYTE E_STATUSNAA_M_S7_S3 1 100 0 1 ECU_ADDRESS 0xFFF86CA5 /end MEASUREMENT
/begin MEASUREMENT status_betriebsbereit_hst_in "" UBYTE sts_int_M_S7_S3 1 100 0 1 ECU_ADDRESS 0xFFF86CCA /end MEASUREMENT
/begin MEASUREMENT status_c_k0_in "Interface returns information concerning energy balance of clutch 0" UBYTE E_STATUSCK0_M_S7_S3 1 100 0 2 ECU_ADDRESS 0xFFF86CA6 /end MEASUREMENT
/begin MEASUREMENT status_cumgebung_in "Statusinformation in GET_CKB_TOUT" UBYTE E_SIGSTATUS_M_S7_S3 1 100 0 2 ECU_ADDRESS 0xFFF86CCB /end MEASUREMENT
/begin MEASUREMENT status_efahren_has_sbe "Status E-Fahren der HAS zur Festlegung der entsprechenden Portout-Groesse in der HAS Signalaufbereitung_Out" UBYTE sts_int_M_S7_S3 1 100 0 1 ECU_ADDRESS 0xFFF86C74 /end MEASUREMENT
/begin MEASUREMENT status_fehler_iep_in "" UBYTE E_FEHLERIEP_M_S7_S3 1 100 0 1 ECU_ADDRESS 0xFFF86CA7 /end MEASUREMENT
/begin MEASUREMENT status_getrbereit_in "Status des hydraulischen Drucks des Getriebes" UBYTE sts_int_M_S7_S3 1 100 0 255 ECU_ADDRESS 0xFFF86CCC /end MEASUREMENT
/begin MEASUREMENT status_hillhold_in "Status der Systeme zur Fahrzeug- Rollverhinderung" UBYTE E_STATUSNAA_M_S7_S3 1 100 0 1 ECU_ADDRESS 0xFFF86CA8 /end MEASUREMENT
/begin MEASUREMENT status_iae_adap_in "Status der Adaption des Integrierten Anfahrelements IAE" UBYTE E_STATUSADA_M_S7_S3 1 100 0 2 ECU_ADDRESS 0xFFF86CA9 /end MEASUREMENT
/begin MEASUREMENT status_iae_in "" UBYTE E_STATUSIAE_M_S7_S3 1 100 0 8 ECU_ADDRESS 0xFFF86CAA /end MEASUREMENT
/begin MEASUREMENT status_iep_in "" UBYTE E_STATUSIEP_M_S7_S3 1 100 0 4 ECU_ADDRESS 0xFFF86CAB /end MEASUREMENT
/begin MEASUREMENT status_k0_adap_in "" UBYTE E_STATUSADA_M_S7_S3 1 100 0 2 ECU_ADDRESS 0xFFF86CAC /end MEASUREMENT
/begin MEASUREMENT status_k0_adap_zaehler_in "Zaehler k0 adaption" UBYTE void_int_M_S7_S3 1 100 0 255 ECU_ADDRESS 0xFFF86CAD /end MEASUREMENT
/begin MEASUREMENT status_k0_befuellung_in "Interface provides the current filling mode of clutch 0" UBYTE E_STAK0BEF_M_S7_S3 1 100 0 3 ECU_ADDRESS 0xFFF86CAE /end MEASUREMENT
/begin MEASUREMENT status_k0_in "" UBYTE E_STATUSK0_M_S7_S3 1 100 0 5 ECU_ADDRESS 0xFFF86CAF /end MEASUREMENT
/begin MEASUREMENT status_kl15_in "" UBYTE sts_int_M_S7_S3 1 100 0 1 ECU_ADDRESS 0xFFF86CCD /end MEASUREMENT
/begin MEASUREMENT status_kraftfluss_egs_in "" UBYTE E_STATUSKSL_M_S7_S3 1 100 0 6 ECU_ADDRESS 0xFFF86CB0 /end MEASUREMENT
/begin MEASUREMENT status_kraftfluss_lev2_egs_in "Power flow (controled) information concerning ASIL B" UBYTE sts_int_M_S7_S3 1 100 0 2 ECU_ADDRESS 0xFFF86CB1 /end MEASUREMENT
/begin MEASUREMENT status_lastanh_svh "Zustand Lastanhebung der Schaltverhinderung der HAS - TRUE = Lastanhebung bzw. Responsestart, FALSE = keine Lastanhebung bzw. Komfortstart" UBYTE sts_int_e_M_S7_S3 1 100 0 1 ECU_ADDRESS 0xFFF98420 /end MEASUREMENT
/begin MEASUREMENT status_ll_vm_in "" UBYTE sts_int_M_S7_S3 1 100 0 255 ECU_ADDRESS 0xFFF86CB2 /end MEASUREMENT
/begin MEASUREMENT status_nem_in "Status zur Drehzahl E-Motor" UBYTE E_SIGSTATUS_M_S7_S3 1 100 0 2 ECU_ADDRESS 0xFFF86CB3 /end MEASUREMENT
/begin MEASUREMENT status_nreg_em_hst_in "" UBYTE sts_int_M_S7_S3 1 100 0 255 ECU_ADDRESS 0xFFF86CCE /end MEASUREMENT
/begin MEASUREMENT status_nvm_in "Status zur Drehzahl VM-Motor" UBYTE E_SIGSTATUS_M_S7_S3 1 100 0 2 ECU_ADDRESS 0xFFF86CB4 /end MEASUREMENT
/begin MEASUREMENT status_posvueb_in "Erkennung PosV Diagnose" UBYTE sts_int_M_S7_S3 1 100 0 255 ECU_ADDRESS 0xFFF86CCF /end MEASUREMENT
/begin MEASUREMENT status_psys_em_has "Anzeige des Status Pumpendruck der Oelversorgung aus EM-Drehzahl der Bestimmung Status Pumpendruck der HAS" UBYTE E_STATUSPSY_M_S7_S3 1 100 0 4 ECU_ADDRESS 0xFFF86A35 /end MEASUREMENT
/begin MEASUREMENT status_psys_em_has_nverz "Anzeige des nicht verzoegerten Status Pumpendruck der Oelversorgung aus EM-Drehzahl der Bestimmung Status Pumpendruck der HAS" UBYTE E_STATUSPSY_M_S7_S3 1 100 0 4 ECU_ADDRESS 0xFFF86A36 /end MEASUREMENT
/begin MEASUREMENT status_psys_has_sbe "Anzeige des Status Pumpendruck der HAS" UBYTE E_STATUSPSY_M_S7_S3 1 100 0 4 ECU_ADDRESS 0xFFF86C6C /end MEASUREMENT
/begin MEASUREMENT status_psys_iep_has "Anzeige des Status Pumpendruck der Oelversorgung mit IEP der Bestimmung Status Pumpendruck der HAS" UBYTE E_STATUSPSY_M_S7_S3 1 100 0 4 ECU_ADDRESS 0xFFF86A37 /end MEASUREMENT
/begin MEASUREMENT status_radschlupf_rse_has_sbe "Anzeige des Status der Radschlupferkennung (RSE) der HAS" UBYTE E_STATUSRSE_M_S7_S3 1 100 0 1 ECU_ADDRESS 0xFFF86C6D /end MEASUREMENT
/begin MEASUREMENT status_rs_anf_svh "Richtung der angeforderten Schaltung der Schaltverhinderung der HAS - TRUE = RS angefordert, FALSE = keine RS angefordert" UBYTE sts_int_M_S7_S3 1 100 0 1 ECU_ADDRESS 0xFFF98421 /end MEASUREMENT
/begin MEASUREMENT status_sa_vm_in "00 Keine Beeinflussung; 01 Schubabschaltung aktiv; 10 Nicht stellbarer Bereich; 11 Signal ungueltig" UBYTE sts_int_e_M_S7_S3 1 100 0 1 ECU_ADDRESS 0xFFF86CD0 /end MEASUREMENT
/begin MEASUREMENT status_schaltanf_fst_svh "Lastzustand der Schaltverhinderung der HAS - TRUE = Zug-Betrieb, FALSE = Schub-Betrieb" SBYTE sts_int_M_S7_S3 1 100 -128 127 ECU_ADDRESS 0xFFF98422 /end MEASUREMENT
/begin MEASUREMENT status_schaltart_svh_has_sbe "Schaltart der angeforderten Schaltung der Schaltverhinderung der HAS (0 = keine Schaltung angefordert) - Bit-Codierung (m/oL = mit/ohne Lastanh.) =  bit0=ZRSmL, 1=ZHSmL, 2=SRSmL, 3=SHSmL, 4=ZRSoL, 5=ZHSoL, 6=SRSoL, 7=SHSoL" UBYTE sts_int_M_S7_S3 1 100 0 255 ECU_ADDRESS 0xFFF86C6E /end MEASUREMENT
/begin MEASUREMENT status_schaltart_zul_svh_has "Status der zulaessigen Schaltart der Schaltverhinderung der HAS (255 = alle Schaltarten zulaessig, 0 = keine Schaltart zulaessig) - Bit-Codierung (m/oL=mit/ohne Lanstanh.)=: bit0=ZRSmL,1=ZHSmL,2=SRSmL,3=SHSmL,4=ZRSoL,5=ZHSoL,6=SRSoL,7=SHSoL" UBYTE sts_int_M_S7_S3 1 100 0 255 ECU_ADDRESS 0xFFF98407 /end MEASUREMENT
/begin MEASUREMENT status_schaltung_egs_in "Anzeige ob Schaltung des Getriebes aktiv ist" SBYTE sts_int_M_S7_S3 1 100 -9 9 ECU_ADDRESS 0xFFF86C6F /end MEASUREMENT
/begin MEASUREMENT status_soc_in "Interface provides status information of soc_in" UBYTE E_SIGSTATUS_M_S7_S3 1 100 0 2 ECU_ADDRESS 0xFFF86CD1 /end MEASUREMENT
/begin MEASUREMENT status_sync_schaltung_sbe "Anzeige der Synchronerkennung der aktuellen Schaltung innerhalb der HAS" UBYTE sts_int_M_S7_S3 1 100 0 1 ECU_ADDRESS 0xFFF86C70 /end MEASUREMENT
/begin MEASUREMENT status_vf_in "Signalstatus fuer die Fahrzeugistgeschwindigkeit  gebildet aus der Getriebe-Abtriebsdrehzahl" UBYTE E_SIGSTATUS_M_S7_S3 1 100 0 2 ECU_ADDRESS 0xFFF86CB5 /end MEASUREMENT
/begin MEASUREMENT status_vfref_in "Signalstatus fuer die Fahrzeuggeschwindigkeit ueber Grund" UBYTE E_SIGSTATUS_M_S7_S3 1 100 0 2 ECU_ADDRESS 0xFFF86CB6 /end MEASUREMENT
/begin MEASUREMENT status_waschstr_in "" UBYTE sts_int_M_S7_S3 1 100 0 255 ECU_ADDRESS 0xFFF86CB7 /end MEASUREMENT
/begin MEASUREMENT status_zug_svh_sbe "Status fuer Anzeige Zug/Schub" UBYTE sts_int_M_S7_S3 1 100 0 1 ECU_ADDRESS 0xFFF98427 /end MEASUREMENT
/begin MEASUREMENT t_aktiv_pvu_has "Timer fuer Zeitraum nach Erkennung der Betriebsbereitschaft des Hybridsystems in dem die Unterstuetzung der Positionsventilueberwachung durch die HAS aktiv ist." UWORD t_int_n_M_S7_S3 1 100 0 5 ECU_ADDRESS 0xFFF984E6 /end MEASUREMENT
/begin MEASUREMENT t_anfmax_pvu_has "Timer fuer den maximaler Zeitraum nach Ueberschreiten der EM-Drehzahlschwelle zur Aktivierung der Ueberwachung durch die Diagnose bei der Unterstuetzung der Positionsventil-Ueberwachung der HAS" UWORD t_int_n_M_S7_S3 1 100 0 5 ECU_ADDRESS 0xFFF86622 /end MEASUREMENT
/begin MEASUREMENT t_betrieb_pvu_has_ee_in "" ULONG t_int_M_S7_S3 1 100 0 10000 ECU_ADDRESS 0xFFF86270 /end MEASUREMENT
/begin MEASUREMENT t_betrieb_pvu_has_sbe "Betriebsdauer seit dem letzten Ablauf der Diagnosefunktion \"Positionsventil-Ueberwachung\" der Funktion zur Unterstuet-zung der Positionsventil-Ueberwachung der HAS" ULONG t_int_M_S7_S3 1 100 0 1000000 ECU_ADDRESS 0xFFF861E0 /end MEASUREMENT
/begin MEASUREMENT t_fak0normiert_zus "Normierte Zeit fuer die K0-Fuellausgleichszeit 0 -100% beim Zustart" FLOAT32_IEEE t_fl_M_S7_S3 1 100 0 200 ECU_ADDRESS 0xFFF860D8 /end MEASUREMENT
/begin MEASUREMENT t_fuellausk0_zus "Aktuelle Zeit einer aktiven Fuellausgleichszeit der K0" UWORD t_int_n_M_S7_S3 1 100 0 5 ECU_ADDRESS 0xFFF866FC /end MEASUREMENT
/begin MEASUREMENT t_max_pvu_has "Timer fuer den maximalen Zeitraum nach Erkennung der Betriebsbereitschaft des Hybridsystems in dem die Unterstuetzung der Positionsventilueberwachung durch die HAS aktiv ist. .
" UWORD t_int_n_M_S7_S3 1 100 0 10 ECU_ADDRESS 0xFFF984E8 /end MEASUREMENT
/begin MEASUREMENT t_msollemaktiv_zus "Timer der Maximalzeit der Vorgabe des K0-Stoermoments und damit der Ausgabe des EM-Vorsteuermoments beim Zustart" UWORD t_int_n_M_S7_S3 1 100 0 10 ECU_ADDRESS 0xFFF86716 /end MEASUREMENT
/begin MEASUREMENT t_mstoerk0emfil_zus "Timer der Verzoegerungszeit nach Beginn der K0 Befuellung zur Aktivierung der Filterung des K0-Stoermoments der EM-Ansteuerung beim Zustart" UWORD t_int_n_M_S7_S3 1 100 0 10 ECU_ADDRESS 0xFFF86718 /end MEASUREMENT
/begin MEASUREMENT t_rueckddaerk_rse_has "Timer zum Ruecksetzen des Radschlupf-Status der Erkennung von durchdrehenden Antriebsraedern der Radschlupferkennung (RSE) der HAS" UWORD t_int_n_M_S7_S3 1 100 0 5 ECU_ADDRESS 0xFFF86624 /end MEASUREMENT
/begin MEASUREMENT t_vstatusiep_aktiv_has "Verzoegerungszeit fuer status_iep_in zur Bestimmung status_psys_iep_has" UWORD t_int_n_M_S7_S3 1 100 0 10 ECU_ADDRESS 0xFFF86626 /end MEASUREMENT
/begin MEASUREMENT t_vstatuspsysem_lp3 "Timer der Verzoegerungszeit zum Setzten des Leistungspunkts 3 der Oelversorgung aus EM-Drehzahl" UWORD t_int_n_M_S7_S3 1 100 0 5 ECU_ADDRESS 0xFFF984EA /end MEASUREMENT
/begin MEASUREMENT t_vsvhreset_svh "Verzoegerungszeit zur Ruecknahme der Schaltverhinderung der HAS nach einem Ablaufs der HAS" UWORD t_int_n_M_S7_S3 1 100 0 2.5 ECU_ADDRESS 0xFFF984DC /end MEASUREMENT
/begin MEASUREMENT t_zielfuellausgleichk0_zus "Max-Zeit einer aktiven Fuellausgleichszeit der K0" UWORD t_int_n_M_S7_S3 1 100 0 5 ECU_ADDRESS 0xFFF86720 /end MEASUREMENT
/begin MEASUREMENT t_ziephasaktiv_bfi "Timer fuer den Zeitraum nach Erkennung der Betriebsbereitschaft des Hybridsystems in dem die Beeinflussung der IEP durch die HAS aktiv ist" UWORD t_int_n_M_S7_S3 1 100 0 5 ECU_ADDRESS 0xFFF984DE /end MEASUREMENT
/begin MEASUREMENT t_ziephasmax_bfi "Timer fuer den maximaler Zeitraum nach Erkennung der Betriebsbereitschaft des Hybridsystems in dem die Beeinflussung der IEP durch die HAS aktiv ist" UWORD t_int_n_M_S7_S3 1 100 0 500 ECU_ADDRESS 0xFFF984E0 /end MEASUREMENT
/begin MEASUREMENT v_f_in "" FLOAT32_IEEE v_fl_M_S7_S3 1 100 0 500 ECU_ADDRESS 0xFFF86274 /end MEASUREMENT
/begin MEASUREMENT v_f_ref_in "Fahrzeuggeschwindigkeit ueber Grund" UWORD v_int_M_S7_S3 1 100 0 511 ECU_ADDRESS 0xFFF86782 /end MEASUREMENT
/begin MEASUREMENT v_f_sbe "Fahrzeuggeschwindigkeit auf Basis der Getriebeabtriebsdrehzahl in der  Hybridablaufsteuerung" FLOAT32_IEEE v_fl_M_S7_S3 1 100 0 500 ECU_ADDRESS 0xFFF861E4 /end MEASUREMENT
/begin MEASUREMENT vg_f_sbe "Fahrzeuggeschwindigkeitsgradient auf Basis der Getriebeabtriebsdrehzahl in der  Hybridablaufsteuerung" FLOAT32_IEEE vg_fl_M_S7_S3 1 100 -100 100 ECU_ADDRESS 0xFFF861E8 /end MEASUREMENT
/begin MEASUREMENT z_ablauf_has_hst_in "" UBYTE sts_int_M_S7_S3 1 100 0 15 ECU_ADDRESS 0xFFF86CB8 /end MEASUREMENT
/begin MEASUREMENT z_ablauf_has_stg "Zusaetzliche Steuergroesse zur Ablaufsteuerung" UBYTE ctrl_int_M_S7_S3 1 100 0 15 ECU_ADDRESS 0xFFF86C57 /end MEASUREMENT
/begin MEASUREMENT z_ablauf_svh_reset_has_fkt "" UBYTE sts_int_M_S7_S3 1 100 0 255 ECU_ADDRESS 0xFFF86C5B /end MEASUREMENT
/begin MEASUREMENT z_ablaufreinit_frk_dihi "Zeigt an, dass der aktuelle HAS-Ablauf erneut begonnen werden soll" UBYTE sts_int_e_M_S7_S3 1 100 0 1 ECU_ADDRESS 0xFFF86C40 /end MEASUREMENT
/begin MEASUREMENT z_ablaufvariante_has_hst_in "" UBYTE sts_int_M_S7_S3 1 100 0 99 ECU_ADDRESS 0xFFF86CB9 /end MEASUREMENT
/begin MEASUREMENT z_ablaufvariante_has_stg "Ablaufvariante, die  die OML ausgibt" UBYTE sts_int_M_S7_S3 1 100 0 99 ECU_ADDRESS 0xFFF86C58 /end MEASUREMENT
/begin MEASUREMENT z_ablaufvariante_kalt_zus "Anzeige der aktiven Ablaufvariante Kaltstart beim Zustart - 0 = kein Kaltstart, 1 = Kaltstart mit abgesenkter EM-Drehzahl" UBYTE st_int_M_S7_S3 1 100 0 255 ECU_ADDRESS 0xFFF86C5C /end MEASUREMENT
/begin MEASUREMENT z_ablaufvariante_sza_zus "Anzeige der aktiven Ablaufvariante Schneller Zustartablauf (SZA) beim Zustart" UBYTE sts_int_e_M_S7_S3 1 100 0 1 ECU_ADDRESS 0xFFF86B69 /end MEASUREMENT
/begin MEASUREMENT z_ala_frk_dihi "Zeigt an, dass die Anlasserstartanforderung der HAS aktiviert werden soll" UBYTE sts_int_e_M_S7_S3 1 100 0 1 ECU_ADDRESS 0xFFF86C41 /end MEASUREMENT
/begin MEASUREMENT z_ba_has_k0_hst_in "" UBYTE st_int_M_S7_S3 1 100 0 1 ECU_ADDRESS 0xFFF86CD2 /end MEASUREMENT
/begin MEASUREMENT z_ba_has_vm_hst_in "" UBYTE st_int_M_S7_S3 1 100 0 1 ECU_ADDRESS 0xFFF86CD3 /end MEASUREMENT
/begin MEASUREMENT z_deaktiv_abo_frk_dihi "Zeigt an, dass die ABO Funktion verlassen werden soll." UBYTE sts_int_e_M_S7_S3 1 100 0 1 ECU_ADDRESS 0xFFF86C42 /end MEASUREMENT
/begin MEASUREMENT z_diag_ersfkt_has_in "Funktionsschnittstelle zur Ermittlung ob irgendeine Ersatzmassnahme in der Diagnoseverwaltung aktiv ist" ULONG b_int_M_S7_S3 1 100 0 4294967295 ECU_ADDRESS 0xFFF86278 /end MEASUREMENT
/begin MEASUREMENT z_diag_ersfkt_hi_96_has_in "Anzeige ob Ersatzmassnahme in der Diagnoseverwaltung aktiv ist bit 64...95" ULONG b_int_M_S7_S3 1 100 0 4294967295 ECU_ADDRESS 0xFFF8627C /end MEASUREMENT
/begin MEASUREMENT z_diag_ersfkt_hi_has_in "Funktionsschnittstelle zur Ermittlung ob irgendeine Ersatzmassnahme in der Diagnoseverwaltung aktiv ist" ULONG b_int_M_S7_S3 1 100 0 4294967295 ECU_ADDRESS 0xFFF86280 /end MEASUREMENT
/begin MEASUREMENT z_diag_notgang_has_in "Notganginformation" UBYTE b_int_b_M_S7_S3 1 100 0 255 ECU_ADDRESS 0xFFF86CBA /end MEASUREMENT
/begin MEASUREMENT z_emaktiv_fuw_zus_fkt "Anzeige der EM Fehlfuntion der Funktionsueberwachung der EM beim Zustart" UBYTE b_int_h_M_S7_S3 1 100 0 1 ECU_ADDRESS 0xFFF86C5D /end MEASUREMENT
/begin MEASUREMENT z_emaktiv_nemfehler_fuw_zus "Anzeige des Ablaufs bei fehlerhafter oder ersetzter EM-Drehzahl der Funktionsueberwachung der EM-Funktion beim Zustart" UBYTE sts_int_e_M_S7_S3 1 100 0 1 ECU_ADDRESS 0xFFF86B6A /end MEASUREMENT
/begin MEASUREMENT z_emfehler_frk_dihi "Zeigt an, dass eine EM Fehlfunktion erkannt wurde, die in der HAS ausgewertet werden soll" UBYTE sts_int_e_M_S7_S3 1 100 0 1 ECU_ADDRESS 0xFFF86C43 /end MEASUREMENT
/begin MEASUREMENT z_fehler15_eh_fkt "" UBYTE st_int_M_S7_S3 1 100 0 1 ECU_ADDRESS 0xFFF86C5E /end MEASUREMENT
/begin MEASUREMENT z_freigabe_pvu_has_sbe "Freigabe zur Aktivierung der Diagnosefunktion \"Positionsventil-Ueberwachung\" der Funktion zur Unterstuetzung der Positi-onsventil-Ueberwachung der HAS" UBYTE st_int_M_S7_S3 1 100 0 1 ECU_ADDRESS 0xFFF86C71 /end MEASUREMENT
/begin MEASUREMENT z_fuwdeakt_frk_dihi "Zeigt an, dass die FUW-Funktion nicht aktiviert werden darf" UBYTE sts_int_e_M_S7_S3 1 100 0 1 ECU_ADDRESS 0xFFF86C44 /end MEASUREMENT
/begin MEASUREMENT z_gebruefahrenaus_frk_dihi "Erkennung Aufheben gebruecktes E Fahren" UBYTE sts_int_e_M_S7_S3 1 100 0 1 ECU_ADDRESS 0xFFF86C45 /end MEASUREMENT
/begin MEASUREMENT z_hybfkt_stg "Anforderung der Aktivierung einer Hybridfunktion durch die Hyrid-Zustandssteuerung" UBYTE E_HYBFKT_M_S7_S3 1 100 0 15 ECU_ADDRESS 0xFFF86C59 /end MEASUREMENT
/begin MEASUREMENT z_iep_in "" UBYTE E_ZIEP_M_S7_S3 1 100 0 4 ECU_ADDRESS 0xFFF86CBB /end MEASUREMENT
/begin MEASUREMENT z_iepein_frk_dihi "Zeigt an, dass die IEP aktiviert werden soll, wenn ein EM-Drehzahl Signalfehler vorliegt, um die Oelversorgung weiterhin sicher zu stellen." UBYTE sts_int_e_M_S7_S3 1 100 0 1 ECU_ADDRESS 0xFFF86C46 /end MEASUREMENT
/begin MEASUREMENT z_init_sta "Anforderung der Initialisierung der Zustandssteuerung (OML) durch die Strategieanpassung" UBYTE sts_int_M_S7_S3 1 100 0 1 ECU_ADDRESS 0xFFF86C85 /end MEASUREMENT
/begin MEASUREMENT z_k0_befuellopt_has_fkt "" UBYTE st_int_M_S7_S3 1 100 0 1 ECU_ADDRESS 0xFFF86C5F /end MEASUREMENT
/begin MEASUREMENT z_k0_fst_in "" UBYTE E_ZK0FSTIN_M_S7_S3 1 100 0 3 ECU_ADDRESS 0xFFF86CBC /end MEASUREMENT
/begin MEASUREMENT z_k0_has_fkt "" UBYTE E_ZK0_M_S7_S3 1 100 0 5 ECU_ADDRESS 0xFFF86C60 /end MEASUREMENT
/begin MEASUREMENT z_k0_has_sbe "K0 Sollzustand der Priorisierung der K0-Ansteuerung der HAS" UBYTE E_ZK0_M_S7_S3 1 100 0 5 ECU_ADDRESS 0xFFF86C75 /end MEASUREMENT
/begin MEASUREMENT z_k0sregaktiv_zus "Anforderung der Aktivierung der K0 Schlupfregelung beim Zustart" UBYTE sts_int_e_M_S7_S3 1 100 0 1 ECU_ADDRESS 0xFFF86B6B /end MEASUREMENT
/begin MEASUREMENT z_k0sregbasis_zus "Anzeige der Basisbedingung fuer die Anforderung der Aktivierung der K0 Schlupfregelung beim Zustart" UBYTE sts_int_e_M_S7_S3 1 100 0 1 ECU_ADDRESS 0xFFF86B6C /end MEASUREMENT
/begin MEASUREMENT z_k0syncmk0erh_frk_dihi "Zeigt an, dass eine K0-Zwangsynchronisation mittels Erhoehung des K0-Moments erfolgen soll" UBYTE sts_int_e_M_S7_S3 1 100 0 1 ECU_ADDRESS 0xFFF86C47 /end MEASUREMENT
/begin MEASUREMENT z_k0zuheiss_zus "Anzeige K0 zu heiss - Aktivierung der Massnahmen zur Verhinderung der K0-Ueberhitzung beim Zustart" UBYTE sts_int_e_M_S7_S3 1 100 0 1 ECU_ADDRESS 0xFFF86B6E /end MEASUREMENT
/begin MEASUREMENT z_kps_stada_in "Sollvorgabe fuer die Trennkupplung K0 durch die Stillstandsadaption" UBYTE sts_int_M_S7_S3 1 100 0 255 ECU_ADDRESS 0xFFF86CBD /end MEASUREMENT
/begin MEASUREMENT z_lls_fktaktiv_has_sbe "Aktive LLS-Funktion - Codierung bit0=STAT,1=IEP,2=CGETR,3=BEFFZP,4=GE,5=KFL,6=PAUS,7=PARKSP,8=RANG,9=MANH,10=IAE,11=SAS,12=KRI,13=DAT,14=IAEADA,15=K0ADA,16=STADA,17-18=frei,19=FKT,20=BZ,21-22=frei,23=VGF,24=ALAE,25-26=frei,27=PVU,28-30=frei,31=DIAG" ULONG sts_int_m_M_S7_S3 1 100 0 4294967295 ECU_ADDRESS 0xFFF86208 /end MEASUREMENT
/begin MEASUREMENT z_m_max_iae_has_fkt "" UBYTE st_int_M_S7_S3 1 100 0 50 ECU_ADDRESS 0xFFF86C61 /end MEASUREMENT
/begin MEASUREMENT z_m_soll_em_has_fkt "" UBYTE st_int_l_M_S7_S3 1 100 0 1 ECU_ADDRESS 0xFFF86C62 /end MEASUREMENT
/begin MEASUREMENT z_modus_em_hst_in "" UBYTE sts_int_M_S7_S3 1 100 0 255 ECU_ADDRESS 0xFFF86CBE /end MEASUREMENT
/begin MEASUREMENT z_modus_iae_has_sbe "" UBYTE E_ZMODUSIAE_M_S7_S3 1 100 0 2 ECU_ADDRESS 0xFFF86C76 /end MEASUREMENT
/begin MEASUREMENT z_modus_iep_dihi_bfi_has "Vorgabe des Betriebsmodus zur Beeinflussung der IEP durch die HAS bei Anforderung durch die HAS Diagnose" UBYTE E_ZMODUSIEP_M_S7_S3 1 100 0 4 ECU_ADDRESS 0xFFF86974 /end MEASUREMENT
/begin MEASUREMENT z_modus_iep_fuw_bfi_has "Vorgabe des Betriebsmodus zur Beeinflussung der IEP durch die HAS bei EM-Fehlfunktion beim Zustart" UBYTE E_ZMODUSIEP_M_S7_S3 1 100 0 4 ECU_ADDRESS 0xFFF86975 /end MEASUREMENT
/begin MEASUREMENT z_modus_iep_has_sbe "Vorgabe des Betriebsmodus der IEP durch die HAS" UBYTE E_ZMODUSIEP_M_S7_S3 1 100 0 4 ECU_ADDRESS 0xFFF86C77 /end MEASUREMENT
/begin MEASUREMENT z_modus_iep_pvu_bfi_has "Vorgabe des Betriebsmodus zur Beeinflussung der IEP zur Unterstuetzung der Positionsventil-Ueberwachung der HAS" UBYTE E_ZMODUSIEP_M_S7_S3 1 100 0 4 ECU_ADDRESS 0xFFF86976 /end MEASUREMENT
/begin MEASUREMENT z_modus_iep_sst_bfi_has "Vorgabe des Betriebsmodus zur Beeinflussung der IEP durch die HAS bei SST-Start" UBYTE E_ZMODUSIEP_M_S7_S3 1 100 0 4 ECU_ADDRESS 0xFFF86977 /end MEASUREMENT
/begin MEASUREMENT z_msa_avh_moni_has_sbe "Anforderung einer Schaltverhinderung der HAS" UBYTE st_int_M_S7_S3 1 100 0 255 ECU_ADDRESS 0xFFF86C78 /end MEASUREMENT
/begin MEASUREMENT z_msa_eaf_moni_has_sbe "Anforderung einer Schaltverhinderung der HAS" UBYTE st_int_M_S7_S3 1 100 0 255 ECU_ADDRESS 0xFFF86C79 /end MEASUREMENT
/begin MEASUREMENT z_msa_fst_in "Anforderung einer Abschaltverhinderung durch die Fahrstrategie ASIS" UBYTE sts_int_M_S7_S3 1 100 0 255 ECU_ADDRESS 0xFFF86CBF /end MEASUREMENT
/begin MEASUREMENT z_msa_has_sbe "Anforderung der Beeinflussung der MSA-Funktionalitaet durch die Hybridablaufsteuerung - Codierung: bit0 = AVZ, bit1 = AVH, bit2 = EAF, bit3 = EVH, bit4 = Deaktivierung, bit7 = Stoerungsbedingt" UBYTE sts_int_M_S7_S3 1 100 0 255 ECU_ADDRESS 0xFFF86C7A /end MEASUREMENT
/begin MEASUREMENT z_msa_stada_in "Anforderung einer Abschaltverhinderung durch die Stillstandadaption" UBYTE sts_int_M_S7_S3 1 100 0 6 ECU_ADDRESS 0xFFF86CD4 /end MEASUREMENT
/begin MEASUREMENT z_n_min_em_parksp_has_in "Anforderung einer EM-Drehzahlanhebung beim Auslegen der Parksperre infolge unzureichender Oelversorgung" UBYTE b_int_b_M_S7_S3 1 100 0 1 ECU_ADDRESS 0xFFF86CC0 /end MEASUREMENT
/begin MEASUREMENT z_n_soll_em_has_fkt "" UBYTE st_int_M_S7_S3 1 100 0 50 ECU_ADDRESS 0xFFF86C63 /end MEASUREMENT
/begin MEASUREMENT z_n_soll_vm_has_fkt "" UBYTE st_int_M_S7_S3 1 100 0 50 ECU_ADDRESS 0xFFF86C64 /end MEASUREMENT
/begin MEASUREMENT z_nemmin_frk_dihi "Zeigt an, dass die EM Leerlauf angehoben werden soll." UBYTE sts_int_e_M_S7_S3 1 100 0 1 ECU_ADDRESS 0xFFF86C48 /end MEASUREMENT
/begin MEASUREMENT z_nllsoll_iae_in "Anforderung der IAE, dass eine definierte LL-Drehzahl durch den Motor eingestellt werden soll" UBYTE E_ZNLLSOLL_M_S7_S3 1 100 0 3 ECU_ADDRESS 0xFFF86CC1 /end MEASUREMENT
/begin MEASUREMENT z_nllsoll_iep_in "" UBYTE void_int_d_M_S7_S3 1 100 0 1 ECU_ADDRESS 0xFFF86CC2 /end MEASUREMENT
/begin MEASUREMENT z_nminemmodus_has_sbe "Modus der Vorgabe der minimalen EM-Drehzahl der HAS" UBYTE E_ZNMODUS_M_S7_S3 1 100 0 4 ECU_ADDRESS 0xFFF86C7B /end MEASUREMENT
/begin MEASUREMENT z_nminemnull_frk_dihi "Zeigt an, dass die Ausgabe der minimalen EM Drehzahl der HAS unterdrueckt werden soll." UBYTE sts_int_e_M_S7_S3 1 100 0 1 ECU_ADDRESS 0xFFF86C49 /end MEASUREMENT
/begin MEASUREMENT z_nsollvmanh_frk_dihi "Zeigt an, dass die VM-Solldrehzahl waehrend eines Start-Ablaufs angehoben werden soll" UBYTE sts_int_e_M_S7_S3 1 100 0 1 ECU_ADDRESS 0xFFF86C4A /end MEASUREMENT
/begin MEASUREMENT z_nsollvmnull_frk_dihi "Zeigt an, dass die VM-Solldrehzahl Vorgabe unterbunden werden soll" UBYTE sts_int_e_M_S7_S3 1 100 0 1 ECU_ADDRESS 0xFFF86C4B /end MEASUREMENT
/begin MEASUREMENT z_nvmsollbegr_frk_dihi "Zeigt an, dass die VM-Solldrehzahl auf die EM-Istdrehzahl be-grenzt werden soll" UBYTE sts_int_e_M_S7_S3 1 100 0 1 ECU_ADDRESS 0xFFF86C4C /end MEASUREMENT
/begin MEASUREMENT z_oea_hst_in "Anforderung fuer das gebrueckte E-Anfahren der HST" UBYTE sts_int_M_S7_S3 1 100 0 1 ECU_ADDRESS 0xFFF86CC3 /end MEASUREMENT
/begin MEASUREMENT z_p_hys_k0_has_fkt "Hysteresekompensation" UBYTE st_int_M_S7_S3 1 100 0 1 ECU_ADDRESS 0xFFF86C65 /end MEASUREMENT
/begin MEASUREMENT z_ponr_fkt "point of no return" UBYTE st_int_M_S7_S3 1 100 0 1 ECU_ADDRESS 0xFFF86C66 /end MEASUREMENT
/begin MEASUREMENT z_pvu_has_sbe "Beeinflussung des Hybridsystems zur Unterstuetzung der Positionsventil- Ueberwachung der HAS-Codierung: 0 = keine Beeinflussung, 1 = Beeinflussung Stufe 1, 2 = Beeinflussung Stufe 2" UBYTE st_int_M_S7_S3 1 100 0 2 ECU_ADDRESS 0xFFF86C72 /end MEASUREMENT
/begin MEASUREMENT z_respschlepp_sas_fkt "" UBYTE st_int_M_S7_S3 1 100 0 1 ECU_ADDRESS 0xFFF86C67 /end MEASUREMENT
/begin MEASUREMENT z_saf_has_fkt "Schaltanforderung 1...aktiv" UBYTE st_int_M_S7_S3 1 100 0 1 ECU_ADDRESS 0xFFF86C68 /end MEASUREMENT
/begin MEASUREMENT z_sas_has_sbe "Aendert im Wahrheitsfall die KupplungsBefuellreihenfolge" UBYTE st_int_M_S7_S3 1 100 0 1 ECU_ADDRESS 0xFFF86C7C /end MEASUREMENT
/begin MEASUREMENT z_sbe_has_fkt "Schaltbeeinflussung  1...aktiv" UBYTE st_int_M_S7_S3 1 100 0 1 ECU_ADDRESS 0xFFF86C69 /end MEASUREMENT
/begin MEASUREMENT z_schaltprioverh_frk_dihi "Zeigt an, dass die Schaltungspriorisierung bei einem Zustart-Ablauf  uterbunden werden soll" UBYTE sts_int_e_M_S7_S3 1 100 0 1 ECU_ADDRESS 0xFFF86C4D /end MEASUREMENT
/begin MEASUREMENT z_schwingungsyncerk_syn_zus "Anzeige einer Antriebsstrangschwingung bei geschlossener K0 zur Erkennung Synchron beim K0-Synchronisieren beim Zustart" UBYTE sts_int_e_M_S7_S3 1 100 0 1 ECU_ADDRESS 0xFFF86B71 /end MEASUREMENT
/begin MEASUREMENT z_start_modus_has_sbe "Anforderung eines Anlasserstarts" UBYTE st_int_M_S7_S3 1 100 0 3 ECU_ADDRESS 0xFFF86C7D /end MEASUREMENT
/begin MEASUREMENT z_status_psys_mps_sbe "Anforderung der Modifikation des Pumpendruckstatus durch die Hybrid Ablaufsteuerung (MPS)" UBYTE sts_int_M_S7_S3 1 100 0 1 ECU_ADDRESS 0xFFF86C7E /end MEASUREMENT
/begin MEASUREMENT z_statuspsysmps_frk_dihi "Zeigt an, dass der Pumpendruck-Status der ATSYS modifiziert werden soll" UBYTE sts_int_e_M_S7_S3 1 100 0 1 ECU_ADDRESS 0xFFF86C4E /end MEASUREMENT
/begin MEASUREMENT z_svh_frk_dihi "Zeigt an, dass die Schaltverhinderung (SVH) aktiviert werden soll" UBYTE sts_int_e_M_S7_S3 1 100 0 1 ECU_ADDRESS 0xFFF86C4F /end MEASUREMENT
/begin MEASUREMENT z_svh_has_sbe "Anforderung einer Schaltverhinderung der HAS" UBYTE st_int_M_S7_S3 1 100 0 1 ECU_ADDRESS 0xFFF86C7F /end MEASUREMENT
/begin MEASUREMENT z_svh_palaus_sak_zus "Anzeige der Schaltart der zum Rest des Zustart-Ablaufs parallel laufenden Schaltungen im Zustand Schaltung aktiv beim Zustart -> Bit-Codierung wie z_ablauf_shv_reset_has" UBYTE b_int_b_M_S7_S3 1 100 0 255 ECU_ADDRESS 0xFFF86B73 /end MEASUREMENT
/begin MEASUREMENT z_svh_reset_zustand_zus "Anzeige der Schaltart der in den einzelnen Zustaenden des Zustart-Ablaufs freigegebenen Schaltungen beim Zustart -> Bit-Codierung wie z_ablauf_shv_reset_has" UBYTE b_int_b_M_S7_S3 1 100 0 255 ECU_ADDRESS 0xFFF86B75 /end MEASUREMENT
/begin MEASUREMENT z_syncdda_zus "Anzeige der Aktivierung der Beeinflussung der K0-Synchronisation bei durchdrehenden Antriebsraedern beim Zustart" UBYTE sts_int_e_M_S7_S3 1 100 0 1 ECU_ADDRESS 0xFFF86B76 /end MEASUREMENT
/begin MEASUREMENT z_uvs_zus "Anzeige der Phase der K0-Unterstuetzung des VM Startsystems (UVS) beim Zustart" UBYTE E_ZUVSZUS_M_S7_S3 1 100 0 3 ECU_ADDRESS 0xFFF86B77 /end MEASUREMENT
/begin MEASUREMENT z_vmkaltstart_pvu_has "Erkennung der Anforderung eines VM Kaltstarts der Funktion zur Unterstuetzung der Positionsventil-Ueberwachung der HAS" UBYTE void_int_d_M_S7_S3 1 100 0 1 ECU_ADDRESS 0xFFF86A38 /end MEASUREMENT
/begin MEASUREMENT z_vmstart_bfi "Erkennung der Anforderung eines VM Starts der Funktion zur  Beeinflussung der IEP durch die HAS" UBYTE st_int_M_S7_S3 1 100 0 1 ECU_ADDRESS 0xFFF9841C /end MEASUREMENT
/begin MEASUREMENT z_vmstart_pvu_has "Erkennung der Anforderung eines VM Starts der Funktion zur Unterstuetzung der Positionsventil-Ueberwachung der HAS" UBYTE void_int_d_M_S7_S3 1 100 0 1 ECU_ADDRESS 0xFFF98423 /end MEASUREMENT
/begin MEASUREMENT z_vmstartanf_frk_dihi "Zeigt an, dass der VM gestartet werden soll." UBYTE sts_int_e_M_S7_S3 1 100 0 1 ECU_ADDRESS 0xFFF86C50 /end MEASUREMENT
/begin MEASUREMENT z_vmstartverbot_frk_dihi "Zeigt an, dass der VM nicht gestartet werden darf." UBYTE sts_int_e_M_S7_S3 1 100 0 1 ECU_ADDRESS 0xFFF86C51 /end MEASUREMENT
/begin MEASUREMENT z_vmstartvoreil_bfi "Erkennung der voreilenden Anforderung eines VM Starts der Funktion zur  Beeinflussung der IEP durch die HAS" UBYTE st_int_M_S7_S3 1 100 0 1 ECU_ADDRESS 0xFFF9841D /end MEASUREMENT
/begin MEASUREMENT z_vmstopverbot_frk_dihi "Zeigt an, dass der VM nicht gestoppt werden darf." UBYTE sts_int_e_M_S7_S3 1 100 0 1 ECU_ADDRESS 0xFFF86C52 /end MEASUREMENT
/begin MEASUREMENT z_zstnachsak_zst_zus "Anzeige der Anzahl der Rueckspruenge in den Zustand Schaltung aktiv im Zustand Zustarten beim Zustart" UBYTE void_int_M_S7_S3 1 100 0 100 ECU_ADDRESS 0xFFF86B78 /end MEASUREMENT
/begin MEASUREMENT z_zuendfreigabe_vm_fkt "" UBYTE st_int_M_S7_S3 1 100 0 1 ECU_ADDRESS 0xFFF86C6A /end MEASUREMENT
/begin MEASUREMENT z_zuendfreigabe_vm_has_fkt "" UBYTE st_int_M_S7_S3 1 100 0 1 ECU_ADDRESS 0xFFF86C6B /end MEASUREMENT
/begin MEASUREMENT z_zust_halten_frk_dihi "Zeigt an, ob der Betriebszustand \"HAS Zustand halten\" aktiv sein soll." UBYTE sts_int_e_M_S7_S3 1 100 0 1 ECU_ADDRESS 0xFFF86C53 /end MEASUREMENT
/begin MEASUREMENT z_zust_init_frk_dihi "Zeigt an, ob der Betriebszustand \"HAS Zustand Init\" aktiv sein soll." UBYTE sts_int_e_M_S7_S3 1 100 0 1 ECU_ADDRESS 0xFFF86C54 /end MEASUREMENT
/begin MEASUREMENT zielgang_egs_in "" SBYTE sts_int_M_S7_S3 1 100 -128 127 ECU_ADDRESS 0xFFF86CC4 /end MEASUREMENT
/begin COMPU_METHOD SAB_M_1NM_M511_S2_S3 "int = ((phys * 1) / 1) - (-511) Nm" RAT_FUNC "%2.0" "Nm" COEFFS 0 1 511 0 0 1 /end COMPU_METHOD
/begin COMPU_METHOD SAB_M_4NM_M511_S2_S3 "int = ((phys * 4) / 1) - (-2044) Nm" RAT_FUNC "%5.3" "Nm" COEFFS 0 4 2044 0 0 1 /end COMPU_METHOD
/begin COMPU_METHOD SAB_M_25NM100_M511_S2_S3 "int = ((phys * 100) / 25) - (-2044) Nm" RAT_FUNC "%5.3" "Nm" COEFFS 0 100 51100 0 0 25 /end COMPU_METHOD
/begin COMPU_METHOD SAB_M_1NM_M100_S2_S3 "int = ((phys * 1) / 1) - (-100) Nm" RAT_FUNC "%2.0" "Nm" COEFFS 0 1 100 0 0 1 /end COMPU_METHOD
/begin COMPU_METHOD SAB_M_10NM_S2_S3 "int = ((phys * 1) / 10) - (0) Nm" RAT_FUNC "%5.3" "Nm" COEFFS 0 1 -0 0 0 10 /end COMPU_METHOD
/begin COMPU_METHOD SAB_M_15NM_S2_S3 "int = ((phys * 1) / 15) - (0) Nm" RAT_FUNC "%5.3" "Nm" COEFFS 0 1 -0 0 0 15 /end COMPU_METHOD
/begin COMPU_METHOD SAB_N_10RPM4_S2_S3 "int = ((phys * 4) / 10) - (0) 1/min" RAT_FUNC "%5.3" "1/min" COEFFS 0 4 -0 0 0 10 /end COMPU_METHOD
/begin COMPU_METHOD SAB_039063PROZENT_S2_S3 "int = ((phys * 100000) / 39063) - (0) %" RAT_FUNC "%5.3" "%" COEFFS 0 100000 -0 0 0 39063 /end COMPU_METHOD
/begin COMPU_METHOD SAB_7874PROZENT10000_M127_S2_S3 "int = ((phys * 10000) / 7874) - (-127) %" RAT_FUNC "%5.3" "%" COEFFS 0 10000 999998 0 0 7874 /end COMPU_METHOD
/begin COMPU_METHOD SAB_7874PROZENT10000_M100_S2_S3 "int = ((phys * 10000) / 7874) - (-128) %" RAT_FUNC "%5.3" "%" COEFFS 0 10000 1007872 0 0 7874 /end COMPU_METHOD
/begin COMPU_METHOD b_int_M_S7_S3 "Bit Feld" RAT_FUNC "%10.0" "-" COEFFS 0 1 0 0 0 1 /end COMPU_METHOD
/begin COMPU_METHOD b_int_b_M_S7_S3 "Bit Feld" RAT_FUNC "%3.0" "-" COEFFS 0 1 0 0 0 1 /end COMPU_METHOD
/begin COMPU_METHOD b_int_h_M_S7_S3 "Bit Feld" RAT_FUNC "%1.0" "-" COEFFS 0 1 0 0 0 1 /end COMPU_METHOD
/begin COMPU_METHOD c_fl_M_S7_S3 "Temperatur" RAT_FUNC "%12.6" "°C" COEFFS 0 1 0 0 0 1 /end COMPU_METHOD
/begin COMPU_METHOD c_int_M_S7_S3 "Temperatur" RAT_FUNC "%12.6" "°C" COEFFS 0 1 0 0 0 1 /end COMPU_METHOD
/begin COMPU_METHOD c_int_v_M_S7_S3 "Temperatur" RAT_FUNC "%5.0" "°C" COEFFS 0 1 0 0 0 1 /end COMPU_METHOD
/begin COMPU_METHOD ctrl_int_M_S7_S3 "Steuerwort" RAT_FUNC "%3.0" "-" COEFFS 0 1 0 0 0 1 /end COMPU_METHOD
/begin COMPU_METHOD E_BREMSPED_M_S7_S3 "" TAB_VERB "%12.6" "" COMPU_TAB_REF CONV_TAB_E_BREMSPED_M_S7_S3 /end COMPU_METHOD
/begin COMPU_METHOD E_DREHRICH_M_S7_S3 "" TAB_VERB "%12.6" "" COMPU_TAB_REF CONV_TAB_E_DREHRICH_M_S7_S3 /end COMPU_METHOD
/begin COMPU_METHOD E_FEHLERIEP_M_S7_S3 "" TAB_VERB "%12.6" "" COMPU_TAB_REF CONV_TAB_E_FEHLERIEP_M_S7_S3 /end COMPU_METHOD
/begin COMPU_METHOD E_HYBFKT_M_S7_S3 "" TAB_VERB "%12.6" "" COMPU_TAB_REF CONV_TAB_E_HYBFKT_M_S7_S3 /end COMPU_METHOD
/begin COMPU_METHOD E_MODUSEFAH_M_S7_S3 "" TAB_VERB "%12.6" "" COMPU_TAB_REF CONV_TAB_E_MODUSEFAH_M_S7_S3 /end COMPU_METHOD
/begin COMPU_METHOD E_POS_M_S7_S3 "" TAB_VERB "%12.6" "" COMPU_TAB_REF CONV_TAB_E_POS_M_S7_S3 /end COMPU_METHOD
/begin COMPU_METHOD E_SIGSTATUS_M_S7_S3 "" TAB_VERB "%12.6" "" COMPU_TAB_REF CONV_TAB_E_SIGSTATUS_M_S7_S3 /end COMPU_METHOD
/begin COMPU_METHOD E_STAK0BEF_M_S7_S3 "" TAB_VERB "%12.6" "" COMPU_TAB_REF CONV_TAB_E_STAK0BEF_M_S7_S3 /end COMPU_METHOD
/begin COMPU_METHOD E_STATUSABS_M_S7_S3 "" TAB_VERB "%12.6" "" COMPU_TAB_REF CONV_TAB_E_STATUSABS_M_S7_S3 /end COMPU_METHOD
/begin COMPU_METHOD E_STATUSADA_M_S7_S3 "" TAB_VERB "%12.6" "" COMPU_TAB_REF CONV_TAB_E_STATUSADA_M_S7_S3 /end COMPU_METHOD
/begin COMPU_METHOD E_STATUSASR_M_S7_S3 "" TAB_VERB "%12.6" "" COMPU_TAB_REF CONV_TAB_E_STATUSASR_M_S7_S3 /end COMPU_METHOD
/begin COMPU_METHOD E_STATUSCK0_M_S7_S3 "" TAB_VERB "%12.6" "" COMPU_TAB_REF CONV_TAB_E_STATUSCK0_M_S7_S3 /end COMPU_METHOD
/begin COMPU_METHOD E_STATUSIAE_M_S7_S3 "" TAB_VERB "%12.6" "" COMPU_TAB_REF CONV_TAB_E_STATUSIAE_M_S7_S3 /end COMPU_METHOD
/begin COMPU_METHOD E_STATUSIEP_M_S7_S3 "" TAB_VERB "%12.6" "" COMPU_TAB_REF CONV_TAB_E_STATUSIEP_M_S7_S3 /end COMPU_METHOD
/begin COMPU_METHOD E_STATUSK0_M_S7_S3 "" TAB_VERB "%12.6" "" COMPU_TAB_REF CONV_TAB_E_STATUSK0_M_S7_S3 /end COMPU_METHOD
/begin COMPU_METHOD E_STATUSKSL_M_S7_S3 "" TAB_VERB "%12.6" "" COMPU_TAB_REF CONV_TAB_E_STATUSKSL_M_S7_S3 /end COMPU_METHOD
/begin COMPU_METHOD E_STATUSNAA_M_S7_S3 "" TAB_VERB "%12.6" "" COMPU_TAB_REF CONV_TAB_E_STATUSNAA_M_S7_S3 /end COMPU_METHOD
/begin COMPU_METHOD E_STATUSPSY_M_S7_S3 "" TAB_VERB "%12.6" "" COMPU_TAB_REF CONV_TAB_E_STATUSPSY_M_S7_S3 /end COMPU_METHOD
/begin COMPU_METHOD E_STATUSRSE_M_S7_S3 "" TAB_VERB "%12.6" "" COMPU_TAB_REF CONV_TAB_E_STATUSRSE_M_S7_S3 /end COMPU_METHOD
/begin COMPU_METHOD E_STBZHAS_M_S7_S3 "" TAB_VERB "%12.6" "" COMPU_TAB_REF CONV_TAB_E_STBZHAS_M_S7_S3 /end COMPU_METHOD
/begin COMPU_METHOD E_ZIEP_M_S7_S3 "" TAB_VERB "%12.6" "" COMPU_TAB_REF CONV_TAB_E_ZIEP_M_S7_S3 /end COMPU_METHOD
/begin COMPU_METHOD E_ZK0_M_S7_S3 "" TAB_VERB "%12.6" "" COMPU_TAB_REF CONV_TAB_E_ZK0_M_S7_S3 /end COMPU_METHOD
/begin COMPU_METHOD E_ZK0FSTIN_M_S7_S3 "" TAB_VERB "%12.6" "" COMPU_TAB_REF CONV_TAB_E_ZK0FSTIN_M_S7_S3 /end COMPU_METHOD
/begin COMPU_METHOD E_ZMODUSIAE_M_S7_S3 "" TAB_VERB "%12.6" "" COMPU_TAB_REF CONV_TAB_E_ZMODUSIAE_M_S7_S3 /end COMPU_METHOD
/begin COMPU_METHOD E_ZMODUSIEP_M_S7_S3 "" TAB_VERB "%12.6" "" COMPU_TAB_REF CONV_TAB_E_ZMODUSIEP_M_S7_S3 /end COMPU_METHOD
/begin COMPU_METHOD E_ZNLLSOLL_M_S7_S3 "" TAB_VERB "%12.6" "" COMPU_TAB_REF CONV_TAB_E_ZNLLSOLL_M_S7_S3 /end COMPU_METHOD
/begin COMPU_METHOD E_ZNMODUS_M_S7_S3 "" TAB_VERB "%12.6" "" COMPU_TAB_REF CONV_TAB_E_ZNMODUS_M_S7_S3 /end COMPU_METHOD
/begin COMPU_METHOD E_ZUVSZUS_M_S7_S3 "" TAB_VERB "%12.6" "" COMPU_TAB_REF CONV_TAB_E_ZUVSZUS_M_S7_S3 /end COMPU_METHOD
/begin COMPU_METHOD n_fl_M_S7_S3 "Drehzahl" RAT_FUNC "%12.6" "1/min" COEFFS 0 1 0 0 0 1 /end COMPU_METHOD
/begin COMPU_METHOD n_int_M_S7_S3 "Drehzahl" RAT_FUNC "%5.0" "1/min" COEFFS 0 1 0 0 0 1 /end COMPU_METHOD
/begin COMPU_METHOD ng_fl_M_S7_S3 "Drehzahlgradient" RAT_FUNC "%12.6" "1/min/s" COEFFS 0 1 0 0 0 1 /end COMPU_METHOD
/begin COMPU_METHOD ng_int_M_S7_S3 "Drehzahlgradient" RAT_FUNC "%5.0" "1/min/s" COEFFS 0 1 0 0 0 1 /end COMPU_METHOD
/begin COMPU_METHOD p_fl_M_S7_S3 "Druck" RAT_FUNC "%12.6" "bar" COEFFS 0 1 0 0 0 1 /end COMPU_METHOD
/begin COMPU_METHOD phigrad_fl_M_S7_S3 "Winkel in grad" RAT_FUNC "%12.6" "grad" COEFFS 0 1 0 0 0 1 /end COMPU_METHOD
/begin COMPU_METHOD ratio_fl_M_S7_S3 "Uebersetzungsverhaeltnis" RAT_FUNC "%12.6" "-" COEFFS 0 1 0 0 0 1 /end COMPU_METHOD
/begin COMPU_METHOD rel_fl_M_S7_S3 "Relative Groesse" RAT_FUNC "%12.6" "%" COEFFS 0 1 0 0 0 1 /end COMPU_METHOD
/begin COMPU_METHOD rel_int_M_S7_S3 "Relative Groesse" RAT_FUNC "%3.0" "%" COEFFS 0 1 0 0 0 1 /end COMPU_METHOD
/begin COMPU_METHOD rel_int_p_M_S7_S3 "Relative Groesse" RAT_FUNC "%12.6" "%" COEFFS 0 1 0 0 0 1 /end COMPU_METHOD
/begin COMPU_METHOD st_fl_M_S7_S3 "Zustandsgroesse" RAT_FUNC "%12.6" "-" COEFFS 0 1 0 0 0 1 /end COMPU_METHOD
/begin COMPU_METHOD st_int_M_S7_S3 "Zustandsgroesse" RAT_FUNC "%3.0" "-" COEFFS 0 1 0 0 0 1 /end COMPU_METHOD
/begin COMPU_METHOD st_int_g_M_S7_S3 "Zustandsgroesse" RAT_FUNC "%5.0" "-" COEFFS 0 1 0 0 0 1 /end COMPU_METHOD
/begin COMPU_METHOD st_int_l_M_S7_S3 "Zustandsgroesse" RAT_FUNC "%1.0" "-" COEFFS 0 1 0 0 0 1 /end COMPU_METHOD
/begin COMPU_METHOD sts_fl_M_S7_S3 "Status" RAT_FUNC "%12.6" "-" COEFFS 0 1 0 0 0 1 /end COMPU_METHOD
/begin COMPU_METHOD sts_int_M_S7_S3 "Status" RAT_FUNC "%3.0" "-" COEFFS 0 1 0 0 0 1 /end COMPU_METHOD
/begin COMPU_METHOD sts_int_e_M_S7_S3 "Status" RAT_FUNC "%1.0" "-" COEFFS 0 1 0 0 0 1 /end COMPU_METHOD
/begin COMPU_METHOD sts_int_m_M_S7_S3 "Status" RAT_FUNC "%10.0" "-" COEFFS 0 1 0 0 0 1 /end COMPU_METHOD
/begin COMPU_METHOD swi_int_M_S7_S3 "Schalter" RAT_FUNC "%1.0" "-" COEFFS 0 1 0 0 0 1 /end COMPU_METHOD
/begin COMPU_METHOD swi_int_o_M_S7_S3 "Schalter" RAT_FUNC "%3.0" "-" COEFFS 0 1 0 0 0 1 /end COMPU_METHOD
/begin COMPU_METHOD t_fl_M_S7_S3 "Zeit" RAT_FUNC "%12.6" "s" COEFFS 0 1 0 0 0 1 /end COMPU_METHOD
/begin COMPU_METHOD t_int_M_S7_S3 "Zeit" RAT_FUNC "%11.2" "s" COEFFS 0 1 0 0 0 0.01 /end COMPU_METHOD
/begin COMPU_METHOD t_int_n_M_S7_S3 "Zeit" RAT_FUNC "%6.2" "s" COEFFS 0 1 0 0 0 0.01 /end COMPU_METHOD
/begin COMPU_METHOD trq_fl_a_M_S7_S3 "Moment" RAT_FUNC "%12.6" "Nm" COEFFS 0 1 0 0 0 1 /end COMPU_METHOD
/begin COMPU_METHOD trq_int_M_S7_S3 "Moment" RAT_FUNC "%5.0" "Nm" COEFFS 0 1 0 0 0 1 /end COMPU_METHOD
/begin COMPU_METHOD trqg_fl_k_M_S7_S3 "Momentengradient" RAT_FUNC "%12.6" "Nm/s" COEFFS 0 1 0 0 0 1 /end COMPU_METHOD
/begin COMPU_METHOD v_fl_M_S7_S3 "Geschwindigkeit" RAT_FUNC "%12.6" "km/h" COEFFS 0 1 0 0 0 1 /end COMPU_METHOD
/begin COMPU_METHOD v_int_M_S7_S3 "Geschwindigkeit" RAT_FUNC "%5.0" "km/h" COEFFS 0 1 0 0 0 1 /end COMPU_METHOD
/begin COMPU_METHOD vg_fl_M_S7_S3 "Geschwindigkeitsgradient" RAT_FUNC "%12.6" "km/h/s" COEFFS 0 1 0 0 0 1 /end COMPU_METHOD
/begin COMPU_METHOD void_fl_M_S7_S3 "ohne Umrechnung" RAT_FUNC "%12.6" "-" COEFFS 0 1 0 0 0 1 /end COMPU_METHOD
/begin COMPU_METHOD void_int_M_S7_S3 "ohne Umrechnung" RAT_FUNC "%3.0" "-" COEFFS 0 1 0 0 0 1 /end COMPU_METHOD
/begin COMPU_METHOD void_int_c_M_S7_S3 "ohne Umrechnung" RAT_FUNC "%5.0" "-" COEFFS 0 1 0 0 0 1 /end COMPU_METHOD
/begin COMPU_METHOD void_int_d_M_S7_S3 "ohne Umrechnung" RAT_FUNC "%1.0" "-" COEFFS 0 1 0 0 0 1 /end COMPU_METHOD
/begin COMPU_VTAB CONV_TAB_E_BREMSPED_M_S7_S3 "Conversion table" TAB_VERB 2 0 "NICHT_GETRETEN" 1 "GETRETEN" /end COMPU_VTAB
/begin COMPU_VTAB CONV_TAB_E_DREHRICH_M_S7_S3 "Conversion table" TAB_VERB 3 0 "UNBESTIMMT" 1 "VORWAERTS" 2 "RUECKWAERTS" /end COMPU_VTAB
/begin COMPU_VTAB CONV_TAB_E_FEHLERIEP_M_S7_S3 "Conversion table" TAB_VERB 2 0 "NORMALBETRIEB" 1 "FEHLER" /end COMPU_VTAB
/begin COMPU_VTAB CONV_TAB_E_HYBFKT_M_S7_S3 "Conversion table" TAB_VERB 14 0 "PASSIV" 1 "ANKOPPELN_VM" 3 "GANGEINLEGEN" 4 "GANGAUSLEGEN" 5 "OHNABLAUFFKT" 7 "VM_ZUSTART" 8 "ABSTELLEN_VM" 9 "NICHTDEFINIERT_4" 10 "VM_SCHLEPPSTART" 11 "VM_NOTSTART" 12 "VM_EIN" 13 "VM_AUS" 14 "ABSTELLPOSOPT_VM" 15 "FEHLER" /end COMPU_VTAB
/begin COMPU_VTAB CONV_TAB_E_MODUSEFAH_M_S7_S3 "Conversion table" TAB_VERB 2 0 "LADUNG_ABBAUEN" 1 "LADUNG_ERHALTEN" /end COMPU_VTAB
/begin COMPU_VTAB CONV_TAB_E_POS_M_S7_S3 "Conversion table" TAB_VERB 9 0 "D1" 1 "D2" 2 "D3" 3 "D4" 4 "D5" 5 "D" 6 "N" 7 "R" 8 "P" /end COMPU_VTAB
/begin COMPU_VTAB CONV_TAB_E_SIGSTATUS_M_S7_S3 "Conversion table" TAB_VERB 3 0 "SIGNAL_OK" 1 "ERSATZWERT" 2 "SIGNAL_FEHLER" /end COMPU_VTAB
/begin COMPU_VTAB CONV_TAB_E_STAK0BEF_M_S7_S3 "Conversion table" TAB_VERB 4 0 "NICHT_AKTIV" 1 "STANDARD_BEF" 2 "OPTIMIERTBEF" 3 "REDUZIERTBEF" /end COMPU_VTAB
/begin COMPU_VTAB CONV_TAB_E_STATUSABS_M_S7_S3 "Conversion table" TAB_VERB 3 1 "AKTIV" 0 "NICHT_AKTIV" 2 "FEHLER" /end COMPU_VTAB
/begin COMPU_VTAB CONV_TAB_E_STATUSADA_M_S7_S3 "Conversion table" TAB_VERB 3 0 "KEINADAPTION" 1 "TOUCHPOINT_ADAPTION" 2 "REIBWERT_ADAPTION" /end COMPU_VTAB
/begin COMPU_VTAB CONV_TAB_E_STATUSASR_M_S7_S3 "Conversion table" TAB_VERB 2 0 "NICHT_AKTIV" 1 "AKTIV" /end COMPU_VTAB
/begin COMPU_VTAB CONV_TAB_E_STATUSCK0_M_S7_S3 "Conversion table" TAB_VERB 3 0 "NORMAL" 1 "ZU_HEISS" 2 "UEBERHITZT" /end COMPU_VTAB
/begin COMPU_VTAB CONV_TAB_E_STATUSIAE_M_S7_S3 "Conversion table" TAB_VERB 9 0 "NICHTDEFINIERT" 1 "OFFEN" 2 "ANGELEGT" 3 "ANFAHREN" 4 "ENTKOPPELT" 5 "ENTKOPPELT_ANFAHREN" 6 "SYNCHRONISIEREN" 7 "GESCHLOSSEN" 8 "OEFFNEN" /end COMPU_VTAB
/begin COMPU_VTAB CONV_TAB_E_STATUSIEP_M_S7_S3 "Conversion table" TAB_VERB 5 0 "AUS" 1 "SLEEP" 2 "LP1" 3 "LP2" 4 "LP3" /end COMPU_VTAB
/begin COMPU_VTAB CONV_TAB_E_STATUSK0_M_S7_S3 "Conversion table" TAB_VERB 6 0 "OFFEN" 1 "ANGELEGT" 2 "DRUCKSTELLUNG" 3 "SCHLUPFGEREGELT" 4 "GEREGELTGESCHL" 5 "GESCHLOSSEN" /end COMPU_VTAB
/begin COMPU_VTAB CONV_TAB_E_STATUSKSL_M_S7_S3 "Conversion table" TAB_VERB 7 0 "KEIN_KRAFTSCHLUSS" 1 "VORW_AUF_ABBAUEND" 2 "VORWAERTS" 3 "RUECKW_AUF_ABBAUEND" 4 "RUECKWAERTS" 5 "VORWAERTS_SCHLUPF" 6 "RUECKWAERTS_SCHLUPF" /end COMPU_VTAB
/begin COMPU_VTAB CONV_TAB_E_STATUSNAA_M_S7_S3 "Conversion table" TAB_VERB 2 0 "NICHT_AKTIV" 1 "AKTIV" /end COMPU_VTAB
/begin COMPU_VTAB CONV_TAB_E_STATUSPSY_M_S7_S3 "Conversion table" TAB_VERB 5 0 "AUS" 1 "NICHTDEFINIERT" 2 "LP1" 3 "LP2" 4 "LP3" /end COMPU_VTAB
/begin COMPU_VTAB CONV_TAB_E_STATUSRSE_M_S7_S3 "Conversion table" TAB_VERB 2 0 "KEIN_RADSCHLUPF" 1 "DURCHDREHEN_ERKANNT" /end COMPU_VTAB
/begin COMPU_VTAB CONV_TAB_E_STBZHAS_M_S7_S3 "Conversion table" TAB_VERB 16 0 "INIT_INAKTIV" 1 "ANGEKOPPELT" 2 "ENTKOPPELT" 3 "EFAHREN" 4 "STOP" 5 "LADEN" 6 "ENTK_VMEIN" 7 "EFAHREN_VMEIN" 8 "HYBRID" 9 "NICHTDEFINIERT_1" 10 "NICHTDEFINIERT_2" 11 "NICHTDEFINIERT_3" 12 "NICHTDEFINIERT_4" 13 "NICHTDEFINIERT_5" 14 "INIT_KL15" 15 "FEHLER" /end COMPU_VTAB
/begin COMPU_VTAB CONV_TAB_E_ZIEP_M_S7_S3 "Conversion table" TAB_VERB 5 0 "AUS" 1 "SLEEP" 2 "LP1" 3 "LP2" 4 "LP3" /end COMPU_VTAB
/begin COMPU_VTAB CONV_TAB_E_ZK0_M_S7_S3 "Conversion table" TAB_VERB 6 0 "OEFFNENSW" 1 "BEFUELLEN" 2 "DRUCKSTELLUNG" 3 "SCHLUPFREGELUNG" 4 "GEREGELTGESCHL" 5 "GESCHLOSSEN" /end COMPU_VTAB
/begin COMPU_VTAB CONV_TAB_E_ZK0FSTIN_M_S7_S3 "Conversion table" TAB_VERB 4 0 "OFFEN" 1 "SCHLUPFGEREGELT" 2 "GEREGELTGESCHL" 3 "GESCHLOSSEN" /end COMPU_VTAB
/begin COMPU_VTAB CONV_TAB_E_ZMODUSIAE_M_S7_S3 "Conversion table" TAB_VERB 3 0 "EFAHREN_SCHLUPF" 1 "EFAHREN_KRAFTSCHL" 2 "HYBRIDFAHREN" /end COMPU_VTAB
/begin COMPU_VTAB CONV_TAB_E_ZMODUSIEP_M_S7_S3 "Conversion table" TAB_VERB 5 0 "KEINVORGABE" 1 "AUS" 2 "LP1" 3 "LP2" 4 "LP3" /end COMPU_VTAB
/begin COMPU_VTAB CONV_TAB_E_ZNLLSOLL_M_S7_S3 "Conversion table" TAB_VERB 4 0 "KEINANF" 1 "ANF_ADAP" 2 "ANF_ALLG" 3 "ANF_ADAP_IEP" /end COMPU_VTAB
/begin COMPU_VTAB CONV_TAB_E_ZNMODUS_M_S7_S3 "Conversion table" TAB_VERB 5 0 "KEIN_AUFBAU" 1 "SCHNELL" 2 "ZUEGIG" 3 "KOMFORTABEL" 4 "UNTERDRUECKT" /end COMPU_VTAB
/begin COMPU_VTAB CONV_TAB_E_ZUVSZUS_M_S7_S3 "Conversion table" TAB_VERB 4 0 "KEINANFORDERUNG" 1 "ANGEFORDERT" 2 "AKTIVIERT" 3 "RUECKNAHME" /end COMPU_VTAB
/begin FUNCTION SFOp_Zus6_Input ""
 /begin DEF_CHARACTERISTIC KL_MSOLLK0MINBEFUVS_ZST_ZUS_Y KL_MSOLLK0MINBEFUVS_ZST_ZUS_X KF_FKMSTOERK0EM_ZUS_W KF_FKMSTOERK0EM_ZUS_X KF_FKMSTOERK0EM_ZUS_Y KL_TVMSTOERK0EMFIL_ZUS_Y KL_TVMSTOERK0EMFIL_ZUS_X KF_KMSTOERK0EMMOD_ZUS_W KF_KMSTOERK0EMMOD_ZUS_X KF_KMSTOERK0EMMOD_ZUS_Y KF_MO_K0BEFUELL_NORM_CGET_ZUS_W KF_MO_K0BEFUELL_NORM_CGET_ZUS_X KF_MO_K0BEFUELL_NORM_CGET_ZUS_Y KF_MO_K0BEFUELL_OPT_CGET_ZUS_W KF_MO_K0BEFUELL_OPT_CGET_ZUS_X KF_MO_K0BEFUELL_OPT_CGET_ZUS_Y KF_MO_K0BEFUELL_RED_CGET_ZUS_W KF_MO_K0BEFUELL_RED_CGET_ZUS_X KF_MO_K0BEFUELL_RED_CGET_ZUS_Y KL_TFC_K0_OPT_ZUS_Y KL_TFC_K0_OPT_ZUS_X KL_TFC_K0_RED_ZUS_Y KL_TFC_K0_RED_ZUS_X KL_TFC_K0_ZUS_Y KL_TFC_K0_ZUS_X KL_MSSOLLEMAKTIV_ZUS_Y KL_MSSOLLEMAKTIV_ZUS_X KL_ZMSOLLEMAKTIVSTKFL_ZUS_Y KL_ZMSOLLEMAKTIVSTKFL_ZUS_X SWI_UVS_ZUS Z_ABLAUFVARIANTE_UVS_ZUS SWI_SYNCDDA_ZUS Z_ABLAUFVARIANTE_SZA_ZUS T_MSOLLEMAKTIVMAX_ZUS MS_K0MSTOERK0EMFIL_ZUS FK_NGEM_ZUS MS_ZIELK0HSTMZIELVM_ZUS SWI_MZIELK0HSTMZIELVM_ZUS NS_EMMINUVS_ZST_ZUS NS_VMAKTMAXUVS_ZST_ZUS NS_VMMAXUVS_ZST_ZUS NS_VMMINUVS_ZST_ZUS MG_SOLLK0UVSNEG_ZST_ZUS MG_SOLLK0UVSPOS_ZST_ZUS M_SOLLK0MININITUVS_ZST_ZUS M_SOLLK0UVS_ZST_ZUS /end DEF_CHARACTERISTIC
 /begin LOC_MEASUREMENT m_ziel_k0_zus z_svh_reset_zustand_zus z_k0sregbasis_zus z_k0sregaktiv_zus z_emaktiv_nemfehler_fuw_zus m_stoerk0em_zus z_svh_palaus_sak_zus m_ziel_k0_min_syn_zus z_schwingungsyncerk_syn_zus z_syncdda_zus z_ablaufvariante_sza_zus t_msollemaktiv_zus t_fak0normiert_zus t_fuellausk0_zus t_zielfuellausgleichk0_zus mo_k0befuell_zus__int t_mstoerk0emfil_zus k_mstoerk0em_zus m_stoerk0em_fil_zus__int n_sec_iae_ist_zus__int n_sec_iae_ziel_zus__int ng_em_zus__int m_ziel_vm_has_zus__int m_ziel_vm_has_zus ng_em_zus n_sec_iae_ziel_zus n_sec_iae_ist_zus m_stoerk0em_fil_zus modus_e_fahren_zus z_k0zuheiss_zus m_soll_k0_min_uvs_zus z_uvs_zus mo_k0befuell_zus m_soll_k0_min_uvs_zus__int m_k0_mod_has_fkt m_soll_em_has_fkt m_soll_k0_has_fkt n_soll_em_has_fkt n_soll_vm_has_fkt st_ablauf_fkt status_ablauf_has_fkt z_k0_has_fkt z_m_soll_em_has_fkt z_n_soll_em_has_fkt z_n_soll_vm_has_fkt z_zuendfreigabe_vm_has_fkt z_p_hys_k0_has_fkt m_soll_res_em_has_fkt z_emaktiv_fuw_zus_fkt z_saf_has_fkt z_m_max_iae_has_fkt m_max_iae_has_fkt z_ablauf_svh_reset_has_fkt z_ablaufvariante_kalt_zus z_ponr_fkt m_max_em_has_fkt m_min_em_has_fkt mg_soll_k0_has_fkt nd_min_saf_has_fkt nd_soll_iae_fkt z_fehler15_eh_fkt z_k0_befuellopt_has_fkt z_respschlepp_sas_fkt z_sbe_has_fkt z_zuendfreigabe_vm_fkt z_nvmsollbegr_frk_dihi z_statuspsysmps_frk_dihi z_nminemnull_frk_dihi z_emfehler_frk_dihi z_ablaufreinit_frk_dihi z_k0syncmk0erh_frk_dihi z_fuwdeakt_frk_dihi z_nemmin_frk_dihi z_vmstopverbot_frk_dihi z_vmstartverbot_frk_dihi z_zust_halten_frk_dihi z_zust_init_frk_dihi z_deaktiv_abo_frk_dihi z_vmstartanf_frk_dihi z_svh_frk_dihi z_iepein_frk_dihi z_nsollvmnull_frk_dihi z_ala_frk_dihi z_schaltprioverh_frk_dihi z_nsollvmanh_frk_dihi z_gebruefahrenaus_frk_dihi z_hybfkt_stg st_ziel_bz_has_stg st_ist_bz_has_stg st_ist_hcomd_has_stg z_ablauf_has_stg z_ablaufvariante_has_stg c_getriebe_egs_in m_em_in m_k0_in m_max_dyn_em_in m_soll_vm_hst_in m_vm_in m_wunsch_fpw_in n_ab_egs_in n_em_in n_vm_in status_k0_in n_soll_ll_vm_in m_vm_start_in status_iae_in z_k0_fst_in istgang_egs_in status_kraftfluss_egs_in gangwechsel_egs_in sollgang_egs_in status_nem_in pos_egs_in z_ablauf_has_hst_in m_min_dyn_em_in m_ziel_k0_hst_in zielgang_egs_in kolbenpos_k0_in status_k0_befuellung_in z_modus_em_hst_in m_iae_in m_soll_em_hst_in n_t_egs_in osmode_next_in p_bremse_fzg_in status_fehler_iep_in status_iep_in z_ablaufvariante_has_hst_in m_mot_in status_iae_adap_in z_diag_ersfkt_has_in z_diag_ersfkt_hi_has_in z_diag_notgang_has_in status_k0_adap_in status_waschstr_in z_n_min_em_parksp_has_in n_mot_soll_iae_in status_alaengs_adaoff_in z_nllsoll_iae_in status_nvm_in z_kps_stada_in t_betrieb_pvu_has_ee_in status_ll_vm_in z_msa_fst_in phi_neigung_in v_f_in drehrichtung_nem_in fpw_in drehrichtung_nab_in schalt_mode_egs_in status_kraftfluss_lev2_egs_in i_gang_lev2_egs_in status_c_k0_in bremspedal_in status_autohold_in status_hillhold_in status_vf_in v_f_ref_in status_vfref_in z_diag_ersfkt_hi_96_has_in status_k0_adap_zaehler_in z_oea_hst_in z_iep_in z_nllsoll_iep_in m_soll_vm_l_hst_in status_nreg_em_hst_in m_min_vm_in m_wunsch_fpw_hst_in n_soll_em_hst_in abstellpos_vm_in c_vm_in abstellpos_vm_status_in z_msa_stada_in status_getrbereit_in status_betriebsbereit_hst_in status_sa_vm_in z_ba_has_vm_hst_in z_ba_has_k0_hst_in status_abs_in status_asr_in modus_e_fahren_hst_in status_kl15_in status_posvueb_in soc_in status_soc_in c_umgebung_in status_cumgebung_in nd_k0_in ndg_k0_in ng_vm_in status_schaltung_egs_in status_psys_has_sbe mg_wunsch_fpw_hst_in i_zielgang_egs status_schaltart_svh_has_sbe status_sync_schaltung_sbe z_pvu_has_sbe status_radschlupf_rse_has_sbe i_istgang_egs m_wunsch_fpw_hst_fil mg_wunsch_fpw_in n_sec_iae n_min_em_psys_lp3_has_sbe vg_f_sbe v_f_sbe z_freigabe_pvu_has_sbe t_betrieb_pvu_has_sbe mg_mot_in z_svh_has_sbe m_motmax_has_sbe z_k0_has_sbe m_soll_res_em_has_sbe m_soll_res_em_bas_sbe z_modus_iae_has_sbe z_sas_has_sbe z_modus_iep_has_sbe z_msa_has_sbe status_efahren_has_sbe n_min_em_has_sbe z_msa_avh_moni_has_sbe z_msa_eaf_moni_has_sbe z_start_modus_has_sbe m_k0_mber_has_sbe z_lls_fktaktiv_has_sbe z_status_psys_mps_sbe m_k0_has_sbe m_soll_k0_has_sbe analyse_has_sbe z_nminemmodus_has_sbe /end LOC_MEASUREMENT
 /begin SUB_FUNCTION SFOp_Zus345_Alt_Bus_Output Run_SFOp_Zus413_cDT1_ngem SFOp_Zus343_Ablaufvariante_Kaltstart_abgesenkter_EM_Drehzahl Run_SFOp_Zus422_cLimiter_Gradient_m_soll_k0_min_uvs_zus /end SUB_FUNCTION
/end FUNCTION
/begin FUNCTION SFOp_Zus63_Initialisierung "" /begin LOC_MEASUREMENT n_soll_vm_has_fkt z_n_soll_vm_has_fkt /end LOC_MEASUREMENT /end FUNCTION
/begin FUNCTION SFOp_Zus7_Output ""
 /begin LOC_MEASUREMENT m_ziel_k0_zus z_svh_reset_zustand_zus z_k0sregbasis_zus z_k0sregaktiv_zus z_emaktiv_nemfehler_fuw_zus m_stoerk0em_zus z_svh_palaus_sak_zus m_ziel_k0_min_syn_zus z_schwingungsyncerk_syn_zus z_syncdda_zus z_ablaufvariante_sza_zus k_mstoerk0em_zus m_ziel_vm_has_zus ng_em_zus n_sec_iae_ziel_zus n_sec_iae_ist_zus m_stoerk0em_fil_zus modus_e_fahren_zus z_k0zuheiss_zus m_soll_k0_min_uvs_zus z_uvs_zus mo_k0befuell_zus m_k0_mod_has_fkt m_soll_em_has_fkt m_soll_k0_has_fkt n_soll_em_has_fkt n_soll_vm_has_fkt st_ablauf_fkt status_ablauf_has_fkt z_k0_has_fkt z_m_soll_em_has_fkt z_n_soll_em_has_fkt z_n_soll_vm_has_fkt z_zuendfreigabe_vm_has_fkt z_p_hys_k0_has_fkt m_soll_res_em_has_fkt z_emaktiv_fuw_zus_fkt z_saf_has_fkt z_m_max_iae_has_fkt m_max_iae_has_fkt z_ablauf_svh_reset_has_fkt z_ablaufvariante_kalt_zus z_ponr_fkt z_emfehler_frk_dihi z_k0syncmk0erh_frk_dihi z_fuwdeakt_frk_dihi z_nsollvmnull_frk_dihi z_schaltprioverh_frk_dihi z_nsollvmanh_frk_dihi z_ablauf_has_stg z_ablaufvariante_has_stg c_getriebe_egs_in m_em_in m_k0_in m_max_dyn_em_in m_soll_vm_hst_in m_vm_in m_wunsch_fpw_in n_ab_egs_in n_em_in n_vm_in status_k0_in n_soll_ll_vm_in m_vm_start_in status_iae_in z_k0_fst_in istgang_egs_in status_kraftfluss_egs_in gangwechsel_egs_in sollgang_egs_in status_nem_in pos_egs_in z_ablauf_has_hst_in m_min_dyn_em_in m_ziel_k0_hst_in zielgang_egs_in kolbenpos_k0_in status_k0_befuellung_in m_soll_vm_l_hst_in status_nreg_em_hst_in m_min_vm_in m_wunsch_fpw_hst_in n_soll_em_hst_in abstellpos_vm_in nd_k0_in ndg_k0_in ng_vm_in status_schaltung_egs_in status_psys_has_sbe mg_wunsch_fpw_hst_in i_zielgang_egs status_schaltart_svh_has_sbe status_sync_schaltung_sbe z_pvu_has_sbe status_radschlupf_rse_has_sbe z_svh_has_sbe /end LOC_MEASUREMENT
 /begin SUB_FUNCTION SFOp_Zus436_Schaltungsbeeinflussung /end SUB_FUNCTION
/end FUNCTION
/begin FUNCTION SFOp_Zus8_PhaseControl ""
 /begin DEF_CHARACTERISTIC KL_KSVHRESETAUSZST_LA_SAK_ZUS_Y KL_KSVHRESETAUSZST_LA_SAK_ZUS_X KL_KSVHRESETAUSZST_LE_SAK_ZUS_Y KL_KSVHRESETAUSZST_LE_SAK_ZUS_X KL_NDSK0MAXSCHLBED_SRT_ZUS_Y KL_NDSK0MAXSCHLBED_SRT_ZUS_X KL_NDSK0MINSCHLBED_SRT_ZUS_Y KL_NDSK0MINSCHLBED_SRT_ZUS_X KL_MSSOLLK0BED_SYN_ZUS_Y KL_MSSOLLK0BED_SYN_ZUS_X KL_NDGSK0SYNCERK_SYN_ZUS_Y KL_NDGSK0SYNCERK_SYN_ZUS_X NS_EMMINBED_SYN_ZUS NDS_VMNEMBED_ANH_ZUS Z_ABLAUF_ABBRUCH_ZUS K_KOLBENPOSK0BEF_ZST_ZUS MS_K0MINFUWKALTBED_ANH_ZUS NDS_K0K0SCHL_FUW_ZUS NDS_K0KALTNEMBED_ANH_ZUS NS_EMMINFUWKALTBED_ANH_ZUS NS_VMMINNEMFEHLERBED_FUW_ZUS NDS_EMNSOLLLLVMBED_ANH_ZUS NDS_SOLLVMNVMBED_ANH_ZUS STATUS_ABLVM_ANH_ZUS MO_SOLLVMHSTBED_SCL_ZUS MO_SOLLVMLHSTBED_SCL_ZUS NS_EMMINBED_SCL_ZUS NDGS_K0SYNCERK_SYN_ZUS NGS_VMSYNCERK_SYN_ZUS MS_K0SCHLBED_SRT_ZUS SCHALTART_VMABFLAUSBED_SRT_ZUS SWI_VMABFANGEN_SRT_ZUS SWI_VMABF_LP3BED_SRT_ZUS NDS_EMNSOLLLLVMBED_ABF_ZUS NDS_VMNEMBED_ABF_ZUS STATUS_ABLVM_ABF_ZUS MS_K0BED_ABB_ZUS SWI_ABBRUCH_AKTIV_ZUS NS_VMEINBED_ZST_ZUS NS_EMSAKBED_ZST_ZUS Z_ZSTNACHSAKMAX_ZST_ZUS TAB_MOMZIELK0BED_SYN_ZUS /end DEF_CHARACTERISTIC
 /begin LOC_MEASUREMENT z_syncdda_zus z_ablaufvariante_sza_zus k_mstoerk0em_zus m_ziel_vm_has_zus ng_em_zus n_sec_iae_ziel_zus n_sec_iae_ist_zus m_stoerk0em_fil_zus modus_e_fahren_zus z_k0zuheiss_zus m_soll_k0_min_uvs_zus z_uvs_zus mo_k0befuell_zus z_zstnachsak_zst_zus z_ablaufvariante_kalt_zus z_emfehler_frk_dihi z_k0syncmk0erh_frk_dihi z_fuwdeakt_frk_dihi z_nsollvmnull_frk_dihi z_schaltprioverh_frk_dihi z_nsollvmanh_frk_dihi z_ablauf_has_stg z_ablaufvariante_has_stg c_getriebe_egs_in m_em_in m_k0_in m_max_dyn_em_in m_soll_vm_hst_in m_vm_in m_wunsch_fpw_in n_ab_egs_in n_em_in n_vm_in status_k0_in n_soll_ll_vm_in m_vm_start_in status_iae_in z_k0_fst_in istgang_egs_in status_kraftfluss_egs_in gangwechsel_egs_in sollgang_egs_in status_nem_in pos_egs_in z_ablauf_has_hst_in m_min_dyn_em_in m_ziel_k0_hst_in zielgang_egs_in kolbenpos_k0_in status_k0_befuellung_in m_soll_vm_l_hst_in status_nreg_em_hst_in m_min_vm_in m_wunsch_fpw_hst_in n_soll_em_hst_in abstellpos_vm_in nd_k0_in ndg_k0_in ng_vm_in status_schaltung_egs_in status_psys_has_sbe mg_wunsch_fpw_hst_in i_zielgang_egs status_schaltart_svh_has_sbe status_sync_schaltung_sbe z_pvu_has_sbe status_radschlupf_rse_has_sbe z_svh_has_sbe /end LOC_MEASUREMENT
 /begin SUB_FUNCTION Run_SFOp_Zus458_abs_fl32 Run_SFOp_Zus461_abs_fl32 SFOp_Zus464_Bitwise_AND_ui8 SFOp_Zus465_Bitwise_AND_ui8 SFOp_Zus466_Bitwise_AND_ui8 SFOp_Zus467_Bitwise_AND_ui8_1 SFOp_Zus468_Bitwise_AND_ui8_2 /end SUB_FUNCTION
/end FUNCTION
/begin FUNCTION SFOp_Zus84_Bitwise_AND_ui8_1 "" /begin DEF_CHARACTERISTIC SWI_K0SREGBASIS_SYN_ZUS /end DEF_CHARACTERISTIC /end FUNCTION
/begin FUNCTION SFOp_Zus85_Bitwise_AND_ui8_2 "" /begin DEF_CHARACTERISTIC SWI_K0SREGBASIS_SYN_ZUS /end DEF_CHARACTERISTIC /end FUNCTION
/begin FUNCTION SFOp_Zus86_Bitwise_AND_ui8_3 "" /begin DEF_CHARACTERISTIC SWI_K0SREGBASIS_SYN_ZUS /end DEF_CHARACTERISTIC /end FUNCTION
/begin FUNCTION SFOp_Zus88_Bitwise_AND_ui8_1 "" /begin DEF_CHARACTERISTIC SWI_K0SREGBASIS_SYN_ZUS /end DEF_CHARACTERISTIC /end FUNCTION
/begin FUNCTION SFOp10_FOp_GAE ""
 /begin LOC_MEASUREMENT st_ablauf_fkt status_ablauf_has_fkt z_modus_em_hst_in c_getriebe_egs_in istgang_egs_in m_em_in m_iae_in m_k0_in m_max_dyn_em_in m_soll_em_hst_in m_soll_vm_hst_in m_vm_in m_vm_start_in m_wunsch_fpw_in n_ab_egs_in n_em_in n_soll_ll_vm_in n_t_egs_in n_vm_in osmode_next_in p_bremse_fzg_in sollgang_egs_in status_fehler_iep_in status_iae_in status_iep_in status_k0_in pos_egs_in z_ablauf_has_hst_in z_ablaufvariante_has_hst_in zielgang_egs_in z_k0_fst_in m_mot_in status_iae_adap_in z_diag_ersfkt_has_in z_diag_ersfkt_hi_has_in z_diag_notgang_has_in status_k0_adap_in status_waschstr_in status_kraftfluss_egs_in z_n_min_em_parksp_has_in n_mot_soll_iae_in status_alaengs_adaoff_in gangwechsel_egs_in z_nllsoll_iae_in status_nem_in status_nvm_in kolbenpos_k0_in z_kps_stada_in t_betrieb_pvu_has_ee_in status_ll_vm_in z_msa_fst_in m_min_dyn_em_in phi_neigung_in v_f_in drehrichtung_nem_in fpw_in drehrichtung_nab_in schalt_mode_egs_in m_ziel_k0_hst_in status_kraftfluss_lev2_egs_in i_gang_lev2_egs_in status_c_k0_in bremspedal_in status_autohold_in status_hillhold_in status_vf_in v_f_ref_in status_vfref_in z_diag_ersfkt_hi_96_has_in status_k0_adap_zaehler_in status_k0_befuellung_in z_oea_hst_in z_iep_in z_nllsoll_iep_in c_vm_in n_soll_em_hst_in abstellpos_vm_in abstellpos_vm_status_in status_nreg_em_hst_in m_min_vm_in m_soll_vm_l_hst_in z_msa_stada_in m_wunsch_fpw_hst_in status_getrbereit_in /end LOC_MEASUREMENT
 /begin SUB_FUNCTION SFOp20_GAE_Kapselung /end SUB_FUNCTION
/end FUNCTION
/begin FUNCTION SFOp11_FOp_NOS ""
 /begin LOC_MEASUREMENT z_hybfkt_stg st_ziel_bz_has_stg st_ist_bz_has_stg st_ist_hcomd_has_stg z_ablauf_has_stg z_ablaufvariante_has_stg m_k0_mod_has_fkt m_soll_k0_has_fkt st_ablauf_fkt status_ablauf_has_fkt z_k0_has_fkt z_p_hys_k0_has_fkt z_zuendfreigabe_vm_fkt i_istgang_egs i_zielgang_egs m_wunsch_fpw_hst_fil mg_wunsch_fpw_in mg_wunsch_fpw_hst_in n_sec_iae nd_k0_in ndg_k0_in ng_vm_in status_schaltung_egs_in n_min_em_psys_lp3_has_sbe status_psys_has_sbe vg_f_sbe v_f_sbe status_sync_schaltung_sbe z_pvu_has_sbe z_freigabe_pvu_has_sbe t_betrieb_pvu_has_sbe mg_mot_in status_radschlupf_rse_has_sbe status_schaltart_svh_has_sbe z_modus_em_hst_in c_getriebe_egs_in istgang_egs_in m_em_in m_iae_in m_k0_in m_max_dyn_em_in m_soll_em_hst_in m_soll_vm_hst_in m_vm_in m_vm_start_in m_wunsch_fpw_in n_ab_egs_in n_em_in n_soll_ll_vm_in n_t_egs_in n_vm_in osmode_next_in p_bremse_fzg_in sollgang_egs_in status_fehler_iep_in status_iae_in status_iep_in status_k0_in pos_egs_in z_ablauf_has_hst_in z_ablaufvariante_has_hst_in zielgang_egs_in z_k0_fst_in m_mot_in status_iae_adap_in z_diag_ersfkt_has_in z_diag_ersfkt_hi_has_in z_diag_notgang_has_in status_k0_adap_in status_waschstr_in status_kraftfluss_egs_in z_n_min_em_parksp_has_in n_mot_soll_iae_in status_alaengs_adaoff_in gangwechsel_egs_in z_nllsoll_iae_in status_nem_in status_nvm_in kolbenpos_k0_in z_kps_stada_in t_betrieb_pvu_has_ee_in status_ll_vm_in z_msa_fst_in m_min_dyn_em_in phi_neigung_in v_f_in drehrichtung_nem_in fpw_in drehrichtung_nab_in schalt_mode_egs_in m_ziel_k0_hst_in status_kraftfluss_lev2_egs_in i_gang_lev2_egs_in status_c_k0_in bremspedal_in status_autohold_in status_hillhold_in status_vf_in v_f_ref_in status_vfref_in z_diag_ersfkt_hi_96_has_in status_k0_adap_zaehler_in status_k0_befuellung_in z_oea_hst_in z_iep_in z_nllsoll_iep_in c_vm_in n_soll_em_hst_in abstellpos_vm_in abstellpos_vm_status_in status_nreg_em_hst_in m_min_vm_in m_soll_vm_l_hst_in z_msa_stada_in m_wunsch_fpw_hst_in status_getrbereit_in /end LOC_MEASUREMENT
 /begin SUB_FUNCTION Action_FOp_NOS /end SUB_FUNCTION
/end FUNCTION
/begin FUNCTION SFOp12_FOp_OAB ""
 /begin LOC_MEASUREMENT status_ablauf_has_fkt z_modus_em_hst_in c_getriebe_egs_in istgang_egs_in m_em_in m_iae_in m_k0_in m_max_dyn_em_in m_soll_em_hst_in m_soll_vm_hst_in m_vm_in m_vm_start_in m_wunsch_fpw_in n_ab_egs_in n_em_in n_soll_ll_vm_in n_t_egs_in n_vm_in osmode_next_in p_bremse_fzg_in sollgang_egs_in status_fehler_iep_in status_iae_in status_iep_in status_k0_in pos_egs_in z_ablauf_has_hst_in z_ablaufvariante_has_hst_in zielgang_egs_in z_k0_fst_in m_mot_in status_iae_adap_in z_diag_ersfkt_has_in z_diag_ersfkt_hi_has_in z_diag_notgang_has_in status_k0_adap_in status_waschstr_in status_kraftfluss_egs_in z_n_min_em_parksp_has_in n_mot_soll_iae_in status_alaengs_adaoff_in gangwechsel_egs_in z_nllsoll_iae_in status_nem_in status_nvm_in kolbenpos_k0_in z_kps_stada_in t_betrieb_pvu_has_ee_in status_ll_vm_in z_msa_fst_in m_min_dyn_em_in phi_neigung_in v_f_in drehrichtung_nem_in fpw_in drehrichtung_nab_in schalt_mode_egs_in m_ziel_k0_hst_in status_kraftfluss_lev2_egs_in i_gang_lev2_egs_in status_c_k0_in bremspedal_in status_autohold_in status_hillhold_in status_vf_in v_f_ref_in status_vfref_in z_diag_ersfkt_hi_96_has_in status_k0_adap_zaehler_in status_k0_befuellung_in z_oea_hst_in z_iep_in z_nllsoll_iep_in c_vm_in n_soll_em_hst_in abstellpos_vm_in abstellpos_vm_status_in status_nreg_em_hst_in m_min_vm_in m_soll_vm_l_hst_in z_msa_stada_in m_wunsch_fpw_hst_in status_getrbereit_in /end LOC_MEASUREMENT
 /begin SUB_FUNCTION Action_FOp_OAB /end SUB_FUNCTION
/end FUNCTION
/begin FUNCTION SFOp13_FOp_PAS ""
 /begin LOC_MEASUREMENT z_hybfkt_stg st_ziel_bz_has_stg st_ist_bz_has_stg st_ist_hcomd_has_stg z_ablauf_has_stg z_ablaufvariante_has_stg m_k0_mod_has_fkt m_max_em_has_fkt m_max_iae_has_fkt m_min_em_has_fkt m_soll_em_has_fkt m_soll_k0_has_fkt m_soll_res_em_has_fkt mg_soll_k0_has_fkt n_soll_em_has_fkt n_soll_vm_has_fkt nd_min_saf_has_fkt nd_soll_iae_fkt st_ablauf_fkt status_ablauf_has_fkt z_ablauf_svh_reset_has_fkt z_ablaufvariante_kalt_zus z_emaktiv_fuw_zus_fkt z_fehler15_eh_fkt z_k0_befuellopt_has_fkt z_k0_has_fkt z_m_max_iae_has_fkt z_m_soll_em_has_fkt z_n_soll_em_has_fkt z_n_soll_vm_has_fkt z_p_hys_k0_has_fkt z_ponr_fkt z_respschlepp_sas_fkt z_saf_has_fkt z_sbe_has_fkt z_zuendfreigabe_vm_fkt z_zuendfreigabe_vm_has_fkt z_modus_em_hst_in c_getriebe_egs_in istgang_egs_in m_em_in m_iae_in m_k0_in m_max_dyn_em_in m_soll_em_hst_in m_soll_vm_hst_in m_vm_in m_vm_start_in m_wunsch_fpw_in n_ab_egs_in n_em_in n_soll_ll_vm_in n_t_egs_in n_vm_in osmode_next_in p_bremse_fzg_in sollgang_egs_in status_fehler_iep_in status_iae_in status_iep_in status_k0_in pos_egs_in z_ablauf_has_hst_in z_ablaufvariante_has_hst_in zielgang_egs_in z_k0_fst_in m_mot_in status_iae_adap_in z_diag_ersfkt_has_in z_diag_ersfkt_hi_has_in z_diag_notgang_has_in status_k0_adap_in status_waschstr_in status_kraftfluss_egs_in z_n_min_em_parksp_has_in n_mot_soll_iae_in status_alaengs_adaoff_in gangwechsel_egs_in z_nllsoll_iae_in status_nem_in status_nvm_in kolbenpos_k0_in z_kps_stada_in t_betrieb_pvu_has_ee_in status_ll_vm_in z_msa_fst_in m_min_dyn_em_in phi_neigung_in v_f_in drehrichtung_nem_in fpw_in drehrichtung_nab_in schalt_mode_egs_in m_ziel_k0_hst_in status_kraftfluss_lev2_egs_in i_gang_lev2_egs_in status_c_k0_in bremspedal_in status_autohold_in status_hillhold_in status_vf_in v_f_ref_in status_vfref_in z_diag_ersfkt_hi_96_has_in status_k0_adap_zaehler_in status_k0_befuellung_in z_oea_hst_in z_iep_in z_nllsoll_iep_in c_vm_in n_soll_em_hst_in abstellpos_vm_in abstellpos_vm_status_in status_nreg_em_hst_in m_min_vm_in m_soll_vm_l_hst_in z_msa_stada_in m_wunsch_fpw_hst_in status_getrbereit_in /end LOC_MEASUREMENT
 /begin SUB_FUNCTION Action_FOp_PAS /end SUB_FUNCTION
/end FUNCTION
/begin FUNCTION SFOp14_FOp_VMA ""
 /begin LOC_MEASUREMENT m_k0_mod_has_fkt m_soll_k0_has_fkt st_ablauf_fkt status_ablauf_has_fkt z_ablauf_svh_reset_has_fkt z_k0_has_fkt z_p_hys_k0_has_fkt z_zuendfreigabe_vm_has_fkt z_modus_em_hst_in c_getriebe_egs_in istgang_egs_in m_em_in m_iae_in m_k0_in m_max_dyn_em_in m_soll_em_hst_in m_soll_vm_hst_in m_vm_in m_vm_start_in m_wunsch_fpw_in n_ab_egs_in n_em_in n_soll_ll_vm_in n_t_egs_in n_vm_in osmode_next_in p_bremse_fzg_in sollgang_egs_in status_fehler_iep_in status_iae_in status_iep_in status_k0_in pos_egs_in z_ablauf_has_hst_in z_ablaufvariante_has_hst_in zielgang_egs_in z_k0_fst_in m_mot_in status_iae_adap_in z_diag_ersfkt_has_in z_diag_ersfkt_hi_has_in z_diag_notgang_has_in status_k0_adap_in status_waschstr_in status_kraftfluss_egs_in z_n_min_em_parksp_has_in n_mot_soll_iae_in status_alaengs_adaoff_in gangwechsel_egs_in z_nllsoll_iae_in status_nem_in status_nvm_in kolbenpos_k0_in z_kps_stada_in t_betrieb_pvu_has_ee_in status_ll_vm_in z_msa_fst_in m_min_dyn_em_in phi_neigung_in v_f_in drehrichtung_nem_in fpw_in drehrichtung_nab_in schalt_mode_egs_in m_ziel_k0_hst_in status_kraftfluss_lev2_egs_in i_gang_lev2_egs_in status_c_k0_in bremspedal_in status_autohold_in status_hillhold_in status_vf_in v_f_ref_in status_vfref_in z_diag_ersfkt_hi_96_has_in status_k0_adap_zaehler_in status_k0_befuellung_in z_oea_hst_in z_iep_in z_nllsoll_iep_in c_vm_in n_soll_em_hst_in abstellpos_vm_in abstellpos_vm_status_in status_nreg_em_hst_in m_min_vm_in m_soll_vm_l_hst_in z_msa_stada_in m_wunsch_fpw_hst_in status_getrbereit_in /end LOC_MEASUREMENT
 /begin SUB_FUNCTION Action_FOp_VMA /end SUB_FUNCTION
/end FUNCTION
/begin FUNCTION SFOp15_FOp_VME ""
 /begin LOC_MEASUREMENT m_k0_mod_has_fkt m_soll_k0_has_fkt st_ablauf_fkt status_ablauf_has_fkt z_ablauf_svh_reset_has_fkt z_k0_has_fkt z_p_hys_k0_has_fkt z_zuendfreigabe_vm_has_fkt z_modus_em_hst_in c_getriebe_egs_in istgang_egs_in m_em_in m_iae_in m_k0_in m_max_dyn_em_in m_soll_em_hst_in m_soll_vm_hst_in m_vm_in m_vm_start_in m_wunsch_fpw_in n_ab_egs_in n_em_in n_soll_ll_vm_in n_t_egs_in n_vm_in osmode_next_in p_bremse_fzg_in sollgang_egs_in status_fehler_iep_in status_iae_in status_iep_in status_k0_in pos_egs_in z_ablauf_has_hst_in z_ablaufvariante_has_hst_in zielgang_egs_in z_k0_fst_in m_mot_in status_iae_adap_in z_diag_ersfkt_has_in z_diag_ersfkt_hi_has_in z_diag_notgang_has_in status_k0_adap_in status_waschstr_in status_kraftfluss_egs_in z_n_min_em_parksp_has_in n_mot_soll_iae_in status_alaengs_adaoff_in gangwechsel_egs_in z_nllsoll_iae_in status_nem_in status_nvm_in kolbenpos_k0_in z_kps_stada_in t_betrieb_pvu_has_ee_in status_ll_vm_in z_msa_fst_in m_min_dyn_em_in phi_neigung_in v_f_in drehrichtung_nem_in fpw_in drehrichtung_nab_in schalt_mode_egs_in m_ziel_k0_hst_in status_kraftfluss_lev2_egs_in i_gang_lev2_egs_in status_c_k0_in bremspedal_in status_autohold_in status_hillhold_in status_vf_in v_f_ref_in status_vfref_in z_diag_ersfkt_hi_96_has_in status_k0_adap_zaehler_in status_k0_befuellung_in z_oea_hst_in z_iep_in z_nllsoll_iep_in c_vm_in n_soll_em_hst_in abstellpos_vm_in abstellpos_vm_status_in status_nreg_em_hst_in m_min_vm_in m_soll_vm_l_hst_in z_msa_stada_in m_wunsch_fpw_hst_in status_getrbereit_in /end LOC_MEASUREMENT
 /begin SUB_FUNCTION Action_FOp_VME /end SUB_FUNCTION
/end FUNCTION
/begin FUNCTION SFOp16_FOp_ZUS ""
 /begin LOC_MEASUREMENT z_nvmsollbegr_frk_dihi z_statuspsysmps_frk_dihi z_nminemnull_frk_dihi z_emfehler_frk_dihi z_ablaufreinit_frk_dihi z_k0syncmk0erh_frk_dihi z_fuwdeakt_frk_dihi z_nemmin_frk_dihi z_vmstopverbot_frk_dihi z_vmstartverbot_frk_dihi z_zust_halten_frk_dihi z_zust_init_frk_dihi z_deaktiv_abo_frk_dihi z_vmstartanf_frk_dihi z_svh_frk_dihi z_iepein_frk_dihi z_nsollvmnull_frk_dihi z_ala_frk_dihi z_schaltprioverh_frk_dihi z_nsollvmanh_frk_dihi z_gebruefahrenaus_frk_dihi z_hybfkt_stg st_ziel_bz_has_stg st_ist_bz_has_stg st_ist_hcomd_has_stg z_ablauf_has_stg z_ablaufvariante_has_stg m_k0_mod_has_fkt m_max_em_has_fkt m_max_iae_has_fkt m_min_em_has_fkt m_soll_em_has_fkt m_soll_k0_has_fkt m_soll_res_em_has_fkt mg_soll_k0_has_fkt n_soll_em_has_fkt n_soll_vm_has_fkt nd_min_saf_has_fkt nd_soll_iae_fkt st_ablauf_fkt status_ablauf_has_fkt z_ablauf_svh_reset_has_fkt z_ablaufvariante_kalt_zus z_emaktiv_fuw_zus_fkt z_fehler15_eh_fkt z_k0_befuellopt_has_fkt z_k0_has_fkt z_m_max_iae_has_fkt z_m_soll_em_has_fkt z_n_soll_em_has_fkt z_n_soll_vm_has_fkt z_p_hys_k0_has_fkt z_ponr_fkt z_respschlepp_sas_fkt z_saf_has_fkt z_sbe_has_fkt z_zuendfreigabe_vm_fkt z_zuendfreigabe_vm_has_fkt i_istgang_egs i_zielgang_egs m_wunsch_fpw_hst_fil mg_wunsch_fpw_in mg_wunsch_fpw_hst_in n_sec_iae nd_k0_in ndg_k0_in ng_vm_in status_schaltung_egs_in n_min_em_psys_lp3_has_sbe status_psys_has_sbe vg_f_sbe v_f_sbe status_sync_schaltung_sbe z_pvu_has_sbe z_freigabe_pvu_has_sbe t_betrieb_pvu_has_sbe mg_mot_in status_radschlupf_rse_has_sbe status_schaltart_svh_has_sbe m_motmax_has_sbe z_k0_has_sbe z_svh_has_sbe m_soll_res_em_has_sbe m_soll_res_em_bas_sbe z_modus_iae_has_sbe z_sas_has_sbe z_modus_iep_has_sbe z_msa_has_sbe status_efahren_has_sbe n_min_em_has_sbe z_msa_avh_moni_has_sbe z_msa_eaf_moni_has_sbe z_start_modus_has_sbe m_k0_mber_has_sbe z_lls_fktaktiv_has_sbe z_status_psys_mps_sbe m_k0_has_sbe m_soll_k0_has_sbe analyse_has_sbe z_nminemmodus_has_sbe z_modus_em_hst_in c_getriebe_egs_in istgang_egs_in m_em_in m_iae_in m_k0_in m_max_dyn_em_in m_soll_em_hst_in m_soll_vm_hst_in m_vm_in m_vm_start_in m_wunsch_fpw_in n_ab_egs_in n_em_in n_soll_ll_vm_in n_t_egs_in n_vm_in osmode_next_in p_bremse_fzg_in sollgang_egs_in status_fehler_iep_in status_iae_in status_iep_in status_k0_in pos_egs_in z_ablauf_has_hst_in z_ablaufvariante_has_hst_in zielgang_egs_in z_k0_fst_in m_mot_in status_iae_adap_in z_diag_ersfkt_has_in z_diag_ersfkt_hi_has_in z_diag_notgang_has_in status_k0_adap_in status_waschstr_in status_kraftfluss_egs_in z_n_min_em_parksp_has_in n_mot_soll_iae_in status_alaengs_adaoff_in gangwechsel_egs_in z_nllsoll_iae_in status_nem_in status_nvm_in kolbenpos_k0_in z_kps_stada_in t_betrieb_pvu_has_ee_in status_ll_vm_in z_msa_fst_in m_min_dyn_em_in phi_neigung_in v_f_in drehrichtung_nem_in fpw_in drehrichtung_nab_in schalt_mode_egs_in m_ziel_k0_hst_in status_kraftfluss_lev2_egs_in i_gang_lev2_egs_in status_c_k0_in bremspedal_in status_autohold_in status_hillhold_in status_vf_in v_f_ref_in status_vfref_in z_diag_ersfkt_hi_96_has_in status_k0_adap_zaehler_in status_k0_befuellung_in z_oea_hst_in z_iep_in z_nllsoll_iep_in c_vm_in n_soll_em_hst_in abstellpos_vm_in abstellpos_vm_status_in status_nreg_em_hst_in m_min_vm_in m_soll_vm_l_hst_in z_msa_stada_in m_wunsch_fpw_hst_in status_getrbereit_in status_betriebsbereit_hst_in status_sa_vm_in z_ba_has_vm_hst_in z_ba_has_k0_hst_in status_abs_in status_asr_in modus_e_fahren_hst_in status_kl15_in status_posvueb_in soc_in status_soc_in c_umgebung_in status_cumgebung_in /end LOC_MEASUREMENT
 /begin SUB_FUNCTION Action_FOp_ZUS /end SUB_FUNCTION
/end FUNCTION
/begin FUNCTION SFOp17_ABO_Kapselung ""
 /begin LOC_MEASUREMENT z_nvmsollbegr_frk_dihi z_statuspsysmps_frk_dihi z_nminemnull_frk_dihi z_emfehler_frk_dihi z_ablaufreinit_frk_dihi z_k0syncmk0erh_frk_dihi z_fuwdeakt_frk_dihi z_nemmin_frk_dihi z_vmstopverbot_frk_dihi z_vmstartverbot_frk_dihi z_zust_halten_frk_dihi z_zust_init_frk_dihi z_deaktiv_abo_frk_dihi z_vmstartanf_frk_dihi z_svh_frk_dihi z_iepein_frk_dihi z_nsollvmnull_frk_dihi z_ala_frk_dihi z_schaltprioverh_frk_dihi z_nsollvmanh_frk_dihi z_gebruefahrenaus_frk_dihi z_hybfkt_stg st_ziel_bz_has_stg st_ist_bz_has_stg st_ist_hcomd_has_stg z_ablauf_has_stg z_ablaufvariante_has_stg m_k0_mod_has_fkt m_max_em_has_fkt m_max_iae_has_fkt m_min_em_has_fkt m_soll_em_has_fkt m_soll_k0_has_fkt m_soll_res_em_has_fkt mg_soll_k0_has_fkt n_soll_em_has_fkt n_soll_vm_has_fkt nd_min_saf_has_fkt nd_soll_iae_fkt st_ablauf_fkt status_ablauf_has_fkt z_ablauf_svh_reset_has_fkt z_ablaufvariante_kalt_zus z_emaktiv_fuw_zus_fkt z_fehler15_eh_fkt z_k0_befuellopt_has_fkt z_k0_has_fkt z_m_max_iae_has_fkt z_m_soll_em_has_fkt z_n_soll_em_has_fkt z_n_soll_vm_has_fkt z_p_hys_k0_has_fkt z_ponr_fkt z_respschlepp_sas_fkt z_saf_has_fkt z_sbe_has_fkt z_zuendfreigabe_vm_fkt z_zuendfreigabe_vm_has_fkt i_istgang_egs i_zielgang_egs m_wunsch_fpw_hst_fil mg_wunsch_fpw_in mg_wunsch_fpw_hst_in n_sec_iae nd_k0_in ndg_k0_in ng_vm_in status_schaltung_egs_in n_min_em_psys_lp3_has_sbe status_psys_has_sbe vg_f_sbe v_f_sbe status_sync_schaltung_sbe z_pvu_has_sbe z_freigabe_pvu_has_sbe t_betrieb_pvu_has_sbe mg_mot_in status_radschlupf_rse_has_sbe status_schaltart_svh_has_sbe m_motmax_has_sbe z_k0_has_sbe z_svh_has_sbe m_soll_res_em_has_sbe m_soll_res_em_bas_sbe z_modus_iae_has_sbe z_sas_has_sbe z_modus_iep_has_sbe z_msa_has_sbe status_efahren_has_sbe n_min_em_has_sbe z_msa_avh_moni_has_sbe z_msa_eaf_moni_has_sbe z_start_modus_has_sbe m_k0_mber_has_sbe z_lls_fktaktiv_has_sbe z_status_psys_mps_sbe m_k0_has_sbe m_soll_k0_has_sbe analyse_has_sbe z_nminemmodus_has_sbe z_modus_em_hst_in c_getriebe_egs_in istgang_egs_in m_em_in m_iae_in m_k0_in m_max_dyn_em_in m_soll_em_hst_in m_soll_vm_hst_in m_vm_in m_vm_start_in m_wunsch_fpw_in n_ab_egs_in n_em_in n_soll_ll_vm_in n_t_egs_in n_vm_in osmode_next_in p_bremse_fzg_in sollgang_egs_in status_fehler_iep_in status_iae_in status_iep_in status_k0_in pos_egs_in z_ablauf_has_hst_in z_ablaufvariante_has_hst_in zielgang_egs_in z_k0_fst_in m_mot_in status_iae_adap_in z_diag_ersfkt_has_in z_diag_ersfkt_hi_has_in z_diag_notgang_has_in status_k0_adap_in status_waschstr_in status_kraftfluss_egs_in z_n_min_em_parksp_has_in n_mot_soll_iae_in status_alaengs_adaoff_in gangwechsel_egs_in z_nllsoll_iae_in status_nem_in status_nvm_in kolbenpos_k0_in z_kps_stada_in t_betrieb_pvu_has_ee_in status_ll_vm_in z_msa_fst_in m_min_dyn_em_in phi_neigung_in v_f_in drehrichtung_nem_in fpw_in drehrichtung_nab_in schalt_mode_egs_in m_ziel_k0_hst_in status_kraftfluss_lev2_egs_in i_gang_lev2_egs_in status_c_k0_in bremspedal_in status_autohold_in status_hillhold_in status_vf_in v_f_ref_in status_vfref_in z_diag_ersfkt_hi_96_has_in status_k0_adap_zaehler_in status_k0_befuellung_in z_oea_hst_in z_iep_in z_nllsoll_iep_in c_vm_in n_soll_em_hst_in abstellpos_vm_in abstellpos_vm_status_in status_nreg_em_hst_in m_min_vm_in m_soll_vm_l_hst_in z_msa_stada_in m_wunsch_fpw_hst_in status_getrbereit_in status_betriebsbereit_hst_in status_sa_vm_in z_ba_has_vm_hst_in z_ba_has_k0_hst_in status_abs_in status_asr_in modus_e_fahren_hst_in status_kl15_in status_posvueb_in soc_in status_soc_in c_umgebung_in status_cumgebung_in /end LOC_MEASUREMENT
/end FUNCTION
/begin FUNCTION SFOp18_Kapselung_ERR ""
 /begin LOC_MEASUREMENT m_soll_em_has_fkt n_soll_em_has_fkt n_soll_vm_has_fkt st_ablauf_fkt status_ablauf_has_fkt z_fehler15_eh_fkt z_k0_has_fkt z_m_soll_em_has_fkt z_n_soll_em_has_fkt z_n_soll_vm_has_fkt z_modus_em_hst_in c_getriebe_egs_in istgang_egs_in m_em_in m_iae_in m_k0_in m_max_dyn_em_in m_soll_em_hst_in m_soll_vm_hst_in m_vm_in m_vm_start_in m_wunsch_fpw_in n_ab_egs_in n_em_in n_soll_ll_vm_in n_t_egs_in n_vm_in osmode_next_in p_bremse_fzg_in sollgang_egs_in status_fehler_iep_in status_iae_in status_iep_in status_k0_in pos_egs_in z_ablauf_has_hst_in z_ablaufvariante_has_hst_in zielgang_egs_in z_k0_fst_in m_mot_in status_iae_adap_in z_diag_ersfkt_has_in z_diag_ersfkt_hi_has_in z_diag_notgang_has_in status_k0_adap_in status_waschstr_in status_kraftfluss_egs_in z_n_min_em_parksp_has_in n_mot_soll_iae_in status_alaengs_adaoff_in gangwechsel_egs_in z_nllsoll_iae_in status_nem_in status_nvm_in kolbenpos_k0_in z_kps_stada_in t_betrieb_pvu_has_ee_in status_ll_vm_in z_msa_fst_in m_min_dyn_em_in phi_neigung_in v_f_in drehrichtung_nem_in fpw_in drehrichtung_nab_in schalt_mode_egs_in m_ziel_k0_hst_in status_kraftfluss_lev2_egs_in i_gang_lev2_egs_in status_c_k0_in bremspedal_in status_autohold_in status_hillhold_in status_vf_in v_f_ref_in status_vfref_in z_diag_ersfkt_hi_96_has_in status_k0_adap_zaehler_in status_k0_befuellung_in z_oea_hst_in z_iep_in z_nllsoll_iep_in c_vm_in n_soll_em_hst_in abstellpos_vm_in abstellpos_vm_status_in status_nreg_em_hst_in m_min_vm_in m_soll_vm_l_hst_in z_msa_stada_in m_wunsch_fpw_hst_in status_getrbereit_in /end LOC_MEASUREMENT
/end FUNCTION
/begin FUNCTION SFOp19_GAA_Kapselung ""
 /begin LOC_MEASUREMENT st_ablauf_fkt status_ablauf_has_fkt z_modus_em_hst_in c_getriebe_egs_in istgang_egs_in m_em_in m_iae_in m_k0_in m_max_dyn_em_in m_soll_em_hst_in m_soll_vm_hst_in m_vm_in m_vm_start_in m_wunsch_fpw_in n_ab_egs_in n_em_in n_soll_ll_vm_in n_t_egs_in n_vm_in osmode_next_in p_bremse_fzg_in sollgang_egs_in status_fehler_iep_in status_iae_in status_iep_in status_k0_in pos_egs_in z_ablauf_has_hst_in z_ablaufvariante_has_hst_in zielgang_egs_in z_k0_fst_in m_mot_in status_iae_adap_in z_diag_ersfkt_has_in z_diag_ersfkt_hi_has_in z_diag_notgang_has_in status_k0_adap_in status_waschstr_in status_kraftfluss_egs_in z_n_min_em_parksp_has_in n_mot_soll_iae_in status_alaengs_adaoff_in gangwechsel_egs_in z_nllsoll_iae_in status_nem_in status_nvm_in kolbenpos_k0_in z_kps_stada_in t_betrieb_pvu_has_ee_in status_ll_vm_in z_msa_fst_in m_min_dyn_em_in phi_neigung_in v_f_in drehrichtung_nem_in fpw_in drehrichtung_nab_in schalt_mode_egs_in m_ziel_k0_hst_in status_kraftfluss_lev2_egs_in i_gang_lev2_egs_in status_c_k0_in bremspedal_in status_autohold_in status_hillhold_in status_vf_in v_f_ref_in status_vfref_in z_diag_ersfkt_hi_96_has_in status_k0_adap_zaehler_in status_k0_befuellung_in z_oea_hst_in z_iep_in z_nllsoll_iep_in c_vm_in n_soll_em_hst_in abstellpos_vm_in abstellpos_vm_status_in status_nreg_em_hst_in m_min_vm_in m_soll_vm_l_hst_in z_msa_stada_in m_wunsch_fpw_hst_in status_getrbereit_in /end LOC_MEASUREMENT
/end FUNCTION
/begin FUNCTION SFOp20_GAE_Kapselung ""
 /begin LOC_MEASUREMENT st_ablauf_fkt status_ablauf_has_fkt z_modus_em_hst_in c_getriebe_egs_in istgang_egs_in m_em_in m_iae_in m_k0_in m_max_dyn_em_in m_soll_em_hst_in m_soll_vm_hst_in m_vm_in m_vm_start_in m_wunsch_fpw_in n_ab_egs_in n_em_in n_soll_ll_vm_in n_t_egs_in n_vm_in osmode_next_in p_bremse_fzg_in sollgang_egs_in status_fehler_iep_in status_iae_in status_iep_in status_k0_in pos_egs_in z_ablauf_has_hst_in z_ablaufvariante_has_hst_in zielgang_egs_in z_k0_fst_in m_mot_in status_iae_adap_in z_diag_ersfkt_has_in z_diag_ersfkt_hi_has_in z_diag_notgang_has_in status_k0_adap_in status_waschstr_in status_kraftfluss_egs_in z_n_min_em_parksp_has_in n_mot_soll_iae_in status_alaengs_adaoff_in gangwechsel_egs_in z_nllsoll_iae_in status_nem_in status_nvm_in kolbenpos_k0_in z_kps_stada_in t_betrieb_pvu_has_ee_in status_ll_vm_in z_msa_fst_in m_min_dyn_em_in phi_neigung_in v_f_in drehrichtung_nem_in fpw_in drehrichtung_nab_in schalt_mode_egs_in m_ziel_k0_hst_in status_kraftfluss_lev2_egs_in i_gang_lev2_egs_in status_c_k0_in bremspedal_in status_autohold_in status_hillhold_in status_vf_in v_f_ref_in status_vfref_in z_diag_ersfkt_hi_96_has_in status_k0_adap_zaehler_in status_k0_befuellung_in z_oea_hst_in z_iep_in z_nllsoll_iep_in c_vm_in n_soll_em_hst_in abstellpos_vm_in abstellpos_vm_status_in status_nreg_em_hst_in m_min_vm_in m_soll_vm_l_hst_in z_msa_stada_in m_wunsch_fpw_hst_in status_getrbereit_in /end LOC_MEASUREMENT
/end FUNCTION
/begin FUNCTION SFOp3_FOpFcn ""
 /begin LOC_MEASUREMENT z_nvmsollbegr_frk_dihi z_statuspsysmps_frk_dihi z_nminemnull_frk_dihi z_emfehler_frk_dihi z_ablaufreinit_frk_dihi z_k0syncmk0erh_frk_dihi z_fuwdeakt_frk_dihi z_nemmin_frk_dihi z_vmstopverbot_frk_dihi z_vmstartverbot_frk_dihi z_zust_halten_frk_dihi z_zust_init_frk_dihi z_deaktiv_abo_frk_dihi z_vmstartanf_frk_dihi z_svh_frk_dihi z_iepein_frk_dihi z_nsollvmnull_frk_dihi z_ala_frk_dihi z_schaltprioverh_frk_dihi z_nsollvmanh_frk_dihi z_gebruefahrenaus_frk_dihi z_hybfkt_stg st_ziel_bz_has_stg st_ist_bz_has_stg st_ist_hcomd_has_stg z_ablauf_has_stg z_ablaufvariante_has_stg m_k0_mod_has_fkt m_max_em_has_fkt m_max_iae_has_fkt m_min_em_has_fkt m_soll_em_has_fkt m_soll_k0_has_fkt m_soll_res_em_has_fkt mg_soll_k0_has_fkt n_soll_em_has_fkt n_soll_vm_has_fkt nd_min_saf_has_fkt nd_soll_iae_fkt st_ablauf_fkt status_ablauf_has_fkt z_ablauf_svh_reset_has_fkt z_ablaufvariante_kalt_zus z_emaktiv_fuw_zus_fkt z_fehler15_eh_fkt z_k0_befuellopt_has_fkt z_k0_has_fkt z_m_max_iae_has_fkt z_m_soll_em_has_fkt z_n_soll_em_has_fkt z_n_soll_vm_has_fkt z_p_hys_k0_has_fkt z_ponr_fkt z_respschlepp_sas_fkt z_saf_has_fkt z_sbe_has_fkt z_zuendfreigabe_vm_fkt z_zuendfreigabe_vm_has_fkt i_istgang_egs i_zielgang_egs m_wunsch_fpw_hst_fil mg_wunsch_fpw_in mg_wunsch_fpw_hst_in n_sec_iae nd_k0_in ndg_k0_in ng_vm_in status_schaltung_egs_in n_min_em_psys_lp3_has_sbe status_psys_has_sbe vg_f_sbe v_f_sbe status_sync_schaltung_sbe z_pvu_has_sbe z_freigabe_pvu_has_sbe t_betrieb_pvu_has_sbe mg_mot_in status_radschlupf_rse_has_sbe status_schaltart_svh_has_sbe m_motmax_has_sbe z_k0_has_sbe z_svh_has_sbe m_soll_res_em_has_sbe m_soll_res_em_bas_sbe z_modus_iae_has_sbe z_sas_has_sbe z_modus_iep_has_sbe z_msa_has_sbe status_efahren_has_sbe n_min_em_has_sbe z_msa_avh_moni_has_sbe z_msa_eaf_moni_has_sbe z_start_modus_has_sbe m_k0_mber_has_sbe z_lls_fktaktiv_has_sbe z_status_psys_mps_sbe m_k0_has_sbe m_soll_k0_has_sbe analyse_has_sbe z_nminemmodus_has_sbe st_soll_bz_has_hst z_init_sta st_soll_bz_hst_sta st_ist_bz_hst_sta bExceptionHybrid bErrorHybrid z_modus_em_hst_in c_getriebe_egs_in istgang_egs_in m_em_in m_iae_in m_k0_in m_max_dyn_em_in m_soll_em_hst_in m_soll_vm_hst_in m_vm_in m_vm_start_in m_wunsch_fpw_in n_ab_egs_in n_em_in n_soll_ll_vm_in n_t_egs_in n_vm_in osmode_next_in p_bremse_fzg_in sollgang_egs_in status_fehler_iep_in status_iae_in status_iep_in status_k0_in pos_egs_in z_ablauf_has_hst_in z_ablaufvariante_has_hst_in zielgang_egs_in z_k0_fst_in m_mot_in status_iae_adap_in z_diag_ersfkt_has_in z_diag_ersfkt_hi_has_in z_diag_notgang_has_in status_k0_adap_in status_waschstr_in status_kraftfluss_egs_in z_n_min_em_parksp_has_in n_mot_soll_iae_in status_alaengs_adaoff_in gangwechsel_egs_in z_nllsoll_iae_in status_nem_in status_nvm_in kolbenpos_k0_in z_kps_stada_in t_betrieb_pvu_has_ee_in status_ll_vm_in z_msa_fst_in m_min_dyn_em_in phi_neigung_in v_f_in drehrichtung_nem_in fpw_in drehrichtung_nab_in schalt_mode_egs_in m_ziel_k0_hst_in status_kraftfluss_lev2_egs_in i_gang_lev2_egs_in status_c_k0_in bremspedal_in status_autohold_in status_hillhold_in status_vf_in v_f_ref_in status_vfref_in z_diag_ersfkt_hi_96_has_in status_k0_adap_zaehler_in status_k0_befuellung_in z_oea_hst_in z_iep_in z_nllsoll_iep_in c_vm_in n_soll_em_hst_in abstellpos_vm_in abstellpos_vm_status_in status_nreg_em_hst_in m_min_vm_in m_soll_vm_l_hst_in z_msa_stada_in m_wunsch_fpw_hst_in status_getrbereit_in status_betriebsbereit_hst_in status_sa_vm_in z_ba_has_vm_hst_in z_ba_has_k0_hst_in status_abs_in status_asr_in modus_e_fahren_hst_in status_kl15_in status_posvueb_in soc_in status_soc_in c_umgebung_in status_cumgebung_in /end LOC_MEASUREMENT
 /begin SUB_FUNCTION SFOp5_FOp_ABO SFOp7_FOp_ANS SFOp16_FOp_ZUS SFOp6_FOp_ABST SFOp11_FOp_NOS SFOp13_FOp_PAS SFOp14_FOp_VMA SFOp15_FOp_VME SFOp8_FOp_ERR SFOp9_FOp_GAA SFOp10_FOp_GAE SFOp12_FOp_OAB /end SUB_FUNCTION
/end FUNCTION
/begin FUNCTION SFOp34_OPAbstellenMerge ""
 /begin LOC_MEASUREMENT m_k0_mod_has_fkt m_max_em_has_fkt m_max_iae_has_fkt m_min_em_has_fkt m_soll_em_has_fkt m_soll_k0_has_fkt m_soll_res_em_has_fkt mg_soll_k0_has_fkt n_soll_em_has_fkt n_soll_vm_has_fkt nd_min_saf_has_fkt nd_soll_iae_fkt st_ablauf_fkt status_ablauf_has_fkt z_ablauf_svh_reset_has_fkt z_ablaufvariante_kalt_zus z_emaktiv_fuw_zus_fkt z_fehler15_eh_fkt z_k0_befuellopt_has_fkt z_k0_has_fkt z_m_max_iae_has_fkt z_m_soll_em_has_fkt z_n_soll_em_has_fkt z_n_soll_vm_has_fkt z_p_hys_k0_has_fkt z_ponr_fkt z_respschlepp_sas_fkt z_saf_has_fkt z_sbe_has_fkt z_zuendfreigabe_vm_fkt z_zuendfreigabe_vm_has_fkt /end LOC_MEASUREMENT
/end FUNCTION
/begin FUNCTION SFOp35_OPAbstellpositionsoptimierungMerge ""
 /begin LOC_MEASUREMENT m_k0_mod_has_fkt m_max_em_has_fkt m_max_iae_has_fkt m_min_em_has_fkt m_soll_em_has_fkt m_soll_k0_has_fkt m_soll_res_em_has_fkt mg_soll_k0_has_fkt n_soll_em_has_fkt n_soll_vm_has_fkt nd_min_saf_has_fkt nd_soll_iae_fkt st_ablauf_fkt status_ablauf_has_fkt z_ablauf_svh_reset_has_fkt z_ablaufvariante_kalt_zus z_emaktiv_fuw_zus_fkt z_fehler15_eh_fkt z_k0_befuellopt_has_fkt z_k0_has_fkt z_m_max_iae_has_fkt z_m_soll_em_has_fkt z_n_soll_em_has_fkt z_n_soll_vm_has_fkt z_p_hys_k0_has_fkt z_ponr_fkt z_respschlepp_sas_fkt z_saf_has_fkt z_sbe_has_fkt z_zuendfreigabe_vm_fkt z_zuendfreigabe_vm_has_fkt /end LOC_MEASUREMENT
/end FUNCTION
/begin FUNCTION SFOp36_OPAnschleppenMerge ""
 /begin LOC_MEASUREMENT m_k0_mod_has_fkt m_max_em_has_fkt m_max_iae_has_fkt m_min_em_has_fkt m_soll_em_has_fkt m_soll_k0_has_fkt m_soll_res_em_has_fkt mg_soll_k0_has_fkt n_soll_em_has_fkt n_soll_vm_has_fkt nd_min_saf_has_fkt nd_soll_iae_fkt st_ablauf_fkt status_ablauf_has_fkt z_ablauf_svh_reset_has_fkt z_ablaufvariante_kalt_zus z_emaktiv_fuw_zus_fkt z_fehler15_eh_fkt z_k0_befuellopt_has_fkt z_k0_has_fkt z_m_max_iae_has_fkt z_m_soll_em_has_fkt z_n_soll_em_has_fkt z_n_soll_vm_has_fkt z_p_hys_k0_has_fkt z_ponr_fkt z_respschlepp_sas_fkt z_saf_has_fkt z_sbe_has_fkt z_zuendfreigabe_vm_fkt z_zuendfreigabe_vm_has_fkt /end LOC_MEASUREMENT
/end FUNCTION
/begin FUNCTION SFOp37_OPErrorMerge ""
 /begin LOC_MEASUREMENT m_k0_mod_has_fkt m_max_em_has_fkt m_max_iae_has_fkt m_min_em_has_fkt m_soll_em_has_fkt m_soll_k0_has_fkt m_soll_res_em_has_fkt mg_soll_k0_has_fkt n_soll_em_has_fkt n_soll_vm_has_fkt nd_min_saf_has_fkt nd_soll_iae_fkt st_ablauf_fkt status_ablauf_has_fkt z_ablauf_svh_reset_has_fkt z_ablaufvariante_kalt_zus z_emaktiv_fuw_zus_fkt z_fehler15_eh_fkt z_k0_befuellopt_has_fkt z_k0_has_fkt z_m_max_iae_has_fkt z_m_soll_em_has_fkt z_n_soll_em_has_fkt z_n_soll_vm_has_fkt z_p_hys_k0_has_fkt z_ponr_fkt z_respschlepp_sas_fkt z_saf_has_fkt z_sbe_has_fkt z_zuendfreigabe_vm_fkt z_zuendfreigabe_vm_has_fkt /end LOC_MEASUREMENT
/end FUNCTION
/begin FUNCTION SFOp38_OPGangAuslegenMerge ""
 /begin LOC_MEASUREMENT m_k0_mod_has_fkt m_max_em_has_fkt m_max_iae_has_fkt m_min_em_has_fkt m_soll_em_has_fkt m_soll_k0_has_fkt m_soll_res_em_has_fkt mg_soll_k0_has_fkt n_soll_em_has_fkt n_soll_vm_has_fkt nd_min_saf_has_fkt nd_soll_iae_fkt st_ablauf_fkt status_ablauf_has_fkt z_ablauf_svh_reset_has_fkt z_ablaufvariante_kalt_zus z_emaktiv_fuw_zus_fkt z_fehler15_eh_fkt z_k0_befuellopt_has_fkt z_k0_has_fkt z_m_max_iae_has_fkt z_m_soll_em_has_fkt z_n_soll_em_has_fkt z_n_soll_vm_has_fkt z_p_hys_k0_has_fkt z_ponr_fkt z_respschlepp_sas_fkt z_saf_has_fkt z_sbe_has_fkt z_zuendfreigabe_vm_fkt z_zuendfreigabe_vm_has_fkt /end LOC_MEASUREMENT
/end FUNCTION
/begin FUNCTION SFOp39_OPGangEinlegenMerge ""
 /begin LOC_MEASUREMENT m_k0_mod_has_fkt m_max_em_has_fkt m_max_iae_has_fkt m_min_em_has_fkt m_soll_em_has_fkt m_soll_k0_has_fkt m_soll_res_em_has_fkt mg_soll_k0_has_fkt n_soll_em_has_fkt n_soll_vm_has_fkt nd_min_saf_has_fkt nd_soll_iae_fkt st_ablauf_fkt status_ablauf_has_fkt z_ablauf_svh_reset_has_fkt z_ablaufvariante_kalt_zus z_emaktiv_fuw_zus_fkt z_fehler15_eh_fkt z_k0_befuellopt_has_fkt z_k0_has_fkt z_m_max_iae_has_fkt z_m_soll_em_has_fkt z_n_soll_em_has_fkt z_n_soll_vm_has_fkt z_p_hys_k0_has_fkt z_ponr_fkt z_respschlepp_sas_fkt z_saf_has_fkt z_sbe_has_fkt z_zuendfreigabe_vm_fkt z_zuendfreigabe_vm_has_fkt /end LOC_MEASUREMENT
/end FUNCTION
/begin FUNCTION SFOp4_FOp_MergeOut ""
 /begin LOC_MEASUREMENT z_hybfkt_stg m_k0_mod_has_fkt m_max_em_has_fkt m_max_iae_has_fkt m_min_em_has_fkt m_soll_em_has_fkt m_soll_k0_has_fkt m_soll_res_em_has_fkt mg_soll_k0_has_fkt n_soll_em_has_fkt n_soll_vm_has_fkt nd_min_saf_has_fkt nd_soll_iae_fkt st_ablauf_fkt status_ablauf_has_fkt z_ablauf_svh_reset_has_fkt z_ablaufvariante_kalt_zus z_emaktiv_fuw_zus_fkt z_fehler15_eh_fkt z_k0_befuellopt_has_fkt z_k0_has_fkt z_m_max_iae_has_fkt z_m_soll_em_has_fkt z_n_soll_em_has_fkt z_n_soll_vm_has_fkt z_p_hys_k0_has_fkt z_ponr_fkt z_respschlepp_sas_fkt z_saf_has_fkt z_sbe_has_fkt z_zuendfreigabe_vm_fkt z_zuendfreigabe_vm_has_fkt /end LOC_MEASUREMENT
 /begin SUB_FUNCTION SFOp34_OPAbstellenMerge SFOp35_OPAbstellpositionsoptimierungMerge SFOp36_OPAnschleppenMerge SFOp37_OPErrorMerge SFOp38_OPGangAuslegenMerge SFOp39_OPGangEinlegenMerge SFOp40_OPNotstartMerge SFOp41_OPOhneAblaufFktMerge SFOp42_OPPassivMerge SFOp43_OPVMausMerge SFOp44_OPVMeinMerge SFOp45_OPZustartMerge /end SUB_FUNCTION
/end FUNCTION
/begin FUNCTION SFOp40_OPNotstartMerge ""
 /begin LOC_MEASUREMENT m_k0_mod_has_fkt m_max_em_has_fkt m_max_iae_has_fkt m_min_em_has_fkt m_soll_em_has_fkt m_soll_k0_has_fkt m_soll_res_em_has_fkt mg_soll_k0_has_fkt n_soll_em_has_fkt n_soll_vm_has_fkt nd_min_saf_has_fkt nd_soll_iae_fkt st_ablauf_fkt status_ablauf_has_fkt z_ablauf_svh_reset_has_fkt z_ablaufvariante_kalt_zus z_emaktiv_fuw_zus_fkt z_fehler15_eh_fkt z_k0_befuellopt_has_fkt z_k0_has_fkt z_m_max_iae_has_fkt z_m_soll_em_has_fkt z_n_soll_em_has_fkt z_n_soll_vm_has_fkt z_p_hys_k0_has_fkt z_ponr_fkt z_respschlepp_sas_fkt z_saf_has_fkt z_sbe_has_fkt z_zuendfreigabe_vm_fkt z_zuendfreigabe_vm_has_fkt /end LOC_MEASUREMENT
/end FUNCTION
/begin FUNCTION SFOp41_OPOhneAblaufFktMerge ""
 /begin LOC_MEASUREMENT m_k0_mod_has_fkt m_max_em_has_fkt m_max_iae_has_fkt m_min_em_has_fkt m_soll_em_has_fkt m_soll_k0_has_fkt m_soll_res_em_has_fkt mg_soll_k0_has_fkt n_soll_em_has_fkt n_soll_vm_has_fkt nd_min_saf_has_fkt nd_soll_iae_fkt st_ablauf_fkt status_ablauf_has_fkt z_ablauf_svh_reset_has_fkt z_ablaufvariante_kalt_zus z_emaktiv_fuw_zus_fkt z_fehler15_eh_fkt z_k0_befuellopt_has_fkt z_k0_has_fkt z_m_max_iae_has_fkt z_m_soll_em_has_fkt z_n_soll_em_has_fkt z_n_soll_vm_has_fkt z_p_hys_k0_has_fkt z_ponr_fkt z_respschlepp_sas_fkt z_saf_has_fkt z_sbe_has_fkt z_zuendfreigabe_vm_fkt z_zuendfreigabe_vm_has_fkt /end LOC_MEASUREMENT
/end FUNCTION
/begin FUNCTION SFOp42_OPPassivMerge ""
 /begin LOC_MEASUREMENT m_k0_mod_has_fkt m_max_em_has_fkt m_max_iae_has_fkt m_min_em_has_fkt m_soll_em_has_fkt m_soll_k0_has_fkt m_soll_res_em_has_fkt mg_soll_k0_has_fkt n_soll_em_has_fkt n_soll_vm_has_fkt nd_min_saf_has_fkt nd_soll_iae_fkt st_ablauf_fkt status_ablauf_has_fkt z_ablauf_svh_reset_has_fkt z_ablaufvariante_kalt_zus z_emaktiv_fuw_zus_fkt z_fehler15_eh_fkt z_k0_befuellopt_has_fkt z_k0_has_fkt z_m_max_iae_has_fkt z_m_soll_em_has_fkt z_n_soll_em_has_fkt z_n_soll_vm_has_fkt z_p_hys_k0_has_fkt z_ponr_fkt z_respschlepp_sas_fkt z_saf_has_fkt z_sbe_has_fkt z_zuendfreigabe_vm_fkt z_zuendfreigabe_vm_has_fkt /end LOC_MEASUREMENT
/end FUNCTION
/begin FUNCTION SFOp43_OPVMausMerge ""
 /begin LOC_MEASUREMENT m_k0_mod_has_fkt m_max_em_has_fkt m_max_iae_has_fkt m_min_em_has_fkt m_soll_em_has_fkt m_soll_k0_has_fkt m_soll_res_em_has_fkt mg_soll_k0_has_fkt n_soll_em_has_fkt n_soll_vm_has_fkt nd_min_saf_has_fkt nd_soll_iae_fkt st_ablauf_fkt status_ablauf_has_fkt z_ablauf_svh_reset_has_fkt z_ablaufvariante_kalt_zus z_emaktiv_fuw_zus_fkt z_fehler15_eh_fkt z_k0_befuellopt_has_fkt z_k0_has_fkt z_m_max_iae_has_fkt z_m_soll_em_has_fkt z_n_soll_em_has_fkt z_n_soll_vm_has_fkt z_p_hys_k0_has_fkt z_ponr_fkt z_respschlepp_sas_fkt z_saf_has_fkt z_sbe_has_fkt z_zuendfreigabe_vm_fkt z_zuendfreigabe_vm_has_fkt /end LOC_MEASUREMENT
/end FUNCTION
/begin FUNCTION SFOp44_OPVMeinMerge ""
 /begin LOC_MEASUREMENT m_k0_mod_has_fkt m_max_em_has_fkt m_max_iae_has_fkt m_min_em_has_fkt m_soll_em_has_fkt m_soll_k0_has_fkt m_soll_res_em_has_fkt mg_soll_k0_has_fkt n_soll_em_has_fkt n_soll_vm_has_fkt nd_min_saf_has_fkt nd_soll_iae_fkt st_ablauf_fkt status_ablauf_has_fkt z_ablauf_svh_reset_has_fkt z_ablaufvariante_kalt_zus z_emaktiv_fuw_zus_fkt z_fehler15_eh_fkt z_k0_befuellopt_has_fkt z_k0_has_fkt z_m_max_iae_has_fkt z_m_soll_em_has_fkt z_n_soll_em_has_fkt z_n_soll_vm_has_fkt z_p_hys_k0_has_fkt z_ponr_fkt z_respschlepp_sas_fkt z_saf_has_fkt z_sbe_has_fkt z_zuendfreigabe_vm_fkt z_zuendfreigabe_vm_has_fkt /end LOC_MEASUREMENT
/end FUNCTION
/begin FUNCTION SFOp45_OPZustartMerge ""
 /begin LOC_MEASUREMENT m_k0_mod_has_fkt m_max_em_has_fkt m_max_iae_has_fkt m_min_em_has_fkt m_soll_em_has_fkt m_soll_k0_has_fkt m_soll_res_em_has_fkt mg_soll_k0_has_fkt n_soll_em_has_fkt n_soll_vm_has_fkt nd_min_saf_has_fkt nd_soll_iae_fkt st_ablauf_fkt status_ablauf_has_fkt z_ablauf_svh_reset_has_fkt z_ablaufvariante_kalt_zus z_emaktiv_fuw_zus_fkt z_fehler15_eh_fkt z_k0_befuellopt_has_fkt z_k0_has_fkt z_m_max_iae_has_fkt z_m_soll_em_has_fkt z_n_soll_em_has_fkt z_n_soll_vm_has_fkt z_p_hys_k0_has_fkt z_ponr_fkt z_respschlepp_sas_fkt z_saf_has_fkt z_sbe_has_fkt z_zuendfreigabe_vm_fkt z_zuendfreigabe_vm_has_fkt /end LOC_MEASUREMENT
/end FUNCTION
/begin FUNCTION SFOp5_FOp_ABO ""
 /begin LOC_MEASUREMENT z_nvmsollbegr_frk_dihi z_statuspsysmps_frk_dihi z_nminemnull_frk_dihi z_emfehler_frk_dihi z_ablaufreinit_frk_dihi z_k0syncmk0erh_frk_dihi z_fuwdeakt_frk_dihi z_nemmin_frk_dihi z_vmstopverbot_frk_dihi z_vmstartverbot_frk_dihi z_zust_halten_frk_dihi z_zust_init_frk_dihi z_deaktiv_abo_frk_dihi z_vmstartanf_frk_dihi z_svh_frk_dihi z_iepein_frk_dihi z_nsollvmnull_frk_dihi z_ala_frk_dihi z_schaltprioverh_frk_dihi z_nsollvmanh_frk_dihi z_gebruefahrenaus_frk_dihi z_hybfkt_stg st_ziel_bz_has_stg st_ist_bz_has_stg st_ist_hcomd_has_stg z_ablauf_has_stg z_ablaufvariante_has_stg m_k0_mod_has_fkt m_max_em_has_fkt m_max_iae_has_fkt m_min_em_has_fkt m_soll_em_has_fkt m_soll_k0_has_fkt m_soll_res_em_has_fkt mg_soll_k0_has_fkt n_soll_em_has_fkt n_soll_vm_has_fkt nd_min_saf_has_fkt nd_soll_iae_fkt st_ablauf_fkt status_ablauf_has_fkt z_ablauf_svh_reset_has_fkt z_ablaufvariante_kalt_zus z_emaktiv_fuw_zus_fkt z_fehler15_eh_fkt z_k0_befuellopt_has_fkt z_k0_has_fkt z_m_max_iae_has_fkt z_m_soll_em_has_fkt z_n_soll_em_has_fkt z_n_soll_vm_has_fkt z_p_hys_k0_has_fkt z_ponr_fkt z_respschlepp_sas_fkt z_saf_has_fkt z_sbe_has_fkt z_zuendfreigabe_vm_fkt z_zuendfreigabe_vm_has_fkt i_istgang_egs i_zielgang_egs m_wunsch_fpw_hst_fil mg_wunsch_fpw_in mg_wunsch_fpw_hst_in n_sec_iae nd_k0_in ndg_k0_in ng_vm_in status_schaltung_egs_in n_min_em_psys_lp3_has_sbe status_psys_has_sbe vg_f_sbe v_f_sbe status_sync_schaltung_sbe z_pvu_has_sbe z_freigabe_pvu_has_sbe t_betrieb_pvu_has_sbe mg_mot_in status_radschlupf_rse_has_sbe status_schaltart_svh_has_sbe m_motmax_has_sbe z_k0_has_sbe z_svh_has_sbe m_soll_res_em_has_sbe m_soll_res_em_bas_sbe z_modus_iae_has_sbe z_sas_has_sbe z_modus_iep_has_sbe z_msa_has_sbe status_efahren_has_sbe n_min_em_has_sbe z_msa_avh_moni_has_sbe z_msa_eaf_moni_has_sbe z_start_modus_has_sbe m_k0_mber_has_sbe z_lls_fktaktiv_has_sbe z_status_psys_mps_sbe m_k0_has_sbe m_soll_k0_has_sbe analyse_has_sbe z_nminemmodus_has_sbe z_modus_em_hst_in c_getriebe_egs_in istgang_egs_in m_em_in m_iae_in m_k0_in m_max_dyn_em_in m_soll_em_hst_in m_soll_vm_hst_in m_vm_in m_vm_start_in m_wunsch_fpw_in n_ab_egs_in n_em_in n_soll_ll_vm_in n_t_egs_in n_vm_in osmode_next_in p_bremse_fzg_in sollgang_egs_in status_fehler_iep_in status_iae_in status_iep_in status_k0_in pos_egs_in z_ablauf_has_hst_in z_ablaufvariante_has_hst_in zielgang_egs_in z_k0_fst_in m_mot_in status_iae_adap_in z_diag_ersfkt_has_in z_diag_ersfkt_hi_has_in z_diag_notgang_has_in status_k0_adap_in status_waschstr_in status_kraftfluss_egs_in z_n_min_em_parksp_has_in n_mot_soll_iae_in status_alaengs_adaoff_in gangwechsel_egs_in z_nllsoll_iae_in status_nem_in status_nvm_in kolbenpos_k0_in z_kps_stada_in t_betrieb_pvu_has_ee_in status_ll_vm_in z_msa_fst_in m_min_dyn_em_in phi_neigung_in v_f_in drehrichtung_nem_in fpw_in drehrichtung_nab_in schalt_mode_egs_in m_ziel_k0_hst_in status_kraftfluss_lev2_egs_in i_gang_lev2_egs_in status_c_k0_in bremspedal_in status_autohold_in status_hillhold_in status_vf_in v_f_ref_in status_vfref_in z_diag_ersfkt_hi_96_has_in status_k0_adap_zaehler_in status_k0_befuellung_in z_oea_hst_in z_iep_in z_nllsoll_iep_in c_vm_in n_soll_em_hst_in abstellpos_vm_in abstellpos_vm_status_in status_nreg_em_hst_in m_min_vm_in m_soll_vm_l_hst_in z_msa_stada_in m_wunsch_fpw_hst_in status_getrbereit_in status_betriebsbereit_hst_in status_sa_vm_in z_ba_has_vm_hst_in z_ba_has_k0_hst_in status_abs_in status_asr_in modus_e_fahren_hst_in status_kl15_in status_posvueb_in soc_in status_soc_in c_umgebung_in status_cumgebung_in /end LOC_MEASUREMENT
 /begin SUB_FUNCTION SFOp17_ABO_Kapselung /end SUB_FUNCTION
/end FUNCTION
/begin FUNCTION SFOp6_FOp_ABST ""
 /begin LOC_MEASUREMENT z_hybfkt_stg st_ziel_bz_has_stg st_ist_bz_has_stg st_ist_hcomd_has_stg z_ablauf_has_stg z_ablaufvariante_has_stg m_k0_mod_has_fkt m_max_em_has_fkt m_max_iae_has_fkt m_min_em_has_fkt m_soll_em_has_fkt m_soll_k0_has_fkt m_soll_res_em_has_fkt mg_soll_k0_has_fkt n_soll_em_has_fkt n_soll_vm_has_fkt nd_min_saf_has_fkt nd_soll_iae_fkt st_ablauf_fkt status_ablauf_has_fkt z_ablauf_svh_reset_has_fkt z_ablaufvariante_kalt_zus z_emaktiv_fuw_zus_fkt z_fehler15_eh_fkt z_k0_befuellopt_has_fkt z_k0_has_fkt z_m_max_iae_has_fkt z_m_soll_em_has_fkt z_n_soll_em_has_fkt z_n_soll_vm_has_fkt z_p_hys_k0_has_fkt z_ponr_fkt z_respschlepp_sas_fkt z_saf_has_fkt z_sbe_has_fkt z_zuendfreigabe_vm_fkt z_zuendfreigabe_vm_has_fkt i_istgang_egs i_zielgang_egs m_wunsch_fpw_hst_fil mg_wunsch_fpw_in mg_wunsch_fpw_hst_in n_sec_iae nd_k0_in ndg_k0_in ng_vm_in status_schaltung_egs_in n_min_em_psys_lp3_has_sbe status_psys_has_sbe vg_f_sbe v_f_sbe status_sync_schaltung_sbe z_pvu_has_sbe z_freigabe_pvu_has_sbe t_betrieb_pvu_has_sbe mg_mot_in status_radschlupf_rse_has_sbe status_schaltart_svh_has_sbe m_motmax_has_sbe z_k0_has_sbe z_svh_has_sbe m_soll_res_em_has_sbe m_soll_res_em_bas_sbe z_modus_iae_has_sbe z_sas_has_sbe z_modus_iep_has_sbe z_msa_has_sbe status_efahren_has_sbe n_min_em_has_sbe z_msa_avh_moni_has_sbe z_msa_eaf_moni_has_sbe z_start_modus_has_sbe m_k0_mber_has_sbe z_lls_fktaktiv_has_sbe z_status_psys_mps_sbe m_k0_has_sbe m_soll_k0_has_sbe analyse_has_sbe z_nminemmodus_has_sbe z_modus_em_hst_in c_getriebe_egs_in istgang_egs_in m_em_in m_iae_in m_k0_in m_max_dyn_em_in m_soll_em_hst_in m_soll_vm_hst_in m_vm_in m_vm_start_in m_wunsch_fpw_in n_ab_egs_in n_em_in n_soll_ll_vm_in n_t_egs_in n_vm_in osmode_next_in p_bremse_fzg_in sollgang_egs_in status_fehler_iep_in status_iae_in status_iep_in status_k0_in pos_egs_in z_ablauf_has_hst_in z_ablaufvariante_has_hst_in zielgang_egs_in z_k0_fst_in m_mot_in status_iae_adap_in z_diag_ersfkt_has_in z_diag_ersfkt_hi_has_in z_diag_notgang_has_in status_k0_adap_in status_waschstr_in status_kraftfluss_egs_in z_n_min_em_parksp_has_in n_mot_soll_iae_in status_alaengs_adaoff_in gangwechsel_egs_in z_nllsoll_iae_in status_nem_in status_nvm_in kolbenpos_k0_in z_kps_stada_in t_betrieb_pvu_has_ee_in status_ll_vm_in z_msa_fst_in m_min_dyn_em_in phi_neigung_in v_f_in drehrichtung_nem_in fpw_in drehrichtung_nab_in schalt_mode_egs_in m_ziel_k0_hst_in status_kraftfluss_lev2_egs_in i_gang_lev2_egs_in status_c_k0_in bremspedal_in status_autohold_in status_hillhold_in status_vf_in v_f_ref_in status_vfref_in z_diag_ersfkt_hi_96_has_in status_k0_adap_zaehler_in status_k0_befuellung_in z_oea_hst_in z_iep_in z_nllsoll_iep_in c_vm_in n_soll_em_hst_in abstellpos_vm_in abstellpos_vm_status_in status_nreg_em_hst_in m_min_vm_in m_soll_vm_l_hst_in z_msa_stada_in m_wunsch_fpw_hst_in status_getrbereit_in status_betriebsbereit_hst_in status_sa_vm_in z_ba_has_vm_hst_in z_ba_has_k0_hst_in status_abs_in status_asr_in modus_e_fahren_hst_in status_kl15_in status_posvueb_in soc_in status_soc_in c_umgebung_in status_cumgebung_in /end LOC_MEASUREMENT
 /begin SUB_FUNCTION Action_FOp_ABST /end SUB_FUNCTION
/end FUNCTION
/begin FUNCTION SFOp7_FOp_ANS ""
 /begin LOC_MEASUREMENT z_nvmsollbegr_frk_dihi z_statuspsysmps_frk_dihi z_nminemnull_frk_dihi z_emfehler_frk_dihi z_ablaufreinit_frk_dihi z_k0syncmk0erh_frk_dihi z_fuwdeakt_frk_dihi z_nemmin_frk_dihi z_vmstopverbot_frk_dihi z_vmstartverbot_frk_dihi z_zust_halten_frk_dihi z_zust_init_frk_dihi z_deaktiv_abo_frk_dihi z_vmstartanf_frk_dihi z_svh_frk_dihi z_iepein_frk_dihi z_nsollvmnull_frk_dihi z_ala_frk_dihi z_schaltprioverh_frk_dihi z_nsollvmanh_frk_dihi z_gebruefahrenaus_frk_dihi z_hybfkt_stg st_ziel_bz_has_stg st_ist_bz_has_stg st_ist_hcomd_has_stg z_ablauf_has_stg z_ablaufvariante_has_stg m_k0_mod_has_fkt m_max_em_has_fkt m_max_iae_has_fkt m_min_em_has_fkt m_soll_em_has_fkt m_soll_k0_has_fkt m_soll_res_em_has_fkt mg_soll_k0_has_fkt n_soll_em_has_fkt n_soll_vm_has_fkt nd_min_saf_has_fkt st_ablauf_fkt status_ablauf_has_fkt z_ablauf_svh_reset_has_fkt z_k0_befuellopt_has_fkt z_k0_has_fkt z_m_max_iae_has_fkt z_m_soll_em_has_fkt z_n_soll_em_has_fkt z_n_soll_vm_has_fkt z_p_hys_k0_has_fkt z_respschlepp_sas_fkt z_saf_has_fkt i_istgang_egs i_zielgang_egs m_wunsch_fpw_hst_fil mg_wunsch_fpw_in mg_wunsch_fpw_hst_in n_sec_iae nd_k0_in ndg_k0_in ng_vm_in status_schaltung_egs_in n_min_em_psys_lp3_has_sbe status_psys_has_sbe vg_f_sbe v_f_sbe status_sync_schaltung_sbe z_pvu_has_sbe z_freigabe_pvu_has_sbe t_betrieb_pvu_has_sbe mg_mot_in status_radschlupf_rse_has_sbe status_schaltart_svh_has_sbe m_motmax_has_sbe z_k0_has_sbe z_svh_has_sbe m_soll_res_em_has_sbe m_soll_res_em_bas_sbe z_modus_iae_has_sbe z_sas_has_sbe z_modus_iep_has_sbe z_msa_has_sbe status_efahren_has_sbe n_min_em_has_sbe z_msa_avh_moni_has_sbe z_msa_eaf_moni_has_sbe z_start_modus_has_sbe m_k0_mber_has_sbe z_lls_fktaktiv_has_sbe z_status_psys_mps_sbe m_k0_has_sbe m_soll_k0_has_sbe analyse_has_sbe z_nminemmodus_has_sbe st_soll_bz_has_hst z_init_sta st_soll_bz_hst_sta st_ist_bz_hst_sta bExceptionHybrid bErrorHybrid z_modus_em_hst_in c_getriebe_egs_in istgang_egs_in m_em_in m_iae_in m_k0_in m_max_dyn_em_in m_soll_em_hst_in m_soll_vm_hst_in m_vm_in m_vm_start_in m_wunsch_fpw_in n_ab_egs_in n_em_in n_soll_ll_vm_in n_t_egs_in n_vm_in osmode_next_in p_bremse_fzg_in sollgang_egs_in status_fehler_iep_in status_iae_in status_iep_in status_k0_in pos_egs_in z_ablauf_has_hst_in z_ablaufvariante_has_hst_in zielgang_egs_in z_k0_fst_in m_mot_in status_iae_adap_in z_diag_ersfkt_has_in z_diag_ersfkt_hi_has_in z_diag_notgang_has_in status_k0_adap_in status_waschstr_in status_kraftfluss_egs_in z_n_min_em_parksp_has_in n_mot_soll_iae_in status_alaengs_adaoff_in gangwechsel_egs_in z_nllsoll_iae_in status_nem_in status_nvm_in kolbenpos_k0_in z_kps_stada_in t_betrieb_pvu_has_ee_in status_ll_vm_in z_msa_fst_in m_min_dyn_em_in phi_neigung_in v_f_in drehrichtung_nem_in fpw_in drehrichtung_nab_in schalt_mode_egs_in m_ziel_k0_hst_in status_kraftfluss_lev2_egs_in i_gang_lev2_egs_in status_c_k0_in bremspedal_in status_autohold_in status_hillhold_in status_vf_in v_f_ref_in status_vfref_in z_diag_ersfkt_hi_96_has_in status_k0_adap_zaehler_in status_k0_befuellung_in z_oea_hst_in z_iep_in z_nllsoll_iep_in c_vm_in n_soll_em_hst_in abstellpos_vm_in abstellpos_vm_status_in status_nreg_em_hst_in m_min_vm_in m_soll_vm_l_hst_in z_msa_stada_in m_wunsch_fpw_hst_in status_getrbereit_in status_betriebsbereit_hst_in status_sa_vm_in z_ba_has_vm_hst_in z_ba_has_k0_hst_in status_abs_in status_asr_in modus_e_fahren_hst_in status_kl15_in status_posvueb_in soc_in status_soc_in c_umgebung_in status_cumgebung_in /end LOC_MEASUREMENT
 /begin SUB_FUNCTION Action_FOp_ANS /end SUB_FUNCTION
/end FUNCTION
/begin FUNCTION SFOp8_FOp_ERR ""
 /begin LOC_MEASUREMENT m_soll_em_has_fkt n_soll_em_has_fkt n_soll_vm_has_fkt st_ablauf_fkt status_ablauf_has_fkt z_fehler15_eh_fkt z_k0_has_fkt z_m_soll_em_has_fkt z_n_soll_em_has_fkt z_n_soll_vm_has_fkt z_modus_em_hst_in c_getriebe_egs_in istgang_egs_in m_em_in m_iae_in m_k0_in m_max_dyn_em_in m_soll_em_hst_in m_soll_vm_hst_in m_vm_in m_vm_start_in m_wunsch_fpw_in n_ab_egs_in n_em_in n_soll_ll_vm_in n_t_egs_in n_vm_in osmode_next_in p_bremse_fzg_in sollgang_egs_in status_fehler_iep_in status_iae_in status_iep_in status_k0_in pos_egs_in z_ablauf_has_hst_in z_ablaufvariante_has_hst_in zielgang_egs_in z_k0_fst_in m_mot_in status_iae_adap_in z_diag_ersfkt_has_in z_diag_ersfkt_hi_has_in z_diag_notgang_has_in status_k0_adap_in status_waschstr_in status_kraftfluss_egs_in z_n_min_em_parksp_has_in n_mot_soll_iae_in status_alaengs_adaoff_in gangwechsel_egs_in z_nllsoll_iae_in status_nem_in status_nvm_in kolbenpos_k0_in z_kps_stada_in t_betrieb_pvu_has_ee_in status_ll_vm_in z_msa_fst_in m_min_dyn_em_in phi_neigung_in v_f_in drehrichtung_nem_in fpw_in drehrichtung_nab_in schalt_mode_egs_in m_ziel_k0_hst_in status_kraftfluss_lev2_egs_in i_gang_lev2_egs_in status_c_k0_in bremspedal_in status_autohold_in status_hillhold_in status_vf_in v_f_ref_in status_vfref_in z_diag_ersfkt_hi_96_has_in status_k0_adap_zaehler_in status_k0_befuellung_in z_oea_hst_in z_iep_in z_nllsoll_iep_in c_vm_in n_soll_em_hst_in abstellpos_vm_in abstellpos_vm_status_in status_nreg_em_hst_in m_min_vm_in m_soll_vm_l_hst_in z_msa_stada_in m_wunsch_fpw_hst_in status_getrbereit_in /end LOC_MEASUREMENT
 /begin SUB_FUNCTION SFOp18_Kapselung_ERR /end SUB_FUNCTION
/end FUNCTION
/begin FUNCTION SFOp9_FOp_GAA ""
 /begin LOC_MEASUREMENT st_ablauf_fkt status_ablauf_has_fkt z_modus_em_hst_in c_getriebe_egs_in istgang_egs_in m_em_in m_iae_in m_k0_in m_max_dyn_em_in m_soll_em_hst_in m_soll_vm_hst_in m_vm_in m_vm_start_in m_wunsch_fpw_in n_ab_egs_in n_em_in n_soll_ll_vm_in n_t_egs_in n_vm_in osmode_next_in p_bremse_fzg_in sollgang_egs_in status_fehler_iep_in status_iae_in status_iep_in status_k0_in pos_egs_in z_ablauf_has_hst_in z_ablaufvariante_has_hst_in zielgang_egs_in z_k0_fst_in m_mot_in status_iae_adap_in z_diag_ersfkt_has_in z_diag_ersfkt_hi_has_in z_diag_notgang_has_in status_k0_adap_in status_waschstr_in status_kraftfluss_egs_in z_n_min_em_parksp_has_in n_mot_soll_iae_in status_alaengs_adaoff_in gangwechsel_egs_in z_nllsoll_iae_in status_nem_in status_nvm_in kolbenpos_k0_in z_kps_stada_in t_betrieb_pvu_has_ee_in status_ll_vm_in z_msa_fst_in m_min_dyn_em_in phi_neigung_in v_f_in drehrichtung_nem_in fpw_in drehrichtung_nab_in schalt_mode_egs_in m_ziel_k0_hst_in status_kraftfluss_lev2_egs_in i_gang_lev2_egs_in status_c_k0_in bremspedal_in status_autohold_in status_hillhold_in status_vf_in v_f_ref_in status_vfref_in z_diag_ersfkt_hi_96_has_in status_k0_adap_zaehler_in status_k0_befuellung_in z_oea_hst_in z_iep_in z_nllsoll_iep_in c_vm_in n_soll_em_hst_in abstellpos_vm_in abstellpos_vm_status_in status_nreg_em_hst_in m_min_vm_in m_soll_vm_l_hst_in z_msa_stada_in m_wunsch_fpw_hst_in status_getrbereit_in /end LOC_MEASUREMENT
 /begin SUB_FUNCTION SFOp19_GAA_Kapselung /end SUB_FUNCTION
/end FUNCTION
/begin FUNCTION SFSBI10_Radschlupferkennung ""
 /begin DEF_CHARACTERISTIC KL_VDSFDDAERK1_RSE_HAS_Y KL_VDSFDDAERK1_RSE_HAS_X KL_VDSFDDAERK2_RSE_HAS_Y KL_VDSFDDAERK2_RSE_HAS_X SWI_RSE_AKTIV_HAS T_VRUECKDDAERK_RSE_HAS /end DEF_CHARACTERISTIC
 /begin LOC_MEASUREMENT t_rueckddaerk_rse_has v_f_in v_f_ref_in /end LOC_MEASUREMENT
/end FUNCTION
/begin FUNCTION SFSBI109_Anforderung_PVU ""
 /begin DEF_CHARACTERISTIC NS_EMANF_KALTNEM_PVU_HAS NS_EMANF_PVU_HAS TS_ANFMAX_KALTNEM_PVU_HAS TS_ANFMAX_PVU_HAS /end DEF_CHARACTERISTIC
 /begin LOC_MEASUREMENT t_anfmax_pvu_has n_em_in status_posvueb_in /end LOC_MEASUREMENT
/end FUNCTION
/begin FUNCTION SFSBI11_Unterstuetzung_Positionsventilueberwachung ""
 /begin LOC_MEASUREMENT st_ziel_bz_has_stg z_ablaufvariante_has_stg z_emaktiv_fuw_zus_fkt n_em_in pos_egs_in status_nem_in t_betrieb_pvu_has_ee_in status_posvueb_in /end LOC_MEASUREMENT
 /begin SUB_FUNCTION SFSBI109_Anforderung_PVU SFSBI111_Timer_BFI SFSBI112_VMStart_PVU SFSBI110_Beeinflussung_PVU /end SUB_FUNCTION
/end FUNCTION
/begin FUNCTION SFSBI110_Beeinflussung_PVU ""
 /begin DEF_CHARACTERISTIC SWI_POSP_ABFR_PVU_HAS SWI_VMSTARTANF_PVU_HAS TS_MAX_PVU_HAS T_BETRIEBKALTSTARTMAX_PVU_HAS T_BETRIEBMAX_PVU_HAS /end DEF_CHARACTERISTIC
 /begin LOC_MEASUREMENT z_emaktiv_fuw_zus_fkt pos_egs_in status_nem_in status_posvueb_in /end LOC_MEASUREMENT
/end FUNCTION
/begin FUNCTION SFSBI111_Timer_BFI "" /begin DEF_CHARACTERISTIC TS_MAX_PVU_HAS TS_AKTIV_PVU_HAS /end DEF_CHARACTERISTIC
 /begin LOC_MEASUREMENT t_aktiv_pvu_has t_max_pvu_has t_betrieb_pvu_has_ee_in status_posvueb_in /end LOC_MEASUREMENT
/end FUNCTION
/begin FUNCTION SFSBI112_VMStart_PVU "" /begin DEF_CHARACTERISTIC Z_ABLAUFVAR_KALTNEM_PVU_HAS /end DEF_CHARACTERISTIC
 /begin LOC_MEASUREMENT z_vmkaltstart_pvu_has z_vmstart_pvu_has st_ziel_bz_has_stg z_ablaufvariante_has_stg /end LOC_MEASUREMENT
/end FUNCTION
/begin FUNCTION SFSBI14_Lastaenderungszustand ""
 /begin DEF_CHARACTERISTIC KL_MOMAXDYNEM_LASTANH_SVH_HAS_Y KL_MOMAXDYNEM_LASTANH_SVH_HAS_X MGS_WUNSCHFPW_LASTANH_SVH_HAS SWI_MODUS_LASTANH_SVH_HAS /end DEF_CHARACTERISTIC
 /begin LOC_MEASUREMENT ms_wunschfpw_lastanh_svh status_lastanh_svh z_hybfkt_stg st_ziel_bz_has_stg st_ist_bz_has_stg mg_wunsch_fpw_in mg_wunsch_fpw_hst_in m_max_dyn_em_in m_wunsch_fpw_in m_wunsch_fpw_hst_in z_svh_has_sbe m_soll_res_em_has_sbe /end LOC_MEASUREMENT
 /begin SUB_FUNCTION SFSBI17_Ablauf_aktiv /end SUB_FUNCTION
/end FUNCTION
/begin FUNCTION SFSBI15_Lastzustand ""
 /begin DEF_CHARACTERISTIC MO_WUNSCHFPW_ZUG_SVH_HAS MS_WUNSCHFPW_ZUG_SVH_HAS PO_BREMSE_ZUG_SVH_HAS PS_BREMSE_ZUG_SVH_HAS /end DEF_CHARACTERISTIC
 /begin LOC_MEASUREMENT status_zug_svh_sbe m_wunsch_fpw_in p_bremse_fzg_in /end LOC_MEASUREMENT
/end FUNCTION
/begin FUNCTION SFSBI16_Schaltungsrichtung ""
 /begin LOC_MEASUREMENT istgang_egs_begr_svh status_rs_anf_svh status_schaltanf_fst_svh istgang_egs_in sollgang_egs_in /end LOC_MEASUREMENT
/end FUNCTION
/begin FUNCTION SFSBI17_Ablauf_aktiv ""
 /begin LOC_MEASUREMENT z_hybfkt_stg mg_wunsch_fpw_in m_max_dyn_em_in m_wunsch_fpw_in m_wunsch_fpw_hst_in m_soll_res_em_has_sbe /end LOC_MEASUREMENT
 /begin SUB_FUNCTION SFSBI19_Andere_Startart SFSBI20_Schleppstart /end SUB_FUNCTION
/end FUNCTION
/begin FUNCTION SFSBI19_Andere_Startart ""
 /begin DEF_CHARACTERISTIC MGO_WUNSCHFPW_LASTANH_SVH_HAS MGS_WUNSCHFPW_LASTANH_SVH_HAS /end DEF_CHARACTERISTIC
 /begin LOC_MEASUREMENT z_hybfkt_stg mg_wunsch_fpw_in m_max_dyn_em_in m_wunsch_fpw_in m_wunsch_fpw_hst_in /end LOC_MEASUREMENT
/end FUNCTION
/begin FUNCTION SFSBI20_Schleppstart ""
 /begin LOC_MEASUREMENT m_max_dyn_em_in m_wunsch_fpw_in m_wunsch_fpw_hst_in m_soll_res_em_has_sbe /end LOC_MEASUREMENT
/end FUNCTION
/begin FUNCTION SFSBI4_Bestimmung_Schaltart "" /begin DEF_CHARACTERISTIC SWI_SCHALTARTAKT_SVH_HAS /end DEF_CHARACTERISTIC
 /begin LOC_MEASUREMENT z_hybfkt_stg st_ziel_bz_has_stg st_ist_bz_has_stg mg_wunsch_fpw_in mg_wunsch_fpw_hst_in istgang_egs_in m_max_dyn_em_in m_wunsch_fpw_in p_bremse_fzg_in sollgang_egs_in m_wunsch_fpw_hst_in z_svh_has_sbe m_soll_res_em_has_sbe /end LOC_MEASUREMENT
 /begin SUB_FUNCTION SFSBI14_Lastaenderungszustand SFSBI16_Schaltungsrichtung SFSBI15_Lastzustand /end SUB_FUNCTION
/end FUNCTION
/begin FUNCTION SFSBI5_Drehzahlen_input ""
 /begin DEF_CHARACTERISTIC KL_MPTNT_SBE_Y KL_MPTNT_SBE_X NS_NT_SBE SWI_NTVIRTNSECIAE_AKTIV_HAS FK_NDGK0_HAS T_VNEMNDK0_HAS T_VNVMNDK0_HAS XP_MAX FK_NGVM_HAS FK_VGF_HAS K_VF_HAS /end DEF_CHARACTERISTIC
 /begin LOC_MEASUREMENT n_sec_iae_mod n_em_verz n_vm_verz n_sec_iae nd_k0_in ndg_k0_in ng_vm_in vg_f_sbe v_f_sbe m_wunsch_fpw_in n_ab_egs_in n_em_in n_t_egs_in n_vm_in status_kraftfluss_egs_in /end LOC_MEASUREMENT
 /begin SUB_FUNCTION Run_SFSBI27_cPt1nseciae Run_SFSBI31_cDelayEM Run_SFSBI32_cDelayNVM Run_SFSBI30_cDT1_ndgk0 Run_SFSBI23_cDT1_ndgvm Run_SFSBI24_cDT1_vg_f /end SUB_FUNCTION
/end FUNCTION
/begin FUNCTION SFSBI56_IfActionSubsystem "" /begin LOC_MEASUREMENT istgang_egs_in zielgang_egs_in /end LOC_MEASUREMENT /end FUNCTION
/begin FUNCTION SFSBI57_IfActionSubsystem2 "" /begin DEF_CHARACTERISTIC T_VSCHALTUNGAKTIV_HAS /end DEF_CHARACTERISTIC /begin LOC_MEASUREMENT istgang_egs_in sollgang_egs_in /end LOC_MEASUREMENT /end FUNCTION
/begin FUNCTION SFSBI6_Getriebe_input "" /begin DEF_CHARACTERISTIC NDS_SYNCHRON_HAS TAB_UEBERSETZUNGEN_EGS /end DEF_CHARACTERISTIC
 /begin LOC_MEASUREMENT istgang_egs_in n_ab_egs_in n_em_in sollgang_egs_in zielgang_egs_in gangwechsel_egs_in /end LOC_MEASUREMENT
 /begin SUB_FUNCTION SFSBI56_IfActionSubsystem SFSBI57_IfActionSubsystem2 /end SUB_FUNCTION
/end FUNCTION
/begin FUNCTION SFSBI78_Bestimmung_minimale_EM_Drehzahl "" /begin DEF_CHARACTERISTIC KL_NMINEM_PSYS_LP3_HAS_Y KL_NMINEM_PSYS_LP3_HAS_X /end DEF_CHARACTERISTIC /begin LOC_MEASUREMENT c_getriebe_egs_in /end LOC_MEASUREMENT /end FUNCTION
/begin FUNCTION SFSBI79_Status_Psys ""
 /begin DEF_CHARACTERISTIC KF_INITTVSTATUSIEP_SBE_W KF_INITTVSTATUSIEP_SBE_X KF_INITTVSTATUSIEP_SBE_Y KF_TVSTATUSIEPSST_SBE_W KF_TVSTATUSIEPSST_SBE_X KF_TVSTATUSIEPSST_SBE_Y KF_TVSTATUSIEP_SBE_W KF_TVSTATUSIEP_SBE_X KF_TVSTATUSIEP_SBE_Y SWI_PVU_STATUSPSYS_HAS SWI_STATUS_GETRBEREIT_HAS /end DEF_CHARACTERISTIC
 /begin LOC_MEASUREMENT status_psys_em_has t_vstatusiep_aktiv_has status_psys_iep_has c_getriebe_egs_in n_em_in status_iep_in status_getrbereit_in /end LOC_MEASUREMENT
 /begin SUB_FUNCTION SFSBI83_Verzoegerung_status_psys_em_has SFSBI82_Bestimmung_LP SFSBI99_Bestimmung_Erststart_aktiv SFSBI96_Bitwise_AND_ui8_1 SFSBI97_Bitwise_AND_ui8_2 SFSBI98_Bitwise_AND_ui8_3 /end SUB_FUNCTION
/end FUNCTION
/begin FUNCTION SFSBI8_Momente_input "" /begin DEF_CHARACTERISTIC XP_MAX FK_MGMOT_HAS FK_MGWUNSCHFPW_HAS MPT_MWUNSCHFPWHST /end DEF_CHARACTERISTIC
 /begin LOC_MEASUREMENT m_wunsch_fpw_hst_fil_azg m_wunsch_fpw_hst_fil mg_wunsch_fpw_in mg_wunsch_fpw_hst_in mg_mot_in m_wunsch_fpw_in m_mot_in m_wunsch_fpw_hst_in /end LOC_MEASUREMENT
 /begin SUB_FUNCTION Run_SFSBI66_cPT1MWunsch Run_SFSBI64_cDT1MgWunsch Run_SFSBI65_cDT1MgWunschHST Run_SFSBI63_cDT1MgMot /end SUB_FUNCTION
/end FUNCTION
/begin FUNCTION SFSBI82_Bestimmung_LP ""
 /begin DEF_CHARACTERISTIC NO_NMIN_PSYS_EM_L1AUS NO_NMIN_PSYS_EM_L1L3 NO_NMIN_PSYS_EM_L3L1 NS_NMIN_EM_L1_HAS /end DEF_CHARACTERISTIC
 /begin LOC_MEASUREMENT status_psys_em_has_nverz n_em_in /end LOC_MEASUREMENT
/end FUNCTION
/begin FUNCTION SFSBI83_Verzoegerung_status_psys_em_has "" /begin DEF_CHARACTERISTIC TAB_STATUSIEP_HAS TAB_STATUSPSYSEM_HAS /end DEF_CHARACTERISTIC /begin LOC_MEASUREMENT c_getriebe_egs_in status_iep_in /end LOC_MEASUREMENT /begin SUB_FUNCTION SFSBI90_then SFSBI89_else /end SUB_FUNCTION /end FUNCTION
/begin FUNCTION SFSBI89_else "" /begin LOC_MEASUREMENT t_vstatuspsysem_lp3 /end LOC_MEASUREMENT /end FUNCTION
/begin FUNCTION SFSBI9_N_Min_Psys_EM ""
 /begin LOC_MEASUREMENT c_getriebe_egs_in n_em_in status_iep_in status_getrbereit_in /end LOC_MEASUREMENT
 /begin SUB_FUNCTION SFSBI79_Status_Psys SFSBI78_Bestimmung_minimale_EM_Drehzahl /end SUB_FUNCTION
/end FUNCTION
/begin FUNCTION SFSBI90_then "" /begin DEF_CHARACTERISTIC KL_TVSTATUSPSYSEM_LP3_HAS_Y KL_TVSTATUSPSYSEM_LP3_HAS_X /end DEF_CHARACTERISTIC /begin LOC_MEASUREMENT c_getriebe_egs_in /end LOC_MEASUREMENT /end FUNCTION
/begin FUNCTION SFSBI96_Bitwise_AND_ui8_1 "" /begin LOC_MEASUREMENT status_getrbereit_in /end LOC_MEASUREMENT /end FUNCTION
/begin FUNCTION SFSBI97_Bitwise_AND_ui8_2 "" /begin LOC_MEASUREMENT status_getrbereit_in /end LOC_MEASUREMENT /end FUNCTION
/begin FUNCTION SFSBI98_Bitwise_AND_ui8_3 "" /begin LOC_MEASUREMENT status_getrbereit_in /end LOC_MEASUREMENT /end FUNCTION
/begin FUNCTION SFSBI99_Bestimmung_Erststart_aktiv "" /begin LOC_MEASUREMENT status_iep_in /end LOC_MEASUREMENT /end FUNCTION
/begin FUNCTION SFSBo10_SBEo_LLS ""
 /begin LOC_MEASUREMENT z_nvmsollbegr_frk_dihi z_statuspsysmps_frk_dihi z_nminemnull_frk_dihi z_emfehler_frk_dihi z_ablaufreinit_frk_dihi z_k0syncmk0erh_frk_dihi z_fuwdeakt_frk_dihi z_nemmin_frk_dihi z_vmstopverbot_frk_dihi z_vmstartverbot_frk_dihi z_zust_halten_frk_dihi z_zust_init_frk_dihi z_deaktiv_abo_frk_dihi z_vmstartanf_frk_dihi z_svh_frk_dihi z_iepein_frk_dihi z_nsollvmnull_frk_dihi z_ala_frk_dihi z_schaltprioverh_frk_dihi z_nsollvmanh_frk_dihi z_gebruefahrenaus_frk_dihi z_hybfkt_stg st_ziel_bz_has_stg st_ist_bz_has_stg st_ist_hcomd_has_stg z_ablauf_has_stg z_ablaufvariante_has_stg i_istgang_egs i_zielgang_egs m_wunsch_fpw_hst_fil mg_wunsch_fpw_in mg_wunsch_fpw_hst_in n_sec_iae nd_k0_in ndg_k0_in ng_vm_in status_schaltung_egs_in n_min_em_psys_lp3_has_sbe status_psys_has_sbe vg_f_sbe v_f_sbe status_sync_schaltung_sbe z_pvu_has_sbe z_freigabe_pvu_has_sbe t_betrieb_pvu_has_sbe mg_mot_in status_radschlupf_rse_has_sbe status_schaltart_svh_has_sbe z_modus_em_hst_in c_getriebe_egs_in istgang_egs_in m_em_in m_iae_in m_k0_in m_max_dyn_em_in m_soll_em_hst_in m_soll_vm_hst_in m_vm_in m_vm_start_in m_wunsch_fpw_in n_ab_egs_in n_em_in n_soll_ll_vm_in n_t_egs_in n_vm_in osmode_next_in p_bremse_fzg_in sollgang_egs_in status_fehler_iep_in status_iae_in status_iep_in status_k0_in pos_egs_in z_ablauf_has_hst_in z_ablaufvariante_has_hst_in zielgang_egs_in z_k0_fst_in m_mot_in status_iae_adap_in z_diag_ersfkt_has_in z_diag_ersfkt_hi_has_in z_diag_notgang_has_in status_k0_adap_in status_waschstr_in status_kraftfluss_egs_in z_n_min_em_parksp_has_in n_mot_soll_iae_in status_alaengs_adaoff_in gangwechsel_egs_in z_nllsoll_iae_in status_nem_in status_nvm_in kolbenpos_k0_in z_kps_stada_in t_betrieb_pvu_has_ee_in status_ll_vm_in z_msa_fst_in m_min_dyn_em_in phi_neigung_in v_f_in drehrichtung_nem_in fpw_in drehrichtung_nab_in schalt_mode_egs_in m_ziel_k0_hst_in status_kraftfluss_lev2_egs_in i_gang_lev2_egs_in status_c_k0_in bremspedal_in status_autohold_in status_hillhold_in status_vf_in v_f_ref_in status_vfref_in z_diag_ersfkt_hi_96_has_in status_k0_adap_zaehler_in status_k0_befuellung_in z_oea_hst_in z_iep_in z_nllsoll_iep_in c_vm_in n_soll_em_hst_in abstellpos_vm_in abstellpos_vm_status_in status_nreg_em_hst_in m_min_vm_in m_soll_vm_l_hst_in z_msa_stada_in m_wunsch_fpw_hst_in status_getrbereit_in status_betriebsbereit_hst_in status_sa_vm_in z_ba_has_vm_hst_in z_ba_has_k0_hst_in status_abs_in status_asr_in modus_e_fahren_hst_in status_kl15_in status_posvueb_in soc_in status_soc_in c_umgebung_in status_cumgebung_in /end LOC_MEASUREMENT
 /begin SUB_FUNCTION SFSBo138_Leerlaufsimulation /end SUB_FUNCTION
/end FUNCTION
/begin FUNCTION SFSBo105_IEP_Beeinflussung ""
 /begin DEF_CHARACTERISTIC KL_ZVMSTARTABLVAR_SST_BFI_HAS_Y KL_ZVMSTARTABLVAR_SST_BFI_HAS_X KL_ZVMSTARTVOREIL_SST_BFI_HAS_Y KL_ZVMSTARTVOREIL_SST_BFI_HAS_X SWI_ZABLVAR_SST_BFI_HAS T_ZIEPHASAKTIV_BFI_HAS T_ZIEPHASMAX_BFI_HAS /end DEF_CHARACTERISTIC
 /begin LOC_MEASUREMENT z_vmstart_bfi z_vmstartvoreil_bfi t_ziephasaktiv_bfi t_ziephasmax_bfi z_iepein_frk_dihi st_ziel_bz_has_stg st_ist_bz_has_stg z_ablaufvariante_has_stg z_emaktiv_fuw_zus_fkt z_pvu_has_sbe n_vm_in z_ablaufvariante_has_hst_in status_waschstr_in status_betriebsbereit_hst_in /end LOC_MEASUREMENT
 /begin SUB_FUNCTION SFSBo108_BeeinflussungIEPHAS /end SUB_FUNCTION
/end FUNCTION
/begin FUNCTION SFSBo108_BeeinflussungIEPHAS ""
 /begin DEF_CHARACTERISTIC SWI_BFIFUWAKTIV_HAS SWI_BFIPVU_BFI_HAS Z_PVU_BFI_HAS NS_VMSTART_BFI_HAS SWI_ZMODUSIEP_SST_BFI_HAS /end DEF_CHARACTERISTIC
 /begin LOC_MEASUREMENT z_modus_iep_fuw_bfi_has z_modus_iep_dihi_bfi_has z_modus_iep_pvu_bfi_has z_modus_iep_sst_bfi_has z_iepein_frk_dihi z_emaktiv_fuw_zus_fkt z_pvu_has_sbe n_vm_in status_waschstr_in status_betriebsbereit_hst_in /end LOC_MEASUREMENT
/end FUNCTION
/begin FUNCTION SFSBo11_SBEo_MOM ""
 /begin DEF_CHARACTERISTIC M_K0MAX_HAS SWI_MK0BERZK0_HAS SWI_MK0MAXK0GEGSL_HAS SWI_MK0MAXK0GSL_HAS SWI_MK0MAXK0SREG_HAS SWI_MK0MODFKT_HAS /end DEF_CHARACTERISTIC
 /begin LOC_MEASUREMENT z_hybfkt_stg st_ziel_bz_has_stg st_ist_bz_has_stg st_ist_hcomd_has_stg z_ablauf_has_stg z_ablaufvariante_has_stg m_k0_mod_has_fkt m_max_em_has_fkt m_max_iae_has_fkt m_min_em_has_fkt m_soll_em_has_fkt m_soll_k0_has_fkt m_soll_res_em_has_fkt mg_soll_k0_has_fkt n_soll_em_has_fkt n_soll_vm_has_fkt nd_min_saf_has_fkt nd_soll_iae_fkt st_ablauf_fkt status_ablauf_has_fkt z_ablauf_svh_reset_has_fkt z_ablaufvariante_kalt_zus z_emaktiv_fuw_zus_fkt z_fehler15_eh_fkt z_k0_befuellopt_has_fkt z_k0_has_fkt z_m_max_iae_has_fkt z_m_soll_em_has_fkt z_n_soll_em_has_fkt z_n_soll_vm_has_fkt z_p_hys_k0_has_fkt z_ponr_fkt z_respschlepp_sas_fkt z_saf_has_fkt z_sbe_has_fkt z_zuendfreigabe_vm_fkt z_zuendfreigabe_vm_has_fkt z_modus_em_hst_in c_getriebe_egs_in istgang_egs_in m_em_in m_iae_in m_k0_in m_max_dyn_em_in m_soll_em_hst_in m_soll_vm_hst_in m_vm_in m_vm_start_in m_wunsch_fpw_in n_ab_egs_in n_em_in n_soll_ll_vm_in n_t_egs_in n_vm_in osmode_next_in p_bremse_fzg_in sollgang_egs_in status_fehler_iep_in status_iae_in status_iep_in status_k0_in pos_egs_in z_ablauf_has_hst_in z_ablaufvariante_has_hst_in zielgang_egs_in z_k0_fst_in m_mot_in status_iae_adap_in z_diag_ersfkt_has_in z_diag_ersfkt_hi_has_in z_diag_notgang_has_in status_k0_adap_in status_waschstr_in status_kraftfluss_egs_in z_n_min_em_parksp_has_in n_mot_soll_iae_in status_alaengs_adaoff_in gangwechsel_egs_in z_nllsoll_iae_in status_nem_in status_nvm_in kolbenpos_k0_in z_kps_stada_in t_betrieb_pvu_has_ee_in status_ll_vm_in z_msa_fst_in m_min_dyn_em_in phi_neigung_in v_f_in drehrichtung_nem_in fpw_in drehrichtung_nab_in schalt_mode_egs_in m_ziel_k0_hst_in status_kraftfluss_lev2_egs_in i_gang_lev2_egs_in status_c_k0_in bremspedal_in status_autohold_in status_hillhold_in status_vf_in v_f_ref_in status_vfref_in z_diag_ersfkt_hi_96_has_in status_k0_adap_zaehler_in status_k0_befuellung_in z_oea_hst_in z_iep_in z_nllsoll_iep_in c_vm_in n_soll_em_hst_in abstellpos_vm_in abstellpos_vm_status_in status_nreg_em_hst_in m_min_vm_in m_soll_vm_l_hst_in z_msa_stada_in m_wunsch_fpw_hst_in status_getrbereit_in /end LOC_MEASUREMENT
 /begin SUB_FUNCTION SFSBo252_Beruecksichtigung_VM_Startmoments SFSBo251_Beruecksichtigung_VM_Abstellposition /end SUB_FUNCTION
/end FUNCTION
/begin FUNCTION SFSBo12_SBEo_MSA ""
 /begin LOC_MEASUREMENT z_nvmsollbegr_frk_dihi z_statuspsysmps_frk_dihi z_nminemnull_frk_dihi z_emfehler_frk_dihi z_ablaufreinit_frk_dihi z_k0syncmk0erh_frk_dihi z_fuwdeakt_frk_dihi z_nemmin_frk_dihi z_vmstopverbot_frk_dihi z_vmstartverbot_frk_dihi z_zust_halten_frk_dihi z_zust_init_frk_dihi z_deaktiv_abo_frk_dihi z_vmstartanf_frk_dihi z_svh_frk_dihi z_iepein_frk_dihi z_nsollvmnull_frk_dihi z_ala_frk_dihi z_schaltprioverh_frk_dihi z_nsollvmanh_frk_dihi z_gebruefahrenaus_frk_dihi z_hybfkt_stg st_ziel_bz_has_stg st_ist_bz_has_stg st_ist_hcomd_has_stg z_ablauf_has_stg z_ablaufvariante_has_stg i_istgang_egs i_zielgang_egs m_wunsch_fpw_hst_fil mg_wunsch_fpw_in mg_wunsch_fpw_hst_in n_sec_iae nd_k0_in ndg_k0_in ng_vm_in status_schaltung_egs_in n_min_em_psys_lp3_has_sbe status_psys_has_sbe vg_f_sbe v_f_sbe status_sync_schaltung_sbe z_pvu_has_sbe z_freigabe_pvu_has_sbe t_betrieb_pvu_has_sbe mg_mot_in status_radschlupf_rse_has_sbe status_schaltart_svh_has_sbe z_msa_has_sbe z_modus_em_hst_in c_getriebe_egs_in istgang_egs_in m_em_in m_iae_in m_k0_in m_max_dyn_em_in m_soll_em_hst_in m_soll_vm_hst_in m_vm_in m_vm_start_in m_wunsch_fpw_in n_ab_egs_in n_em_in n_soll_ll_vm_in n_t_egs_in n_vm_in osmode_next_in p_bremse_fzg_in sollgang_egs_in status_fehler_iep_in status_iae_in status_iep_in status_k0_in pos_egs_in z_ablauf_has_hst_in z_ablaufvariante_has_hst_in zielgang_egs_in z_k0_fst_in m_mot_in status_iae_adap_in z_diag_ersfkt_has_in z_diag_ersfkt_hi_has_in z_diag_notgang_has_in status_k0_adap_in status_waschstr_in status_kraftfluss_egs_in z_n_min_em_parksp_has_in n_mot_soll_iae_in status_alaengs_adaoff_in gangwechsel_egs_in z_nllsoll_iae_in status_nem_in status_nvm_in kolbenpos_k0_in z_kps_stada_in t_betrieb_pvu_has_ee_in status_ll_vm_in z_msa_fst_in m_min_dyn_em_in phi_neigung_in v_f_in drehrichtung_nem_in fpw_in drehrichtung_nab_in schalt_mode_egs_in m_ziel_k0_hst_in status_kraftfluss_lev2_egs_in i_gang_lev2_egs_in status_c_k0_in bremspedal_in status_autohold_in status_hillhold_in status_vf_in v_f_ref_in status_vfref_in z_diag_ersfkt_hi_96_has_in status_k0_adap_zaehler_in status_k0_befuellung_in z_oea_hst_in z_iep_in z_nllsoll_iep_in c_vm_in n_soll_em_hst_in abstellpos_vm_in abstellpos_vm_status_in status_nreg_em_hst_in m_min_vm_in m_soll_vm_l_hst_in z_msa_stada_in m_wunsch_fpw_hst_in status_getrbereit_in status_betriebsbereit_hst_in status_sa_vm_in z_ba_has_vm_hst_in z_ba_has_k0_hst_in status_abs_in status_asr_in modus_e_fahren_hst_in status_kl15_in status_posvueb_in soc_in status_soc_in c_umgebung_in status_cumgebung_in /end LOC_MEASUREMENT
 /begin SUB_FUNCTION SFSBo273_MSA_Beeinflussung /end SUB_FUNCTION
/end FUNCTION
/begin FUNCTION SFSBo124_K0_Sollmoment "" /begin DEF_CHARACTERISTIC M_SOLLK0MAX_HAS /end DEF_CHARACTERISTIC /begin LOC_MEASUREMENT m_soll_k0_has_fkt /end LOC_MEASUREMENT /end FUNCTION
/begin FUNCTION SFSBo13_SBEo_SVH ""
 /begin DEF_CHARACTERISTIC KF_SCHALTART_ZUL_SVH_HAS_W KF_SCHALTART_ZUL_SVH_HAS_X KF_SCHALTART_ZUL_SVH_HAS_Y TAB_TVSVHRESET_SVH_HAS /end DEF_CHARACTERISTIC
 /begin LOC_MEASUREMENT t_vsvhreset_svh status_schaltart_zul_svh_has z_nvmsollbegr_frk_dihi z_statuspsysmps_frk_dihi z_nminemnull_frk_dihi z_emfehler_frk_dihi z_ablaufreinit_frk_dihi z_k0syncmk0erh_frk_dihi z_fuwdeakt_frk_dihi z_nemmin_frk_dihi z_vmstopverbot_frk_dihi z_vmstartverbot_frk_dihi z_zust_halten_frk_dihi z_zust_init_frk_dihi z_deaktiv_abo_frk_dihi z_vmstartanf_frk_dihi z_svh_frk_dihi z_iepein_frk_dihi z_nsollvmnull_frk_dihi z_ala_frk_dihi z_schaltprioverh_frk_dihi z_nsollvmanh_frk_dihi z_gebruefahrenaus_frk_dihi z_hybfkt_stg st_ziel_bz_has_stg st_ist_bz_has_stg st_ist_hcomd_has_stg z_ablauf_has_stg z_ablaufvariante_has_stg m_k0_mod_has_fkt m_max_em_has_fkt m_max_iae_has_fkt m_min_em_has_fkt m_soll_em_has_fkt m_soll_k0_has_fkt m_soll_res_em_has_fkt mg_soll_k0_has_fkt n_soll_em_has_fkt n_soll_vm_has_fkt nd_min_saf_has_fkt nd_soll_iae_fkt st_ablauf_fkt status_ablauf_has_fkt z_ablauf_svh_reset_has_fkt z_ablaufvariante_kalt_zus z_emaktiv_fuw_zus_fkt z_fehler15_eh_fkt z_k0_befuellopt_has_fkt z_k0_has_fkt z_m_max_iae_has_fkt z_m_soll_em_has_fkt z_n_soll_em_has_fkt z_n_soll_vm_has_fkt z_p_hys_k0_has_fkt z_ponr_fkt z_respschlepp_sas_fkt z_saf_has_fkt z_sbe_has_fkt z_zuendfreigabe_vm_fkt z_zuendfreigabe_vm_has_fkt i_istgang_egs i_zielgang_egs m_wunsch_fpw_hst_fil mg_wunsch_fpw_in mg_wunsch_fpw_hst_in n_sec_iae nd_k0_in ndg_k0_in ng_vm_in status_schaltung_egs_in n_min_em_psys_lp3_has_sbe status_psys_has_sbe vg_f_sbe v_f_sbe status_sync_schaltung_sbe z_pvu_has_sbe z_freigabe_pvu_has_sbe t_betrieb_pvu_has_sbe mg_mot_in status_radschlupf_rse_has_sbe status_schaltart_svh_has_sbe /end LOC_MEASUREMENT
 /begin SUB_FUNCTION SFSBo408_Bitwise_AND_ui8_ SFSBo409_Bitwise_AND_ui8_1 /end SUB_FUNCTION
/end FUNCTION
/begin RECORD_LAYOUT FLOAT32_IEEE_COL_DIRECT_M_S7_S3 FNC_VALUES 1 FLOAT32_IEEE COLUMN_DIR DIRECT /end RECORD_LAYOUT
/begin RECORD_LAYOUT FLOAT32_IEEE_X_INCR_DIRECT_M_S7_S3 AXIS_PTS_X 1 FLOAT32_IEEE INDEX_INCR DIRECT /end RECORD_LAYOUT
/begin RECORD_LAYOUT SBYTE_X_INCR_DIRECT_M_S7_S3 AXIS_PTS_X 1 SBYTE INDEX_INCR DIRECT /end RECORD_LAYOUT
/begin RECORD_LAYOUT SWORD_X_INCR_DIRECT_M_S7_S3 AXIS_PTS_X 1 SWORD INDEX_INCR DIRECT /end RECORD_LAYOUT
/begin RECORD_LAYOUT UBYTE_COL_DIRECT_M_S7_S3 FNC_VALUES 1 UBYTE COLUMN_DIR DIRECT /end RECORD_LAYOUT
/begin RECORD_LAYOUT UBYTE_X_INCR_DIRECT_M_S7_S3 AXIS_PTS_X 1 UBYTE INDEX_INCR DIRECT /end RECORD_LAYOUT
/begin RECORD_LAYOUT ULONG_COL_DIRECT_M_S7_S3 FNC_VALUES 1 ULONG COLUMN_DIR DIRECT /end RECORD_LAYOUT
/begin RECORD_LAYOUT UWORD_COL_DIRECT_M_S7_S3 FNC_VALUES 1 UWORD COLUMN_DIR DIRECT /end RECORD_LAYOUT
/end MODULE
/end PROJECT
