ASAP2_VERSION 1 51
/begin PROJECT _929_929 "Gen2_BMW_System_Supplier_Lib"
/begin HEADER "" VERSION "C_03_03" PROJECT_NO _929_929 /end HEADER
/begin MODULE DIM ""
/begin MOD_COMMON "" BYTE_ORDER MSB_FIRST ALIGNMENT_BYTE 1 ALIGNMENT_WORD 2 ALIGNMENT_LONG 4 ALIGNMENT_FLOAT32_IEEE 4 /end MOD_COMMON
/begin CHARACTERISTIC NS_SYNISTESP64 "Turbinendifferenzdrehzahlschwelle zur Erkennung Synchron istgang verlassen" VALUE 0x26D9B4 kw_si16_S6_S3 1000 UMR_U_MIN_1_1_0_S6_S3 0 1000 /end CHARACTERISTIC
/begin CHARACTERISTIC KL_TMAXCGSP64 "Maximaldauer Schaltung" CURVE 0x238274 kl_ui16_S6_S3 10000 UMR_MSEC__10_1_0_S6_S3 0 10000
 /begin AXIS_DESCR STD_AXIS zff_atsys._.iSignale._.obj.sig_c_getr UMR_GRADC__1_1_M40_S6_S3 2 -40 150 DEPOSIT ABSOLUTE MONOTONY MON_INCREASE /end AXIS_DESCR
/end CHARACTERISTIC
/begin CHARACTERISTIC T_RAMAXSP64 "Rampe bei Timeout" VALUE 0x26E692 kw_ui8_S6_S3 2540 UMR_MSEC__10_1_0_S6_S3 0 2540 /end CHARACTERISTIC
/begin CHARACTERISTIC NS_VERSIAESP64 "Drehzahlschwelle auf Leerlaufdrehzahl zur Verhinderung der Verschachtelung bei IAE" VALUE 0x26D9B6 kw_si16_S6_S3 8200 UMR_U_MIN_1_1_0_S6_S3 0 8200 /end CHARACTERISTIC
/begin CHARACTERISTIC NGS_VERIAESP64 "Abtriebsdrehzahlgradientenschwelle für ausführen der verschachtelten Schaltung mit IAE" VALUE 0x26D9B8 kw_si16_S6_S3 20000 UMR_U_MINSEC_1_1_0_S6_S3 -10000 10000 /end CHARACTERISTIC
/begin CHARACTERISTIC HYS_NGS_VERIAESP64 "Hysterese für Gradientenschwelle bei IAE" VALUE 0x26D9BA kw_si16_S6_S3 20000 UMR_U_MINSEC_1_1_0_S6_S3 -10000 10000 /end CHARACTERISTIC
/begin CHARACTERISTIC NS_DKIRSSSP64 "DKI Schwelle zum Start der Funktion" VALUE 0x26E693 kw_ui8_S6_S3 100 UMR_PROZENT__20_51_0_S6_S3 0 100 /end CHARACTERISTIC
/begin CHARACTERISTIC KL_TSYNCGRSSSP64 "Start der Sonderfunktion mit Zeit vor/nach Synchron" CURVE 0x238280 kl_si16_S6_S3 6000 UMR_MSEC__10_1_0_S6_S3 -5000 1000
 /begin AXIS_DESCR STD_AXIS zff_atsys._.iSignale._.obj.sig_c_getr UMR_GRADC__1_1_M40_S6_S3 4 -80 150 DEPOSIT ABSOLUTE MONOTONY MON_INCREASE /end AXIS_DESCR
/end CHARACTERISTIC
/begin CHARACTERISTIC KL_MGMOTMAXAUFRSSSP64 "Momentengradient bei Ruecknahme Sonderfunktion, RSS mit formschluessigen Element, Momentenbegrenzung" CURVE 0x238294 kl_si16_S6_S3 25500 UMR_NM_SEC_10_1_0_S6_S3 0 25500
 /begin AXIS_DESCR STD_AXIS iSasZentr.timer_z_m_motmax_rss UMR_MSEC__10_1_0_S6_S3 6 0 2550 DEPOSIT ABSOLUTE MONOTONY MON_INCREASE /end AXIS_DESCR
/end CHARACTERISTIC
/begin CHARACTERISTIC KF_MOMOTMAXNDCGSP64 "Sicherheitsmomenten bei Sonderfunktion Phase 2, RSS mit formschluessigen Element, Momentenbegrenzung" MAP 0x2382B0 kf_si16_S6_S3 1400 UMR_NM__1_1_0_S6_S3 -100 1300
 /begin AXIS_DESCR STD_AXIS iSasZentr.nd_nmot_nt UMR_U_MIN_1_1_0_S6_S3 6 -16320 16320 DEPOSIT ABSOLUTE MONOTONY MON_INCREASE /end AXIS_DESCR
 /begin AXIS_DESCR STD_AXIS zff_atsys._.iSignale._.obj.sig_c_getr UMR_GRADC__1_1_M40_S6_S3 4 -80 150 DEPOSIT ABSOLUTE MONOTONY MON_INCREASE /end AXIS_DESCR
/end CHARACTERISTIC
/begin CHARACTERISTIC KL_MOMOTMAXNDRSSSP64 "Sicherheitsmomentenoffset bei Ruecknahme Sonderfunktion, RSS mit formschluessigen Element, Momentenbegrenzung" CURVE 0x2382FC kl_si16_S6_S3 1000 UMR_NM__1_1_0_S6_S3 0 1000
 /begin AXIS_DESCR STD_AXIS iSasZentr.nd_nmot_nt UMR_U_MIN_1_1_0_S6_S3 6 -16320 16320 DEPOSIT ABSOLUTE MONOTONY MON_INCREASE /end AXIS_DESCR
/end CHARACTERISTIC
/begin CHARACTERISTIC T_RAMOTMAXRSSSP64 "Ueberfuehrung der Momentenbegrenzungen" VALUE 0x26E694 kw_ui8_S6_S3 1000 UMR_MSEC__10_1_0_S6_S3 0 1000 /end CHARACTERISTIC
/begin CHARACTERISTIC KL_TSYNCGNSYNRSSSP64 "Start Phase 2 der Sonderfunktion mit Zeit um Synchron" CURVE 0x238318 kl_si16_S6_S3 6000 UMR_MSEC__10_1_0_S6_S3 -5000 1000
 /begin AXIS_DESCR STD_AXIS zff_atsys._.iSignale._.obj.sig_c_getr UMR_GRADC__1_1_M40_S6_S3 4 -80 150 DEPOSIT ABSOLUTE MONOTONY MON_INCREASE /end AXIS_DESCR
/end CHARACTERISTIC
/begin CHARACTERISTIC ND_NTNMOTRSSSP64 "Ausstieg der Sonderfunktion bei Differenzdrehzahl" VALUE 0x26D9BC kw_si16_S6_S3 6000 UMR___1_1_0_S6_S3 -3000 3000 /end CHARACTERISTIC
/begin CHARACTERISTIC KL_TSYNAUSCGRSSSP64 "Ausstieg der Sonderfunktion mit Zeit vor bzw. nach Synchron" CURVE 0x23832C kl_si16_S6_S3 6000 UMR_MSEC__10_1_0_S6_S3 -5000 1000
 /begin AXIS_DESCR STD_AXIS zff_atsys._.iSignale._.obj.sig_c_getr UMR_GRADC__1_1_M40_S6_S3 4 -80 150 DEPOSIT ABSOLUTE MONOTONY MON_INCREASE /end AXIS_DESCR
/end CHARACTERISTIC
/begin CHARACTERISTIC T_OTSYNKABVSP64 "Rampe bei Timeout" VALUE 0x26E695 kw_ui8_S6_S3 2550 UMR_MSEC__10_1_M255_S6_S3 -2550 0 /end CHARACTERISTIC
/begin CHARACTERISTIC NS_SYNISTESP71 "Turbinendifferenzdrehzahlschwelle zur Erkennung Synchron istgang verlassen" VALUE 0x26D9BE kw_si16_S6_S3 1000 UMR_U_MIN_1_1_0_S6_S3 0 1000 /end CHARACTERISTIC
/begin CHARACTERISTIC KL_TMAXCGSP71 "Maximaldauer Schaltung" CURVE 0x238340 kl_ui16_S6_S3 10000 UMR_MSEC__10_1_0_S6_S3 0 10000
 /begin AXIS_DESCR STD_AXIS zff_atsys._.iSignale._.obj.sig_c_getr UMR_GRADC__1_1_M40_S6_S3 2 -40 150 DEPOSIT ABSOLUTE MONOTONY MON_INCREASE /end AXIS_DESCR
/end CHARACTERISTIC
/begin CHARACTERISTIC T_RAMAXSP71 "Rampe bei Timeout" VALUE 0x26E696 kw_ui8_S6_S3 2540 UMR_MSEC__10_1_0_S6_S3 0 2540 /end CHARACTERISTIC
/begin CHARACTERISTIC NS_VERSIAESP71 "Drehzahlschwelle auf Leerlaufdrehzahl zur Verhinderung der Verschachtelung bei IAE" VALUE 0x26D9C0 kw_si16_S6_S3 8200 UMR_U_MIN_1_1_0_S6_S3 0 8200 /end CHARACTERISTIC
/begin CHARACTERISTIC NGS_VERIAESP71 "Abtriebsdrehzahlgradientenschwelle für ausführen der verschachtelten Schaltung mit IAE" VALUE 0x26D9C2 kw_si16_S6_S3 20000 UMR_U_MINSEC_1_1_0_S6_S3 -10000 10000 /end CHARACTERISTIC
/begin CHARACTERISTIC HYS_NGS_VERIAESP71 "Hysterese für Gradientenschwelle bei IAE" VALUE 0x26D9C4 kw_si16_S6_S3 20000 UMR_U_MINSEC_1_1_0_S6_S3 -10000 10000 /end CHARACTERISTIC
/begin CHARACTERISTIC NS_DKIRSSSP71 "DKI Schwelle zum Start der Funktion" VALUE 0x26E697 kw_ui8_S6_S3 100 UMR_PROZENT__20_51_0_S6_S3 0 100 /end CHARACTERISTIC
/begin CHARACTERISTIC KL_TSYNCGRSSSP71 "Start der Sonderfunktion mit Zeit vor/nach Synchron" CURVE 0x23834C kl_si16_S6_S3 6000 UMR_MSEC__10_1_0_S6_S3 -5000 1000
 /begin AXIS_DESCR STD_AXIS zff_atsys._.iSignale._.obj.sig_c_getr UMR_GRADC__1_1_M40_S6_S3 4 -80 150 DEPOSIT ABSOLUTE MONOTONY MON_INCREASE /end AXIS_DESCR
/end CHARACTERISTIC
/begin CHARACTERISTIC KL_MGMOTMAXAUFRSSSP71 "Momentengradient bei Ruecknahme Sonderfunktion, RSS mit formschluessigen Element, Momentenbegrenzung" CURVE 0x238360 kl_si16_S6_S3 25500 UMR_NM_SEC_10_1_0_S6_S3 0 25500
 /begin AXIS_DESCR STD_AXIS iSasZentr.timer_z_m_motmax_rss UMR_MSEC__10_1_0_S6_S3 6 0 2550 DEPOSIT ABSOLUTE MONOTONY MON_INCREASE /end AXIS_DESCR
/end CHARACTERISTIC
/begin CHARACTERISTIC KF_MOMOTMAXNDCGSP71 "Sicherheitsmomenten bei Sonderfunktion Phase 2, RSS mit formschluessigen Element, Momentenbegrenzung" MAP 0x23837C kf_si16_S6_S3 1400 UMR_NM__1_1_0_S6_S3 -100 1300
 /begin AXIS_DESCR STD_AXIS iSasZentr.nd_nmot_nt UMR_U_MIN_1_1_0_S6_S3 6 -16320 16320 DEPOSIT ABSOLUTE MONOTONY MON_INCREASE /end AXIS_DESCR
 /begin AXIS_DESCR STD_AXIS zff_atsys._.iSignale._.obj.sig_c_getr UMR_GRADC__1_1_M40_S6_S3 4 -80 150 DEPOSIT ABSOLUTE MONOTONY MON_INCREASE /end AXIS_DESCR
/end CHARACTERISTIC
/begin CHARACTERISTIC KL_MOMOTMAXNDRSSSP71 "Sicherheitsmomentenoffset bei Ruecknahme Sonderfunktion, RSS mit formschluessigen Element, Momentenbegrenzung" CURVE 0x2383C8 kl_si16_S6_S3 1000 UMR_NM__1_1_0_S6_S3 0 1000
 /begin AXIS_DESCR STD_AXIS iSasZentr.nd_nmot_nt UMR_U_MIN_1_1_0_S6_S3 6 -16320 16320 DEPOSIT ABSOLUTE MONOTONY MON_INCREASE /end AXIS_DESCR
/end CHARACTERISTIC
/begin CHARACTERISTIC T_RAMOTMAXRSSSP71 "Ueberfuehrung der Momentenbegrenzungen" VALUE 0x26E698 kw_ui8_S6_S3 1000 UMR_MSEC__10_1_0_S6_S3 0 1000 /end CHARACTERISTIC
/begin CHARACTERISTIC KL_TSYNCGNSYNRSSSP71 "Start Phase 2 der Sonderfunktion mit Zeit um Synchron" CURVE 0x2383E4 kl_si16_S6_S3 6000 UMR_MSEC__10_1_0_S6_S3 -5000 1000
 /begin AXIS_DESCR STD_AXIS zff_atsys._.iSignale._.obj.sig_c_getr UMR_GRADC__1_1_M40_S6_S3 4 -80 150 DEPOSIT ABSOLUTE MONOTONY MON_INCREASE /end AXIS_DESCR
/end CHARACTERISTIC
/begin CHARACTERISTIC ND_NTNMOTRSSSP71 "Ausstieg der Sonderfunktion bei Differenzdrehzahl" VALUE 0x26D9C6 kw_si16_S6_S3 6000 UMR___1_1_0_S6_S3 -3000 3000 /end CHARACTERISTIC
/begin CHARACTERISTIC KL_TSYNAUSCGRSSSP71 "Ausstieg der Sonderfunktion mit Zeit vor bzw. nach Synchron" CURVE 0x2383F8 kl_si16_S6_S3 6000 UMR_MSEC__10_1_0_S6_S3 -5000 1000
 /begin AXIS_DESCR STD_AXIS zff_atsys._.iSignale._.obj.sig_c_getr UMR_GRADC__1_1_M40_S6_S3 4 -80 150 DEPOSIT ABSOLUTE MONOTONY MON_INCREASE /end AXIS_DESCR
/end CHARACTERISTIC
/begin CHARACTERISTIC T_OTSYNKABVSP71 "Rampe bei Timeout" VALUE 0x26E699 kw_ui8_S6_S3 2550 UMR_MSEC__10_1_M255_S6_S3 -2550 0 /end CHARACTERISTIC
/begin CHARACTERISTIC NS_SYNISTESP75 "Turbinendifferenzdrehzahlschwelle zur Erkennung Synchron istgang verlassen" VALUE 0x26D9C8 kw_si16_S6_S3 1000 UMR_U_MIN_1_1_0_S6_S3 0 1000 /end CHARACTERISTIC
/begin CHARACTERISTIC KL_TMAXCGSP75 "Maximaldauer Schaltung" CURVE 0x23840C kl_ui16_S6_S3 10000 UMR_MSEC__10_1_0_S6_S3 0 10000
 /begin AXIS_DESCR STD_AXIS zff_atsys._.iSignale._.obj.sig_c_getr UMR_GRADC__1_1_M40_S6_S3 2 -40 150 DEPOSIT ABSOLUTE MONOTONY MON_INCREASE /end AXIS_DESCR
/end CHARACTERISTIC
/begin CHARACTERISTIC T_RAMAXSP75 "Rampe bei Timeout" VALUE 0x26E69A kw_ui8_S6_S3 2540 UMR_MSEC__10_1_0_S6_S3 0 2540 /end CHARACTERISTIC
/begin CHARACTERISTIC NS_VERSIAESP75 "Drehzahlschwelle auf Leerlaufdrehzahl zur Verhinderung der Verschachtelung bei IAE" VALUE 0x26D9CA kw_si16_S6_S3 8200 UMR_U_MIN_1_1_0_S6_S3 0 8200 /end CHARACTERISTIC
/begin CHARACTERISTIC NGS_VERIAESP75 "Abtriebsdrehzahlgradientenschwelle für ausführen der verschachtelten Schaltung mit IAE" VALUE 0x26D9CC kw_si16_S6_S3 20000 UMR_U_MINSEC_1_1_0_S6_S3 -10000 10000 /end CHARACTERISTIC
/begin CHARACTERISTIC HYS_NGS_VERIAESP75 "Hysterese für Gradientenschwelle bei IAE" VALUE 0x26D9CE kw_si16_S6_S3 20000 UMR_U_MINSEC_1_1_0_S6_S3 -10000 10000 /end CHARACTERISTIC
/begin CHARACTERISTIC NS_DKIRSSSP75 "DKI Schwelle zum Start der Funktion" VALUE 0x26E69B kw_ui8_S6_S3 100 UMR_PROZENT__20_51_0_S6_S3 0 100 /end CHARACTERISTIC
/begin CHARACTERISTIC KL_TSYNCGRSSSP75 "Start der Sonderfunktion mit Zeit vor/nach Synchron" CURVE 0x238418 kl_si16_S6_S3 6000 UMR_MSEC__10_1_0_S6_S3 -5000 1000
 /begin AXIS_DESCR STD_AXIS zff_atsys._.iSignale._.obj.sig_c_getr UMR_GRADC__1_1_M40_S6_S3 4 -80 150 DEPOSIT ABSOLUTE MONOTONY MON_INCREASE /end AXIS_DESCR
/end CHARACTERISTIC
/begin CHARACTERISTIC KL_MGMOTMAXAUFRSSSP75 "Momentengradient bei Ruecknahme Sonderfunktion, RSS mit formschluessigen Element, Momentenbegrenzung" CURVE 0x23842C kl_si16_S6_S3 25500 UMR_NM_SEC_10_1_0_S6_S3 0 25500
 /begin AXIS_DESCR STD_AXIS iSasZentr.timer_z_m_motmax_rss UMR_MSEC__10_1_0_S6_S3 6 0 2550 DEPOSIT ABSOLUTE MONOTONY MON_INCREASE /end AXIS_DESCR
/end CHARACTERISTIC
/begin CHARACTERISTIC KF_MOMOTMAXNDCGSP75 "Sicherheitsmomenten bei Sonderfunktion Phase 2, RSS mit formschluessigen Element, Momentenbegrenzung" MAP 0x238448 kf_si16_S6_S3 1400 UMR_NM__1_1_0_S6_S3 -100 1300
 /begin AXIS_DESCR STD_AXIS iSasZentr.nd_nmot_nt UMR_U_MIN_1_1_0_S6_S3 6 -16320 16320 DEPOSIT ABSOLUTE MONOTONY MON_INCREASE /end AXIS_DESCR
 /begin AXIS_DESCR STD_AXIS zff_atsys._.iSignale._.obj.sig_c_getr UMR_GRADC__1_1_M40_S6_S3 4 -80 150 DEPOSIT ABSOLUTE MONOTONY MON_INCREASE /end AXIS_DESCR
/end CHARACTERISTIC
/begin CHARACTERISTIC KL_MOMOTMAXNDRSSSP75 "Sicherheitsmomentenoffset bei Ruecknahme Sonderfunktion, RSS mit formschluessigen Element, Momentenbegrenzung" CURVE 0x238494 kl_si16_S6_S3 1000 UMR_NM__1_1_0_S6_S3 0 1000
 /begin AXIS_DESCR STD_AXIS iSasZentr.nd_nmot_nt UMR_U_MIN_1_1_0_S6_S3 6 -16320 16320 DEPOSIT ABSOLUTE MONOTONY MON_INCREASE /end AXIS_DESCR
/end CHARACTERISTIC
/begin CHARACTERISTIC T_RAMOTMAXRSSSP75 "Ueberfuehrung der Momentenbegrenzungen" VALUE 0x26E69C kw_ui8_S6_S3 1000 UMR_MSEC__10_1_0_S6_S3 0 1000 /end CHARACTERISTIC
/begin CHARACTERISTIC KL_TSYNCGNSYNRSSSP75 "Start Phase 2 der Sonderfunktion mit Zeit um Synchron" CURVE 0x2384B0 kl_si16_S6_S3 6000 UMR_MSEC__10_1_0_S6_S3 -5000 1000
 /begin AXIS_DESCR STD_AXIS zff_atsys._.iSignale._.obj.sig_c_getr UMR_GRADC__1_1_M40_S6_S3 4 -80 150 DEPOSIT ABSOLUTE MONOTONY MON_INCREASE /end AXIS_DESCR
/end CHARACTERISTIC
/begin CHARACTERISTIC ND_NTNMOTRSSSP75 "Ausstieg der Sonderfunktion bei Differenzdrehzahl" VALUE 0x26D9D0 kw_si16_S6_S3 6000 UMR___1_1_0_S6_S3 -3000 3000 /end CHARACTERISTIC
/begin CHARACTERISTIC KL_TSYNAUSCGRSSSP75 "Ausstieg der Sonderfunktion mit Zeit vor bzw. nach Synchron" CURVE 0x2384C4 kl_si16_S6_S3 6000 UMR_MSEC__10_1_0_S6_S3 -5000 1000
 /begin AXIS_DESCR STD_AXIS zff_atsys._.iSignale._.obj.sig_c_getr UMR_GRADC__1_1_M40_S6_S3 4 -80 150 DEPOSIT ABSOLUTE MONOTONY MON_INCREASE /end AXIS_DESCR
/end CHARACTERISTIC
/begin CHARACTERISTIC T_OTSYNKABVSP75 "Rampe bei Timeout" VALUE 0x26E69D kw_ui8_S6_S3 2550 UMR_MSEC__10_1_M255_S6_S3 -2550 0 /end CHARACTERISTIC
/begin CHARACTERISTIC NS_SYNISTESP82 "Turbinendifferenzdrehzahlschwelle zur Erkennung Synchron istgang verlassen" VALUE 0x26D9D2 kw_si16_S6_S3 1000 UMR_U_MIN_1_1_0_S6_S3 0 1000 /end CHARACTERISTIC
/begin CHARACTERISTIC KL_TMAXCGSP82 "Maximaldauer Schaltung" CURVE 0x2384D8 kl_ui16_S6_S3 10000 UMR_MSEC__10_1_0_S6_S3 0 10000
 /begin AXIS_DESCR STD_AXIS zff_atsys._.iSignale._.obj.sig_c_getr UMR_GRADC__1_1_M40_S6_S3 2 -40 150 DEPOSIT ABSOLUTE MONOTONY MON_INCREASE /end AXIS_DESCR
/end CHARACTERISTIC
/begin CHARACTERISTIC T_RAMAXSP82 "Rampe bei Timeout" VALUE 0x26E69E kw_ui8_S6_S3 2540 UMR_MSEC__10_1_0_S6_S3 0 2540 /end CHARACTERISTIC
/begin CHARACTERISTIC NS_VERSIAESP82 "Drehzahlschwelle auf Leerlaufdrehzahl zur Verhinderung der Verschachtelung bei IAE" VALUE 0x26D9D4 kw_si16_S6_S3 8200 UMR_U_MIN_1_1_0_S6_S3 0 8200 /end CHARACTERISTIC
/begin CHARACTERISTIC NGS_VERIAESP82 "Abtriebsdrehzahlgradientenschwelle für ausführen der verschachtelten Schaltung mit IAE" VALUE 0x26D9D6 kw_si16_S6_S3 20000 UMR_U_MINSEC_1_1_0_S6_S3 -10000 10000 /end CHARACTERISTIC
/begin CHARACTERISTIC HYS_NGS_VERIAESP82 "Hysterese für Gradientenschwelle bei IAE" VALUE 0x26D9D8 kw_si16_S6_S3 20000 UMR_U_MINSEC_1_1_0_S6_S3 -10000 10000 /end CHARACTERISTIC
/begin CHARACTERISTIC NS_DKIRSSSP82 "DKI Schwelle zum Start der Funktion" VALUE 0x26E69F kw_ui8_S6_S3 100 UMR_PROZENT__20_51_0_S6_S3 0 100 /end CHARACTERISTIC
/begin CHARACTERISTIC KL_TSYNCGRSSSP82 "Start der Sonderfunktion mit Zeit vor/nach Synchron" CURVE 0x2384E4 kl_si16_S6_S3 6000 UMR_MSEC__10_1_0_S6_S3 -5000 1000
 /begin AXIS_DESCR STD_AXIS zff_atsys._.iSignale._.obj.sig_c_getr UMR_GRADC__1_1_M40_S6_S3 4 -80 150 DEPOSIT ABSOLUTE MONOTONY MON_INCREASE /end AXIS_DESCR
/end CHARACTERISTIC
/begin CHARACTERISTIC KL_MGMOTMAXAUFRSSSP82 "Momentengradient bei Ruecknahme Sonderfunktion, RSS mit formschluessigen Element, Momentenbegrenzung" CURVE 0x2384F8 kl_si16_S6_S3 25500 UMR_NM_SEC_10_1_0_S6_S3 0 25500
 /begin AXIS_DESCR STD_AXIS iSasZentr.timer_z_m_motmax_rss UMR_MSEC__10_1_0_S6_S3 6 0 2550 DEPOSIT ABSOLUTE MONOTONY MON_INCREASE /end AXIS_DESCR
/end CHARACTERISTIC
/begin CHARACTERISTIC KF_MOMOTMAXNDCGSP82 "Sicherheitsmomenten bei Sonderfunktion Phase 2, RSS mit formschluessigen Element, Momentenbegrenzung" MAP 0x238514 kf_si16_S6_S3 1400 UMR_NM__1_1_0_S6_S3 -100 1300
 /begin AXIS_DESCR STD_AXIS iSasZentr.nd_nmot_nt UMR_U_MIN_1_1_0_S6_S3 6 -16320 16320 DEPOSIT ABSOLUTE MONOTONY MON_INCREASE /end AXIS_DESCR
 /begin AXIS_DESCR STD_AXIS zff_atsys._.iSignale._.obj.sig_c_getr UMR_GRADC__1_1_M40_S6_S3 4 -80 150 DEPOSIT ABSOLUTE MONOTONY MON_INCREASE /end AXIS_DESCR
/end CHARACTERISTIC
/begin CHARACTERISTIC KL_MOMOTMAXNDRSSSP82 "Sicherheitsmomentenoffset bei Ruecknahme Sonderfunktion, RSS mit formschluessigen Element, Momentenbegrenzung" CURVE 0x238560 kl_si16_S6_S3 1000 UMR_NM__1_1_0_S6_S3 0 1000
 /begin AXIS_DESCR STD_AXIS iSasZentr.nd_nmot_nt UMR_U_MIN_1_1_0_S6_S3 6 -16320 16320 DEPOSIT ABSOLUTE MONOTONY MON_INCREASE /end AXIS_DESCR
/end CHARACTERISTIC
/begin CHARACTERISTIC T_RAMOTMAXRSSSP82 "Ueberfuehrung der Momentenbegrenzungen" VALUE 0x26E6A0 kw_ui8_S6_S3 1000 UMR_MSEC__10_1_0_S6_S3 0 1000 /end CHARACTERISTIC
/begin CHARACTERISTIC KL_TSYNCGNSYNRSSSP82 "Start Phase 2 der Sonderfunktion mit Zeit um Synchron" CURVE 0x23857C kl_si16_S6_S3 6000 UMR_MSEC__10_1_0_S6_S3 -5000 1000
 /begin AXIS_DESCR STD_AXIS zff_atsys._.iSignale._.obj.sig_c_getr UMR_GRADC__1_1_M40_S6_S3 4 -80 150 DEPOSIT ABSOLUTE MONOTONY MON_INCREASE /end AXIS_DESCR
/end CHARACTERISTIC
/begin CHARACTERISTIC ND_NTNMOTRSSSP82 "Ausstieg der Sonderfunktion bei Differenzdrehzahl" VALUE 0x26D9DA kw_si16_S6_S3 6000 UMR___1_1_0_S6_S3 -3000 3000 /end CHARACTERISTIC
/begin CHARACTERISTIC KL_TSYNAUSCGRSSSP82 "Ausstieg der Sonderfunktion mit Zeit vor bzw. nach Synchron" CURVE 0x238590 kl_si16_S6_S3 6000 UMR_MSEC__10_1_0_S6_S3 -5000 1000
 /begin AXIS_DESCR STD_AXIS zff_atsys._.iSignale._.obj.sig_c_getr UMR_GRADC__1_1_M40_S6_S3 4 -80 150 DEPOSIT ABSOLUTE MONOTONY MON_INCREASE /end AXIS_DESCR
/end CHARACTERISTIC
/begin CHARACTERISTIC T_OTSYNKABVSP82 "Rampe bei Timeout" VALUE 0x26E6A1 kw_ui8_S6_S3 2550 UMR_MSEC__10_1_M255_S6_S3 -2550 0 /end CHARACTERISTIC
/begin CHARACTERISTIC NS_SYNISTESP84 "Turbinendifferenzdrehzahlschwelle zur Erkennung Synchron istgang verlassen" VALUE 0x26D9DC kw_si16_S6_S3 1000 UMR_U_MIN_1_1_0_S6_S3 0 1000 /end CHARACTERISTIC
/begin CHARACTERISTIC KL_TMAXCGSP84 "Maximaldauer Schaltung" CURVE 0x2385A4 kl_ui16_S6_S3 10000 UMR_MSEC__10_1_0_S6_S3 0 10000
 /begin AXIS_DESCR STD_AXIS zff_atsys._.iSignale._.obj.sig_c_getr UMR_GRADC__1_1_M40_S6_S3 2 -40 150 DEPOSIT ABSOLUTE MONOTONY MON_INCREASE /end AXIS_DESCR
/end CHARACTERISTIC
/begin CHARACTERISTIC T_RAMAXSP84 "Rampe bei Timeout" VALUE 0x26E6A2 kw_ui8_S6_S3 2540 UMR_MSEC__10_1_0_S6_S3 0 2540 /end CHARACTERISTIC
/begin CHARACTERISTIC NS_VERSIAESP84 "Drehzahlschwelle auf Leerlaufdrehzahl zur Verhinderung der Verschachtelung bei IAE" VALUE 0x26D9DE kw_si16_S6_S3 8200 UMR_U_MIN_1_1_0_S6_S3 0 8200 /end CHARACTERISTIC
/begin CHARACTERISTIC NGS_VERIAESP84 "Abtriebsdrehzahlgradientenschwelle für ausführen der verschachtelten Schaltung mit IAE" VALUE 0x26D9E0 kw_si16_S6_S3 20000 UMR_U_MINSEC_1_1_0_S6_S3 -10000 10000 /end CHARACTERISTIC
/begin CHARACTERISTIC HYS_NGS_VERIAESP84 "Hysterese für Gradientenschwelle bei IAE" VALUE 0x26D9E2 kw_si16_S6_S3 20000 UMR_U_MINSEC_1_1_0_S6_S3 -10000 10000 /end CHARACTERISTIC
/begin CHARACTERISTIC NS_DKIRSSSP84 "DKI Schwelle zum Start der Funktion" VALUE 0x26E6A3 kw_ui8_S6_S3 100 UMR_PROZENT__20_51_0_S6_S3 0 100 /end CHARACTERISTIC
/begin CHARACTERISTIC KL_TSYNCGRSSSP84 "Start der Sonderfunktion mit Zeit vor/nach Synchron" CURVE 0x2385B0 kl_si16_S6_S3 6000 UMR_MSEC__10_1_0_S6_S3 -5000 1000
 /begin AXIS_DESCR STD_AXIS zff_atsys._.iSignale._.obj.sig_c_getr UMR_GRADC__1_1_M40_S6_S3 4 -80 150 DEPOSIT ABSOLUTE MONOTONY MON_INCREASE /end AXIS_DESCR
/end CHARACTERISTIC
/begin CHARACTERISTIC KL_MGMOTMAXAUFRSSSP84 "Momentengradient bei Ruecknahme Sonderfunktion, RSS mit formschluessigen Element, Momentenbegrenzung" CURVE 0x2385C4 kl_si16_S6_S3 25500 UMR_NM_SEC_10_1_0_S6_S3 0 25500
 /begin AXIS_DESCR STD_AXIS iSasZentr.timer_z_m_motmax_rss UMR_MSEC__10_1_0_S6_S3 6 0 2550 DEPOSIT ABSOLUTE MONOTONY MON_INCREASE /end AXIS_DESCR
/end CHARACTERISTIC
/begin CHARACTERISTIC KF_MOMOTMAXNDCGSP84 "Sicherheitsmomenten bei Sonderfunktion Phase 2, RSS mit formschluessigen Element, Momentenbegrenzung" MAP 0x2385E0 kf_si16_S6_S3 1400 UMR_NM__1_1_0_S6_S3 -100 1300
 /begin AXIS_DESCR STD_AXIS iSasZentr.nd_nmot_nt UMR_U_MIN_1_1_0_S6_S3 6 -16320 16320 DEPOSIT ABSOLUTE MONOTONY MON_INCREASE /end AXIS_DESCR
 /begin AXIS_DESCR STD_AXIS zff_atsys._.iSignale._.obj.sig_c_getr UMR_GRADC__1_1_M40_S6_S3 4 -80 150 DEPOSIT ABSOLUTE MONOTONY MON_INCREASE /end AXIS_DESCR
/end CHARACTERISTIC
/begin CHARACTERISTIC KL_MOMOTMAXNDRSSSP84 "Sicherheitsmomentenoffset bei Ruecknahme Sonderfunktion, RSS mit formschluessigen Element, Momentenbegrenzung" CURVE 0x23862C kl_si16_S6_S3 1000 UMR_NM__1_1_0_S6_S3 0 1000
 /begin AXIS_DESCR STD_AXIS iSasZentr.nd_nmot_nt UMR_U_MIN_1_1_0_S6_S3 6 -16320 16320 DEPOSIT ABSOLUTE MONOTONY MON_INCREASE /end AXIS_DESCR
/end CHARACTERISTIC
/begin CHARACTERISTIC T_RAMOTMAXRSSSP84 "Ueberfuehrung der Momentenbegrenzungen" VALUE 0x26E6A4 kw_ui8_S6_S3 1000 UMR_MSEC__10_1_0_S6_S3 0 1000 /end CHARACTERISTIC
/begin CHARACTERISTIC KL_TSYNCGNSYNRSSSP84 "Start Phase 2 der Sonderfunktion mit Zeit um Synchron" CURVE 0x238648 kl_si16_S6_S3 6000 UMR_MSEC__10_1_0_S6_S3 -5000 1000
 /begin AXIS_DESCR STD_AXIS zff_atsys._.iSignale._.obj.sig_c_getr UMR_GRADC__1_1_M40_S6_S3 4 -80 150 DEPOSIT ABSOLUTE MONOTONY MON_INCREASE /end AXIS_DESCR
/end CHARACTERISTIC
/begin CHARACTERISTIC ND_NTNMOTRSSSP84 "Ausstieg der Sonderfunktion bei Differenzdrehzahl" VALUE 0x26D9E4 kw_si16_S6_S3 6000 UMR___1_1_0_S6_S3 -3000 3000 /end CHARACTERISTIC
/begin CHARACTERISTIC KL_TSYNAUSCGRSSSP84 "Ausstieg der Sonderfunktion mit Zeit vor bzw. nach Synchron" CURVE 0x23865C kl_si16_S6_S3 6000 UMR_MSEC__10_1_0_S6_S3 -5000 1000
 /begin AXIS_DESCR STD_AXIS zff_atsys._.iSignale._.obj.sig_c_getr UMR_GRADC__1_1_M40_S6_S3 4 -80 150 DEPOSIT ABSOLUTE MONOTONY MON_INCREASE /end AXIS_DESCR
/end CHARACTERISTIC
/begin CHARACTERISTIC T_OTSYNKABVSP84 "Rampe bei Timeout" VALUE 0x26E6A5 kw_ui8_S6_S3 2550 UMR_MSEC__10_1_M255_S6_S3 -2550 0 /end CHARACTERISTIC
/begin CHARACTERISTIC NS_SYNISTESP86 "Turbinendifferenzdrehzahlschwelle zur Erkennung Synchron istgang verlassen" VALUE 0x26D9E6 kw_si16_S6_S3 1000 UMR_U_MIN_1_1_0_S6_S3 0 1000 /end CHARACTERISTIC
/begin CHARACTERISTIC KL_TMAXCGSP86 "Maximaldauer Schaltung" CURVE 0x238670 kl_ui16_S6_S3 10000 UMR_MSEC__10_1_0_S6_S3 0 10000
 /begin AXIS_DESCR STD_AXIS zff_atsys._.iSignale._.obj.sig_c_getr UMR_GRADC__1_1_M40_S6_S3 2 -40 150 DEPOSIT ABSOLUTE MONOTONY MON_INCREASE /end AXIS_DESCR
/end CHARACTERISTIC
/begin CHARACTERISTIC T_RAMAXSP86 "Rampe bei Timeout" VALUE 0x26E6A6 kw_ui8_S6_S3 2540 UMR_MSEC__10_1_0_S6_S3 0 2540 /end CHARACTERISTIC
/begin CHARACTERISTIC NS_VERSIAESP86 "Drehzahlschwelle auf Leerlaufdrehzahl zur Verhinderung der Verschachtelung bei IAE" VALUE 0x26D9E8 kw_si16_S6_S3 8200 UMR_U_MIN_1_1_0_S6_S3 0 8200 /end CHARACTERISTIC
/begin CHARACTERISTIC NGS_VERIAESP86 "Abtriebsdrehzahlgradientenschwelle für ausführen der verschachtelten Schaltung mit IAE" VALUE 0x26D9EA kw_si16_S6_S3 20000 UMR_U_MINSEC_1_1_0_S6_S3 -10000 10000 /end CHARACTERISTIC
/begin CHARACTERISTIC HYS_NGS_VERIAESP86 "Hysterese für Gradientenschwelle bei IAE" VALUE 0x26D9EC kw_si16_S6_S3 20000 UMR_U_MINSEC_1_1_0_S6_S3 -10000 10000 /end CHARACTERISTIC
/begin CHARACTERISTIC NS_DKIRSSSP86 "DKI Schwelle zum Start der Funktion" VALUE 0x26E6A7 kw_ui8_S6_S3 100 UMR_PROZENT__20_51_0_S6_S3 0 100 /end CHARACTERISTIC
/begin CHARACTERISTIC KL_TSYNCGRSSSP86 "Start der Sonderfunktion mit Zeit vor/nach Synchron" CURVE 0x23867C kl_si16_S6_S3 6000 UMR_MSEC__10_1_0_S6_S3 -5000 1000
 /begin AXIS_DESCR STD_AXIS zff_atsys._.iSignale._.obj.sig_c_getr UMR_GRADC__1_1_M40_S6_S3 4 -80 150 DEPOSIT ABSOLUTE MONOTONY MON_INCREASE /end AXIS_DESCR
/end CHARACTERISTIC
/begin CHARACTERISTIC KL_MGMOTMAXAUFRSSSP86 "Momentengradient bei Ruecknahme Sonderfunktion, RSS mit formschluessigen Element, Momentenbegrenzung" CURVE 0x238690 kl_si16_S6_S3 25500 UMR_NM_SEC_10_1_0_S6_S3 0 25500
 /begin AXIS_DESCR STD_AXIS iSasZentr.timer_z_m_motmax_rss UMR_MSEC__10_1_0_S6_S3 6 0 2550 DEPOSIT ABSOLUTE MONOTONY MON_INCREASE /end AXIS_DESCR
/end CHARACTERISTIC
/begin CHARACTERISTIC KF_MOMOTMAXNDCGSP86 "Sicherheitsmomenten bei Sonderfunktion Phase 2, RSS mit formschluessigen Element, Momentenbegrenzung" MAP 0x2386AC kf_si16_S6_S3 1400 UMR_NM__1_1_0_S6_S3 -100 1300
 /begin AXIS_DESCR STD_AXIS iSasZentr.nd_nmot_nt UMR_U_MIN_1_1_0_S6_S3 6 -16320 16320 DEPOSIT ABSOLUTE MONOTONY MON_INCREASE /end AXIS_DESCR
 /begin AXIS_DESCR STD_AXIS zff_atsys._.iSignale._.obj.sig_c_getr UMR_GRADC__1_1_M40_S6_S3 4 -80 150 DEPOSIT ABSOLUTE MONOTONY MON_INCREASE /end AXIS_DESCR
/end CHARACTERISTIC
/begin CHARACTERISTIC KL_MOMOTMAXNDRSSSP86 "Sicherheitsmomentenoffset bei Ruecknahme Sonderfunktion, RSS mit formschluessigen Element, Momentenbegrenzung" CURVE 0x2386F8 kl_si16_S6_S3 1000 UMR_NM__1_1_0_S6_S3 0 1000
 /begin AXIS_DESCR STD_AXIS iSasZentr.nd_nmot_nt UMR_U_MIN_1_1_0_S6_S3 6 -16320 16320 DEPOSIT ABSOLUTE MONOTONY MON_INCREASE /end AXIS_DESCR
/end CHARACTERISTIC
/begin CHARACTERISTIC T_RAMOTMAXRSSSP86 "Ueberfuehrung der Momentenbegrenzungen" VALUE 0x26E6A8 kw_ui8_S6_S3 1000 UMR_MSEC__10_1_0_S6_S3 0 1000 /end CHARACTERISTIC
/begin CHARACTERISTIC KL_TSYNCGNSYNRSSSP86 "Start Phase 2 der Sonderfunktion mit Zeit um Synchron" CURVE 0x238714 kl_si16_S6_S3 6000 UMR_MSEC__10_1_0_S6_S3 -5000 1000
 /begin AXIS_DESCR STD_AXIS zff_atsys._.iSignale._.obj.sig_c_getr UMR_GRADC__1_1_M40_S6_S3 4 -80 150 DEPOSIT ABSOLUTE MONOTONY MON_INCREASE /end AXIS_DESCR
/end CHARACTERISTIC
/begin CHARACTERISTIC ND_NTNMOTRSSSP86 "Ausstieg der Sonderfunktion bei Differenzdrehzahl" VALUE 0x26D9EE kw_si16_S6_S3 6000 UMR___1_1_0_S6_S3 -3000 3000 /end CHARACTERISTIC
/begin CHARACTERISTIC KL_TSYNAUSCGRSSSP86 "Ausstieg der Sonderfunktion mit Zeit vor bzw. nach Synchron" CURVE 0x238728 kl_si16_S6_S3 6000 UMR_MSEC__10_1_0_S6_S3 -5000 1000
 /begin AXIS_DESCR STD_AXIS zff_atsys._.iSignale._.obj.sig_c_getr UMR_GRADC__1_1_M40_S6_S3 4 -80 150 DEPOSIT ABSOLUTE MONOTONY MON_INCREASE /end AXIS_DESCR
/end CHARACTERISTIC
/begin CHARACTERISTIC T_OTSYNKABVSP86 "Rampe bei Timeout" VALUE 0x26E6A9 kw_ui8_S6_S3 2550 UMR_MSEC__10_1_M255_S6_S3 -2550 0 /end CHARACTERISTIC
/begin CHARACTERISTIC KF_POGANDNMOTNTV2_R "Druckoffset f(n_mot-n_t, timer) 2. NKL Gangauslegen" MAP 0x23EBB0 kf_si16_S6_S3 12.75 UMR_BAR__1_1000_0_S6_S3 -6.4 6.35
 /begin AXIS_DESCR STD_AXIS iSasZentr.nd_nmot_nt UMR_U_MIN_1_1_0_S6_S3 4 -16320 16320 DEPOSIT ABSOLUTE MONOTONY MON_INCREASE /end AXIS_DESCR
 /begin AXIS_DESCR STD_AXIS NO_INPUT_QUANTITY UMR_MSEC__10_1_0_S6_S3 4 0 2540 DEPOSIT ABSOLUTE MONOTONY MON_INCREASE /end AXIS_DESCR
/end CHARACTERISTIC
/begin CHARACTERISTIC KF_PRAGACGV2_R "Druckkennfeld abschaltende Kupplung 2. NKL Gangauslegen" MAP 0x23EBE8 kf_si16_S6_S3 12.75 UMR_BAR__1_1000_0_S6_S3 0 12.75
 /begin AXIS_DESCR STD_AXIS zff_atsys._.iSignale._.obj.sig_c_getr UMR_GRADC__1_1_M40_S6_S3 5 -40 150 DEPOSIT ABSOLUTE MONOTONY MON_INCREASE /end AXIS_DESCR
 /begin AXIS_DESCR STD_AXIS NO_INPUT_QUANTITY UMR_MSEC__10_1_0_S6_S3 5 0 2540 DEPOSIT ABSOLUTE MONOTONY MON_INCREASE /end AXIS_DESCR
/end CHARACTERISTIC
/begin CHARACTERISTIC KF_POGANDNMOTNT_R "Druckoffset f(n_mot-n_t, timer) Gangauslegen" MAP 0x23EC38 kf_si16_S6_S3 12.75 UMR_BAR__1_1000_0_S6_S3 -6.4 6.35
 /begin AXIS_DESCR STD_AXIS iSasZentr.nd_nmot_nt UMR_U_MIN_1_1_0_S6_S3 4 -16320 16320 DEPOSIT ABSOLUTE MONOTONY MON_INCREASE /end AXIS_DESCR
 /begin AXIS_DESCR STD_AXIS NO_INPUT_QUANTITY UMR_MSEC__10_1_0_S6_S3 4 0 2540 DEPOSIT ABSOLUTE MONOTONY MON_INCREASE /end AXIS_DESCR
/end CHARACTERISTIC
/begin CHARACTERISTIC KF_PRAGACG_R "Druckkennfeld abschaltende Kupplung Gangauslegen" MAP 0x23EC70 kf_si16_S6_S3 12.75 UMR_BAR__1_1000_0_S6_S3 -6.4 6.35
 /begin AXIS_DESCR STD_AXIS zff_atsys._.iSignale._.obj.sig_c_getr UMR_GRADC__1_1_M40_S6_S3 8 -40 150 DEPOSIT ABSOLUTE MONOTONY MON_INCREASE /end AXIS_DESCR
 /begin AXIS_DESCR STD_AXIS NO_INPUT_QUANTITY UMR_MSEC__10_1_0_S6_S3 6 0 2540 DEPOSIT ABSOLUTE MONOTONY MON_INCREASE /end AXIS_DESCR
/end CHARACTERISTIC
/begin CHARACTERISTIC KL_FCGPOGA_R "Druckoffset Faktor Gangauslegen" CURVE 0x23ECF4 kl_ui8_S6_S3 1 UMR___1_100_0_S6_S3 0 1
 /begin AXIS_DESCR STD_AXIS zff_atsys._.iSignale._.obj.sig_c_getr UMR_GRADC__1_1_M40_S6_S3 6 -40 215 DEPOSIT ABSOLUTE MONOTONY MON_INCREASE /end AXIS_DESCR
/end CHARACTERISTIC
/begin CHARACTERISTIC KF_POGANDNMOTNTV2_1 "Druckoffset f(n_mot-n_t, timer) 2. NKL Gangauslegen" MAP 0x23ED04 kf_si16_S6_S3 12.75 UMR_BAR__1_1000_0_S6_S3 -6.4 6.35
 /begin AXIS_DESCR STD_AXIS iSasZentr.nd_nmot_nt UMR_U_MIN_1_1_0_S6_S3 4 -16320 16320 DEPOSIT ABSOLUTE MONOTONY MON_INCREASE /end AXIS_DESCR
 /begin AXIS_DESCR STD_AXIS NO_INPUT_QUANTITY UMR_MSEC__10_1_0_S6_S3 4 0 2540 DEPOSIT ABSOLUTE MONOTONY MON_INCREASE /end AXIS_DESCR
/end CHARACTERISTIC
/begin CHARACTERISTIC KF_PRAGACGV2_1 "Druckkennfeld abschaltende Kupplung 2. NKL Gangauslegen" MAP 0x23ED3C kf_si16_S6_S3 12.75 UMR_BAR__1_1000_0_S6_S3 0 12.75
 /begin AXIS_DESCR STD_AXIS zff_atsys._.iSignale._.obj.sig_c_getr UMR_GRADC__1_1_M40_S6_S3 5 -40 150 DEPOSIT ABSOLUTE MONOTONY MON_INCREASE /end AXIS_DESCR
 /begin AXIS_DESCR STD_AXIS NO_INPUT_QUANTITY UMR_MSEC__10_1_0_S6_S3 5 0 2540 DEPOSIT ABSOLUTE MONOTONY MON_INCREASE /end AXIS_DESCR
/end CHARACTERISTIC
/begin CHARACTERISTIC KF_POGANDNMOTNT_1 "Druckoffset f(n_mot-n_t, timer) Gangauslegen" MAP 0x23ED8C kf_si16_S6_S3 12.75 UMR_BAR__1_1000_0_S6_S3 -6.4 6.35
 /begin AXIS_DESCR STD_AXIS iSasZentr.nd_nmot_nt UMR_U_MIN_1_1_0_S6_S3 4 -16320 16320 DEPOSIT ABSOLUTE MONOTONY MON_INCREASE /end AXIS_DESCR
 /begin AXIS_DESCR STD_AXIS NO_INPUT_QUANTITY UMR_MSEC__10_1_0_S6_S3 4 0 2540 DEPOSIT ABSOLUTE MONOTONY MON_INCREASE /end AXIS_DESCR
/end CHARACTERISTIC
/begin CHARACTERISTIC KF_PRAGACG_1 "Druckkennfeld abschaltende Kupplung Gangauslegen" MAP 0x23EDC4 kf_si16_S6_S3 12.75 UMR_BAR__1_1000_0_S6_S3 -6.4 6.35
 /begin AXIS_DESCR STD_AXIS zff_atsys._.iSignale._.obj.sig_c_getr UMR_GRADC__1_1_M40_S6_S3 8 -40 150 DEPOSIT ABSOLUTE MONOTONY MON_INCREASE /end AXIS_DESCR
 /begin AXIS_DESCR STD_AXIS NO_INPUT_QUANTITY UMR_MSEC__10_1_0_S6_S3 6 0 2540 DEPOSIT ABSOLUTE MONOTONY MON_INCREASE /end AXIS_DESCR
/end CHARACTERISTIC
/begin CHARACTERISTIC KL_FCGPOGA_1 "Druckoffset Faktor Gangauslegen" CURVE 0x23EE48 kl_ui8_S6_S3 1 UMR___1_100_0_S6_S3 0 1
 /begin AXIS_DESCR STD_AXIS zff_atsys._.iSignale._.obj.sig_c_getr UMR_GRADC__1_1_M40_S6_S3 6 -40 215 DEPOSIT ABSOLUTE MONOTONY MON_INCREASE /end AXIS_DESCR
/end CHARACTERISTIC
/begin CHARACTERISTIC KF_POGANDNMOTNTV2_2 "Druckoffset f(n_mot-n_t, timer) 2. NKL Gangauslegen" MAP 0x23EE58 kf_si16_S6_S3 12.75 UMR_BAR__1_1000_0_S6_S3 -6.4 6.35
 /begin AXIS_DESCR STD_AXIS iSasZentr.nd_nmot_nt UMR_U_MIN_1_1_0_S6_S3 4 -16320 16320 DEPOSIT ABSOLUTE MONOTONY MON_INCREASE /end AXIS_DESCR
 /begin AXIS_DESCR STD_AXIS NO_INPUT_QUANTITY UMR_MSEC__10_1_0_S6_S3 4 0 2540 DEPOSIT ABSOLUTE MONOTONY MON_INCREASE /end AXIS_DESCR
/end CHARACTERISTIC
/begin CHARACTERISTIC KF_PRAGACGV2_2 "Druckkennfeld abschaltende Kupplung 2. NKL Gangauslegen" MAP 0x23EE90 kf_si16_S6_S3 12.75 UMR_BAR__1_1000_0_S6_S3 0 12.75
 /begin AXIS_DESCR STD_AXIS zff_atsys._.iSignale._.obj.sig_c_getr UMR_GRADC__1_1_M40_S6_S3 5 -40 150 DEPOSIT ABSOLUTE MONOTONY MON_INCREASE /end AXIS_DESCR
 /begin AXIS_DESCR STD_AXIS NO_INPUT_QUANTITY UMR_MSEC__10_1_0_S6_S3 5 0 2540 DEPOSIT ABSOLUTE MONOTONY MON_INCREASE /end AXIS_DESCR
/end CHARACTERISTIC
/begin CHARACTERISTIC KF_POGANDNMOTNT_2 "Druckoffset f(n_mot-n_t, timer) Gangauslegen" MAP 0x23EEE0 kf_si16_S6_S3 12.75 UMR_BAR__1_1000_0_S6_S3 -6.4 6.35
 /begin AXIS_DESCR STD_AXIS iSasZentr.nd_nmot_nt UMR_U_MIN_1_1_0_S6_S3 4 -16320 16320 DEPOSIT ABSOLUTE MONOTONY MON_INCREASE /end AXIS_DESCR
 /begin AXIS_DESCR STD_AXIS NO_INPUT_QUANTITY UMR_MSEC__10_1_0_S6_S3 4 0 2540 DEPOSIT ABSOLUTE MONOTONY MON_INCREASE /end AXIS_DESCR
/end CHARACTERISTIC
/begin CHARACTERISTIC KF_PRAGACG_2 "Druckkennfeld abschaltende Kupplung Gangauslegen" MAP 0x23EF18 kf_si16_S6_S3 12.75 UMR_BAR__1_1000_0_S6_S3 -6.4 6.35
 /begin AXIS_DESCR STD_AXIS zff_atsys._.iSignale._.obj.sig_c_getr UMR_GRADC__1_1_M40_S6_S3 8 -40 150 DEPOSIT ABSOLUTE MONOTONY MON_INCREASE /end AXIS_DESCR
 /begin AXIS_DESCR STD_AXIS NO_INPUT_QUANTITY UMR_MSEC__10_1_0_S6_S3 6 0 2540 DEPOSIT ABSOLUTE MONOTONY MON_INCREASE /end AXIS_DESCR
/end CHARACTERISTIC
/begin CHARACTERISTIC KL_FCGPOGA_2 "Druckoffset Faktor Gangauslegen" CURVE 0x23EF9C kl_ui8_S6_S3 1 UMR___1_100_0_S6_S3 0 1
 /begin AXIS_DESCR STD_AXIS zff_atsys._.iSignale._.obj.sig_c_getr UMR_GRADC__1_1_M40_S6_S3 6 -40 215 DEPOSIT ABSOLUTE MONOTONY MON_INCREASE /end AXIS_DESCR
/end CHARACTERISTIC
/begin CHARACTERISTIC KF_POGANDNMOTNTV2_3 "Druckoffset f(n_mot-n_t, timer) 2. NKL Gangauslegen" MAP 0x23EFAC kf_si16_S6_S3 12.75 UMR_BAR__1_1000_0_S6_S3 -6.4 6.35
 /begin AXIS_DESCR STD_AXIS iSasZentr.nd_nmot_nt UMR_U_MIN_1_1_0_S6_S3 4 -16320 16320 DEPOSIT ABSOLUTE MONOTONY MON_INCREASE /end AXIS_DESCR
 /begin AXIS_DESCR STD_AXIS NO_INPUT_QUANTITY UMR_MSEC__10_1_0_S6_S3 4 0 2540 DEPOSIT ABSOLUTE MONOTONY MON_INCREASE /end AXIS_DESCR
/end CHARACTERISTIC
/begin CHARACTERISTIC KF_PRAGACGV2_3 "Druckkennfeld abschaltende Kupplung 2. NKL Gangauslegen" MAP 0x23EFE4 kf_si16_S6_S3 12.75 UMR_BAR__1_1000_0_S6_S3 0 12.75
 /begin AXIS_DESCR STD_AXIS zff_atsys._.iSignale._.obj.sig_c_getr UMR_GRADC__1_1_M40_S6_S3 5 -40 150 DEPOSIT ABSOLUTE MONOTONY MON_INCREASE /end AXIS_DESCR
 /begin AXIS_DESCR STD_AXIS NO_INPUT_QUANTITY UMR_MSEC__10_1_0_S6_S3 5 0 2540 DEPOSIT ABSOLUTE MONOTONY MON_INCREASE /end AXIS_DESCR
/end CHARACTERISTIC
/begin CHARACTERISTIC KF_POGANDNMOTNT_3 "Druckoffset f(n_mot-n_t, timer) Gangauslegen" MAP 0x23F034 kf_si16_S6_S3 12.75 UMR_BAR__1_1000_0_S6_S3 -6.4 6.35
 /begin AXIS_DESCR STD_AXIS iSasZentr.nd_nmot_nt UMR_U_MIN_1_1_0_S6_S3 4 -16320 16320 DEPOSIT ABSOLUTE MONOTONY MON_INCREASE /end AXIS_DESCR
 /begin AXIS_DESCR STD_AXIS NO_INPUT_QUANTITY UMR_MSEC__10_1_0_S6_S3 4 0 2540 DEPOSIT ABSOLUTE MONOTONY MON_INCREASE /end AXIS_DESCR
/end CHARACTERISTIC
/begin CHARACTERISTIC KF_PRAGACG_3 "Druckkennfeld abschaltende Kupplung Gangauslegen" MAP 0x23F06C kf_si16_S6_S3 12.75 UMR_BAR__1_1000_0_S6_S3 -6.4 6.35
 /begin AXIS_DESCR STD_AXIS zff_atsys._.iSignale._.obj.sig_c_getr UMR_GRADC__1_1_M40_S6_S3 8 -40 150 DEPOSIT ABSOLUTE MONOTONY MON_INCREASE /end AXIS_DESCR
 /begin AXIS_DESCR STD_AXIS NO_INPUT_QUANTITY UMR_MSEC__10_1_0_S6_S3 6 0 2540 DEPOSIT ABSOLUTE MONOTONY MON_INCREASE /end AXIS_DESCR
/end CHARACTERISTIC
/begin CHARACTERISTIC KL_FCGPOGA_3 "Druckoffset Faktor Gangauslegen" CURVE 0x23F0F0 kl_ui8_S6_S3 1 UMR___1_100_0_S6_S3 0 1
 /begin AXIS_DESCR STD_AXIS zff_atsys._.iSignale._.obj.sig_c_getr UMR_GRADC__1_1_M40_S6_S3 6 -40 215 DEPOSIT ABSOLUTE MONOTONY MON_INCREASE /end AXIS_DESCR
/end CHARACTERISTIC
/begin CHARACTERISTIC KF_POGANDNMOTNTV2_4 "Druckoffset f(n_mot-n_t, timer) 2. NKL Gangauslegen" MAP 0x23F100 kf_si16_S6_S3 12.75 UMR_BAR__1_1000_0_S6_S3 -6.4 6.35
 /begin AXIS_DESCR STD_AXIS iSasZentr.nd_nmot_nt UMR_U_MIN_1_1_0_S6_S3 4 -16320 16320 DEPOSIT ABSOLUTE MONOTONY MON_INCREASE /end AXIS_DESCR
 /begin AXIS_DESCR STD_AXIS NO_INPUT_QUANTITY UMR_MSEC__10_1_0_S6_S3 4 0 2540 DEPOSIT ABSOLUTE MONOTONY MON_INCREASE /end AXIS_DESCR
/end CHARACTERISTIC
/begin CHARACTERISTIC KF_PRAGACGV2_4 "Druckkennfeld abschaltende Kupplung 2. NKL Gangauslegen" MAP 0x23F138 kf_si16_S6_S3 12.75 UMR_BAR__1_1000_0_S6_S3 0 12.75
 /begin AXIS_DESCR STD_AXIS zff_atsys._.iSignale._.obj.sig_c_getr UMR_GRADC__1_1_M40_S6_S3 5 -40 150 DEPOSIT ABSOLUTE MONOTONY MON_INCREASE /end AXIS_DESCR
 /begin AXIS_DESCR STD_AXIS NO_INPUT_QUANTITY UMR_MSEC__10_1_0_S6_S3 5 0 2540 DEPOSIT ABSOLUTE MONOTONY MON_INCREASE /end AXIS_DESCR
/end CHARACTERISTIC
/begin CHARACTERISTIC KF_POGANDNMOTNT_4 "Druckoffset f(n_mot-n_t, timer) Gangauslegen" MAP 0x23F188 kf_si16_S6_S3 12.75 UMR_BAR__1_1000_0_S6_S3 -6.4 6.35
 /begin AXIS_DESCR STD_AXIS iSasZentr.nd_nmot_nt UMR_U_MIN_1_1_0_S6_S3 4 -16320 16320 DEPOSIT ABSOLUTE MONOTONY MON_INCREASE /end AXIS_DESCR
 /begin AXIS_DESCR STD_AXIS NO_INPUT_QUANTITY UMR_MSEC__10_1_0_S6_S3 4 0 2540 DEPOSIT ABSOLUTE MONOTONY MON_INCREASE /end AXIS_DESCR
/end CHARACTERISTIC
/begin CHARACTERISTIC KF_PRAGACG_4 "Druckkennfeld abschaltende Kupplung Gangauslegen" MAP 0x23F1C0 kf_si16_S6_S3 12.75 UMR_BAR__1_1000_0_S6_S3 -6.4 6.35
 /begin AXIS_DESCR STD_AXIS zff_atsys._.iSignale._.obj.sig_c_getr UMR_GRADC__1_1_M40_S6_S3 8 -40 150 DEPOSIT ABSOLUTE MONOTONY MON_INCREASE /end AXIS_DESCR
 /begin AXIS_DESCR STD_AXIS NO_INPUT_QUANTITY UMR_MSEC__10_1_0_S6_S3 6 0 2540 DEPOSIT ABSOLUTE MONOTONY MON_INCREASE /end AXIS_DESCR
/end CHARACTERISTIC
/begin CHARACTERISTIC KL_FCGPOGA_4 "Druckoffset Faktor Gangauslegen" CURVE 0x23F244 kl_ui8_S6_S3 1 UMR___1_100_0_S6_S3 0 1
 /begin AXIS_DESCR STD_AXIS zff_atsys._.iSignale._.obj.sig_c_getr UMR_GRADC__1_1_M40_S6_S3 6 -40 215 DEPOSIT ABSOLUTE MONOTONY MON_INCREASE /end AXIS_DESCR
/end CHARACTERISTIC
/begin CHARACTERISTIC KF_POGANDNMOTNTV2_5 "Druckoffset f(n_mot-n_t, timer) 2. NKL Gangauslegen" MAP 0x23F254 kf_si16_S6_S3 12.75 UMR_BAR__1_1000_0_S6_S3 -6.4 6.35
 /begin AXIS_DESCR STD_AXIS iSasZentr.nd_nmot_nt UMR_U_MIN_1_1_0_S6_S3 4 -16320 16320 DEPOSIT ABSOLUTE MONOTONY MON_INCREASE /end AXIS_DESCR
 /begin AXIS_DESCR STD_AXIS NO_INPUT_QUANTITY UMR_MSEC__10_1_0_S6_S3 4 0 2540 DEPOSIT ABSOLUTE MONOTONY MON_INCREASE /end AXIS_DESCR
/end CHARACTERISTIC
/begin CHARACTERISTIC KF_PRAGACGV2_5 "Druckkennfeld abschaltende Kupplung 2. NKL Gangauslegen" MAP 0x23F28C kf_si16_S6_S3 12.75 UMR_BAR__1_1000_0_S6_S3 0 12.75
 /begin AXIS_DESCR STD_AXIS zff_atsys._.iSignale._.obj.sig_c_getr UMR_GRADC__1_1_M40_S6_S3 5 -40 150 DEPOSIT ABSOLUTE MONOTONY MON_INCREASE /end AXIS_DESCR
 /begin AXIS_DESCR STD_AXIS NO_INPUT_QUANTITY UMR_MSEC__10_1_0_S6_S3 5 0 2540 DEPOSIT ABSOLUTE MONOTONY MON_INCREASE /end AXIS_DESCR
/end CHARACTERISTIC
/begin CHARACTERISTIC KF_POGANDNMOTNT_5 "Druckoffset f(n_mot-n_t, timer) Gangauslegen" MAP 0x23F2DC kf_si16_S6_S3 12.75 UMR_BAR__1_1000_0_S6_S3 -6.4 6.35
 /begin AXIS_DESCR STD_AXIS iSasZentr.nd_nmot_nt UMR_U_MIN_1_1_0_S6_S3 4 -16320 16320 DEPOSIT ABSOLUTE MONOTONY MON_INCREASE /end AXIS_DESCR
 /begin AXIS_DESCR STD_AXIS NO_INPUT_QUANTITY UMR_MSEC__10_1_0_S6_S3 4 0 2540 DEPOSIT ABSOLUTE MONOTONY MON_INCREASE /end AXIS_DESCR
/end CHARACTERISTIC
/begin CHARACTERISTIC KF_PRAGACG_5 "Druckkennfeld abschaltende Kupplung Gangauslegen" MAP 0x23F314 kf_si16_S6_S3 12.75 UMR_BAR__1_1000_0_S6_S3 -6.4 6.35
 /begin AXIS_DESCR STD_AXIS zff_atsys._.iSignale._.obj.sig_c_getr UMR_GRADC__1_1_M40_S6_S3 8 -40 150 DEPOSIT ABSOLUTE MONOTONY MON_INCREASE /end AXIS_DESCR
 /begin AXIS_DESCR STD_AXIS NO_INPUT_QUANTITY UMR_MSEC__10_1_0_S6_S3 6 0 2540 DEPOSIT ABSOLUTE MONOTONY MON_INCREASE /end AXIS_DESCR
/end CHARACTERISTIC
/begin CHARACTERISTIC KL_FCGPOGA_5 "Druckoffset Faktor Gangauslegen" CURVE 0x23F398 kl_ui8_S6_S3 1 UMR___1_100_0_S6_S3 0 1
 /begin AXIS_DESCR STD_AXIS zff_atsys._.iSignale._.obj.sig_c_getr UMR_GRADC__1_1_M40_S6_S3 6 -40 215 DEPOSIT ABSOLUTE MONOTONY MON_INCREASE /end AXIS_DESCR
/end CHARACTERISTIC
/begin CHARACTERISTIC KF_POGANDNMOTNTV2_6 "Druckoffset f(n_mot-n_t, timer) 2. NKL Gangauslegen" MAP 0x23F3A8 kf_si16_S6_S3 12.75 UMR_BAR__1_1000_0_S6_S3 -6.4 6.35
 /begin AXIS_DESCR STD_AXIS iSasZentr.nd_nmot_nt UMR_U_MIN_1_1_0_S6_S3 4 -16320 16320 DEPOSIT ABSOLUTE MONOTONY MON_INCREASE /end AXIS_DESCR
 /begin AXIS_DESCR STD_AXIS NO_INPUT_QUANTITY UMR_MSEC__10_1_0_S6_S3 4 0 2540 DEPOSIT ABSOLUTE MONOTONY MON_INCREASE /end AXIS_DESCR
/end CHARACTERISTIC
/begin CHARACTERISTIC KF_PRAGACGV2_6 "Druckkennfeld abschaltende Kupplung 2. NKL Gangauslegen" MAP 0x23F3E0 kf_si16_S6_S3 12.75 UMR_BAR__1_1000_0_S6_S3 0 12.75
 /begin AXIS_DESCR STD_AXIS zff_atsys._.iSignale._.obj.sig_c_getr UMR_GRADC__1_1_M40_S6_S3 5 -40 150 DEPOSIT ABSOLUTE MONOTONY MON_INCREASE /end AXIS_DESCR
 /begin AXIS_DESCR STD_AXIS NO_INPUT_QUANTITY UMR_MSEC__10_1_0_S6_S3 5 0 2540 DEPOSIT ABSOLUTE MONOTONY MON_INCREASE /end AXIS_DESCR
/end CHARACTERISTIC
/begin CHARACTERISTIC KF_POGANDNMOTNT_6 "Druckoffset f(n_mot-n_t, timer) Gangauslegen" MAP 0x23F430 kf_si16_S6_S3 12.75 UMR_BAR__1_1000_0_S6_S3 -6.4 6.35
 /begin AXIS_DESCR STD_AXIS iSasZentr.nd_nmot_nt UMR_U_MIN_1_1_0_S6_S3 4 -16320 16320 DEPOSIT ABSOLUTE MONOTONY MON_INCREASE /end AXIS_DESCR
 /begin AXIS_DESCR STD_AXIS NO_INPUT_QUANTITY UMR_MSEC__10_1_0_S6_S3 4 0 2540 DEPOSIT ABSOLUTE MONOTONY MON_INCREASE /end AXIS_DESCR
/end CHARACTERISTIC
/begin CHARACTERISTIC KF_PRAGACG_6 "Druckkennfeld abschaltende Kupplung Gangauslegen" MAP 0x23F468 kf_si16_S6_S3 12.75 UMR_BAR__1_1000_0_S6_S3 -6.4 6.35
 /begin AXIS_DESCR STD_AXIS zff_atsys._.iSignale._.obj.sig_c_getr UMR_GRADC__1_1_M40_S6_S3 8 -40 150 DEPOSIT ABSOLUTE MONOTONY MON_INCREASE /end AXIS_DESCR
 /begin AXIS_DESCR STD_AXIS NO_INPUT_QUANTITY UMR_MSEC__10_1_0_S6_S3 6 0 2540 DEPOSIT ABSOLUTE MONOTONY MON_INCREASE /end AXIS_DESCR
/end CHARACTERISTIC
/begin CHARACTERISTIC KL_FCGPOGA_6 "Druckoffset Faktor Gangauslegen" CURVE 0x23F4EC kl_ui8_S6_S3 1 UMR___1_100_0_S6_S3 0 1
 /begin AXIS_DESCR STD_AXIS zff_atsys._.iSignale._.obj.sig_c_getr UMR_GRADC__1_1_M40_S6_S3 6 -40 215 DEPOSIT ABSOLUTE MONOTONY MON_INCREASE /end AXIS_DESCR
/end CHARACTERISTIC
/begin CHARACTERISTIC KF_POGANDNMOTNTV2_7 "Druckoffset f(n_mot-n_t, timer) 2. NKL Gangauslegen" MAP 0x23F4FC kf_si16_S6_S3 12.75 UMR_BAR__1_1000_0_S6_S3 -6.4 6.35
 /begin AXIS_DESCR STD_AXIS iSasZentr.nd_nmot_nt UMR_U_MIN_1_1_0_S6_S3 4 -16320 16320 DEPOSIT ABSOLUTE MONOTONY MON_INCREASE /end AXIS_DESCR
 /begin AXIS_DESCR STD_AXIS NO_INPUT_QUANTITY UMR_MSEC__10_1_0_S6_S3 4 0 2540 DEPOSIT ABSOLUTE MONOTONY MON_INCREASE /end AXIS_DESCR
/end CHARACTERISTIC
/begin CHARACTERISTIC KF_PRAGACGV2_7 "Druckkennfeld abschaltende Kupplung 2. NKL Gangauslegen" MAP 0x23F534 kf_si16_S6_S3 12.75 UMR_BAR__1_1000_0_S6_S3 0 12.75
 /begin AXIS_DESCR STD_AXIS zff_atsys._.iSignale._.obj.sig_c_getr UMR_GRADC__1_1_M40_S6_S3 5 -40 150 DEPOSIT ABSOLUTE MONOTONY MON_INCREASE /end AXIS_DESCR
 /begin AXIS_DESCR STD_AXIS NO_INPUT_QUANTITY UMR_MSEC__10_1_0_S6_S3 5 0 2540 DEPOSIT ABSOLUTE MONOTONY MON_INCREASE /end AXIS_DESCR
/end CHARACTERISTIC
/begin CHARACTERISTIC KF_POGANDNMOTNT_7 "Druckoffset f(n_mot-n_t, timer) Gangauslegen" MAP 0x23F584 kf_si16_S6_S3 12.75 UMR_BAR__1_1000_0_S6_S3 -6.4 6.35
 /begin AXIS_DESCR STD_AXIS iSasZentr.nd_nmot_nt UMR_U_MIN_1_1_0_S6_S3 4 -16320 16320 DEPOSIT ABSOLUTE MONOTONY MON_INCREASE /end AXIS_DESCR
 /begin AXIS_DESCR STD_AXIS NO_INPUT_QUANTITY UMR_MSEC__10_1_0_S6_S3 4 0 2540 DEPOSIT ABSOLUTE MONOTONY MON_INCREASE /end AXIS_DESCR
/end CHARACTERISTIC
/begin CHARACTERISTIC KF_PRAGACG_7 "Druckkennfeld abschaltende Kupplung Gangauslegen" MAP 0x23F5BC kf_si16_S6_S3 12.75 UMR_BAR__1_1000_0_S6_S3 -6.4 6.35
 /begin AXIS_DESCR STD_AXIS zff_atsys._.iSignale._.obj.sig_c_getr UMR_GRADC__1_1_M40_S6_S3 8 -40 150 DEPOSIT ABSOLUTE MONOTONY MON_INCREASE /end AXIS_DESCR
 /begin AXIS_DESCR STD_AXIS NO_INPUT_QUANTITY UMR_MSEC__10_1_0_S6_S3 6 0 2540 DEPOSIT ABSOLUTE MONOTONY MON_INCREASE /end AXIS_DESCR
/end CHARACTERISTIC
/begin CHARACTERISTIC KL_FCGPOGA_7 "Druckoffset Faktor Gangauslegen" CURVE 0x23F640 kl_ui8_S6_S3 1 UMR___1_100_0_S6_S3 0 1
 /begin AXIS_DESCR STD_AXIS zff_atsys._.iSignale._.obj.sig_c_getr UMR_GRADC__1_1_M40_S6_S3 6 -40 215 DEPOSIT ABSOLUTE MONOTONY MON_INCREASE /end AXIS_DESCR
/end CHARACTERISTIC
/begin CHARACTERISTIC KF_POGANDNMOTNTV2_8 "Druckoffset f(n_mot-n_t, timer) 2. NKL Gangauslegen" MAP 0x23F650 kf_si16_S6_S3 12.75 UMR_BAR__1_1000_0_S6_S3 -6.4 6.35
 /begin AXIS_DESCR STD_AXIS iSasZentr.nd_nmot_nt UMR_U_MIN_1_1_0_S6_S3 4 -16320 16320 DEPOSIT ABSOLUTE MONOTONY MON_INCREASE /end AXIS_DESCR
 /begin AXIS_DESCR STD_AXIS NO_INPUT_QUANTITY UMR_MSEC__10_1_0_S6_S3 4 0 2540 DEPOSIT ABSOLUTE MONOTONY MON_INCREASE /end AXIS_DESCR
/end CHARACTERISTIC
/begin CHARACTERISTIC KF_PRAGACGV2_8 "Druckkennfeld abschaltende Kupplung 2. NKL Gangauslegen" MAP 0x23F688 kf_si16_S6_S3 12.75 UMR_BAR__1_1000_0_S6_S3 0 12.75
 /begin AXIS_DESCR STD_AXIS zff_atsys._.iSignale._.obj.sig_c_getr UMR_GRADC__1_1_M40_S6_S3 5 -40 150 DEPOSIT ABSOLUTE MONOTONY MON_INCREASE /end AXIS_DESCR
 /begin AXIS_DESCR STD_AXIS NO_INPUT_QUANTITY UMR_MSEC__10_1_0_S6_S3 5 0 2540 DEPOSIT ABSOLUTE MONOTONY MON_INCREASE /end AXIS_DESCR
/end CHARACTERISTIC
/begin CHARACTERISTIC KF_POGANDNMOTNT_8 "Druckoffset f(n_mot-n_t, timer) Gangauslegen" MAP 0x23F6D8 kf_si16_S6_S3 12.75 UMR_BAR__1_1000_0_S6_S3 -6.4 6.35
 /begin AXIS_DESCR STD_AXIS iSasZentr.nd_nmot_nt UMR_U_MIN_1_1_0_S6_S3 4 -16320 16320 DEPOSIT ABSOLUTE MONOTONY MON_INCREASE /end AXIS_DESCR
 /begin AXIS_DESCR STD_AXIS NO_INPUT_QUANTITY UMR_MSEC__10_1_0_S6_S3 4 0 2540 DEPOSIT ABSOLUTE MONOTONY MON_INCREASE /end AXIS_DESCR
/end CHARACTERISTIC
/begin CHARACTERISTIC KF_PRAGACG_8 "Druckkennfeld abschaltende Kupplung Gangauslegen" MAP 0x23F710 kf_si16_S6_S3 12.75 UMR_BAR__1_1000_0_S6_S3 -6.4 6.35
 /begin AXIS_DESCR STD_AXIS zff_atsys._.iSignale._.obj.sig_c_getr UMR_GRADC__1_1_M40_S6_S3 8 -40 150 DEPOSIT ABSOLUTE MONOTONY MON_INCREASE /end AXIS_DESCR
 /begin AXIS_DESCR STD_AXIS NO_INPUT_QUANTITY UMR_MSEC__10_1_0_S6_S3 6 0 2540 DEPOSIT ABSOLUTE MONOTONY MON_INCREASE /end AXIS_DESCR
/end CHARACTERISTIC
/begin CHARACTERISTIC KL_FCGPOGA_8 "Druckoffset Faktor Gangauslegen" CURVE 0x23F794 kl_ui8_S6_S3 1 UMR___1_100_0_S6_S3 0 1
 /begin AXIS_DESCR STD_AXIS zff_atsys._.iSignale._.obj.sig_c_getr UMR_GRADC__1_1_M40_S6_S3 6 -40 215 DEPOSIT ABSOLUTE MONOTONY MON_INCREASE /end AXIS_DESCR
/end CHARACTERISTIC
/begin CHARACTERISTIC KF_PODKIMOTSOLLNMOTGE_R "Druckoffset Fuell- und Schaltdruck" MAP 0x21F760 kf_si16_S6_S3 22 UMR_BAR__1_1000_0_S6_S3 0 22
 /begin AXIS_DESCR STD_AXIS zff_atsys._.iSignale._.obj.sig_dki_mmotsoll UMR___1_1_0_S6_S3 5 -400 1640 DEPOSIT ABSOLUTE MONOTONY MON_INCREASE /end AXIS_DESCR
 /begin AXIS_DESCR STD_AXIS zff_atsys._.iSignale._.obj.sig_n_mot UMR_U_MIN_1_1_0_S6_S3 5 0 8160 DEPOSIT ABSOLUTE MONOTONY MON_INCREASE /end AXIS_DESCR
/end CHARACTERISTIC
/begin CHARACTERISTIC KF_PODKIMOTSOLLNMOTGE_1 "Druckoffset Fuell- und Schaltdruck" MAP 0x21F7B0 kf_si16_S6_S3 22 UMR_BAR__1_1000_0_S6_S3 0 22
 /begin AXIS_DESCR STD_AXIS zff_atsys._.iSignale._.obj.sig_dki_mmotsoll UMR___1_1_0_S6_S3 5 -400 1640 DEPOSIT ABSOLUTE MONOTONY MON_INCREASE /end AXIS_DESCR
 /begin AXIS_DESCR STD_AXIS zff_atsys._.iSignale._.obj.sig_n_mot UMR_U_MIN_1_1_0_S6_S3 5 0 8160 DEPOSIT ABSOLUTE MONOTONY MON_INCREASE /end AXIS_DESCR
/end CHARACTERISTIC
/begin CHARACTERISTIC KF_PODKIMOTSOLLNMOTGE_2 "Druckoffset Fuell- und Schaltdruck" MAP 0x21F800 kf_si16_S6_S3 22 UMR_BAR__1_1000_0_S6_S3 0 22
 /begin AXIS_DESCR STD_AXIS zff_atsys._.iSignale._.obj.sig_dki_mmotsoll UMR___1_1_0_S6_S3 5 -400 1640 DEPOSIT ABSOLUTE MONOTONY MON_INCREASE /end AXIS_DESCR
 /begin AXIS_DESCR STD_AXIS zff_atsys._.iSignale._.obj.sig_n_mot UMR_U_MIN_1_1_0_S6_S3 5 0 8160 DEPOSIT ABSOLUTE MONOTONY MON_INCREASE /end AXIS_DESCR
/end CHARACTERISTIC
/begin CHARACTERISTIC KF_PODKIMOTSOLLNMOTGE_3 "Druckoffset Fuell- und Schaltdruck" MAP 0x21F850 kf_si16_S6_S3 22 UMR_BAR__1_1000_0_S6_S3 0 22
 /begin AXIS_DESCR STD_AXIS zff_atsys._.iSignale._.obj.sig_dki_mmotsoll UMR___1_1_0_S6_S3 5 -400 1640 DEPOSIT ABSOLUTE MONOTONY MON_INCREASE /end AXIS_DESCR
 /begin AXIS_DESCR STD_AXIS zff_atsys._.iSignale._.obj.sig_n_mot UMR_U_MIN_1_1_0_S6_S3 5 0 8160 DEPOSIT ABSOLUTE MONOTONY MON_INCREASE /end AXIS_DESCR
/end CHARACTERISTIC
/begin CHARACTERISTIC KF_PODKIMOTSOLLNMOTGE_4 "Druckoffset Fuell- und Schaltdruck" MAP 0x21F8A0 kf_si16_S6_S3 22 UMR_BAR__1_1000_0_S6_S3 0 22
 /begin AXIS_DESCR STD_AXIS zff_atsys._.iSignale._.obj.sig_dki_mmotsoll UMR___1_1_0_S6_S3 5 -400 1640 DEPOSIT ABSOLUTE MONOTONY MON_INCREASE /end AXIS_DESCR
 /begin AXIS_DESCR STD_AXIS zff_atsys._.iSignale._.obj.sig_n_mot UMR_U_MIN_1_1_0_S6_S3 5 0 8160 DEPOSIT ABSOLUTE MONOTONY MON_INCREASE /end AXIS_DESCR
/end CHARACTERISTIC
/begin CHARACTERISTIC KF_PODKIMOTSOLLNMOTGE_5 "Druckoffset Fuell- und Schaltdruck" MAP 0x21F8F0 kf_si16_S6_S3 22 UMR_BAR__1_1000_0_S6_S3 0 22
 /begin AXIS_DESCR STD_AXIS zff_atsys._.iSignale._.obj.sig_dki_mmotsoll UMR___1_1_0_S6_S3 5 -400 1640 DEPOSIT ABSOLUTE MONOTONY MON_INCREASE /end AXIS_DESCR
 /begin AXIS_DESCR STD_AXIS zff_atsys._.iSignale._.obj.sig_n_mot UMR_U_MIN_1_1_0_S6_S3 5 0 8160 DEPOSIT ABSOLUTE MONOTONY MON_INCREASE /end AXIS_DESCR
/end CHARACTERISTIC
/begin CHARACTERISTIC KF_PODKIMOTSOLLNMOTGE_6 "Druckoffset Fuell- und Schaltdruck" MAP 0x21F940 kf_si16_S6_S3 22 UMR_BAR__1_1000_0_S6_S3 0 22
 /begin AXIS_DESCR STD_AXIS zff_atsys._.iSignale._.obj.sig_dki_mmotsoll UMR___1_1_0_S6_S3 5 -400 1640 DEPOSIT ABSOLUTE MONOTONY MON_INCREASE /end AXIS_DESCR
 /begin AXIS_DESCR STD_AXIS zff_atsys._.iSignale._.obj.sig_n_mot UMR_U_MIN_1_1_0_S6_S3 5 0 8160 DEPOSIT ABSOLUTE MONOTONY MON_INCREASE /end AXIS_DESCR
/end CHARACTERISTIC
/begin CHARACTERISTIC KF_PODKIMOTSOLLNMOTGE_7 "Druckoffset Fuell- und Schaltdruck" MAP 0x21F990 kf_si16_S6_S3 22 UMR_BAR__1_1000_0_S6_S3 0 22
 /begin AXIS_DESCR STD_AXIS zff_atsys._.iSignale._.obj.sig_dki_mmotsoll UMR___1_1_0_S6_S3 5 -400 1640 DEPOSIT ABSOLUTE MONOTONY MON_INCREASE /end AXIS_DESCR
 /begin AXIS_DESCR STD_AXIS zff_atsys._.iSignale._.obj.sig_n_mot UMR_U_MIN_1_1_0_S6_S3 5 0 8160 DEPOSIT ABSOLUTE MONOTONY MON_INCREASE /end AXIS_DESCR
/end CHARACTERISTIC
/begin CHARACTERISTIC KF_PODKIMOTSOLLNMOTGE_8 "Druckoffset Fuell- und Schaltdruck" MAP 0x21F9E0 kf_si16_S6_S3 22 UMR_BAR__1_1000_0_S6_S3 0 22
 /begin AXIS_DESCR STD_AXIS zff_atsys._.iSignale._.obj.sig_dki_mmotsoll UMR___1_1_0_S6_S3 5 -400 1640 DEPOSIT ABSOLUTE MONOTONY MON_INCREASE /end AXIS_DESCR
 /begin AXIS_DESCR STD_AXIS zff_atsys._.iSignale._.obj.sig_n_mot UMR_U_MIN_1_1_0_S6_S3 5 0 8160 DEPOSIT ABSOLUTE MONOTONY MON_INCREASE /end AXIS_DESCR
/end CHARACTERISTIC
/begin CHARACTERISTIC KF_PODKIMOTSOLLNMOTGE_ECO_R "Druckoffset Fuell- und Schaltdruck" MAP 0x21FA30 kf_si16_S6_S3 22 UMR_BAR__1_1000_0_S6_S3 0 22
 /begin AXIS_DESCR STD_AXIS zff_atsys._.iSignale._.obj.sig_dki_mmotsoll UMR___1_1_0_S6_S3 5 -400 1640 DEPOSIT ABSOLUTE MONOTONY MON_INCREASE /end AXIS_DESCR
 /begin AXIS_DESCR STD_AXIS zff_atsys._.iSignale._.obj.sig_n_mot UMR_U_MIN_1_1_0_S6_S3 5 0 8160 DEPOSIT ABSOLUTE MONOTONY MON_INCREASE /end AXIS_DESCR
/end CHARACTERISTIC
/begin CHARACTERISTIC KF_PODKIMOTSOLLNMOTGE_ECO_1 "Druckoffset Fuell- und Schaltdruck" MAP 0x21FA80 kf_si16_S6_S3 22 UMR_BAR__1_1000_0_S6_S3 0 22
 /begin AXIS_DESCR STD_AXIS zff_atsys._.iSignale._.obj.sig_dki_mmotsoll UMR___1_1_0_S6_S3 5 -400 1640 DEPOSIT ABSOLUTE MONOTONY MON_INCREASE /end AXIS_DESCR
 /begin AXIS_DESCR STD_AXIS zff_atsys._.iSignale._.obj.sig_n_mot UMR_U_MIN_1_1_0_S6_S3 5 0 8160 DEPOSIT ABSOLUTE MONOTONY MON_INCREASE /end AXIS_DESCR
/end CHARACTERISTIC
/begin CHARACTERISTIC KF_PODKIMOTSOLLNMOTGE_ECO_2 "Druckoffset Fuell- und Schaltdruck" MAP 0x21FAD0 kf_si16_S6_S3 22 UMR_BAR__1_1000_0_S6_S3 0 22
 /begin AXIS_DESCR STD_AXIS zff_atsys._.iSignale._.obj.sig_dki_mmotsoll UMR___1_1_0_S6_S3 5 -400 1640 DEPOSIT ABSOLUTE MONOTONY MON_INCREASE /end AXIS_DESCR
 /begin AXIS_DESCR STD_AXIS zff_atsys._.iSignale._.obj.sig_n_mot UMR_U_MIN_1_1_0_S6_S3 5 0 8160 DEPOSIT ABSOLUTE MONOTONY MON_INCREASE /end AXIS_DESCR
/end CHARACTERISTIC
/begin CHARACTERISTIC KF_PODKIMOTSOLLNMOTGE_ECO_3 "Druckoffset Fuell- und Schaltdruck" MAP 0x21FB20 kf_si16_S6_S3 22 UMR_BAR__1_1000_0_S6_S3 0 22
 /begin AXIS_DESCR STD_AXIS zff_atsys._.iSignale._.obj.sig_dki_mmotsoll UMR___1_1_0_S6_S3 5 -400 1640 DEPOSIT ABSOLUTE MONOTONY MON_INCREASE /end AXIS_DESCR
 /begin AXIS_DESCR STD_AXIS zff_atsys._.iSignale._.obj.sig_n_mot UMR_U_MIN_1_1_0_S6_S3 5 0 8160 DEPOSIT ABSOLUTE MONOTONY MON_INCREASE /end AXIS_DESCR
/end CHARACTERISTIC
/begin CHARACTERISTIC KF_PODKIMOTSOLLNMOTGE_ECO_4 "Druckoffset Fuell- und Schaltdruck" MAP 0x21FB70 kf_si16_S6_S3 22 UMR_BAR__1_1000_0_S6_S3 0 22
 /begin AXIS_DESCR STD_AXIS zff_atsys._.iSignale._.obj.sig_dki_mmotsoll UMR___1_1_0_S6_S3 5 -400 1640 DEPOSIT ABSOLUTE MONOTONY MON_INCREASE /end AXIS_DESCR
 /begin AXIS_DESCR STD_AXIS zff_atsys._.iSignale._.obj.sig_n_mot UMR_U_MIN_1_1_0_S6_S3 5 0 8160 DEPOSIT ABSOLUTE MONOTONY MON_INCREASE /end AXIS_DESCR
/end CHARACTERISTIC
/begin CHARACTERISTIC KF_PODKIMOTSOLLNMOTGE_ECO_5 "Druckoffset Fuell- und Schaltdruck" MAP 0x21FBC0 kf_si16_S6_S3 22 UMR_BAR__1_1000_0_S6_S3 0 22
 /begin AXIS_DESCR STD_AXIS zff_atsys._.iSignale._.obj.sig_dki_mmotsoll UMR___1_1_0_S6_S3 5 -400 1640 DEPOSIT ABSOLUTE MONOTONY MON_INCREASE /end AXIS_DESCR
 /begin AXIS_DESCR STD_AXIS zff_atsys._.iSignale._.obj.sig_n_mot UMR_U_MIN_1_1_0_S6_S3 5 0 8160 DEPOSIT ABSOLUTE MONOTONY MON_INCREASE /end AXIS_DESCR
/end CHARACTERISTIC
/begin CHARACTERISTIC KF_PODKIMOTSOLLNMOTGE_ECO_6 "Druckoffset Fuell- und Schaltdruck" MAP 0x21FC10 kf_si16_S6_S3 22 UMR_BAR__1_1000_0_S6_S3 0 22
 /begin AXIS_DESCR STD_AXIS zff_atsys._.iSignale._.obj.sig_dki_mmotsoll UMR___1_1_0_S6_S3 5 -400 1640 DEPOSIT ABSOLUTE MONOTONY MON_INCREASE /end AXIS_DESCR
 /begin AXIS_DESCR STD_AXIS zff_atsys._.iSignale._.obj.sig_n_mot UMR_U_MIN_1_1_0_S6_S3 5 0 8160 DEPOSIT ABSOLUTE MONOTONY MON_INCREASE /end AXIS_DESCR
/end CHARACTERISTIC
/begin CHARACTERISTIC KF_PODKIMOTSOLLNMOTGE_ECO_7 "Druckoffset Fuell- und Schaltdruck" MAP 0x21FC60 kf_si16_S6_S3 22 UMR_BAR__1_1000_0_S6_S3 0 22
 /begin AXIS_DESCR STD_AXIS zff_atsys._.iSignale._.obj.sig_dki_mmotsoll UMR___1_1_0_S6_S3 5 -400 1640 DEPOSIT ABSOLUTE MONOTONY MON_INCREASE /end AXIS_DESCR
 /begin AXIS_DESCR STD_AXIS zff_atsys._.iSignale._.obj.sig_n_mot UMR_U_MIN_1_1_0_S6_S3 5 0 8160 DEPOSIT ABSOLUTE MONOTONY MON_INCREASE /end AXIS_DESCR
/end CHARACTERISTIC
/begin CHARACTERISTIC KF_PODKIMOTSOLLNMOTGE_ECO_8 "Druckoffset Fuell- und Schaltdruck" MAP 0x21FCB0 kf_si16_S6_S3 22 UMR_BAR__1_1000_0_S6_S3 0 22
 /begin AXIS_DESCR STD_AXIS zff_atsys._.iSignale._.obj.sig_dki_mmotsoll UMR___1_1_0_S6_S3 5 -400 1640 DEPOSIT ABSOLUTE MONOTONY MON_INCREASE /end AXIS_DESCR
 /begin AXIS_DESCR STD_AXIS zff_atsys._.iSignale._.obj.sig_n_mot UMR_U_MIN_1_1_0_S6_S3 5 0 8160 DEPOSIT ABSOLUTE MONOTONY MON_INCREASE /end AXIS_DESCR
/end CHARACTERISTIC
/begin CHARACTERISTIC KL_TMAXCG_R "Maximaldauer Gangeinlegen" CURVE 0x236498 kl_ui16_S6_S3 10000 UMR_MSEC__10_1_0_S6_S3 0 10000
 /begin AXIS_DESCR STD_AXIS zff_atsys._.iSignale._.obj.sig_c_getr UMR_GRADC__1_1_M40_S6_S3 2 -40 150 DEPOSIT ABSOLUTE MONOTONY MON_INCREASE /end AXIS_DESCR
/end CHARACTERISTIC
/begin CHARACTERISTIC T_RAMAX_R "Rampe bei Timeout" VALUE 0x26E642 kw_ui8_S6_S3 2540 UMR_MSEC__10_1_0_S6_S3 0 2540 /end CHARACTERISTIC
/begin CHARACTERISTIC KL_TMAXCGGA_R "Maximaldauer Gangauslegen" CURVE 0x2364A4 kl_ui16_S6_S3 10000 UMR_MSEC__10_1_0_S6_S3 0 10000
 /begin AXIS_DESCR STD_AXIS zff_atsys._.iSignale._.obj.sig_c_getr UMR_GRADC__1_1_M40_S6_S3 2 -40 150 DEPOSIT ABSOLUTE MONOTONY MON_INCREASE /end AXIS_DESCR
/end CHARACTERISTIC
/begin CHARACTERISTIC KL_TMAXCG_1 "Maximaldauer Gangeinlegen" CURVE 0x2364B0 kl_ui16_S6_S3 10000 UMR_MSEC__10_1_0_S6_S3 0 10000
 /begin AXIS_DESCR STD_AXIS zff_atsys._.iSignale._.obj.sig_c_getr UMR_GRADC__1_1_M40_S6_S3 2 -40 150 DEPOSIT ABSOLUTE MONOTONY MON_INCREASE /end AXIS_DESCR
/end CHARACTERISTIC
/begin CHARACTERISTIC T_RAMAX_1 "Rampe bei Timeout" VALUE 0x26E643 kw_ui8_S6_S3 2540 UMR_MSEC__10_1_0_S6_S3 0 2540 /end CHARACTERISTIC
/begin CHARACTERISTIC KL_TMAXCGGA_1 "Maximaldauer Gangauslegen" CURVE 0x2364BC kl_ui16_S6_S3 10000 UMR_MSEC__10_1_0_S6_S3 0 10000
 /begin AXIS_DESCR STD_AXIS zff_atsys._.iSignale._.obj.sig_c_getr UMR_GRADC__1_1_M40_S6_S3 2 -40 150 DEPOSIT ABSOLUTE MONOTONY MON_INCREASE /end AXIS_DESCR
/end CHARACTERISTIC
/begin CHARACTERISTIC KL_TMAXCG_2 "Maximaldauer Gangeinlegen" CURVE 0x2364C8 kl_ui16_S6_S3 10000 UMR_MSEC__10_1_0_S6_S3 0 10000
 /begin AXIS_DESCR STD_AXIS zff_atsys._.iSignale._.obj.sig_c_getr UMR_GRADC__1_1_M40_S6_S3 2 -40 150 DEPOSIT ABSOLUTE MONOTONY MON_INCREASE /end AXIS_DESCR
/end CHARACTERISTIC
/begin CHARACTERISTIC T_RAMAX_2 "Rampe bei Timeout" VALUE 0x26E644 kw_ui8_S6_S3 2540 UMR_MSEC__10_1_0_S6_S3 0 2540 /end CHARACTERISTIC
/begin CHARACTERISTIC KL_TMAXCGGA_2 "Maximaldauer Gangauslegen" CURVE 0x2364D4 kl_ui16_S6_S3 10000 UMR_MSEC__10_1_0_S6_S3 0 10000
 /begin AXIS_DESCR STD_AXIS zff_atsys._.iSignale._.obj.sig_c_getr UMR_GRADC__1_1_M40_S6_S3 2 -40 150 DEPOSIT ABSOLUTE MONOTONY MON_INCREASE /end AXIS_DESCR
/end CHARACTERISTIC
/begin CHARACTERISTIC KL_TMAXCG_3 "Maximaldauer Gangeinlegen" CURVE 0x2364E0 kl_ui16_S6_S3 10000 UMR_MSEC__10_1_0_S6_S3 0 10000
 /begin AXIS_DESCR STD_AXIS zff_atsys._.iSignale._.obj.sig_c_getr UMR_GRADC__1_1_M40_S6_S3 2 -40 150 DEPOSIT ABSOLUTE MONOTONY MON_INCREASE /end AXIS_DESCR
/end CHARACTERISTIC
/begin CHARACTERISTIC T_RAMAX_3 "Rampe bei Timeout" VALUE 0x26E645 kw_ui8_S6_S3 2540 UMR_MSEC__10_1_0_S6_S3 0 2540 /end CHARACTERISTIC
/begin CHARACTERISTIC KL_TMAXCGGA_3 "Maximaldauer Gangauslegen" CURVE 0x2364EC kl_ui16_S6_S3 10000 UMR_MSEC__10_1_0_S6_S3 0 10000
 /begin AXIS_DESCR STD_AXIS zff_atsys._.iSignale._.obj.sig_c_getr UMR_GRADC__1_1_M40_S6_S3 2 -40 150 DEPOSIT ABSOLUTE MONOTONY MON_INCREASE /end AXIS_DESCR
/end CHARACTERISTIC
/begin CHARACTERISTIC KL_TMAXCG_4 "Maximaldauer Gangeinlegen" CURVE 0x2364F8 kl_ui16_S6_S3 10000 UMR_MSEC__10_1_0_S6_S3 0 10000
 /begin AXIS_DESCR STD_AXIS zff_atsys._.iSignale._.obj.sig_c_getr UMR_GRADC__1_1_M40_S6_S3 2 -40 150 DEPOSIT ABSOLUTE MONOTONY MON_INCREASE /end AXIS_DESCR
/end CHARACTERISTIC
/begin CHARACTERISTIC T_RAMAX_4 "Rampe bei Timeout" VALUE 0x26E646 kw_ui8_S6_S3 2540 UMR_MSEC__10_1_0_S6_S3 0 2540 /end CHARACTERISTIC
/begin CHARACTERISTIC KL_TMAXCGGA_4 "Maximaldauer Gangauslegen" CURVE 0x236504 kl_ui16_S6_S3 10000 UMR_MSEC__10_1_0_S6_S3 0 10000
 /begin AXIS_DESCR STD_AXIS zff_atsys._.iSignale._.obj.sig_c_getr UMR_GRADC__1_1_M40_S6_S3 2 -40 150 DEPOSIT ABSOLUTE MONOTONY MON_INCREASE /end AXIS_DESCR
/end CHARACTERISTIC
/begin CHARACTERISTIC KL_TMAXCG_5 "Maximaldauer Gangeinlegen" CURVE 0x236510 kl_ui16_S6_S3 10000 UMR_MSEC__10_1_0_S6_S3 0 10000
 /begin AXIS_DESCR STD_AXIS zff_atsys._.iSignale._.obj.sig_c_getr UMR_GRADC__1_1_M40_S6_S3 2 -40 150 DEPOSIT ABSOLUTE MONOTONY MON_INCREASE /end AXIS_DESCR
/end CHARACTERISTIC
/begin CHARACTERISTIC T_RAMAX_5 "Rampe bei Timeout" VALUE 0x26E647 kw_ui8_S6_S3 2540 UMR_MSEC__10_1_0_S6_S3 0 2540 /end CHARACTERISTIC
/begin CHARACTERISTIC KL_TMAXCGGA_5 "Maximaldauer Gangauslegen" CURVE 0x23651C kl_ui16_S6_S3 10000 UMR_MSEC__10_1_0_S6_S3 0 10000
 /begin AXIS_DESCR STD_AXIS zff_atsys._.iSignale._.obj.sig_c_getr UMR_GRADC__1_1_M40_S6_S3 2 -40 150 DEPOSIT ABSOLUTE MONOTONY MON_INCREASE /end AXIS_DESCR
/end CHARACTERISTIC
/begin CHARACTERISTIC KL_TMAXCG_6 "Maximaldauer Gangeinlegen" CURVE 0x236528 kl_ui16_S6_S3 10000 UMR_MSEC__10_1_0_S6_S3 0 10000
 /begin AXIS_DESCR STD_AXIS zff_atsys._.iSignale._.obj.sig_c_getr UMR_GRADC__1_1_M40_S6_S3 2 -40 150 DEPOSIT ABSOLUTE MONOTONY MON_INCREASE /end AXIS_DESCR
/end CHARACTERISTIC
/begin CHARACTERISTIC T_RAMAX_6 "Rampe bei Timeout" VALUE 0x26E648 kw_ui8_S6_S3 2540 UMR_MSEC__10_1_0_S6_S3 0 2540 /end CHARACTERISTIC
/begin CHARACTERISTIC KL_TMAXCGGA_6 "Maximaldauer Gangauslegen" CURVE 0x236534 kl_ui16_S6_S3 10000 UMR_MSEC__10_1_0_S6_S3 0 10000
 /begin AXIS_DESCR STD_AXIS zff_atsys._.iSignale._.obj.sig_c_getr UMR_GRADC__1_1_M40_S6_S3 2 -40 150 DEPOSIT ABSOLUTE MONOTONY MON_INCREASE /end AXIS_DESCR
/end CHARACTERISTIC
/begin CHARACTERISTIC KL_TMAXCG_7 "Maximaldauer Gangeinlegen" CURVE 0x236540 kl_ui16_S6_S3 10000 UMR_MSEC__10_1_0_S6_S3 0 10000
 /begin AXIS_DESCR STD_AXIS zff_atsys._.iSignale._.obj.sig_c_getr UMR_GRADC__1_1_M40_S6_S3 2 -40 150 DEPOSIT ABSOLUTE MONOTONY MON_INCREASE /end AXIS_DESCR
/end CHARACTERISTIC
/begin CHARACTERISTIC T_RAMAX_7 "Rampe bei Timeout" VALUE 0x26E649 kw_ui8_S6_S3 2540 UMR_MSEC__10_1_0_S6_S3 0 2540 /end CHARACTERISTIC
/begin CHARACTERISTIC KL_TMAXCGGA_7 "Maximaldauer Gangauslegen" CURVE 0x23654C kl_ui16_S6_S3 10000 UMR_MSEC__10_1_0_S6_S3 0 10000
 /begin AXIS_DESCR STD_AXIS zff_atsys._.iSignale._.obj.sig_c_getr UMR_GRADC__1_1_M40_S6_S3 2 -40 150 DEPOSIT ABSOLUTE MONOTONY MON_INCREASE /end AXIS_DESCR
/end CHARACTERISTIC
/begin CHARACTERISTIC KL_TMAXCG_8 "Maximaldauer Gangeinlegen" CURVE 0x236558 kl_ui16_S6_S3 10000 UMR_MSEC__10_1_0_S6_S3 0 10000
 /begin AXIS_DESCR STD_AXIS zff_atsys._.iSignale._.obj.sig_c_getr UMR_GRADC__1_1_M40_S6_S3 2 -40 150 DEPOSIT ABSOLUTE MONOTONY MON_INCREASE /end AXIS_DESCR
/end CHARACTERISTIC
/begin CHARACTERISTIC T_RAMAX_8 "Rampe bei Timeout" VALUE 0x26E64A kw_ui8_S6_S3 2540 UMR_MSEC__10_1_0_S6_S3 0 2540 /end CHARACTERISTIC
/begin CHARACTERISTIC KL_TMAXCGGA_8 "Maximaldauer Gangauslegen" CURVE 0x236564 kl_ui16_S6_S3 10000 UMR_MSEC__10_1_0_S6_S3 0 10000
 /begin AXIS_DESCR STD_AXIS zff_atsys._.iSignale._.obj.sig_c_getr UMR_GRADC__1_1_M40_S6_S3 2 -40 150 DEPOSIT ABSOLUTE MONOTONY MON_INCREASE /end AXIS_DESCR
/end CHARACTERISTIC
/begin CHARACTERISTIC T_POGERDDR "Zeit seit letztem GA fuer Verwendung Druckoffsets" VALUE 0x26E620 kw_ui8_S6_S3 2550 UMR_MSEC__10_1_0_S6_S3 0 2550 /end CHARACTERISTIC
/begin CHARACTERISTIC PO_FGEDR "Druckoffset Fuelldruck GE nach R und vorher Kraftfluss in D" VALUE 0x26D874 kw_si16_S6_S3 6.4 UMR_BAR__1_1000_0_S6_S3 -6.4 0 /end CHARACTERISTIC
/begin CHARACTERISTIC PO_FGERD "Druckoffset Fuelldruck GE nach D und vorher Kraftfluss in R" VALUE 0x26D876 kw_si16_S6_S3 6.4 UMR_BAR__1_1000_0_S6_S3 -6.4 0 /end CHARACTERISTIC
/begin CHARACTERISTIC PO_FDNR "Fuelldruckoffset GE nicht kraftschl.Kup bei Dx-N-R" VALUE 0x26D878 kw_si16_S6_S3 19.15 UMR_BAR__1_1000_0_S6_S3 -6.4 12.75 /end CHARACTERISTIC
/begin CHARACTERISTIC PO_FRND "Fuelldruckoffset GE nicht kraftschl.Kup bei R-N-Dx oder Dx-N-Dx" VALUE 0x26D87A kw_si16_S6_S3 19.15 UMR_BAR__1_1000_0_S6_S3 -6.4 12.75 /end CHARACTERISTIC
/begin CHARACTERISTIC PO_SDGEDR "Druckoffset Schaltdruck GE nach R und vorher Kraftfluss in D" VALUE 0x26D87C kw_si16_S6_S3 6.4 UMR_BAR__1_1000_0_S6_S3 -6.4 0 /end CHARACTERISTIC
/begin CHARACTERISTIC PO_SDGERD "Druckoffset Schaltdruck GE nach D und vorher Kraftfluss in R" VALUE 0x26D87E kw_si16_S6_S3 6.4 UMR_BAR__1_1000_0_S6_S3 -6.4 0 /end CHARACTERISTIC
/begin CHARACTERISTIC P_GAKUPPC "Druck Kup. C bei GA als nicht kraftloesende Kupplung" VALUE 0x26D880 kw_si16_S6_S3 12.75 UMR_BAR__1_1000_0_S6_S3 0 12.75 /end CHARACTERISTIC
/begin CHARACTERISTIC ND_SYNABBRGA_D "Differenzdrehzahl zu Synchron fuer Abbruch GA" VALUE 0x26D882 kw_ui16_S6_S3 1999 UMR_U_MIN_1_1_0_S6_S3 1 2000 /end CHARACTERISTIC
/begin CHARACTERISTIC ND_SYNABBRGA_R "Differenzdrehzahl zu Synchron fuer Abbruch GA" VALUE 0x26D884 kw_ui16_S6_S3 1999 UMR_U_MIN_1_1_0_S6_S3 1 2000 /end CHARACTERISTIC
/begin CHARACTERISTIC KL_PORASASABBRUCHGA "Gesteuerte Druckrampe bei Schaltungsabbruch" CURVE 0x234C2C kl_ui16_S6_S3 12.5 UMR_BAR__1_1000_0_S6_S3 0 12.5
 /begin AXIS_DESCR STD_AXIS iSasAnGeaNichtKraftschl1.timer_zgea UMR_MSEC__10_1_0_S6_S3 3 0 1000 DEPOSIT ABSOLUTE MONOTONY MON_INCREASE /end AXIS_DESCR
/end CHARACTERISTIC
/begin CHARACTERISTIC KL_TOSFCGRND "Offset auf Schnellfüllzeit beim Reversieren RND" CURVE 0x234C3C kl_si16_S6_S3 2000 UMR_MSEC__1_1_0_S6_S3 -1000 1000
 /begin AXIS_DESCR STD_AXIS zff_atsys._.iSignale._.obj.sig_c_getr UMR_GRADC__1_1_M40_S6_S3 4 -40 150 DEPOSIT ABSOLUTE MONOTONY MON_INCREASE /end AXIS_DESCR
/end CHARACTERISTIC
/begin CHARACTERISTIC KL_TOSFCGD2NR "Offset auf Schnellfüllzeit beim Reversieren D2NR" CURVE 0x234C50 kl_si16_S6_S3 2000 UMR_MSEC__1_1_0_S6_S3 -1000 1000
 /begin AXIS_DESCR STD_AXIS zff_atsys._.iSignale._.obj.sig_c_getr UMR_GRADC__1_1_M40_S6_S3 4 -40 150 DEPOSIT ABSOLUTE MONOTONY MON_INCREASE /end AXIS_DESCR
/end CHARACTERISTIC
/begin CHARACTERISTIC KL_TOSFCGDNR "Offset auf Schnellfüllzeit beim Reversieren DNR" CURVE 0x234C64 kl_si16_S6_S3 2000 UMR_MSEC__1_1_0_S6_S3 -1000 1000
 /begin AXIS_DESCR STD_AXIS zff_atsys._.iSignale._.obj.sig_c_getr UMR_GRADC__1_1_M40_S6_S3 4 -40 150 DEPOSIT ABSOLUTE MONOTONY MON_INCREASE /end AXIS_DESCR
/end CHARACTERISTIC
/begin CHARACTERISTIC PG_OFV1_R "Gradient Offset Fuelldruck 1.nicht kraftschl. Kup." VALUE 0x26E81A kw_ui8_S6_S3 5 UMR_BAR_SEC_1_10_0_S6_S3 0 5 /end CHARACTERISTIC
/begin CHARACTERISTIC KL_PGOFCGV2_R "Gradient Offset Fuelldruck 2. nicht kraftschl. Kup." CURVE 0x24C704 kl_ui8_S6_S3 5 UMR_BAR_SEC_1_10_0_S6_S3 0 5
 /begin AXIS_DESCR STD_AXIS zff_atsys._.iSignale._.obj.sig_c_getr UMR_GRADC__1_1_M40_S6_S3 4 -40 150 DEPOSIT ABSOLUTE MONOTONY MON_INCREASE /end AXIS_DESCR
/end CHARACTERISTIC
/begin CHARACTERISTIC KL_PGOFMT_R "Gradient Druckoffset Fuellphase" CURVE 0x24C710 kl_si16_S6_S3 200 UMR_BAR_SEC_1_10_0_S6_S3 -100 100
 /begin AXIS_DESCR STD_AXIS zff_atsys._.iSignale._.obj.sig_m_t UMR_NM__1_1_0_S6_S3 4 -400 1640 DEPOSIT ABSOLUTE MONOTONY MON_INCREASE /end AXIS_DESCR
/end CHARACTERISTIC
/begin CHARACTERISTIC KL_PORAKZU_R "Schaltdruckoffset" CURVE 0x24C724 kl_si16_S6_S3 12.75 UMR_BAR__1_1000_0_S6_S3 -6.4 6.35
 /begin AXIS_DESCR STD_AXIS NO_INPUT_QUANTITY UMR_MSEC__10_1_0_S6_S3 3 0 2540 DEPOSIT ABSOLUTE MONOTONY MON_INCREASE /end AXIS_DESCR
/end CHARACTERISTIC
/begin CHARACTERISTIC KF_POFMTN_R "Kennfeld Fuelldruckoffset(nd_syn, m_t)" MAP 0x24C734 kf_si16_S6_S3 12.75 UMR_BAR__1_1000_0_S6_S3 -6.4 6.35
 /begin AXIS_DESCR STD_AXIS iSasZentr.iSchaltend.nd_syn UMR_U_MIN_1_1_0_S6_S3 4 -8000 8000 DEPOSIT ABSOLUTE MONOTONY MON_INCREASE /end AXIS_DESCR
 /begin AXIS_DESCR STD_AXIS zff_atsys._.iSignale._.obj.sig_m_t UMR_NM__1_1_0_S6_S3 6 -400 1640 DEPOSIT ABSOLUTE MONOTONY MON_INCREASE /end AXIS_DESCR
/end CHARACTERISTIC
/begin CHARACTERISTIC KL_PGOKZU_R "Druckgradient in Abhaengigkeit von m_t" CURVE 0x24C780 kl_si16_S6_S3 200 UMR_BAR_SEC_1_10_0_S6_S3 -100 100
 /begin AXIS_DESCR STD_AXIS zff_atsys._.iSignale._.obj.sig_m_t UMR_NM__1_1_0_S6_S3 6 -400 1640 DEPOSIT ABSOLUTE MONOTONY MON_INCREASE /end AXIS_DESCR
/end CHARACTERISTIC
/begin CHARACTERISTIC KL_PGRASYN_R "Schliessrampenradient f(m_t)" CURVE 0x24C79C kl_si16_S6_S3 6553.4 UMR_BAR_SEC_1_10_0_S6_S3 -3276.7 3276.7
 /begin AXIS_DESCR STD_AXIS zff_atsys._.iSignale._.obj.sig_m_t UMR_NM__1_1_0_S6_S3 6 -400 1640 DEPOSIT ABSOLUTE MONOTONY MON_INCREASE /end AXIS_DESCR
/end CHARACTERISTIC
/begin CHARACTERISTIC KL_PGRASYNNAB_R "Schliessrampenradient f(n_ab)" CURVE 0x24C7B8 kl_si16_S6_S3 200 UMR_BAR_SEC_1_10_0_S6_S3 -100 100
 /begin AXIS_DESCR STD_AXIS zff_atsys._.iSignale._.obj.sig_n_ab UMR_U_MIN_1_1_0_S6_S3 2 0 8160 DEPOSIT ABSOLUTE MONOTONY MON_INCREASE /end AXIS_DESCR
/end CHARACTERISTIC
/begin CHARACTERISTIC KL_PGRASYNV1_R "Schliessrampenradient 1. nichtkraftschl. Kupplung" CURVE 0x24C7C4 kl_si16_S6_S3 1000 UMR_BAR_SEC_1_10_0_S6_S3 0 1000
 /begin AXIS_DESCR STD_AXIS zff_atsys._.iSignale._.obj.sig_m_t UMR_NM__1_1_0_S6_S3 6 -400 1640 DEPOSIT ABSOLUTE MONOTONY MON_INCREASE /end AXIS_DESCR
/end CHARACTERISTIC
/begin CHARACTERISTIC KL_PORASYNV1_R "Schliessrampendruckoffset 1. nichtkraftschl. Kupplung" CURVE 0x24C7E0 kl_si16_S6_S3 12.75 UMR_BAR__1_1000_0_S6_S3 0 12.75
 /begin AXIS_DESCR STD_AXIS NO_INPUT_QUANTITY UMR_MSEC__10_1_0_S6_S3 3 0 2540 DEPOSIT ABSOLUTE MONOTONY MON_INCREASE /end AXIS_DESCR
/end CHARACTERISTIC
/begin CHARACTERISTIC KL_PGRASYNV2_R "Schliessrampenradient 2. nichtkraftschl. Kupplung" CURVE 0x24C7F0 kl_si16_S6_S3 1000 UMR_BAR_SEC_1_10_0_S6_S3 0 1000
 /begin AXIS_DESCR STD_AXIS zff_atsys._.iSignale._.obj.sig_m_t UMR_NM__1_1_0_S6_S3 6 -400 1640 DEPOSIT ABSOLUTE MONOTONY MON_INCREASE /end AXIS_DESCR
/end CHARACTERISTIC
/begin CHARACTERISTIC KL_PORASYNV2_R "Schliessrampendruckoffset 2. nichtkraftschl. Kupplung" CURVE 0x24C80C kl_si16_S6_S3 12.75 UMR_BAR__1_1000_0_S6_S3 0 12.75
 /begin AXIS_DESCR STD_AXIS NO_INPUT_QUANTITY UMR_MSEC__10_1_0_S6_S3 3 0 2540 DEPOSIT ABSOLUTE MONOTONY MON_INCREASE /end AXIS_DESCR
/end CHARACTERISTIC
/begin CHARACTERISTIC KL_TOVKZUCG_R "Offset auf Verzoegerungszeit kraftschliessende KZU" CURVE 0x24C81C kl_ui8_S6_S3 2540 UMR_MSEC__10_1_0_S6_S3 0 2540
 /begin AXIS_DESCR STD_AXIS zff_atsys._.iSignale._.obj.sig_c_getr UMR_GRADC__1_1_M40_S6_S3 4 -40 150 DEPOSIT ABSOLUTE MONOTONY MON_INCREASE /end AXIS_DESCR
/end CHARACTERISTIC
/begin CHARACTERISTIC KL_TVKZU_R "Verzoegerungszeit kraftschliessende KZU" CURVE 0x24C828 kl_ui16_S6_S3 2540 UMR_MSEC__10_1_0_S6_S3 0 2540
 /begin AXIS_DESCR STD_AXIS zff_atsys._.iSignale._.obj.sig_n_ab UMR_U_MIN_1_1_0_S6_S3 4 0 8160 DEPOSIT ABSOLUTE MONOTONY MON_INCREASE /end AXIS_DESCR
/end CHARACTERISTIC
/begin CHARACTERISTIC KL_TVKZUCGV2_R "Verzoegerungszeit 2. nichtkraftschliessende KZU" CURVE 0x24C83C kl_ui8_S6_S3 2540 UMR_MSEC__10_1_0_S6_S3 0 2540
 /begin AXIS_DESCR STD_AXIS zff_atsys._.iSignale._.obj.sig_c_getr UMR_GRADC__1_1_M40_S6_S3 4 -40 150 DEPOSIT ABSOLUTE MONOTONY MON_INCREASE /end AXIS_DESCR
/end CHARACTERISTIC
/begin CHARACTERISTIC T_VKZUV2_R "Verzoegerungszeit 2. nicht kraftschliessende KZU" VALUE 0x26E81B kw_ui8_S6_S3 2540 UMR_MSEC__10_1_0_S6_S3 0 2540 /end CHARACTERISTIC
/begin CHARACTERISTIC KL_TFCGGE_R "Fuellzeit" CURVE 0x24C848 kl_ui8_S6_S3 2540 UMR_MSEC__10_1_0_S6_S3 0 2540
 /begin AXIS_DESCR STD_AXIS zff_atsys._.iSignale._.obj.sig_c_getr UMR_GRADC__1_1_M40_S6_S3 10 -40 210 DEPOSIT ABSOLUTE MONOTONY MON_INCREASE /end AXIS_DESCR
/end CHARACTERISTIC
/begin CHARACTERISTIC KL_TFV1_R "Fuellzeit GE 1. nicht kraftschl. Kupplung" CURVE 0x24C860 kl_ui16_S6_S3 2540 UMR_MSEC__10_1_0_S6_S3 0 2540
 /begin AXIS_DESCR STD_AXIS zff_atsys._.iSignale._.obj.sig_n_ab UMR_U_MIN_1_1_0_S6_S3 4 0 8160 DEPOSIT ABSOLUTE MONOTONY MON_INCREASE /end AXIS_DESCR
/end CHARACTERISTIC
/begin CHARACTERISTIC KL_TFCGV2_R "Fuellzeit GE 2. nicht kraftschl. Kupplung" CURVE 0x24C874 kl_ui8_S6_S3 2540 UMR_MSEC__10_1_0_S6_S3 0 2540
 /begin AXIS_DESCR STD_AXIS zff_atsys._.iSignale._.obj.sig_c_getr UMR_GRADC__1_1_M40_S6_S3 4 -40 210 DEPOSIT ABSOLUTE MONOTONY MON_INCREASE /end AXIS_DESCR
/end CHARACTERISTIC
/begin CHARACTERISTIC T_SYN_R "Verweilzeit in Synchron zum Start Max.Rampe" VALUE 0x26E81C kw_ui8_S6_S3 2540 UMR_MSEC__10_1_0_S6_S3 0 2540 /end CHARACTERISTIC
/begin CHARACTERISTIC KL_POFCG_R "Kennlinie Fuelldruckoffset" CURVE 0x24C880 kl_si16_S6_S3 12.75 UMR_BAR__1_1000_0_S6_S3 -6.4 6.35
 /begin AXIS_DESCR STD_AXIS zff_atsys._.iSignale._.obj.sig_c_getr UMR_GRADC__1_1_M40_S6_S3 10 -40 150 DEPOSIT ABSOLUTE MONOTONY MON_INCREASE /end AXIS_DESCR
/end CHARACTERISTIC
/begin CHARACTERISTIC KL_POFCGV1_R "Kennlinie Fuelldruckoffset" CURVE 0x24C8AC kl_si16_S6_S3 12.75 UMR_BAR__1_1000_0_S6_S3 -6.4 6.35
 /begin AXIS_DESCR STD_AXIS zff_atsys._.iSignale._.obj.sig_c_getr UMR_GRADC__1_1_M40_S6_S3 10 -40 150 DEPOSIT ABSOLUTE MONOTONY MON_INCREASE /end AXIS_DESCR
/end CHARACTERISTIC
/begin CHARACTERISTIC KL_POFCGV2_R "Kennlinie Fuelldruckoffset" CURVE 0x24C8D8 kl_si16_S6_S3 12.75 UMR_BAR__1_1000_0_S6_S3 -6.4 6.35
 /begin AXIS_DESCR STD_AXIS zff_atsys._.iSignale._.obj.sig_c_getr UMR_GRADC__1_1_M40_S6_S3 10 -40 150 DEPOSIT ABSOLUTE MONOTONY MON_INCREASE /end AXIS_DESCR
/end CHARACTERISTIC
/begin CHARACTERISTIC KL_POKZUCG_R "Schaltdruckoffset" CURVE 0x24C904 kl_si16_S6_S3 12.75 UMR_BAR__1_1000_0_S6_S3 -6.4 6.35
 /begin AXIS_DESCR STD_AXIS zff_atsys._.iSignale._.obj.sig_c_getr UMR_GRADC__1_1_M40_S6_S3 10 -40 150 DEPOSIT ABSOLUTE MONOTONY MON_INCREASE /end AXIS_DESCR
/end CHARACTERISTIC
/begin CHARACTERISTIC KL_PORASYN_R "Rampe n.Syn.->letz.Stuetz.y PMAX" CURVE 0x24C930 kl_si16_S6_S3 12.75 UMR_BAR__1_1000_0_S6_S3 0 12.75
 /begin AXIS_DESCR STD_AXIS NO_INPUT_QUANTITY UMR_MSEC__10_1_0_S6_S3 3 0 2540 DEPOSIT ABSOLUTE MONOTONY MON_INCREASE /end AXIS_DESCR
/end CHARACTERISTIC
/begin CHARACTERISTIC KF_PKZU_R "Schaltdruck zuschaltende Kupplung" MAP 0x24C940 kf_si16_S6_S3 12.75 UMR_BAR__1_1000_0_S6_S3 0 12.75
 /begin AXIS_DESCR STD_AXIS iSasZentr.iSchaltend.n_tkf UMR_U_MIN_32_1_0_S6_S3 8 0 8160 DEPOSIT ABSOLUTE MONOTONY MON_INCREASE /end AXIS_DESCR
 /begin AXIS_DESCR STD_AXIS zff_atsys._.iSignale._.obj.sig_m_t UMR_NM__1_1_0_S6_S3 10 -400 1640 DEPOSIT ABSOLUTE MONOTONY MON_INCREASE /end AXIS_DESCR
/end CHARACTERISTIC
/begin CHARACTERISTIC KF_TRAMTCG_R "Kennlinie Zeit 1. Rampe der zuschaltenden Kupplung" MAP 0x24CA0C kf_si16_S6_S3 2540 UMR_MSEC__10_1_0_S6_S3 0 2540
 /begin AXIS_DESCR STD_AXIS zff_atsys._.iSignale._.obj.sig_m_t UMR_NM__1_1_0_S6_S3 4 -400 1640 DEPOSIT ABSOLUTE MONOTONY MON_INCREASE /end AXIS_DESCR
 /begin AXIS_DESCR STD_AXIS zff_atsys._.iSignale._.obj.sig_c_getr UMR_GRADC__1_1_M40_S6_S3 4 -40 150 DEPOSIT ABSOLUTE MONOTONY MON_INCREASE /end AXIS_DESCR
/end CHARACTERISTIC
/begin CHARACTERISTIC T_SYNRAKZU_R "Zeit vor sync. Ende Schaltdruck/Start 3. Rampe KZU" VALUE 0x26E81D kw_ui8_S6_S3 1280 UMR_MSEC__10_1_M128_S6_S3 -1280 0 /end CHARACTERISTIC
/begin CHARACTERISTIC KL_PGOKZUNAB_R "Schaltdruckgradienten Offset f(n_ab)" CURVE 0x24CA44 kl_si16_S6_S3 200 UMR_BAR_SEC_1_10_0_S6_S3 -100 100
 /begin AXIS_DESCR STD_AXIS zff_atsys._.iSignale._.obj.sig_n_ab UMR_U_MIN_1_1_0_S6_S3 2 0 8160 DEPOSIT ABSOLUTE MONOTONY MON_INCREASE /end AXIS_DESCR
/end CHARACTERISTIC
/begin CHARACTERISTIC KF_POMLASTCGV2_R "Momentenabhaengiger Druckoffset in FA der 2. nichtkraftschliessende KZU" MAP 0x24CA50 kf_si16_S6_S3 3 UMR_BAR__1_1000_0_S6_S3 0 3
 /begin AXIS_DESCR STD_AXIS NO_INPUT_QUANTITY UMR_NM__1_1_0_S6_S3 5 -400 1640 DEPOSIT ABSOLUTE MONOTONY MON_INCREASE /end AXIS_DESCR
 /begin AXIS_DESCR STD_AXIS zff_atsys._.iSignale._.obj.sig_c_getr UMR_GRADC__1_1_M40_S6_S3 4 -40 150 DEPOSIT ABSOLUTE MONOTONY MON_INCREASE /end AXIS_DESCR
/end CHARACTERISTIC
/begin CHARACTERISTIC KF_POTNDSYNV2_R "Differenzdrehzahlabhaengiger Druckoffset in FA der 2. nichtkraftschliessende KZU" MAP 0x24CA94 kf_si16_S6_S3 3 UMR_BAR__1_1000_0_S6_S3 0 3
 /begin AXIS_DESCR STD_AXIS NO_INPUT_QUANTITY UMR_MSEC__10_1_0_S6_S3 6 0 2540 DEPOSIT ABSOLUTE MONOTONY MON_INCREASE /end AXIS_DESCR
 /begin AXIS_DESCR STD_AXIS NO_INPUT_QUANTITY UMR_U_MIN_1_1_0_S6_S3 8 -8160 8160 DEPOSIT ABSOLUTE MONOTONY MON_INCREASE /end AXIS_DESCR
/end CHARACTERISTIC
/begin CHARACTERISTIC KL_FPOTNDSYNV2_R "Temp. abhaengiger Faktor fuer Druckoffset waehrend FA 2. nichtkraftschliessende KZU" CURVE 0x24CB18 kl_ui8_S6_S3 1 UMR___1_100_0_S6_S3 0 1
 /begin AXIS_DESCR STD_AXIS zff_atsys._.iSignale._.obj.sig_c_getr UMR_GRADC__1_1_M40_S6_S3 5 -40 150 DEPOSIT ABSOLUTE MONOTONY MON_INCREASE /end AXIS_DESCR
/end CHARACTERISTIC
/begin CHARACTERISTIC NS_GENDSYNIAE_R "Drehzahlschwelle Endebedingung Fuellausgleich 2. nichtkraftschliessende KZU" VALUE 0x26DE32 kw_si16_S6_S3 8000 UMR_U_MIN_1_1_0_S6_S3 0 8000 /end CHARACTERISTIC
/begin CHARACTERISTIC T_VGEIAE_R "Verzoegerung Drehzahlschwelle GE Hybrid" VALUE 0x26E81E kw_ui8_S6_S3 2540 UMR_MSEC__10_1_0_S6_S3 0 2540 /end CHARACTERISTIC
/begin CHARACTERISTIC KL_POLASTDKIV2_R "Druckoffset auf Fülldruck zweites nichtkraftschließendes Schaltelement" CURVE 0x24CB28 kl_si16_S6_S3 6 UMR_BAR__1_1000_0_S6_S3 0 6
 /begin AXIS_DESCR STD_AXIS zff_atsys._.iSignale._.obj.sig_dki UMR_PROZENT__20_51_0_S6_S3 6 0 100 DEPOSIT ABSOLUTE MONOTONY MON_INCREASE /end AXIS_DESCR
/end CHARACTERISTIC
/begin CHARACTERISTIC PG_OFV1_1 "Gradient Offset Fuelldruck 1.nicht kraftschl. Kup." VALUE 0x26E81F kw_ui8_S6_S3 5 UMR_BAR_SEC_1_10_0_S6_S3 0 5 /end CHARACTERISTIC
/begin CHARACTERISTIC KL_PGOFCGV2_1 "Gradient Offset Fuelldruck 2. nicht kraftschl. Kup." CURVE 0x24CB44 kl_ui8_S6_S3 5 UMR_BAR_SEC_1_10_0_S6_S3 0 5
 /begin AXIS_DESCR STD_AXIS zff_atsys._.iSignale._.obj.sig_c_getr UMR_GRADC__1_1_M40_S6_S3 4 -40 150 DEPOSIT ABSOLUTE MONOTONY MON_INCREASE /end AXIS_DESCR
/end CHARACTERISTIC
/begin CHARACTERISTIC KL_PGOFMT_1 "Gradient Druckoffset Fuellphase" CURVE 0x24CB50 kl_si16_S6_S3 200 UMR_BAR_SEC_1_10_0_S6_S3 -100 100
 /begin AXIS_DESCR STD_AXIS zff_atsys._.iSignale._.obj.sig_m_t UMR_NM__1_1_0_S6_S3 4 -400 1640 DEPOSIT ABSOLUTE MONOTONY MON_INCREASE /end AXIS_DESCR
/end CHARACTERISTIC
/begin CHARACTERISTIC KL_PORAKZU_1 "Schaltdruckoffset" CURVE 0x24CB64 kl_si16_S6_S3 12.75 UMR_BAR__1_1000_0_S6_S3 -6.4 6.35
 /begin AXIS_DESCR STD_AXIS NO_INPUT_QUANTITY UMR_MSEC__10_1_0_S6_S3 3 0 2540 DEPOSIT ABSOLUTE MONOTONY MON_INCREASE /end AXIS_DESCR
/end CHARACTERISTIC
/begin CHARACTERISTIC KF_POFMTN_1 "Kennfeld Fuelldruckoffset(nd_syn, m_t)" MAP 0x24CB74 kf_si16_S6_S3 12.75 UMR_BAR__1_1000_0_S6_S3 -6.4 6.35
 /begin AXIS_DESCR STD_AXIS iSasZentr.iSchaltend.nd_syn UMR_U_MIN_1_1_0_S6_S3 4 -8000 8000 DEPOSIT ABSOLUTE MONOTONY MON_INCREASE /end AXIS_DESCR
 /begin AXIS_DESCR STD_AXIS zff_atsys._.iSignale._.obj.sig_m_t UMR_NM__1_1_0_S6_S3 6 -400 1640 DEPOSIT ABSOLUTE MONOTONY MON_INCREASE /end AXIS_DESCR
/end CHARACTERISTIC
/begin CHARACTERISTIC KL_PGOKZU_1 "Druckgradient in Abhaengigkeit von m_t" CURVE 0x24CBC0 kl_si16_S6_S3 200 UMR_BAR_SEC_1_10_0_S6_S3 -100 100
 /begin AXIS_DESCR STD_AXIS zff_atsys._.iSignale._.obj.sig_m_t UMR_NM__1_1_0_S6_S3 6 -400 1640 DEPOSIT ABSOLUTE MONOTONY MON_INCREASE /end AXIS_DESCR
/end CHARACTERISTIC
/begin CHARACTERISTIC KL_PGRASYN_1 "Schliessrampenradient f(m_t)" CURVE 0x24CBDC kl_si16_S6_S3 6553.4 UMR_BAR_SEC_1_10_0_S6_S3 -3276.7 3276.7
 /begin AXIS_DESCR STD_AXIS zff_atsys._.iSignale._.obj.sig_m_t UMR_NM__1_1_0_S6_S3 6 -400 1640 DEPOSIT ABSOLUTE MONOTONY MON_INCREASE /end AXIS_DESCR
/end CHARACTERISTIC
/begin CHARACTERISTIC KL_PGRASYNNAB_1 "Schliessrampenradient f(n_ab)" CURVE 0x24CBF8 kl_si16_S6_S3 200 UMR_BAR_SEC_1_10_0_S6_S3 -100 100
 /begin AXIS_DESCR STD_AXIS zff_atsys._.iSignale._.obj.sig_n_ab UMR_U_MIN_1_1_0_S6_S3 2 0 8160 DEPOSIT ABSOLUTE MONOTONY MON_INCREASE /end AXIS_DESCR
/end CHARACTERISTIC
/begin CHARACTERISTIC KL_PGRASYNV1_1 "Schliessrampenradient 1. nichtkraftschl. Kupplung" CURVE 0x24CC04 kl_si16_S6_S3 1000 UMR_BAR_SEC_1_10_0_S6_S3 0 1000
 /begin AXIS_DESCR STD_AXIS zff_atsys._.iSignale._.obj.sig_m_t UMR_NM__1_1_0_S6_S3 6 -400 1640 DEPOSIT ABSOLUTE MONOTONY MON_INCREASE /end AXIS_DESCR
/end CHARACTERISTIC
/begin CHARACTERISTIC KL_PORASYNV1_1 "Schliessrampendruckoffset 1. nichtkraftschl. Kupplung" CURVE 0x24CC20 kl_si16_S6_S3 12.75 UMR_BAR__1_1000_0_S6_S3 0 12.75
 /begin AXIS_DESCR STD_AXIS NO_INPUT_QUANTITY UMR_MSEC__10_1_0_S6_S3 3 0 2540 DEPOSIT ABSOLUTE MONOTONY MON_INCREASE /end AXIS_DESCR
/end CHARACTERISTIC
/begin CHARACTERISTIC KL_PGRASYNV2_1 "Schliessrampenradient 2. nichtkraftschl. Kupplung" CURVE 0x24CC30 kl_si16_S6_S3 1000 UMR_BAR_SEC_1_10_0_S6_S3 0 1000
 /begin AXIS_DESCR STD_AXIS zff_atsys._.iSignale._.obj.sig_m_t UMR_NM__1_1_0_S6_S3 6 -400 1640 DEPOSIT ABSOLUTE MONOTONY MON_INCREASE /end AXIS_DESCR
/end CHARACTERISTIC
/begin CHARACTERISTIC KL_PORASYNV2_1 "Schliessrampendruckoffset 2. nichtkraftschl. Kupplung" CURVE 0x24CC4C kl_si16_S6_S3 12.75 UMR_BAR__1_1000_0_S6_S3 0 12.75
 /begin AXIS_DESCR STD_AXIS NO_INPUT_QUANTITY UMR_MSEC__10_1_0_S6_S3 3 0 2540 DEPOSIT ABSOLUTE MONOTONY MON_INCREASE /end AXIS_DESCR
/end CHARACTERISTIC
/begin CHARACTERISTIC KL_TOVKZUCG_1 "Offset auf Verzoegerungszeit kraftschliessende KZU" CURVE 0x24CC5C kl_ui8_S6_S3 2540 UMR_MSEC__10_1_0_S6_S3 0 2540
 /begin AXIS_DESCR STD_AXIS zff_atsys._.iSignale._.obj.sig_c_getr UMR_GRADC__1_1_M40_S6_S3 4 -40 150 DEPOSIT ABSOLUTE MONOTONY MON_INCREASE /end AXIS_DESCR
/end CHARACTERISTIC
/begin CHARACTERISTIC KL_TVKZU_1 "Verzoegerungszeit kraftschliessende KZU" CURVE 0x24CC68 kl_ui16_S6_S3 2540 UMR_MSEC__10_1_0_S6_S3 0 2540
 /begin AXIS_DESCR STD_AXIS zff_atsys._.iSignale._.obj.sig_n_ab UMR_U_MIN_1_1_0_S6_S3 4 0 8160 DEPOSIT ABSOLUTE MONOTONY MON_INCREASE /end AXIS_DESCR
/end CHARACTERISTIC
/begin CHARACTERISTIC KL_TVKZUCGV2_1 "Verzoegerungszeit 2. nichtkraftschliessende KZU" CURVE 0x24CC7C kl_ui8_S6_S3 2540 UMR_MSEC__10_1_0_S6_S3 0 2540
 /begin AXIS_DESCR STD_AXIS zff_atsys._.iSignale._.obj.sig_c_getr UMR_GRADC__1_1_M40_S6_S3 4 -40 150 DEPOSIT ABSOLUTE MONOTONY MON_INCREASE /end AXIS_DESCR
/end CHARACTERISTIC
/begin CHARACTERISTIC T_VKZUV2_1 "Verzoegerungszeit 2. nicht kraftschliessende KZU" VALUE 0x26E820 kw_ui8_S6_S3 2540 UMR_MSEC__10_1_0_S6_S3 0 2540 /end CHARACTERISTIC
/begin CHARACTERISTIC KL_TFCGGE_1 "Fuellzeit" CURVE 0x24CC88 kl_ui8_S6_S3 2540 UMR_MSEC__10_1_0_S6_S3 0 2540
 /begin AXIS_DESCR STD_AXIS zff_atsys._.iSignale._.obj.sig_c_getr UMR_GRADC__1_1_M40_S6_S3 10 -40 210 DEPOSIT ABSOLUTE MONOTONY MON_INCREASE /end AXIS_DESCR
/end CHARACTERISTIC
/begin CHARACTERISTIC KL_TFV1_1 "Fuellzeit GE 1. nicht kraftschl. Kupplung" CURVE 0x24CCA0 kl_ui16_S6_S3 2540 UMR_MSEC__10_1_0_S6_S3 0 2540
 /begin AXIS_DESCR STD_AXIS zff_atsys._.iSignale._.obj.sig_n_ab UMR_U_MIN_1_1_0_S6_S3 4 0 8160 DEPOSIT ABSOLUTE MONOTONY MON_INCREASE /end AXIS_DESCR
/end CHARACTERISTIC
/begin CHARACTERISTIC KL_TFCGV2_1 "Fuellzeit GE 2. nicht kraftschl. Kupplung" CURVE 0x24CCB4 kl_ui8_S6_S3 2540 UMR_MSEC__10_1_0_S6_S3 0 2540
 /begin AXIS_DESCR STD_AXIS zff_atsys._.iSignale._.obj.sig_c_getr UMR_GRADC__1_1_M40_S6_S3 4 -40 210 DEPOSIT ABSOLUTE MONOTONY MON_INCREASE /end AXIS_DESCR
/end CHARACTERISTIC
/begin CHARACTERISTIC T_SYN_1 "Verweilzeit in Synchron zum Start Max.Rampe" VALUE 0x26E821 kw_ui8_S6_S3 2540 UMR_MSEC__10_1_0_S6_S3 0 2540 /end CHARACTERISTIC
/begin CHARACTERISTIC KL_POFCG_1 "Kennlinie Fuelldruckoffset" CURVE 0x24CCC0 kl_si16_S6_S3 12.75 UMR_BAR__1_1000_0_S6_S3 -6.4 6.35
 /begin AXIS_DESCR STD_AXIS zff_atsys._.iSignale._.obj.sig_c_getr UMR_GRADC__1_1_M40_S6_S3 10 -40 150 DEPOSIT ABSOLUTE MONOTONY MON_INCREASE /end AXIS_DESCR
/end CHARACTERISTIC
/begin CHARACTERISTIC KL_POFCGV1_1 "Kennlinie Fuelldruckoffset" CURVE 0x24CCEC kl_si16_S6_S3 12.75 UMR_BAR__1_1000_0_S6_S3 -6.4 6.35
 /begin AXIS_DESCR STD_AXIS zff_atsys._.iSignale._.obj.sig_c_getr UMR_GRADC__1_1_M40_S6_S3 10 -40 150 DEPOSIT ABSOLUTE MONOTONY MON_INCREASE /end AXIS_DESCR
/end CHARACTERISTIC
/begin CHARACTERISTIC KL_POFCGV2_1 "Kennlinie Fuelldruckoffset" CURVE 0x24CD18 kl_si16_S6_S3 12.75 UMR_BAR__1_1000_0_S6_S3 -6.4 6.35
 /begin AXIS_DESCR STD_AXIS zff_atsys._.iSignale._.obj.sig_c_getr UMR_GRADC__1_1_M40_S6_S3 10 -40 150 DEPOSIT ABSOLUTE MONOTONY MON_INCREASE /end AXIS_DESCR
/end CHARACTERISTIC
/begin CHARACTERISTIC KL_POKZUCG_1 "Schaltdruckoffset" CURVE 0x24CD44 kl_si16_S6_S3 12.75 UMR_BAR__1_1000_0_S6_S3 -6.4 6.35
 /begin AXIS_DESCR STD_AXIS zff_atsys._.iSignale._.obj.sig_c_getr UMR_GRADC__1_1_M40_S6_S3 10 -40 150 DEPOSIT ABSOLUTE MONOTONY MON_INCREASE /end AXIS_DESCR
/end CHARACTERISTIC
/begin CHARACTERISTIC KL_PORASYN_1 "Rampe n.Syn.->letz.Stuetz.y PMAX" CURVE 0x24CD70 kl_si16_S6_S3 12.75 UMR_BAR__1_1000_0_S6_S3 0 12.75
 /begin AXIS_DESCR STD_AXIS NO_INPUT_QUANTITY UMR_MSEC__10_1_0_S6_S3 3 0 2540 DEPOSIT ABSOLUTE MONOTONY MON_INCREASE /end AXIS_DESCR
/end CHARACTERISTIC
/begin CHARACTERISTIC KF_PKZU_1 "Schaltdruck zuschaltende Kupplung" MAP 0x24CD80 kf_si16_S6_S3 12.75 UMR_BAR__1_1000_0_S6_S3 0 12.75
 /begin AXIS_DESCR STD_AXIS iSasZentr.iSchaltend.n_tkf UMR_U_MIN_32_1_0_S6_S3 8 0 8160 DEPOSIT ABSOLUTE MONOTONY MON_INCREASE /end AXIS_DESCR
 /begin AXIS_DESCR STD_AXIS zff_atsys._.iSignale._.obj.sig_m_t UMR_NM__1_1_0_S6_S3 10 -400 1640 DEPOSIT ABSOLUTE MONOTONY MON_INCREASE /end AXIS_DESCR
/end CHARACTERISTIC
/begin CHARACTERISTIC KF_TRAMTCG_1 "Kennlinie Zeit 1. Rampe der zuschaltenden Kupplung" MAP 0x24CE4C kf_si16_S6_S3 2540 UMR_MSEC__10_1_0_S6_S3 0 2540
 /begin AXIS_DESCR STD_AXIS zff_atsys._.iSignale._.obj.sig_m_t UMR_NM__1_1_0_S6_S3 4 -400 1640 DEPOSIT ABSOLUTE MONOTONY MON_INCREASE /end AXIS_DESCR
 /begin AXIS_DESCR STD_AXIS zff_atsys._.iSignale._.obj.sig_c_getr UMR_GRADC__1_1_M40_S6_S3 4 -40 150 DEPOSIT ABSOLUTE MONOTONY MON_INCREASE /end AXIS_DESCR
/end CHARACTERISTIC
/begin CHARACTERISTIC T_SYNRAKZU_1 "Zeit vor sync. Ende Schaltdruck/Start 3. Rampe KZU" VALUE 0x26E822 kw_ui8_S6_S3 1280 UMR_MSEC__10_1_M128_S6_S3 -1280 0 /end CHARACTERISTIC
/begin CHARACTERISTIC KL_PGOKZUNAB_1 "Schaltdruckgradienten Offset f(n_ab)" CURVE 0x24CE84 kl_si16_S6_S3 200 UMR_BAR_SEC_1_10_0_S6_S3 -100 100
 /begin AXIS_DESCR STD_AXIS zff_atsys._.iSignale._.obj.sig_n_ab UMR_U_MIN_1_1_0_S6_S3 2 0 8160 DEPOSIT ABSOLUTE MONOTONY MON_INCREASE /end AXIS_DESCR
/end CHARACTERISTIC
/begin CHARACTERISTIC KF_POMLASTCGV2_1 "Momentenabhaengiger Druckoffset in FA der 2. nichtkraftschliessende KZU" MAP 0x24CE90 kf_si16_S6_S3 3 UMR_BAR__1_1000_0_S6_S3 0 3
 /begin AXIS_DESCR STD_AXIS NO_INPUT_QUANTITY UMR_NM__1_1_0_S6_S3 5 -400 1640 DEPOSIT ABSOLUTE MONOTONY MON_INCREASE /end AXIS_DESCR
 /begin AXIS_DESCR STD_AXIS zff_atsys._.iSignale._.obj.sig_c_getr UMR_GRADC__1_1_M40_S6_S3 4 -40 150 DEPOSIT ABSOLUTE MONOTONY MON_INCREASE /end AXIS_DESCR
/end CHARACTERISTIC
/begin CHARACTERISTIC KF_POTNDSYNV2_1 "Differenzdrehzahlabhaengiger Druckoffset in FA der 2. nichtkraftschliessende KZU" MAP 0x24CED4 kf_si16_S6_S3 3 UMR_BAR__1_1000_0_S6_S3 0 3
 /begin AXIS_DESCR STD_AXIS NO_INPUT_QUANTITY UMR_MSEC__10_1_0_S6_S3 6 0 2540 DEPOSIT ABSOLUTE MONOTONY MON_INCREASE /end AXIS_DESCR
 /begin AXIS_DESCR STD_AXIS NO_INPUT_QUANTITY UMR_U_MIN_1_1_0_S6_S3 8 -8160 8160 DEPOSIT ABSOLUTE MONOTONY MON_INCREASE /end AXIS_DESCR
/end CHARACTERISTIC
/begin CHARACTERISTIC KL_FPOTNDSYNV2_1 "Temp. abhaengiger Faktor fuer Druckoffset waehrend FA 2. nichtkraftschliessende KZU" CURVE 0x24CF58 kl_ui8_S6_S3 1 UMR___1_100_0_S6_S3 0 1
 /begin AXIS_DESCR STD_AXIS zff_atsys._.iSignale._.obj.sig_c_getr UMR_GRADC__1_1_M40_S6_S3 5 -40 150 DEPOSIT ABSOLUTE MONOTONY MON_INCREASE /end AXIS_DESCR
/end CHARACTERISTIC
/begin CHARACTERISTIC NS_GENDSYNIAE_1 "Drehzahlschwelle Endebedingung Fuellausgleich 2. nichtkraftschliessende KZU" VALUE 0x26DE34 kw_si16_S6_S3 8000 UMR_U_MIN_1_1_0_S6_S3 0 8000 /end CHARACTERISTIC
/begin CHARACTERISTIC T_VGEIAE_1 "Verzoegerung Drehzahlschwelle GE Hybrid" VALUE 0x26E823 kw_ui8_S6_S3 2540 UMR_MSEC__10_1_0_S6_S3 0 2540 /end CHARACTERISTIC
/begin CHARACTERISTIC KL_POLASTDKIV2_1 "Druckoffset auf Fülldruck zweites nichtkraftschließendes Schaltelement" CURVE 0x24CF68 kl_si16_S6_S3 6 UMR_BAR__1_1000_0_S6_S3 0 6
 /begin AXIS_DESCR STD_AXIS zff_atsys._.iSignale._.obj.sig_dki UMR_PROZENT__20_51_0_S6_S3 6 0 100 DEPOSIT ABSOLUTE MONOTONY MON_INCREASE /end AXIS_DESCR
/end CHARACTERISTIC
/begin CHARACTERISTIC PG_OFV1_2 "Gradient Offset Fuelldruck 1.nicht kraftschl. Kup." VALUE 0x26E824 kw_ui8_S6_S3 5 UMR_BAR_SEC_1_10_0_S6_S3 0 5 /end CHARACTERISTIC
/begin CHARACTERISTIC KL_PGOFCGV2_2 "Gradient Offset Fuelldruck 2. nicht kraftschl. Kup." CURVE 0x24CF84 kl_ui8_S6_S3 5 UMR_BAR_SEC_1_10_0_S6_S3 0 5
 /begin AXIS_DESCR STD_AXIS zff_atsys._.iSignale._.obj.sig_c_getr UMR_GRADC__1_1_M40_S6_S3 4 -40 150 DEPOSIT ABSOLUTE MONOTONY MON_INCREASE /end AXIS_DESCR
/end CHARACTERISTIC
/begin CHARACTERISTIC KL_PGOFMT_2 "Gradient Druckoffset Fuellphase" CURVE 0x24CF90 kl_si16_S6_S3 200 UMR_BAR_SEC_1_10_0_S6_S3 -100 100
 /begin AXIS_DESCR STD_AXIS zff_atsys._.iSignale._.obj.sig_m_t UMR_NM__1_1_0_S6_S3 4 -400 1640 DEPOSIT ABSOLUTE MONOTONY MON_INCREASE /end AXIS_DESCR
/end CHARACTERISTIC
/begin CHARACTERISTIC KL_PORAKZU_2 "Schaltdruckoffset" CURVE 0x24CFA4 kl_si16_S6_S3 12.75 UMR_BAR__1_1000_0_S6_S3 -6.4 6.35
 /begin AXIS_DESCR STD_AXIS NO_INPUT_QUANTITY UMR_MSEC__10_1_0_S6_S3 3 0 2540 DEPOSIT ABSOLUTE MONOTONY MON_INCREASE /end AXIS_DESCR
/end CHARACTERISTIC
/begin CHARACTERISTIC KF_POFMTN_2 "Kennfeld Fuelldruckoffset(nd_syn, m_t)" MAP 0x24CFB4 kf_si16_S6_S3 12.75 UMR_BAR__1_1000_0_S6_S3 -6.4 6.35
 /begin AXIS_DESCR STD_AXIS iSasZentr.iSchaltend.nd_syn UMR_U_MIN_1_1_0_S6_S3 4 -8000 8000 DEPOSIT ABSOLUTE MONOTONY MON_INCREASE /end AXIS_DESCR
 /begin AXIS_DESCR STD_AXIS zff_atsys._.iSignale._.obj.sig_m_t UMR_NM__1_1_0_S6_S3 6 -400 1640 DEPOSIT ABSOLUTE MONOTONY MON_INCREASE /end AXIS_DESCR
/end CHARACTERISTIC
/begin CHARACTERISTIC KL_PGOKZU_2 "Druckgradient in Abhaengigkeit von m_t" CURVE 0x24D000 kl_si16_S6_S3 200 UMR_BAR_SEC_1_10_0_S6_S3 -100 100
 /begin AXIS_DESCR STD_AXIS zff_atsys._.iSignale._.obj.sig_m_t UMR_NM__1_1_0_S6_S3 6 -400 1640 DEPOSIT ABSOLUTE MONOTONY MON_INCREASE /end AXIS_DESCR
/end CHARACTERISTIC
/begin CHARACTERISTIC KL_PGRASYN_2 "Schliessrampenradient f(m_t)" CURVE 0x24D01C kl_si16_S6_S3 6553.4 UMR_BAR_SEC_1_10_0_S6_S3 -3276.7 3276.7
 /begin AXIS_DESCR STD_AXIS zff_atsys._.iSignale._.obj.sig_m_t UMR_NM__1_1_0_S6_S3 6 -400 1640 DEPOSIT ABSOLUTE MONOTONY MON_INCREASE /end AXIS_DESCR
/end CHARACTERISTIC
/begin CHARACTERISTIC KL_PGRASYNNAB_2 "Schliessrampenradient f(n_ab)" CURVE 0x24D038 kl_si16_S6_S3 200 UMR_BAR_SEC_1_10_0_S6_S3 -100 100
 /begin AXIS_DESCR STD_AXIS zff_atsys._.iSignale._.obj.sig_n_ab UMR_U_MIN_1_1_0_S6_S3 2 0 8160 DEPOSIT ABSOLUTE MONOTONY MON_INCREASE /end AXIS_DESCR
/end CHARACTERISTIC
/begin CHARACTERISTIC KL_PGRASYNV1_2 "Schliessrampenradient 1. nichtkraftschl. Kupplung" CURVE 0x24D044 kl_si16_S6_S3 1000 UMR_BAR_SEC_1_10_0_S6_S3 0 1000
 /begin AXIS_DESCR STD_AXIS zff_atsys._.iSignale._.obj.sig_m_t UMR_NM__1_1_0_S6_S3 6 -400 1640 DEPOSIT ABSOLUTE MONOTONY MON_INCREASE /end AXIS_DESCR
/end CHARACTERISTIC
/begin CHARACTERISTIC KL_PORASYNV1_2 "Schliessrampendruckoffset 1. nichtkraftschl. Kupplung" CURVE 0x24D060 kl_si16_S6_S3 12.75 UMR_BAR__1_1000_0_S6_S3 0 12.75
 /begin AXIS_DESCR STD_AXIS NO_INPUT_QUANTITY UMR_MSEC__10_1_0_S6_S3 3 0 2540 DEPOSIT ABSOLUTE MONOTONY MON_INCREASE /end AXIS_DESCR
/end CHARACTERISTIC
/begin CHARACTERISTIC KL_PGRASYNV2_2 "Schliessrampenradient 2. nichtkraftschl. Kupplung" CURVE 0x24D070 kl_si16_S6_S3 1000 UMR_BAR_SEC_1_10_0_S6_S3 0 1000
 /begin AXIS_DESCR STD_AXIS zff_atsys._.iSignale._.obj.sig_m_t UMR_NM__1_1_0_S6_S3 6 -400 1640 DEPOSIT ABSOLUTE MONOTONY MON_INCREASE /end AXIS_DESCR
/end CHARACTERISTIC
/begin CHARACTERISTIC KL_PORASYNV2_2 "Schliessrampendruckoffset 2. nichtkraftschl. Kupplung" CURVE 0x24D08C kl_si16_S6_S3 12.75 UMR_BAR__1_1000_0_S6_S3 0 12.75
 /begin AXIS_DESCR STD_AXIS NO_INPUT_QUANTITY UMR_MSEC__10_1_0_S6_S3 3 0 2540 DEPOSIT ABSOLUTE MONOTONY MON_INCREASE /end AXIS_DESCR
/end CHARACTERISTIC
/begin CHARACTERISTIC KL_TOVKZUCG_2 "Offset auf Verzoegerungszeit kraftschliessende KZU" CURVE 0x24D09C kl_ui8_S6_S3 2540 UMR_MSEC__10_1_0_S6_S3 0 2540
 /begin AXIS_DESCR STD_AXIS zff_atsys._.iSignale._.obj.sig_c_getr UMR_GRADC__1_1_M40_S6_S3 4 -40 150 DEPOSIT ABSOLUTE MONOTONY MON_INCREASE /end AXIS_DESCR
/end CHARACTERISTIC
/begin CHARACTERISTIC KL_TVKZU_2 "Verzoegerungszeit kraftschliessende KZU" CURVE 0x24D0A8 kl_ui16_S6_S3 2540 UMR_MSEC__10_1_0_S6_S3 0 2540
 /begin AXIS_DESCR STD_AXIS zff_atsys._.iSignale._.obj.sig_n_ab UMR_U_MIN_1_1_0_S6_S3 4 0 8160 DEPOSIT ABSOLUTE MONOTONY MON_INCREASE /end AXIS_DESCR
/end CHARACTERISTIC
/begin CHARACTERISTIC KL_TVKZUCGV2_2 "Verzoegerungszeit 2. nichtkraftschliessende KZU" CURVE 0x24D0BC kl_ui8_S6_S3 2540 UMR_MSEC__10_1_0_S6_S3 0 2540
 /begin AXIS_DESCR STD_AXIS zff_atsys._.iSignale._.obj.sig_c_getr UMR_GRADC__1_1_M40_S6_S3 4 -40 150 DEPOSIT ABSOLUTE MONOTONY MON_INCREASE /end AXIS_DESCR
/end CHARACTERISTIC
/begin CHARACTERISTIC T_VKZUV2_2 "Verzoegerungszeit 2. nicht kraftschliessende KZU" VALUE 0x26E825 kw_ui8_S6_S3 2540 UMR_MSEC__10_1_0_S6_S3 0 2540 /end CHARACTERISTIC
/begin CHARACTERISTIC KL_TFCGGE_2 "Fuellzeit" CURVE 0x24D0C8 kl_ui8_S6_S3 2540 UMR_MSEC__10_1_0_S6_S3 0 2540
 /begin AXIS_DESCR STD_AXIS zff_atsys._.iSignale._.obj.sig_c_getr UMR_GRADC__1_1_M40_S6_S3 10 -40 210 DEPOSIT ABSOLUTE MONOTONY MON_INCREASE /end AXIS_DESCR
/end CHARACTERISTIC
/begin CHARACTERISTIC KL_TFV1_2 "Fuellzeit GE 1. nicht kraftschl. Kupplung" CURVE 0x24D0E0 kl_ui16_S6_S3 2540 UMR_MSEC__10_1_0_S6_S3 0 2540
 /begin AXIS_DESCR STD_AXIS zff_atsys._.iSignale._.obj.sig_n_ab UMR_U_MIN_1_1_0_S6_S3 4 0 8160 DEPOSIT ABSOLUTE MONOTONY MON_INCREASE /end AXIS_DESCR
/end CHARACTERISTIC
/begin CHARACTERISTIC KL_TFCGV2_2 "Fuellzeit GE 2. nicht kraftschl. Kupplung" CURVE 0x24D0F4 kl_ui8_S6_S3 2540 UMR_MSEC__10_1_0_S6_S3 0 2540
 /begin AXIS_DESCR STD_AXIS zff_atsys._.iSignale._.obj.sig_c_getr UMR_GRADC__1_1_M40_S6_S3 4 -40 210 DEPOSIT ABSOLUTE MONOTONY MON_INCREASE /end AXIS_DESCR
/end CHARACTERISTIC
/begin CHARACTERISTIC T_SYN_2 "Verweilzeit in Synchron zum Start Max.Rampe" VALUE 0x26E826 kw_ui8_S6_S3 2540 UMR_MSEC__10_1_0_S6_S3 0 2540 /end CHARACTERISTIC
/begin CHARACTERISTIC KL_POFCG_2 "Kennlinie Fuelldruckoffset" CURVE 0x24D100 kl_si16_S6_S3 12.75 UMR_BAR__1_1000_0_S6_S3 -6.4 6.35
 /begin AXIS_DESCR STD_AXIS zff_atsys._.iSignale._.obj.sig_c_getr UMR_GRADC__1_1_M40_S6_S3 10 -40 150 DEPOSIT ABSOLUTE MONOTONY MON_INCREASE /end AXIS_DESCR
/end CHARACTERISTIC
/begin CHARACTERISTIC KL_POFCGV1_2 "Kennlinie Fuelldruckoffset" CURVE 0x24D12C kl_si16_S6_S3 12.75 UMR_BAR__1_1000_0_S6_S3 -6.4 6.35
 /begin AXIS_DESCR STD_AXIS zff_atsys._.iSignale._.obj.sig_c_getr UMR_GRADC__1_1_M40_S6_S3 10 -40 150 DEPOSIT ABSOLUTE MONOTONY MON_INCREASE /end AXIS_DESCR
/end CHARACTERISTIC
/begin CHARACTERISTIC KL_POFCGV2_2 "Kennlinie Fuelldruckoffset" CURVE 0x24D158 kl_si16_S6_S3 12.75 UMR_BAR__1_1000_0_S6_S3 -6.4 6.35
 /begin AXIS_DESCR STD_AXIS zff_atsys._.iSignale._.obj.sig_c_getr UMR_GRADC__1_1_M40_S6_S3 10 -40 150 DEPOSIT ABSOLUTE MONOTONY MON_INCREASE /end AXIS_DESCR
/end CHARACTERISTIC
/begin CHARACTERISTIC KL_POKZUCG_2 "Schaltdruckoffset" CURVE 0x24D184 kl_si16_S6_S3 12.75 UMR_BAR__1_1000_0_S6_S3 -6.4 6.35
 /begin AXIS_DESCR STD_AXIS zff_atsys._.iSignale._.obj.sig_c_getr UMR_GRADC__1_1_M40_S6_S3 10 -40 150 DEPOSIT ABSOLUTE MONOTONY MON_INCREASE /end AXIS_DESCR
/end CHARACTERISTIC
/begin CHARACTERISTIC KL_PORASYN_2 "Rampe n.Syn.->letz.Stuetz.y PMAX" CURVE 0x24D1B0 kl_si16_S6_S3 12.75 UMR_BAR__1_1000_0_S6_S3 0 12.75
 /begin AXIS_DESCR STD_AXIS NO_INPUT_QUANTITY UMR_MSEC__10_1_0_S6_S3 3 0 2540 DEPOSIT ABSOLUTE MONOTONY MON_INCREASE /end AXIS_DESCR
/end CHARACTERISTIC
/begin CHARACTERISTIC KF_PKZU_2 "Schaltdruck zuschaltende Kupplung" MAP 0x24D1C0 kf_si16_S6_S3 12.75 UMR_BAR__1_1000_0_S6_S3 0 12.75
 /begin AXIS_DESCR STD_AXIS iSasZentr.iSchaltend.n_tkf UMR_U_MIN_32_1_0_S6_S3 8 0 8160 DEPOSIT ABSOLUTE MONOTONY MON_INCREASE /end AXIS_DESCR
 /begin AXIS_DESCR STD_AXIS zff_atsys._.iSignale._.obj.sig_m_t UMR_NM__1_1_0_S6_S3 10 -400 1640 DEPOSIT ABSOLUTE MONOTONY MON_INCREASE /end AXIS_DESCR
/end CHARACTERISTIC
/begin CHARACTERISTIC KF_TRAMTCG_2 "Kennlinie Zeit 1. Rampe der zuschaltenden Kupplung" MAP 0x24D28C kf_si16_S6_S3 2540 UMR_MSEC__10_1_0_S6_S3 0 2540
 /begin AXIS_DESCR STD_AXIS zff_atsys._.iSignale._.obj.sig_m_t UMR_NM__1_1_0_S6_S3 4 -400 1640 DEPOSIT ABSOLUTE MONOTONY MON_INCREASE /end AXIS_DESCR
 /begin AXIS_DESCR STD_AXIS zff_atsys._.iSignale._.obj.sig_c_getr UMR_GRADC__1_1_M40_S6_S3 4 -40 150 DEPOSIT ABSOLUTE MONOTONY MON_INCREASE /end AXIS_DESCR
/end CHARACTERISTIC
/begin CHARACTERISTIC T_SYNRAKZU_2 "Zeit vor sync. Ende Schaltdruck/Start 3. Rampe KZU" VALUE 0x26E827 kw_ui8_S6_S3 1280 UMR_MSEC__10_1_M128_S6_S3 -1280 0 /end CHARACTERISTIC
/begin CHARACTERISTIC KL_PGOKZUNAB_2 "Schaltdruckgradienten Offset f(n_ab)" CURVE 0x24D2C4 kl_si16_S6_S3 200 UMR_BAR_SEC_1_10_0_S6_S3 -100 100
 /begin AXIS_DESCR STD_AXIS zff_atsys._.iSignale._.obj.sig_n_ab UMR_U_MIN_1_1_0_S6_S3 2 0 8160 DEPOSIT ABSOLUTE MONOTONY MON_INCREASE /end AXIS_DESCR
/end CHARACTERISTIC
/begin CHARACTERISTIC KF_POMLASTCGV2_2 "Momentenabhaengiger Druckoffset in FA der 2. nichtkraftschliessende KZU" MAP 0x24D2D0 kf_si16_S6_S3 3 UMR_BAR__1_1000_0_S6_S3 0 3
 /begin AXIS_DESCR STD_AXIS NO_INPUT_QUANTITY UMR_NM__1_1_0_S6_S3 5 -400 1640 DEPOSIT ABSOLUTE MONOTONY MON_INCREASE /end AXIS_DESCR
 /begin AXIS_DESCR STD_AXIS zff_atsys._.iSignale._.obj.sig_c_getr UMR_GRADC__1_1_M40_S6_S3 4 -40 150 DEPOSIT ABSOLUTE MONOTONY MON_INCREASE /end AXIS_DESCR
/end CHARACTERISTIC
/begin CHARACTERISTIC KF_POTNDSYNV2_2 "Differenzdrehzahlabhaengiger Druckoffset in FA der 2. nichtkraftschliessende KZU" MAP 0x24D314 kf_si16_S6_S3 3 UMR_BAR__1_1000_0_S6_S3 0 3
 /begin AXIS_DESCR STD_AXIS NO_INPUT_QUANTITY UMR_MSEC__10_1_0_S6_S3 6 0 2540 DEPOSIT ABSOLUTE MONOTONY MON_INCREASE /end AXIS_DESCR
 /begin AXIS_DESCR STD_AXIS NO_INPUT_QUANTITY UMR_U_MIN_1_1_0_S6_S3 8 -8160 8160 DEPOSIT ABSOLUTE MONOTONY MON_INCREASE /end AXIS_DESCR
/end CHARACTERISTIC
/begin CHARACTERISTIC KL_FPOTNDSYNV2_2 "Temp. abhaengiger Faktor fuer Druckoffset waehrend FA 2. nichtkraftschliessende KZU" CURVE 0x24D398 kl_ui8_S6_S3 1 UMR___1_100_0_S6_S3 0 1
 /begin AXIS_DESCR STD_AXIS zff_atsys._.iSignale._.obj.sig_c_getr UMR_GRADC__1_1_M40_S6_S3 5 -40 150 DEPOSIT ABSOLUTE MONOTONY MON_INCREASE /end AXIS_DESCR
/end CHARACTERISTIC
/begin CHARACTERISTIC NS_GENDSYNIAE_2 "Drehzahlschwelle Endebedingung Fuellausgleich 2. nichtkraftschliessende KZU" VALUE 0x26DE36 kw_si16_S6_S3 8000 UMR_U_MIN_1_1_0_S6_S3 0 8000 /end CHARACTERISTIC
/begin CHARACTERISTIC T_VGEIAE_2 "Verzoegerung Drehzahlschwelle GE Hybrid" VALUE 0x26E828 kw_ui8_S6_S3 2540 UMR_MSEC__10_1_0_S6_S3 0 2540 /end CHARACTERISTIC
/begin CHARACTERISTIC KL_POLASTDKIV2_2 "Druckoffset auf Fülldruck zweites nichtkraftschließendes Schaltelement" CURVE 0x24D3A8 kl_si16_S6_S3 6 UMR_BAR__1_1000_0_S6_S3 0 6
 /begin AXIS_DESCR STD_AXIS zff_atsys._.iSignale._.obj.sig_dki UMR_PROZENT__20_51_0_S6_S3 6 0 100 DEPOSIT ABSOLUTE MONOTONY MON_INCREASE /end AXIS_DESCR
/end CHARACTERISTIC
/begin CHARACTERISTIC PG_OFV1_3 "Gradient Offset Fuelldruck 1.nicht kraftschl. Kup." VALUE 0x26E829 kw_ui8_S6_S3 5 UMR_BAR_SEC_1_10_0_S6_S3 0 5 /end CHARACTERISTIC
/begin CHARACTERISTIC KL_PGOFCGV2_3 "Gradient Offset Fuelldruck 2. nicht kraftschl. Kup." CURVE 0x24D3C4 kl_ui8_S6_S3 5 UMR_BAR_SEC_1_10_0_S6_S3 0 5
 /begin AXIS_DESCR STD_AXIS zff_atsys._.iSignale._.obj.sig_c_getr UMR_GRADC__1_1_M40_S6_S3 4 -40 150 DEPOSIT ABSOLUTE MONOTONY MON_INCREASE /end AXIS_DESCR
/end CHARACTERISTIC
/begin CHARACTERISTIC KL_PGOFMT_3 "Gradient Druckoffset Fuellphase" CURVE 0x24D3D0 kl_si16_S6_S3 200 UMR_BAR_SEC_1_10_0_S6_S3 -100 100
 /begin AXIS_DESCR STD_AXIS zff_atsys._.iSignale._.obj.sig_m_t UMR_NM__1_1_0_S6_S3 4 -400 1640 DEPOSIT ABSOLUTE MONOTONY MON_INCREASE /end AXIS_DESCR
/end CHARACTERISTIC
/begin CHARACTERISTIC KL_PORAKZU_3 "Schaltdruckoffset" CURVE 0x24D3E4 kl_si16_S6_S3 12.75 UMR_BAR__1_1000_0_S6_S3 -6.4 6.35
 /begin AXIS_DESCR STD_AXIS NO_INPUT_QUANTITY UMR_MSEC__10_1_0_S6_S3 3 0 2540 DEPOSIT ABSOLUTE MONOTONY MON_INCREASE /end AXIS_DESCR
/end CHARACTERISTIC
/begin CHARACTERISTIC KF_POFMTN_3 "Kennfeld Fuelldruckoffset(nd_syn, m_t)" MAP 0x24D3F4 kf_si16_S6_S3 12.75 UMR_BAR__1_1000_0_S6_S3 -6.4 6.35
 /begin AXIS_DESCR STD_AXIS iSasZentr.iSchaltend.nd_syn UMR_U_MIN_1_1_0_S6_S3 4 -8000 8000 DEPOSIT ABSOLUTE MONOTONY MON_INCREASE /end AXIS_DESCR
 /begin AXIS_DESCR STD_AXIS zff_atsys._.iSignale._.obj.sig_m_t UMR_NM__1_1_0_S6_S3 6 -400 1640 DEPOSIT ABSOLUTE MONOTONY MON_INCREASE /end AXIS_DESCR
/end CHARACTERISTIC
/begin CHARACTERISTIC KL_PGOKZU_3 "Druckgradient in Abhaengigkeit von m_t" CURVE 0x24D440 kl_si16_S6_S3 200 UMR_BAR_SEC_1_10_0_S6_S3 -100 100
 /begin AXIS_DESCR STD_AXIS zff_atsys._.iSignale._.obj.sig_m_t UMR_NM__1_1_0_S6_S3 6 -400 1640 DEPOSIT ABSOLUTE MONOTONY MON_INCREASE /end AXIS_DESCR
/end CHARACTERISTIC
/begin CHARACTERISTIC KL_PGRASYN_3 "Schliessrampenradient f(m_t)" CURVE 0x24D45C kl_si16_S6_S3 6553.4 UMR_BAR_SEC_1_10_0_S6_S3 -3276.7 3276.7
 /begin AXIS_DESCR STD_AXIS zff_atsys._.iSignale._.obj.sig_m_t UMR_NM__1_1_0_S6_S3 6 -400 1640 DEPOSIT ABSOLUTE MONOTONY MON_INCREASE /end AXIS_DESCR
/end CHARACTERISTIC
/begin CHARACTERISTIC KL_PGRASYNNAB_3 "Schliessrampenradient f(n_ab)" CURVE 0x24D478 kl_si16_S6_S3 200 UMR_BAR_SEC_1_10_0_S6_S3 -100 100
 /begin AXIS_DESCR STD_AXIS zff_atsys._.iSignale._.obj.sig_n_ab UMR_U_MIN_1_1_0_S6_S3 2 0 8160 DEPOSIT ABSOLUTE MONOTONY MON_INCREASE /end AXIS_DESCR
/end CHARACTERISTIC
/begin CHARACTERISTIC KL_PGRASYNV1_3 "Schliessrampenradient 1. nichtkraftschl. Kupplung" CURVE 0x24D484 kl_si16_S6_S3 1000 UMR_BAR_SEC_1_10_0_S6_S3 0 1000
 /begin AXIS_DESCR STD_AXIS zff_atsys._.iSignale._.obj.sig_m_t UMR_NM__1_1_0_S6_S3 6 -400 1640 DEPOSIT ABSOLUTE MONOTONY MON_INCREASE /end AXIS_DESCR
/end CHARACTERISTIC
/begin CHARACTERISTIC KL_PORASYNV1_3 "Schliessrampendruckoffset 1. nichtkraftschl. Kupplung" CURVE 0x24D4A0 kl_si16_S6_S3 12.75 UMR_BAR__1_1000_0_S6_S3 0 12.75
 /begin AXIS_DESCR STD_AXIS NO_INPUT_QUANTITY UMR_MSEC__10_1_0_S6_S3 3 0 2540 DEPOSIT ABSOLUTE MONOTONY MON_INCREASE /end AXIS_DESCR
/end CHARACTERISTIC
/begin CHARACTERISTIC KL_PGRASYNV2_3 "Schliessrampenradient 2. nichtkraftschl. Kupplung" CURVE 0x24D4B0 kl_si16_S6_S3 1000 UMR_BAR_SEC_1_10_0_S6_S3 0 1000
 /begin AXIS_DESCR STD_AXIS zff_atsys._.iSignale._.obj.sig_m_t UMR_NM__1_1_0_S6_S3 6 -400 1640 DEPOSIT ABSOLUTE MONOTONY MON_INCREASE /end AXIS_DESCR
/end CHARACTERISTIC
/begin CHARACTERISTIC KL_PORASYNV2_3 "Schliessrampendruckoffset 2. nichtkraftschl. Kupplung" CURVE 0x24D4CC kl_si16_S6_S3 12.75 UMR_BAR__1_1000_0_S6_S3 0 12.75
 /begin AXIS_DESCR STD_AXIS NO_INPUT_QUANTITY UMR_MSEC__10_1_0_S6_S3 3 0 2540 DEPOSIT ABSOLUTE MONOTONY MON_INCREASE /end AXIS_DESCR
/end CHARACTERISTIC
/begin CHARACTERISTIC KL_TOVKZUCG_3 "Offset auf Verzoegerungszeit kraftschliessende KZU" CURVE 0x24D4DC kl_ui8_S6_S3 2540 UMR_MSEC__10_1_0_S6_S3 0 2540
 /begin AXIS_DESCR STD_AXIS zff_atsys._.iSignale._.obj.sig_c_getr UMR_GRADC__1_1_M40_S6_S3 4 -40 150 DEPOSIT ABSOLUTE MONOTONY MON_INCREASE /end AXIS_DESCR
/end CHARACTERISTIC
/begin CHARACTERISTIC KL_TVKZU_3 "Verzoegerungszeit kraftschliessende KZU" CURVE 0x24D4E8 kl_ui16_S6_S3 2540 UMR_MSEC__10_1_0_S6_S3 0 2540
 /begin AXIS_DESCR STD_AXIS zff_atsys._.iSignale._.obj.sig_n_ab UMR_U_MIN_1_1_0_S6_S3 4 0 8160 DEPOSIT ABSOLUTE MONOTONY MON_INCREASE /end AXIS_DESCR
/end CHARACTERISTIC
/begin CHARACTERISTIC KL_TVKZUCGV2_3 "Verzoegerungszeit 2. nichtkraftschliessende KZU" CURVE 0x24D4FC kl_ui8_S6_S3 2540 UMR_MSEC__10_1_0_S6_S3 0 2540
 /begin AXIS_DESCR STD_AXIS zff_atsys._.iSignale._.obj.sig_c_getr UMR_GRADC__1_1_M40_S6_S3 4 -40 150 DEPOSIT ABSOLUTE MONOTONY MON_INCREASE /end AXIS_DESCR
/end CHARACTERISTIC
/begin CHARACTERISTIC T_VKZUV2_3 "Verzoegerungszeit 2. nicht kraftschliessende KZU" VALUE 0x26E82A kw_ui8_S6_S3 2540 UMR_MSEC__10_1_0_S6_S3 0 2540 /end CHARACTERISTIC
/begin CHARACTERISTIC KL_TFCGGE_3 "Fuellzeit" CURVE 0x24D508 kl_ui8_S6_S3 2540 UMR_MSEC__10_1_0_S6_S3 0 2540
 /begin AXIS_DESCR STD_AXIS zff_atsys._.iSignale._.obj.sig_c_getr UMR_GRADC__1_1_M40_S6_S3 10 -40 210 DEPOSIT ABSOLUTE MONOTONY MON_INCREASE /end AXIS_DESCR
/end CHARACTERISTIC
/begin CHARACTERISTIC KL_TFV1_3 "Fuellzeit GE 1. nicht kraftschl. Kupplung" CURVE 0x24D520 kl_ui16_S6_S3 2540 UMR_MSEC__10_1_0_S6_S3 0 2540
 /begin AXIS_DESCR STD_AXIS zff_atsys._.iSignale._.obj.sig_n_ab UMR_U_MIN_1_1_0_S6_S3 4 0 8160 DEPOSIT ABSOLUTE MONOTONY MON_INCREASE /end AXIS_DESCR
/end CHARACTERISTIC
/begin CHARACTERISTIC KL_TFCGV2_3 "Fuellzeit GE 2. nicht kraftschl. Kupplung" CURVE 0x24D534 kl_ui8_S6_S3 2540 UMR_MSEC__10_1_0_S6_S3 0 2540
 /begin AXIS_DESCR STD_AXIS zff_atsys._.iSignale._.obj.sig_c_getr UMR_GRADC__1_1_M40_S6_S3 4 -40 210 DEPOSIT ABSOLUTE MONOTONY MON_INCREASE /end AXIS_DESCR
/end CHARACTERISTIC
/begin CHARACTERISTIC T_SYN_3 "Verweilzeit in Synchron zum Start Max.Rampe" VALUE 0x26E82B kw_ui8_S6_S3 2540 UMR_MSEC__10_1_0_S6_S3 0 2540 /end CHARACTERISTIC
/begin CHARACTERISTIC KL_POFCG_3 "Kennlinie Fuelldruckoffset" CURVE 0x24D540 kl_si16_S6_S3 12.75 UMR_BAR__1_1000_0_S6_S3 -6.4 6.35
 /begin AXIS_DESCR STD_AXIS zff_atsys._.iSignale._.obj.sig_c_getr UMR_GRADC__1_1_M40_S6_S3 10 -40 150 DEPOSIT ABSOLUTE MONOTONY MON_INCREASE /end AXIS_DESCR
/end CHARACTERISTIC
/begin CHARACTERISTIC KL_POFCGV1_3 "Kennlinie Fuelldruckoffset" CURVE 0x24D56C kl_si16_S6_S3 12.75 UMR_BAR__1_1000_0_S6_S3 -6.4 6.35
 /begin AXIS_DESCR STD_AXIS zff_atsys._.iSignale._.obj.sig_c_getr UMR_GRADC__1_1_M40_S6_S3 10 -40 150 DEPOSIT ABSOLUTE MONOTONY MON_INCREASE /end AXIS_DESCR
/end CHARACTERISTIC
/begin CHARACTERISTIC KL_POFCGV2_3 "Kennlinie Fuelldruckoffset" CURVE 0x24D598 kl_si16_S6_S3 12.75 UMR_BAR__1_1000_0_S6_S3 -6.4 6.35
 /begin AXIS_DESCR STD_AXIS zff_atsys._.iSignale._.obj.sig_c_getr UMR_GRADC__1_1_M40_S6_S3 10 -40 150 DEPOSIT ABSOLUTE MONOTONY MON_INCREASE /end AXIS_DESCR
/end CHARACTERISTIC
/begin CHARACTERISTIC KL_POKZUCG_3 "Schaltdruckoffset" CURVE 0x24D5C4 kl_si16_S6_S3 12.75 UMR_BAR__1_1000_0_S6_S3 -6.4 6.35
 /begin AXIS_DESCR STD_AXIS zff_atsys._.iSignale._.obj.sig_c_getr UMR_GRADC__1_1_M40_S6_S3 10 -40 150 DEPOSIT ABSOLUTE MONOTONY MON_INCREASE /end AXIS_DESCR
/end CHARACTERISTIC
/begin CHARACTERISTIC KL_PORASYN_3 "Rampe n.Syn.->letz.Stuetz.y PMAX" CURVE 0x24D5F0 kl_si16_S6_S3 12.75 UMR_BAR__1_1000_0_S6_S3 0 12.75
 /begin AXIS_DESCR STD_AXIS NO_INPUT_QUANTITY UMR_MSEC__10_1_0_S6_S3 3 0 2540 DEPOSIT ABSOLUTE MONOTONY MON_INCREASE /end AXIS_DESCR
/end CHARACTERISTIC
/begin CHARACTERISTIC KF_PKZU_3 "Schaltdruck zuschaltende Kupplung" MAP 0x24D600 kf_si16_S6_S3 12.75 UMR_BAR__1_1000_0_S6_S3 0 12.75
 /begin AXIS_DESCR STD_AXIS iSasZentr.iSchaltend.n_tkf UMR_U_MIN_32_1_0_S6_S3 8 0 8160 DEPOSIT ABSOLUTE MONOTONY MON_INCREASE /end AXIS_DESCR
 /begin AXIS_DESCR STD_AXIS zff_atsys._.iSignale._.obj.sig_m_t UMR_NM__1_1_0_S6_S3 10 -400 1640 DEPOSIT ABSOLUTE MONOTONY MON_INCREASE /end AXIS_DESCR
/end CHARACTERISTIC
/begin CHARACTERISTIC KF_TRAMTCG_3 "Kennlinie Zeit 1. Rampe der zuschaltenden Kupplung" MAP 0x24D6CC kf_si16_S6_S3 2540 UMR_MSEC__10_1_0_S6_S3 0 2540
 /begin AXIS_DESCR STD_AXIS zff_atsys._.iSignale._.obj.sig_m_t UMR_NM__1_1_0_S6_S3 4 -400 1640 DEPOSIT ABSOLUTE MONOTONY MON_INCREASE /end AXIS_DESCR
 /begin AXIS_DESCR STD_AXIS zff_atsys._.iSignale._.obj.sig_c_getr UMR_GRADC__1_1_M40_S6_S3 4 -40 150 DEPOSIT ABSOLUTE MONOTONY MON_INCREASE /end AXIS_DESCR
/end CHARACTERISTIC
/begin CHARACTERISTIC T_SYNRAKZU_3 "Zeit vor sync. Ende Schaltdruck/Start 3. Rampe KZU" VALUE 0x26E82C kw_ui8_S6_S3 1280 UMR_MSEC__10_1_M128_S6_S3 -1280 0 /end CHARACTERISTIC
/begin CHARACTERISTIC KL_PGOKZUNAB_3 "Schaltdruckgradienten Offset f(n_ab)" CURVE 0x24D704 kl_si16_S6_S3 200 UMR_BAR_SEC_1_10_0_S6_S3 -100 100
 /begin AXIS_DESCR STD_AXIS zff_atsys._.iSignale._.obj.sig_n_ab UMR_U_MIN_1_1_0_S6_S3 2 0 8160 DEPOSIT ABSOLUTE MONOTONY MON_INCREASE /end AXIS_DESCR
/end CHARACTERISTIC
/begin CHARACTERISTIC KF_POMLASTCGV2_3 "Momentenabhaengiger Druckoffset in FA der 2. nichtkraftschliessende KZU" MAP 0x24D710 kf_si16_S6_S3 3 UMR_BAR__1_1000_0_S6_S3 0 3
 /begin AXIS_DESCR STD_AXIS NO_INPUT_QUANTITY UMR_NM__1_1_0_S6_S3 5 -400 1640 DEPOSIT ABSOLUTE MONOTONY MON_INCREASE /end AXIS_DESCR
 /begin AXIS_DESCR STD_AXIS zff_atsys._.iSignale._.obj.sig_c_getr UMR_GRADC__1_1_M40_S6_S3 4 -40 150 DEPOSIT ABSOLUTE MONOTONY MON_INCREASE /end AXIS_DESCR
/end CHARACTERISTIC
/begin CHARACTERISTIC KF_POTNDSYNV2_3 "Differenzdrehzahlabhaengiger Druckoffset in FA der 2. nichtkraftschliessende KZU" MAP 0x24D754 kf_si16_S6_S3 3 UMR_BAR__1_1000_0_S6_S3 0 3
 /begin AXIS_DESCR STD_AXIS NO_INPUT_QUANTITY UMR_MSEC__10_1_0_S6_S3 6 0 2540 DEPOSIT ABSOLUTE MONOTONY MON_INCREASE /end AXIS_DESCR
 /begin AXIS_DESCR STD_AXIS NO_INPUT_QUANTITY UMR_U_MIN_1_1_0_S6_S3 8 -8160 8160 DEPOSIT ABSOLUTE MONOTONY MON_INCREASE /end AXIS_DESCR
/end CHARACTERISTIC
/begin CHARACTERISTIC KL_FPOTNDSYNV2_3 "Temp. abhaengiger Faktor fuer Druckoffset waehrend FA 2. nichtkraftschliessende KZU" CURVE 0x24D7D8 kl_ui8_S6_S3 1 UMR___1_100_0_S6_S3 0 1
 /begin AXIS_DESCR STD_AXIS zff_atsys._.iSignale._.obj.sig_c_getr UMR_GRADC__1_1_M40_S6_S3 5 -40 150 DEPOSIT ABSOLUTE MONOTONY MON_INCREASE /end AXIS_DESCR
/end CHARACTERISTIC
/begin CHARACTERISTIC NS_GENDSYNIAE_3 "Drehzahlschwelle Endebedingung Fuellausgleich 2. nichtkraftschliessende KZU" VALUE 0x26DE38 kw_si16_S6_S3 8000 UMR_U_MIN_1_1_0_S6_S3 0 8000 /end CHARACTERISTIC
/begin CHARACTERISTIC T_VGEIAE_3 "Verzoegerung Drehzahlschwelle GE Hybrid" VALUE 0x26E82D kw_ui8_S6_S3 2540 UMR_MSEC__10_1_0_S6_S3 0 2540 /end CHARACTERISTIC
/begin CHARACTERISTIC KL_POLASTDKIV2_3 "Druckoffset auf Fülldruck zweites nichtkraftschließendes Schaltelement" CURVE 0x24D7E8 kl_si16_S6_S3 6 UMR_BAR__1_1000_0_S6_S3 0 6
 /begin AXIS_DESCR STD_AXIS zff_atsys._.iSignale._.obj.sig_dki UMR_PROZENT__20_51_0_S6_S3 6 0 100 DEPOSIT ABSOLUTE MONOTONY MON_INCREASE /end AXIS_DESCR
/end CHARACTERISTIC
/begin CHARACTERISTIC PG_OFV1_4 "Gradient Offset Fuelldruck 1.nicht kraftschl. Kup." VALUE 0x26E82E kw_ui8_S6_S3 5 UMR_BAR_SEC_1_10_0_S6_S3 0 5 /end CHARACTERISTIC
/begin CHARACTERISTIC KL_PGOFCGV2_4 "Gradient Offset Fuelldruck 2. nicht kraftschl. Kup." CURVE 0x24D804 kl_ui8_S6_S3 5 UMR_BAR_SEC_1_10_0_S6_S3 0 5
 /begin AXIS_DESCR STD_AXIS zff_atsys._.iSignale._.obj.sig_c_getr UMR_GRADC__1_1_M40_S6_S3 4 -40 150 DEPOSIT ABSOLUTE MONOTONY MON_INCREASE /end AXIS_DESCR
/end CHARACTERISTIC
/begin CHARACTERISTIC KL_PGOFMT_4 "Gradient Druckoffset Fuellphase" CURVE 0x24D810 kl_si16_S6_S3 200 UMR_BAR_SEC_1_10_0_S6_S3 -100 100
 /begin AXIS_DESCR STD_AXIS zff_atsys._.iSignale._.obj.sig_m_t UMR_NM__1_1_0_S6_S3 4 -400 1640 DEPOSIT ABSOLUTE MONOTONY MON_INCREASE /end AXIS_DESCR
/end CHARACTERISTIC
/begin CHARACTERISTIC KL_PORAKZU_4 "Schaltdruckoffset" CURVE 0x24D824 kl_si16_S6_S3 12.75 UMR_BAR__1_1000_0_S6_S3 -6.4 6.35
 /begin AXIS_DESCR STD_AXIS NO_INPUT_QUANTITY UMR_MSEC__10_1_0_S6_S3 3 0 2540 DEPOSIT ABSOLUTE MONOTONY MON_INCREASE /end AXIS_DESCR
/end CHARACTERISTIC
/begin CHARACTERISTIC KF_POFMTN_4 "Kennfeld Fuelldruckoffset(nd_syn, m_t)" MAP 0x24D834 kf_si16_S6_S3 12.75 UMR_BAR__1_1000_0_S6_S3 -6.4 6.35
 /begin AXIS_DESCR STD_AXIS iSasZentr.iSchaltend.nd_syn UMR_U_MIN_1_1_0_S6_S3 4 -8000 8000 DEPOSIT ABSOLUTE MONOTONY MON_INCREASE /end AXIS_DESCR
 /begin AXIS_DESCR STD_AXIS zff_atsys._.iSignale._.obj.sig_m_t UMR_NM__1_1_0_S6_S3 6 -400 1640 DEPOSIT ABSOLUTE MONOTONY MON_INCREASE /end AXIS_DESCR
/end CHARACTERISTIC
/begin CHARACTERISTIC KL_PGOKZU_4 "Druckgradient in Abhaengigkeit von m_t" CURVE 0x24D880 kl_si16_S6_S3 200 UMR_BAR_SEC_1_10_0_S6_S3 -100 100
 /begin AXIS_DESCR STD_AXIS zff_atsys._.iSignale._.obj.sig_m_t UMR_NM__1_1_0_S6_S3 6 -400 1640 DEPOSIT ABSOLUTE MONOTONY MON_INCREASE /end AXIS_DESCR
/end CHARACTERISTIC
/begin CHARACTERISTIC KL_PGRASYN_4 "Schliessrampenradient f(m_t)" CURVE 0x24D89C kl_si16_S6_S3 6553.4 UMR_BAR_SEC_1_10_0_S6_S3 -3276.7 3276.7
 /begin AXIS_DESCR STD_AXIS zff_atsys._.iSignale._.obj.sig_m_t UMR_NM__1_1_0_S6_S3 6 -400 1640 DEPOSIT ABSOLUTE MONOTONY MON_INCREASE /end AXIS_DESCR
/end CHARACTERISTIC
/begin CHARACTERISTIC KL_PGRASYNNAB_4 "Schliessrampenradient f(n_ab)" CURVE 0x24D8B8 kl_si16_S6_S3 200 UMR_BAR_SEC_1_10_0_S6_S3 -100 100
 /begin AXIS_DESCR STD_AXIS zff_atsys._.iSignale._.obj.sig_n_ab UMR_U_MIN_1_1_0_S6_S3 2 0 8160 DEPOSIT ABSOLUTE MONOTONY MON_INCREASE /end AXIS_DESCR
/end CHARACTERISTIC
/begin CHARACTERISTIC KL_PGRASYNV1_4 "Schliessrampenradient 1. nichtkraftschl. Kupplung" CURVE 0x24D8C4 kl_si16_S6_S3 1000 UMR_BAR_SEC_1_10_0_S6_S3 0 1000
 /begin AXIS_DESCR STD_AXIS zff_atsys._.iSignale._.obj.sig_m_t UMR_NM__1_1_0_S6_S3 6 -400 1640 DEPOSIT ABSOLUTE MONOTONY MON_INCREASE /end AXIS_DESCR
/end CHARACTERISTIC
/begin CHARACTERISTIC KL_PORASYNV1_4 "Schliessrampendruckoffset 1. nichtkraftschl. Kupplung" CURVE 0x24D8E0 kl_si16_S6_S3 12.75 UMR_BAR__1_1000_0_S6_S3 0 12.75
 /begin AXIS_DESCR STD_AXIS NO_INPUT_QUANTITY UMR_MSEC__10_1_0_S6_S3 3 0 2540 DEPOSIT ABSOLUTE MONOTONY MON_INCREASE /end AXIS_DESCR
/end CHARACTERISTIC
/begin CHARACTERISTIC KL_PGRASYNV2_4 "Schliessrampenradient 2. nichtkraftschl. Kupplung" CURVE 0x24D8F0 kl_si16_S6_S3 1000 UMR_BAR_SEC_1_10_0_S6_S3 0 1000
 /begin AXIS_DESCR STD_AXIS zff_atsys._.iSignale._.obj.sig_m_t UMR_NM__1_1_0_S6_S3 6 -400 1640 DEPOSIT ABSOLUTE MONOTONY MON_INCREASE /end AXIS_DESCR
/end CHARACTERISTIC
/begin CHARACTERISTIC KL_PORASYNV2_4 "Schliessrampendruckoffset 2. nichtkraftschl. Kupplung" CURVE 0x24D90C kl_si16_S6_S3 12.75 UMR_BAR__1_1000_0_S6_S3 0 12.75
 /begin AXIS_DESCR STD_AXIS NO_INPUT_QUANTITY UMR_MSEC__10_1_0_S6_S3 3 0 2540 DEPOSIT ABSOLUTE MONOTONY MON_INCREASE /end AXIS_DESCR
/end CHARACTERISTIC
/begin CHARACTERISTIC KL_TOVKZUCG_4 "Offset auf Verzoegerungszeit kraftschliessende KZU" CURVE 0x24D91C kl_ui8_S6_S3 2540 UMR_MSEC__10_1_0_S6_S3 0 2540
 /begin AXIS_DESCR STD_AXIS zff_atsys._.iSignale._.obj.sig_c_getr UMR_GRADC__1_1_M40_S6_S3 4 -40 150 DEPOSIT ABSOLUTE MONOTONY MON_INCREASE /end AXIS_DESCR
/end CHARACTERISTIC
/begin CHARACTERISTIC KL_TVKZU_4 "Verzoegerungszeit kraftschliessende KZU" CURVE 0x24D928 kl_ui16_S6_S3 2540 UMR_MSEC__10_1_0_S6_S3 0 2540
 /begin AXIS_DESCR STD_AXIS zff_atsys._.iSignale._.obj.sig_n_ab UMR_U_MIN_1_1_0_S6_S3 4 0 8160 DEPOSIT ABSOLUTE MONOTONY MON_INCREASE /end AXIS_DESCR
/end CHARACTERISTIC
/begin CHARACTERISTIC KL_TVKZUCGV2_4 "Verzoegerungszeit 2. nichtkraftschliessende KZU" CURVE 0x24D93C kl_ui8_S6_S3 2540 UMR_MSEC__10_1_0_S6_S3 0 2540
 /begin AXIS_DESCR STD_AXIS zff_atsys._.iSignale._.obj.sig_c_getr UMR_GRADC__1_1_M40_S6_S3 4 -40 150 DEPOSIT ABSOLUTE MONOTONY MON_INCREASE /end AXIS_DESCR
/end CHARACTERISTIC
/begin CHARACTERISTIC T_VKZUV2_4 "Verzoegerungszeit 2. nicht kraftschliessende KZU" VALUE 0x26E82F kw_ui8_S6_S3 2540 UMR_MSEC__10_1_0_S6_S3 0 2540 /end CHARACTERISTIC
/begin CHARACTERISTIC KL_TFCGGE_4 "Fuellzeit" CURVE 0x24D948 kl_ui8_S6_S3 2540 UMR_MSEC__10_1_0_S6_S3 0 2540
 /begin AXIS_DESCR STD_AXIS zff_atsys._.iSignale._.obj.sig_c_getr UMR_GRADC__1_1_M40_S6_S3 10 -40 210 DEPOSIT ABSOLUTE MONOTONY MON_INCREASE /end AXIS_DESCR
/end CHARACTERISTIC
/begin CHARACTERISTIC KL_TFV1_4 "Fuellzeit GE 1. nicht kraftschl. Kupplung" CURVE 0x24D960 kl_ui16_S6_S3 2540 UMR_MSEC__10_1_0_S6_S3 0 2540
 /begin AXIS_DESCR STD_AXIS zff_atsys._.iSignale._.obj.sig_n_ab UMR_U_MIN_1_1_0_S6_S3 4 0 8160 DEPOSIT ABSOLUTE MONOTONY MON_INCREASE /end AXIS_DESCR
/end CHARACTERISTIC
/begin CHARACTERISTIC KL_TFCGV2_4 "Fuellzeit GE 2. nicht kraftschl. Kupplung" CURVE 0x24D974 kl_ui8_S6_S3 2540 UMR_MSEC__10_1_0_S6_S3 0 2540
 /begin AXIS_DESCR STD_AXIS zff_atsys._.iSignale._.obj.sig_c_getr UMR_GRADC__1_1_M40_S6_S3 4 -40 210 DEPOSIT ABSOLUTE MONOTONY MON_INCREASE /end AXIS_DESCR
/end CHARACTERISTIC
/begin CHARACTERISTIC T_SYN_4 "Verweilzeit in Synchron zum Start Max.Rampe" VALUE 0x26E830 kw_ui8_S6_S3 2540 UMR_MSEC__10_1_0_S6_S3 0 2540 /end CHARACTERISTIC
/begin CHARACTERISTIC KL_POFCG_4 "Kennlinie Fuelldruckoffset" CURVE 0x24D980 kl_si16_S6_S3 12.75 UMR_BAR__1_1000_0_S6_S3 -6.4 6.35
 /begin AXIS_DESCR STD_AXIS zff_atsys._.iSignale._.obj.sig_c_getr UMR_GRADC__1_1_M40_S6_S3 10 -40 150 DEPOSIT ABSOLUTE MONOTONY MON_INCREASE /end AXIS_DESCR
/end CHARACTERISTIC
/begin CHARACTERISTIC KL_POFCGV1_4 "Kennlinie Fuelldruckoffset" CURVE 0x24D9AC kl_si16_S6_S3 12.75 UMR_BAR__1_1000_0_S6_S3 -6.4 6.35
 /begin AXIS_DESCR STD_AXIS zff_atsys._.iSignale._.obj.sig_c_getr UMR_GRADC__1_1_M40_S6_S3 10 -40 150 DEPOSIT ABSOLUTE MONOTONY MON_INCREASE /end AXIS_DESCR
/end CHARACTERISTIC
/begin CHARACTERISTIC KL_POFCGV2_4 "Kennlinie Fuelldruckoffset" CURVE 0x24D9D8 kl_si16_S6_S3 12.75 UMR_BAR__1_1000_0_S6_S3 -6.4 6.35
 /begin AXIS_DESCR STD_AXIS zff_atsys._.iSignale._.obj.sig_c_getr UMR_GRADC__1_1_M40_S6_S3 10 -40 150 DEPOSIT ABSOLUTE MONOTONY MON_INCREASE /end AXIS_DESCR
/end CHARACTERISTIC
/begin CHARACTERISTIC KL_POKZUCG_4 "Schaltdruckoffset" CURVE 0x24DA04 kl_si16_S6_S3 12.75 UMR_BAR__1_1000_0_S6_S3 -6.4 6.35
 /begin AXIS_DESCR STD_AXIS zff_atsys._.iSignale._.obj.sig_c_getr UMR_GRADC__1_1_M40_S6_S3 10 -40 150 DEPOSIT ABSOLUTE MONOTONY MON_INCREASE /end AXIS_DESCR
/end CHARACTERISTIC
/begin CHARACTERISTIC KL_PORASYN_4 "Rampe n.Syn.->letz.Stuetz.y PMAX" CURVE 0x24DA30 kl_si16_S6_S3 12.75 UMR_BAR__1_1000_0_S6_S3 0 12.75
 /begin AXIS_DESCR STD_AXIS NO_INPUT_QUANTITY UMR_MSEC__10_1_0_S6_S3 3 0 2540 DEPOSIT ABSOLUTE MONOTONY MON_INCREASE /end AXIS_DESCR
/end CHARACTERISTIC
/begin CHARACTERISTIC KF_PKZU_4 "Schaltdruck zuschaltende Kupplung" MAP 0x24DA40 kf_si16_S6_S3 12.75 UMR_BAR__1_1000_0_S6_S3 0 12.75
 /begin AXIS_DESCR STD_AXIS iSasZentr.iSchaltend.n_tkf UMR_U_MIN_32_1_0_S6_S3 8 0 8160 DEPOSIT ABSOLUTE MONOTONY MON_INCREASE /end AXIS_DESCR
 /begin AXIS_DESCR STD_AXIS zff_atsys._.iSignale._.obj.sig_m_t UMR_NM__1_1_0_S6_S3 10 -400 1640 DEPOSIT ABSOLUTE MONOTONY MON_INCREASE /end AXIS_DESCR
/end CHARACTERISTIC
/begin CHARACTERISTIC KF_TRAMTCG_4 "Kennlinie Zeit 1. Rampe der zuschaltenden Kupplung" MAP 0x24DB0C kf_si16_S6_S3 2540 UMR_MSEC__10_1_0_S6_S3 0 2540
 /begin AXIS_DESCR STD_AXIS zff_atsys._.iSignale._.obj.sig_m_t UMR_NM__1_1_0_S6_S3 4 -400 1640 DEPOSIT ABSOLUTE MONOTONY MON_INCREASE /end AXIS_DESCR
 /begin AXIS_DESCR STD_AXIS zff_atsys._.iSignale._.obj.sig_c_getr UMR_GRADC__1_1_M40_S6_S3 4 -40 150 DEPOSIT ABSOLUTE MONOTONY MON_INCREASE /end AXIS_DESCR
/end CHARACTERISTIC
/begin CHARACTERISTIC T_SYNRAKZU_4 "Zeit vor sync. Ende Schaltdruck/Start 3. Rampe KZU" VALUE 0x26E831 kw_ui8_S6_S3 1280 UMR_MSEC__10_1_M128_S6_S3 -1280 0 /end CHARACTERISTIC
/begin CHARACTERISTIC KL_PGOKZUNAB_4 "Schaltdruckgradienten Offset f(n_ab)" CURVE 0x24DB44 kl_si16_S6_S3 200 UMR_BAR_SEC_1_10_0_S6_S3 -100 100
 /begin AXIS_DESCR STD_AXIS zff_atsys._.iSignale._.obj.sig_n_ab UMR_U_MIN_1_1_0_S6_S3 2 0 8160 DEPOSIT ABSOLUTE MONOTONY MON_INCREASE /end AXIS_DESCR
/end CHARACTERISTIC
/begin CHARACTERISTIC KF_POMLASTCGV2_4 "Momentenabhaengiger Druckoffset in FA der 2. nichtkraftschliessende KZU" MAP 0x24DB50 kf_si16_S6_S3 3 UMR_BAR__1_1000_0_S6_S3 0 3
 /begin AXIS_DESCR STD_AXIS NO_INPUT_QUANTITY UMR_NM__1_1_0_S6_S3 5 -400 1640 DEPOSIT ABSOLUTE MONOTONY MON_INCREASE /end AXIS_DESCR
 /begin AXIS_DESCR STD_AXIS zff_atsys._.iSignale._.obj.sig_c_getr UMR_GRADC__1_1_M40_S6_S3 4 -40 150 DEPOSIT ABSOLUTE MONOTONY MON_INCREASE /end AXIS_DESCR
/end CHARACTERISTIC
/begin CHARACTERISTIC KF_POTNDSYNV2_4 "Differenzdrehzahlabhaengiger Druckoffset in FA der 2. nichtkraftschliessende KZU" MAP 0x24DB94 kf_si16_S6_S3 3 UMR_BAR__1_1000_0_S6_S3 0 3
 /begin AXIS_DESCR STD_AXIS NO_INPUT_QUANTITY UMR_MSEC__10_1_0_S6_S3 6 0 2540 DEPOSIT ABSOLUTE MONOTONY MON_INCREASE /end AXIS_DESCR
 /begin AXIS_DESCR STD_AXIS NO_INPUT_QUANTITY UMR_U_MIN_1_1_0_S6_S3 8 -8160 8160 DEPOSIT ABSOLUTE MONOTONY MON_INCREASE /end AXIS_DESCR
/end CHARACTERISTIC
/begin CHARACTERISTIC KL_FPOTNDSYNV2_4 "Temp. abhaengiger Faktor fuer Druckoffset waehrend FA 2. nichtkraftschliessende KZU" CURVE 0x24DC18 kl_ui8_S6_S3 1 UMR___1_100_0_S6_S3 0 1
 /begin AXIS_DESCR STD_AXIS zff_atsys._.iSignale._.obj.sig_c_getr UMR_GRADC__1_1_M40_S6_S3 5 -40 150 DEPOSIT ABSOLUTE MONOTONY MON_INCREASE /end AXIS_DESCR
/end CHARACTERISTIC
/begin CHARACTERISTIC NS_GENDSYNIAE_4 "Drehzahlschwelle Endebedingung Fuellausgleich 2. nichtkraftschliessende KZU" VALUE 0x26DE3A kw_si16_S6_S3 8000 UMR_U_MIN_1_1_0_S6_S3 0 8000 /end CHARACTERISTIC
/begin CHARACTERISTIC T_VGEIAE_4 "Verzoegerung Drehzahlschwelle GE Hybrid" VALUE 0x26E832 kw_ui8_S6_S3 2540 UMR_MSEC__10_1_0_S6_S3 0 2540 /end CHARACTERISTIC
/begin CHARACTERISTIC KL_POLASTDKIV2_4 "Druckoffset auf Fülldruck zweites nichtkraftschließendes Schaltelement" CURVE 0x24DC28 kl_si16_S6_S3 6 UMR_BAR__1_1000_0_S6_S3 0 6
 /begin AXIS_DESCR STD_AXIS zff_atsys._.iSignale._.obj.sig_dki UMR_PROZENT__20_51_0_S6_S3 6 0 100 DEPOSIT ABSOLUTE MONOTONY MON_INCREASE /end AXIS_DESCR
/end CHARACTERISTIC
/begin CHARACTERISTIC PG_OFV1_5 "Gradient Offset Fuelldruck 1.nicht kraftschl. Kup." VALUE 0x26E833 kw_ui8_S6_S3 5 UMR_BAR_SEC_1_10_0_S6_S3 0 5 /end CHARACTERISTIC
/begin CHARACTERISTIC KL_PGOFCGV2_5 "Gradient Offset Fuelldruck 2. nicht kraftschl. Kup." CURVE 0x24DC44 kl_ui8_S6_S3 5 UMR_BAR_SEC_1_10_0_S6_S3 0 5
 /begin AXIS_DESCR STD_AXIS zff_atsys._.iSignale._.obj.sig_c_getr UMR_GRADC__1_1_M40_S6_S3 4 -40 150 DEPOSIT ABSOLUTE MONOTONY MON_INCREASE /end AXIS_DESCR
/end CHARACTERISTIC
/begin CHARACTERISTIC KL_PGOFMT_5 "Gradient Druckoffset Fuellphase" CURVE 0x24DC50 kl_si16_S6_S3 200 UMR_BAR_SEC_1_10_0_S6_S3 -100 100
 /begin AXIS_DESCR STD_AXIS zff_atsys._.iSignale._.obj.sig_m_t UMR_NM__1_1_0_S6_S3 4 -400 1640 DEPOSIT ABSOLUTE MONOTONY MON_INCREASE /end AXIS_DESCR
/end CHARACTERISTIC
/begin CHARACTERISTIC KL_PORAKZU_5 "Schaltdruckoffset" CURVE 0x24DC64 kl_si16_S6_S3 12.75 UMR_BAR__1_1000_0_S6_S3 -6.4 6.35
 /begin AXIS_DESCR STD_AXIS NO_INPUT_QUANTITY UMR_MSEC__10_1_0_S6_S3 3 0 2540 DEPOSIT ABSOLUTE MONOTONY MON_INCREASE /end AXIS_DESCR
/end CHARACTERISTIC
/begin CHARACTERISTIC KF_POFMTN_5 "Kennfeld Fuelldruckoffset(nd_syn, m_t)" MAP 0x24DC74 kf_si16_S6_S3 12.75 UMR_BAR__1_1000_0_S6_S3 -6.4 6.35
 /begin AXIS_DESCR STD_AXIS iSasZentr.iSchaltend.nd_syn UMR_U_MIN_1_1_0_S6_S3 4 -8000 8000 DEPOSIT ABSOLUTE MONOTONY MON_INCREASE /end AXIS_DESCR
 /begin AXIS_DESCR STD_AXIS zff_atsys._.iSignale._.obj.sig_m_t UMR_NM__1_1_0_S6_S3 6 -400 1640 DEPOSIT ABSOLUTE MONOTONY MON_INCREASE /end AXIS_DESCR
/end CHARACTERISTIC
/begin CHARACTERISTIC KL_PGOKZU_5 "Druckgradient in Abhaengigkeit von m_t" CURVE 0x24DCC0 kl_si16_S6_S3 200 UMR_BAR_SEC_1_10_0_S6_S3 -100 100
 /begin AXIS_DESCR STD_AXIS zff_atsys._.iSignale._.obj.sig_m_t UMR_NM__1_1_0_S6_S3 6 -400 1640 DEPOSIT ABSOLUTE MONOTONY MON_INCREASE /end AXIS_DESCR
/end CHARACTERISTIC
/begin CHARACTERISTIC KL_PGRASYN_5 "Schliessrampenradient f(m_t)" CURVE 0x24DCDC kl_si16_S6_S3 6553.4 UMR_BAR_SEC_1_10_0_S6_S3 -3276.7 3276.7
 /begin AXIS_DESCR STD_AXIS zff_atsys._.iSignale._.obj.sig_m_t UMR_NM__1_1_0_S6_S3 6 -400 1640 DEPOSIT ABSOLUTE MONOTONY MON_INCREASE /end AXIS_DESCR
/end CHARACTERISTIC
/begin CHARACTERISTIC KL_PGRASYNNAB_5 "Schliessrampenradient f(n_ab)" CURVE 0x24DCF8 kl_si16_S6_S3 200 UMR_BAR_SEC_1_10_0_S6_S3 -100 100
 /begin AXIS_DESCR STD_AXIS zff_atsys._.iSignale._.obj.sig_n_ab UMR_U_MIN_1_1_0_S6_S3 2 0 8160 DEPOSIT ABSOLUTE MONOTONY MON_INCREASE /end AXIS_DESCR
/end CHARACTERISTIC
/begin CHARACTERISTIC KL_PGRASYNV1_5 "Schliessrampenradient 1. nichtkraftschl. Kupplung" CURVE 0x24DD04 kl_si16_S6_S3 1000 UMR_BAR_SEC_1_10_0_S6_S3 0 1000
 /begin AXIS_DESCR STD_AXIS zff_atsys._.iSignale._.obj.sig_m_t UMR_NM__1_1_0_S6_S3 6 -400 1640 DEPOSIT ABSOLUTE MONOTONY MON_INCREASE /end AXIS_DESCR
/end CHARACTERISTIC
/begin CHARACTERISTIC KL_PORASYNV1_5 "Schliessrampendruckoffset 1. nichtkraftschl. Kupplung" CURVE 0x24DD20 kl_si16_S6_S3 12.75 UMR_BAR__1_1000_0_S6_S3 0 12.75
 /begin AXIS_DESCR STD_AXIS NO_INPUT_QUANTITY UMR_MSEC__10_1_0_S6_S3 3 0 2540 DEPOSIT ABSOLUTE MONOTONY MON_INCREASE /end AXIS_DESCR
/end CHARACTERISTIC
/begin CHARACTERISTIC KL_PGRASYNV2_5 "Schliessrampenradient 2. nichtkraftschl. Kupplung" CURVE 0x24DD30 kl_si16_S6_S3 1000 UMR_BAR_SEC_1_10_0_S6_S3 0 1000
 /begin AXIS_DESCR STD_AXIS zff_atsys._.iSignale._.obj.sig_m_t UMR_NM__1_1_0_S6_S3 6 -400 1640 DEPOSIT ABSOLUTE MONOTONY MON_INCREASE /end AXIS_DESCR
/end CHARACTERISTIC
/begin CHARACTERISTIC KL_PORASYNV2_5 "Schliessrampendruckoffset 2. nichtkraftschl. Kupplung" CURVE 0x24DD4C kl_si16_S6_S3 12.75 UMR_BAR__1_1000_0_S6_S3 0 12.75
 /begin AXIS_DESCR STD_AXIS NO_INPUT_QUANTITY UMR_MSEC__10_1_0_S6_S3 3 0 2540 DEPOSIT ABSOLUTE MONOTONY MON_INCREASE /end AXIS_DESCR
/end CHARACTERISTIC
/begin CHARACTERISTIC KL_TOVKZUCG_5 "Offset auf Verzoegerungszeit kraftschliessende KZU" CURVE 0x24DD5C kl_ui8_S6_S3 2540 UMR_MSEC__10_1_0_S6_S3 0 2540
 /begin AXIS_DESCR STD_AXIS zff_atsys._.iSignale._.obj.sig_c_getr UMR_GRADC__1_1_M40_S6_S3 4 -40 150 DEPOSIT ABSOLUTE MONOTONY MON_INCREASE /end AXIS_DESCR
/end CHARACTERISTIC
/begin CHARACTERISTIC KL_TVKZU_5 "Verzoegerungszeit kraftschliessende KZU" CURVE 0x24DD68 kl_ui16_S6_S3 2540 UMR_MSEC__10_1_0_S6_S3 0 2540
 /begin AXIS_DESCR STD_AXIS zff_atsys._.iSignale._.obj.sig_n_ab UMR_U_MIN_1_1_0_S6_S3 4 0 8160 DEPOSIT ABSOLUTE MONOTONY MON_INCREASE /end AXIS_DESCR
/end CHARACTERISTIC
/begin CHARACTERISTIC KL_TVKZUCGV2_5 "Verzoegerungszeit 2. nichtkraftschliessende KZU" CURVE 0x24DD7C kl_ui8_S6_S3 2540 UMR_MSEC__10_1_0_S6_S3 0 2540
 /begin AXIS_DESCR STD_AXIS zff_atsys._.iSignale._.obj.sig_c_getr UMR_GRADC__1_1_M40_S6_S3 4 -40 150 DEPOSIT ABSOLUTE MONOTONY MON_INCREASE /end AXIS_DESCR
/end CHARACTERISTIC
/begin CHARACTERISTIC T_VKZUV2_5 "Verzoegerungszeit 2. nicht kraftschliessende KZU" VALUE 0x26E834 kw_ui8_S6_S3 2540 UMR_MSEC__10_1_0_S6_S3 0 2540 /end CHARACTERISTIC
/begin CHARACTERISTIC KL_TFCGGE_5 "Fuellzeit" CURVE 0x24DD88 kl_ui8_S6_S3 2540 UMR_MSEC__10_1_0_S6_S3 0 2540
 /begin AXIS_DESCR STD_AXIS zff_atsys._.iSignale._.obj.sig_c_getr UMR_GRADC__1_1_M40_S6_S3 10 -40 210 DEPOSIT ABSOLUTE MONOTONY MON_INCREASE /end AXIS_DESCR
/end CHARACTERISTIC
/begin CHARACTERISTIC KL_TFV1_5 "Fuellzeit GE 1. nicht kraftschl. Kupplung" CURVE 0x24DDA0 kl_ui16_S6_S3 2540 UMR_MSEC__10_1_0_S6_S3 0 2540
 /begin AXIS_DESCR STD_AXIS zff_atsys._.iSignale._.obj.sig_n_ab UMR_U_MIN_1_1_0_S6_S3 4 0 8160 DEPOSIT ABSOLUTE MONOTONY MON_INCREASE /end AXIS_DESCR
/end CHARACTERISTIC
/begin CHARACTERISTIC KL_TFCGV2_5 "Fuellzeit GE 2. nicht kraftschl. Kupplung" CURVE 0x24DDB4 kl_ui8_S6_S3 2540 UMR_MSEC__10_1_0_S6_S3 0 2540
 /begin AXIS_DESCR STD_AXIS zff_atsys._.iSignale._.obj.sig_c_getr UMR_GRADC__1_1_M40_S6_S3 4 -40 210 DEPOSIT ABSOLUTE MONOTONY MON_INCREASE /end AXIS_DESCR
/end CHARACTERISTIC
/begin CHARACTERISTIC T_SYN_5 "Verweilzeit in Synchron zum Start Max.Rampe" VALUE 0x26E835 kw_ui8_S6_S3 2540 UMR_MSEC__10_1_0_S6_S3 0 2540 /end CHARACTERISTIC
/begin CHARACTERISTIC KL_POFCG_5 "Kennlinie Fuelldruckoffset" CURVE 0x24DDC0 kl_si16_S6_S3 12.75 UMR_BAR__1_1000_0_S6_S3 -6.4 6.35
 /begin AXIS_DESCR STD_AXIS zff_atsys._.iSignale._.obj.sig_c_getr UMR_GRADC__1_1_M40_S6_S3 10 -40 150 DEPOSIT ABSOLUTE MONOTONY MON_INCREASE /end AXIS_DESCR
/end CHARACTERISTIC
/begin CHARACTERISTIC KL_POFCGV1_5 "Kennlinie Fuelldruckoffset" CURVE 0x24DDEC kl_si16_S6_S3 12.75 UMR_BAR__1_1000_0_S6_S3 -6.4 6.35
 /begin AXIS_DESCR STD_AXIS zff_atsys._.iSignale._.obj.sig_c_getr UMR_GRADC__1_1_M40_S6_S3 10 -40 150 DEPOSIT ABSOLUTE MONOTONY MON_INCREASE /end AXIS_DESCR
/end CHARACTERISTIC
/begin CHARACTERISTIC KL_POFCGV2_5 "Kennlinie Fuelldruckoffset" CURVE 0x24DE18 kl_si16_S6_S3 12.75 UMR_BAR__1_1000_0_S6_S3 -6.4 6.35
 /begin AXIS_DESCR STD_AXIS zff_atsys._.iSignale._.obj.sig_c_getr UMR_GRADC__1_1_M40_S6_S3 10 -40 150 DEPOSIT ABSOLUTE MONOTONY MON_INCREASE /end AXIS_DESCR
/end CHARACTERISTIC
/begin CHARACTERISTIC KL_POKZUCG_5 "Schaltdruckoffset" CURVE 0x24DE44 kl_si16_S6_S3 12.75 UMR_BAR__1_1000_0_S6_S3 -6.4 6.35
 /begin AXIS_DESCR STD_AXIS zff_atsys._.iSignale._.obj.sig_c_getr UMR_GRADC__1_1_M40_S6_S3 10 -40 150 DEPOSIT ABSOLUTE MONOTONY MON_INCREASE /end AXIS_DESCR
/end CHARACTERISTIC
/begin CHARACTERISTIC KL_PORASYN_5 "Rampe n.Syn.->letz.Stuetz.y PMAX" CURVE 0x24DE70 kl_si16_S6_S3 12.75 UMR_BAR__1_1000_0_S6_S3 0 12.75
 /begin AXIS_DESCR STD_AXIS NO_INPUT_QUANTITY UMR_MSEC__10_1_0_S6_S3 3 0 2540 DEPOSIT ABSOLUTE MONOTONY MON_INCREASE /end AXIS_DESCR
/end CHARACTERISTIC
/begin CHARACTERISTIC KF_PKZU_5 "Schaltdruck zuschaltende Kupplung" MAP 0x24DE80 kf_si16_S6_S3 12.75 UMR_BAR__1_1000_0_S6_S3 0 12.75
 /begin AXIS_DESCR STD_AXIS iSasZentr.iSchaltend.n_tkf UMR_U_MIN_32_1_0_S6_S3 8 0 8160 DEPOSIT ABSOLUTE MONOTONY MON_INCREASE /end AXIS_DESCR
 /begin AXIS_DESCR STD_AXIS zff_atsys._.iSignale._.obj.sig_m_t UMR_NM__1_1_0_S6_S3 10 -400 1640 DEPOSIT ABSOLUTE MONOTONY MON_INCREASE /end AXIS_DESCR
/end CHARACTERISTIC
/begin CHARACTERISTIC KF_TRAMTCG_5 "Kennlinie Zeit 1. Rampe der zuschaltenden Kupplung" MAP 0x24DF4C kf_si16_S6_S3 2540 UMR_MSEC__10_1_0_S6_S3 0 2540
 /begin AXIS_DESCR STD_AXIS zff_atsys._.iSignale._.obj.sig_m_t UMR_NM__1_1_0_S6_S3 4 -400 1640 DEPOSIT ABSOLUTE MONOTONY MON_INCREASE /end AXIS_DESCR
 /begin AXIS_DESCR STD_AXIS zff_atsys._.iSignale._.obj.sig_c_getr UMR_GRADC__1_1_M40_S6_S3 4 -40 150 DEPOSIT ABSOLUTE MONOTONY MON_INCREASE /end AXIS_DESCR
/end CHARACTERISTIC
/begin CHARACTERISTIC T_SYNRAKZU_5 "Zeit vor sync. Ende Schaltdruck/Start 3. Rampe KZU" VALUE 0x26E836 kw_ui8_S6_S3 1280 UMR_MSEC__10_1_M128_S6_S3 -1280 0 /end CHARACTERISTIC
/begin CHARACTERISTIC KL_PGOKZUNAB_5 "Schaltdruckgradienten Offset f(n_ab)" CURVE 0x24DF84 kl_si16_S6_S3 200 UMR_BAR_SEC_1_10_0_S6_S3 -100 100
 /begin AXIS_DESCR STD_AXIS zff_atsys._.iSignale._.obj.sig_n_ab UMR_U_MIN_1_1_0_S6_S3 2 0 8160 DEPOSIT ABSOLUTE MONOTONY MON_INCREASE /end AXIS_DESCR
/end CHARACTERISTIC
/begin CHARACTERISTIC KF_POMLASTCGV2_5 "Momentenabhaengiger Druckoffset in FA der 2. nichtkraftschliessende KZU" MAP 0x24DF90 kf_si16_S6_S3 3 UMR_BAR__1_1000_0_S6_S3 0 3
 /begin AXIS_DESCR STD_AXIS NO_INPUT_QUANTITY UMR_NM__1_1_0_S6_S3 5 -400 1640 DEPOSIT ABSOLUTE MONOTONY MON_INCREASE /end AXIS_DESCR
 /begin AXIS_DESCR STD_AXIS zff_atsys._.iSignale._.obj.sig_c_getr UMR_GRADC__1_1_M40_S6_S3 4 -40 150 DEPOSIT ABSOLUTE MONOTONY MON_INCREASE /end AXIS_DESCR
/end CHARACTERISTIC
/begin CHARACTERISTIC KF_POTNDSYNV2_5 "Differenzdrehzahlabhaengiger Druckoffset in FA der 2. nichtkraftschliessende KZU" MAP 0x24DFD4 kf_si16_S6_S3 3 UMR_BAR__1_1000_0_S6_S3 0 3
 /begin AXIS_DESCR STD_AXIS NO_INPUT_QUANTITY UMR_MSEC__10_1_0_S6_S3 6 0 2540 DEPOSIT ABSOLUTE MONOTONY MON_INCREASE /end AXIS_DESCR
 /begin AXIS_DESCR STD_AXIS NO_INPUT_QUANTITY UMR_U_MIN_1_1_0_S6_S3 8 -8160 8160 DEPOSIT ABSOLUTE MONOTONY MON_INCREASE /end AXIS_DESCR
/end CHARACTERISTIC
/begin CHARACTERISTIC KL_FPOTNDSYNV2_5 "Temp. abhaengiger Faktor fuer Druckoffset waehrend FA 2. nichtkraftschliessende KZU" CURVE 0x24E058 kl_ui8_S6_S3 1 UMR___1_100_0_S6_S3 0 1
 /begin AXIS_DESCR STD_AXIS zff_atsys._.iSignale._.obj.sig_c_getr UMR_GRADC__1_1_M40_S6_S3 5 -40 150 DEPOSIT ABSOLUTE MONOTONY MON_INCREASE /end AXIS_DESCR
/end CHARACTERISTIC
/begin CHARACTERISTIC NS_GENDSYNIAE_5 "Drehzahlschwelle Endebedingung Fuellausgleich 2. nichtkraftschliessende KZU" VALUE 0x26DE3C kw_si16_S6_S3 8000 UMR_U_MIN_1_1_0_S6_S3 0 8000 /end CHARACTERISTIC
/begin CHARACTERISTIC T_VGEIAE_5 "Verzoegerung Drehzahlschwelle GE Hybrid" VALUE 0x26E837 kw_ui8_S6_S3 2540 UMR_MSEC__10_1_0_S6_S3 0 2540 /end CHARACTERISTIC
/begin CHARACTERISTIC KL_POLASTDKIV2_5 "Druckoffset auf Fülldruck zweites nichtkraftschließendes Schaltelement" CURVE 0x24E068 kl_si16_S6_S3 6 UMR_BAR__1_1000_0_S6_S3 0 6
 /begin AXIS_DESCR STD_AXIS zff_atsys._.iSignale._.obj.sig_dki UMR_PROZENT__20_51_0_S6_S3 6 0 100 DEPOSIT ABSOLUTE MONOTONY MON_INCREASE /end AXIS_DESCR
/end CHARACTERISTIC
/begin CHARACTERISTIC PG_OFV1_6 "Gradient Offset Fuelldruck 1.nicht kraftschl. Kup." VALUE 0x26E838 kw_ui8_S6_S3 5 UMR_BAR_SEC_1_10_0_S6_S3 0 5 /end CHARACTERISTIC
/begin CHARACTERISTIC KL_PGOFCGV2_6 "Gradient Offset Fuelldruck 2. nicht kraftschl. Kup." CURVE 0x24E084 kl_ui8_S6_S3 5 UMR_BAR_SEC_1_10_0_S6_S3 0 5
 /begin AXIS_DESCR STD_AXIS zff_atsys._.iSignale._.obj.sig_c_getr UMR_GRADC__1_1_M40_S6_S3 4 -40 150 DEPOSIT ABSOLUTE MONOTONY MON_INCREASE /end AXIS_DESCR
/end CHARACTERISTIC
/begin CHARACTERISTIC KL_PGOFMT_6 "Gradient Druckoffset Fuellphase" CURVE 0x24E090 kl_si16_S6_S3 200 UMR_BAR_SEC_1_10_0_S6_S3 -100 100
 /begin AXIS_DESCR STD_AXIS zff_atsys._.iSignale._.obj.sig_m_t UMR_NM__1_1_0_S6_S3 4 -400 1640 DEPOSIT ABSOLUTE MONOTONY MON_INCREASE /end AXIS_DESCR
/end CHARACTERISTIC
/begin CHARACTERISTIC KL_PORAKZU_6 "Schaltdruckoffset" CURVE 0x24E0A4 kl_si16_S6_S3 12.75 UMR_BAR__1_1000_0_S6_S3 -6.4 6.35
 /begin AXIS_DESCR STD_AXIS NO_INPUT_QUANTITY UMR_MSEC__10_1_0_S6_S3 3 0 2540 DEPOSIT ABSOLUTE MONOTONY MON_INCREASE /end AXIS_DESCR
/end CHARACTERISTIC
/begin CHARACTERISTIC KF_POFMTN_6 "Kennfeld Fuelldruckoffset(nd_syn, m_t)" MAP 0x24E0B4 kf_si16_S6_S3 12.75 UMR_BAR__1_1000_0_S6_S3 -6.4 6.35
 /begin AXIS_DESCR STD_AXIS iSasZentr.iSchaltend.nd_syn UMR_U_MIN_1_1_0_S6_S3 4 -8000 8000 DEPOSIT ABSOLUTE MONOTONY MON_INCREASE /end AXIS_DESCR
 /begin AXIS_DESCR STD_AXIS zff_atsys._.iSignale._.obj.sig_m_t UMR_NM__1_1_0_S6_S3 6 -400 1640 DEPOSIT ABSOLUTE MONOTONY MON_INCREASE /end AXIS_DESCR
/end CHARACTERISTIC
/begin CHARACTERISTIC KL_PGOKZU_6 "Druckgradient in Abhaengigkeit von m_t" CURVE 0x24E100 kl_si16_S6_S3 200 UMR_BAR_SEC_1_10_0_S6_S3 -100 100
 /begin AXIS_DESCR STD_AXIS zff_atsys._.iSignale._.obj.sig_m_t UMR_NM__1_1_0_S6_S3 6 -400 1640 DEPOSIT ABSOLUTE MONOTONY MON_INCREASE /end AXIS_DESCR
/end CHARACTERISTIC
/begin CHARACTERISTIC KL_PGRASYN_6 "Schliessrampenradient f(m_t)" CURVE 0x24E11C kl_si16_S6_S3 6553.4 UMR_BAR_SEC_1_10_0_S6_S3 -3276.7 3276.7
 /begin AXIS_DESCR STD_AXIS zff_atsys._.iSignale._.obj.sig_m_t UMR_NM__1_1_0_S6_S3 6 -400 1640 DEPOSIT ABSOLUTE MONOTONY MON_INCREASE /end AXIS_DESCR
/end CHARACTERISTIC
/begin CHARACTERISTIC KL_PGRASYNNAB_6 "Schliessrampenradient f(n_ab)" CURVE 0x24E138 kl_si16_S6_S3 200 UMR_BAR_SEC_1_10_0_S6_S3 -100 100
 /begin AXIS_DESCR STD_AXIS zff_atsys._.iSignale._.obj.sig_n_ab UMR_U_MIN_1_1_0_S6_S3 2 0 8160 DEPOSIT ABSOLUTE MONOTONY MON_INCREASE /end AXIS_DESCR
/end CHARACTERISTIC
/begin CHARACTERISTIC KL_PGRASYNV1_6 "Schliessrampenradient 1. nichtkraftschl. Kupplung" CURVE 0x24E144 kl_si16_S6_S3 1000 UMR_BAR_SEC_1_10_0_S6_S3 0 1000
 /begin AXIS_DESCR STD_AXIS zff_atsys._.iSignale._.obj.sig_m_t UMR_NM__1_1_0_S6_S3 6 -400 1640 DEPOSIT ABSOLUTE MONOTONY MON_INCREASE /end AXIS_DESCR
/end CHARACTERISTIC
/begin CHARACTERISTIC KL_PORASYNV1_6 "Schliessrampendruckoffset 1. nichtkraftschl. Kupplung" CURVE 0x24E160 kl_si16_S6_S3 12.75 UMR_BAR__1_1000_0_S6_S3 0 12.75
 /begin AXIS_DESCR STD_AXIS NO_INPUT_QUANTITY UMR_MSEC__10_1_0_S6_S3 3 0 2540 DEPOSIT ABSOLUTE MONOTONY MON_INCREASE /end AXIS_DESCR
/end CHARACTERISTIC
/begin CHARACTERISTIC KL_PGRASYNV2_6 "Schliessrampenradient 2. nichtkraftschl. Kupplung" CURVE 0x24E170 kl_si16_S6_S3 1000 UMR_BAR_SEC_1_10_0_S6_S3 0 1000
 /begin AXIS_DESCR STD_AXIS zff_atsys._.iSignale._.obj.sig_m_t UMR_NM__1_1_0_S6_S3 6 -400 1640 DEPOSIT ABSOLUTE MONOTONY MON_INCREASE /end AXIS_DESCR
/end CHARACTERISTIC
/begin CHARACTERISTIC KL_PORASYNV2_6 "Schliessrampendruckoffset 2. nichtkraftschl. Kupplung" CURVE 0x24E18C kl_si16_S6_S3 12.75 UMR_BAR__1_1000_0_S6_S3 0 12.75
 /begin AXIS_DESCR STD_AXIS NO_INPUT_QUANTITY UMR_MSEC__10_1_0_S6_S3 3 0 2540 DEPOSIT ABSOLUTE MONOTONY MON_INCREASE /end AXIS_DESCR
/end CHARACTERISTIC
/begin CHARACTERISTIC KL_TOVKZUCG_6 "Offset auf Verzoegerungszeit kraftschliessende KZU" CURVE 0x24E19C kl_ui8_S6_S3 2540 UMR_MSEC__10_1_0_S6_S3 0 2540
 /begin AXIS_DESCR STD_AXIS zff_atsys._.iSignale._.obj.sig_c_getr UMR_GRADC__1_1_M40_S6_S3 4 -40 150 DEPOSIT ABSOLUTE MONOTONY MON_INCREASE /end AXIS_DESCR
/end CHARACTERISTIC
/begin CHARACTERISTIC KL_TVKZU_6 "Verzoegerungszeit kraftschliessende KZU" CURVE 0x24E1A8 kl_ui16_S6_S3 2540 UMR_MSEC__10_1_0_S6_S3 0 2540
 /begin AXIS_DESCR STD_AXIS zff_atsys._.iSignale._.obj.sig_n_ab UMR_U_MIN_1_1_0_S6_S3 4 0 8160 DEPOSIT ABSOLUTE MONOTONY MON_INCREASE /end AXIS_DESCR
/end CHARACTERISTIC
/begin CHARACTERISTIC KL_TVKZUCGV2_6 "Verzoegerungszeit 2. nichtkraftschliessende KZU" CURVE 0x24E1BC kl_ui8_S6_S3 2540 UMR_MSEC__10_1_0_S6_S3 0 2540
 /begin AXIS_DESCR STD_AXIS zff_atsys._.iSignale._.obj.sig_c_getr UMR_GRADC__1_1_M40_S6_S3 4 -40 150 DEPOSIT ABSOLUTE MONOTONY MON_INCREASE /end AXIS_DESCR
/end CHARACTERISTIC
/begin CHARACTERISTIC T_VKZUV2_6 "Verzoegerungszeit 2. nicht kraftschliessende KZU" VALUE 0x26E839 kw_ui8_S6_S3 2540 UMR_MSEC__10_1_0_S6_S3 0 2540 /end CHARACTERISTIC
/begin CHARACTERISTIC KL_TFCGGE_6 "Fuellzeit" CURVE 0x24E1C8 kl_ui8_S6_S3 2540 UMR_MSEC__10_1_0_S6_S3 0 2540
 /begin AXIS_DESCR STD_AXIS zff_atsys._.iSignale._.obj.sig_c_getr UMR_GRADC__1_1_M40_S6_S3 10 -40 210 DEPOSIT ABSOLUTE MONOTONY MON_INCREASE /end AXIS_DESCR
/end CHARACTERISTIC
/begin CHARACTERISTIC KL_TFV1_6 "Fuellzeit GE 1. nicht kraftschl. Kupplung" CURVE 0x24E1E0 kl_ui16_S6_S3 2540 UMR_MSEC__10_1_0_S6_S3 0 2540
 /begin AXIS_DESCR STD_AXIS zff_atsys._.iSignale._.obj.sig_n_ab UMR_U_MIN_1_1_0_S6_S3 4 0 8160 DEPOSIT ABSOLUTE MONOTONY MON_INCREASE /end AXIS_DESCR
/end CHARACTERISTIC
/begin CHARACTERISTIC KL_TFCGV2_6 "Fuellzeit GE 2. nicht kraftschl. Kupplung" CURVE 0x24E1F4 kl_ui8_S6_S3 2540 UMR_MSEC__10_1_0_S6_S3 0 2540
 /begin AXIS_DESCR STD_AXIS zff_atsys._.iSignale._.obj.sig_c_getr UMR_GRADC__1_1_M40_S6_S3 4 -40 210 DEPOSIT ABSOLUTE MONOTONY MON_INCREASE /end AXIS_DESCR
/end CHARACTERISTIC
/begin CHARACTERISTIC T_SYN_6 "Verweilzeit in Synchron zum Start Max.Rampe" VALUE 0x26E83A kw_ui8_S6_S3 2540 UMR_MSEC__10_1_0_S6_S3 0 2540 /end CHARACTERISTIC
/begin CHARACTERISTIC KL_POFCG_6 "Kennlinie Fuelldruckoffset" CURVE 0x24E200 kl_si16_S6_S3 12.75 UMR_BAR__1_1000_0_S6_S3 -6.4 6.35
 /begin AXIS_DESCR STD_AXIS zff_atsys._.iSignale._.obj.sig_c_getr UMR_GRADC__1_1_M40_S6_S3 10 -40 150 DEPOSIT ABSOLUTE MONOTONY MON_INCREASE /end AXIS_DESCR
/end CHARACTERISTIC
/begin CHARACTERISTIC KL_POFCGV1_6 "Kennlinie Fuelldruckoffset" CURVE 0x24E22C kl_si16_S6_S3 12.75 UMR_BAR__1_1000_0_S6_S3 -6.4 6.35
 /begin AXIS_DESCR STD_AXIS zff_atsys._.iSignale._.obj.sig_c_getr UMR_GRADC__1_1_M40_S6_S3 10 -40 150 DEPOSIT ABSOLUTE MONOTONY MON_INCREASE /end AXIS_DESCR
/end CHARACTERISTIC
/begin CHARACTERISTIC KL_POFCGV2_6 "Kennlinie Fuelldruckoffset" CURVE 0x24E258 kl_si16_S6_S3 12.75 UMR_BAR__1_1000_0_S6_S3 -6.4 6.35
 /begin AXIS_DESCR STD_AXIS zff_atsys._.iSignale._.obj.sig_c_getr UMR_GRADC__1_1_M40_S6_S3 10 -40 150 DEPOSIT ABSOLUTE MONOTONY MON_INCREASE /end AXIS_DESCR
/end CHARACTERISTIC
/begin CHARACTERISTIC KL_POKZUCG_6 "Schaltdruckoffset" CURVE 0x24E284 kl_si16_S6_S3 12.75 UMR_BAR__1_1000_0_S6_S3 -6.4 6.35
 /begin AXIS_DESCR STD_AXIS zff_atsys._.iSignale._.obj.sig_c_getr UMR_GRADC__1_1_M40_S6_S3 10 -40 150 DEPOSIT ABSOLUTE MONOTONY MON_INCREASE /end AXIS_DESCR
/end CHARACTERISTIC
/begin CHARACTERISTIC KL_PORASYN_6 "Rampe n.Syn.->letz.Stuetz.y PMAX" CURVE 0x24E2B0 kl_si16_S6_S3 12.75 UMR_BAR__1_1000_0_S6_S3 0 12.75
 /begin AXIS_DESCR STD_AXIS NO_INPUT_QUANTITY UMR_MSEC__10_1_0_S6_S3 3 0 2540 DEPOSIT ABSOLUTE MONOTONY MON_INCREASE /end AXIS_DESCR
/end CHARACTERISTIC
/begin CHARACTERISTIC KF_PKZU_6 "Schaltdruck zuschaltende Kupplung" MAP 0x24E2C0 kf_si16_S6_S3 12.75 UMR_BAR__1_1000_0_S6_S3 0 12.75
 /begin AXIS_DESCR STD_AXIS iSasZentr.iSchaltend.n_tkf UMR_U_MIN_32_1_0_S6_S3 8 0 8160 DEPOSIT ABSOLUTE MONOTONY MON_INCREASE /end AXIS_DESCR
 /begin AXIS_DESCR STD_AXIS zff_atsys._.iSignale._.obj.sig_m_t UMR_NM__1_1_0_S6_S3 10 -400 1640 DEPOSIT ABSOLUTE MONOTONY MON_INCREASE /end AXIS_DESCR
/end CHARACTERISTIC
/begin CHARACTERISTIC KF_TRAMTCG_6 "Kennlinie Zeit 1. Rampe der zuschaltenden Kupplung" MAP 0x24E38C kf_si16_S6_S3 2540 UMR_MSEC__10_1_0_S6_S3 0 2540
 /begin AXIS_DESCR STD_AXIS zff_atsys._.iSignale._.obj.sig_m_t UMR_NM__1_1_0_S6_S3 4 -400 1640 DEPOSIT ABSOLUTE MONOTONY MON_INCREASE /end AXIS_DESCR
 /begin AXIS_DESCR STD_AXIS zff_atsys._.iSignale._.obj.sig_c_getr UMR_GRADC__1_1_M40_S6_S3 4 -40 150 DEPOSIT ABSOLUTE MONOTONY MON_INCREASE /end AXIS_DESCR
/end CHARACTERISTIC
/begin CHARACTERISTIC T_SYNRAKZU_6 "Zeit vor sync. Ende Schaltdruck/Start 3. Rampe KZU" VALUE 0x26E83B kw_ui8_S6_S3 1280 UMR_MSEC__10_1_M128_S6_S3 -1280 0 /end CHARACTERISTIC
/begin CHARACTERISTIC KL_PGOKZUNAB_6 "Schaltdruckgradienten Offset f(n_ab)" CURVE 0x24E3C4 kl_si16_S6_S3 200 UMR_BAR_SEC_1_10_0_S6_S3 -100 100
 /begin AXIS_DESCR STD_AXIS zff_atsys._.iSignale._.obj.sig_n_ab UMR_U_MIN_1_1_0_S6_S3 2 0 8160 DEPOSIT ABSOLUTE MONOTONY MON_INCREASE /end AXIS_DESCR
/end CHARACTERISTIC
/begin CHARACTERISTIC KF_POMLASTCGV2_6 "Momentenabhaengiger Druckoffset in FA der 2. nichtkraftschliessende KZU" MAP 0x24E3D0 kf_si16_S6_S3 3 UMR_BAR__1_1000_0_S6_S3 0 3
 /begin AXIS_DESCR STD_AXIS NO_INPUT_QUANTITY UMR_NM__1_1_0_S6_S3 5 -400 1640 DEPOSIT ABSOLUTE MONOTONY MON_INCREASE /end AXIS_DESCR
 /begin AXIS_DESCR STD_AXIS zff_atsys._.iSignale._.obj.sig_c_getr UMR_GRADC__1_1_M40_S6_S3 4 -40 150 DEPOSIT ABSOLUTE MONOTONY MON_INCREASE /end AXIS_DESCR
/end CHARACTERISTIC
/begin CHARACTERISTIC KF_POTNDSYNV2_6 "Differenzdrehzahlabhaengiger Druckoffset in FA der 2. nichtkraftschliessende KZU" MAP 0x24E414 kf_si16_S6_S3 3 UMR_BAR__1_1000_0_S6_S3 0 3
 /begin AXIS_DESCR STD_AXIS NO_INPUT_QUANTITY UMR_MSEC__10_1_0_S6_S3 6 0 2540 DEPOSIT ABSOLUTE MONOTONY MON_INCREASE /end AXIS_DESCR
 /begin AXIS_DESCR STD_AXIS NO_INPUT_QUANTITY UMR_U_MIN_1_1_0_S6_S3 8 -8160 8160 DEPOSIT ABSOLUTE MONOTONY MON_INCREASE /end AXIS_DESCR
/end CHARACTERISTIC
/begin CHARACTERISTIC KL_FPOTNDSYNV2_6 "Temp. abhaengiger Faktor fuer Druckoffset waehrend FA 2. nichtkraftschliessende KZU" CURVE 0x24E498 kl_ui8_S6_S3 1 UMR___1_100_0_S6_S3 0 1
 /begin AXIS_DESCR STD_AXIS zff_atsys._.iSignale._.obj.sig_c_getr UMR_GRADC__1_1_M40_S6_S3 5 -40 150 DEPOSIT ABSOLUTE MONOTONY MON_INCREASE /end AXIS_DESCR
/end CHARACTERISTIC
/begin CHARACTERISTIC NS_GENDSYNIAE_6 "Drehzahlschwelle Endebedingung Fuellausgleich 2. nichtkraftschliessende KZU" VALUE 0x26DE3E kw_si16_S6_S3 8000 UMR_U_MIN_1_1_0_S6_S3 0 8000 /end CHARACTERISTIC
/begin CHARACTERISTIC T_VGEIAE_6 "Verzoegerung Drehzahlschwelle GE Hybrid" VALUE 0x26E83C kw_ui8_S6_S3 2540 UMR_MSEC__10_1_0_S6_S3 0 2540 /end CHARACTERISTIC
/begin CHARACTERISTIC KL_POLASTDKIV2_6 "Druckoffset auf Fülldruck zweites nichtkraftschließendes Schaltelement" CURVE 0x24E4A8 kl_si16_S6_S3 6 UMR_BAR__1_1000_0_S6_S3 0 6
 /begin AXIS_DESCR STD_AXIS zff_atsys._.iSignale._.obj.sig_dki UMR_PROZENT__20_51_0_S6_S3 6 0 100 DEPOSIT ABSOLUTE MONOTONY MON_INCREASE /end AXIS_DESCR
/end CHARACTERISTIC
/begin CHARACTERISTIC PG_OFV1_7 "Gradient Offset Fuelldruck 1.nicht kraftschl. Kup." VALUE 0x26E83D kw_ui8_S6_S3 5 UMR_BAR_SEC_1_10_0_S6_S3 0 5 /end CHARACTERISTIC
/begin CHARACTERISTIC KL_PGOFCGV2_7 "Gradient Offset Fuelldruck 2. nicht kraftschl. Kup." CURVE 0x24E4C4 kl_ui8_S6_S3 5 UMR_BAR_SEC_1_10_0_S6_S3 0 5
 /begin AXIS_DESCR STD_AXIS zff_atsys._.iSignale._.obj.sig_c_getr UMR_GRADC__1_1_M40_S6_S3 4 -40 150 DEPOSIT ABSOLUTE MONOTONY MON_INCREASE /end AXIS_DESCR
/end CHARACTERISTIC
/begin CHARACTERISTIC KL_PGOFMT_7 "Gradient Druckoffset Fuellphase" CURVE 0x24E4D0 kl_si16_S6_S3 200 UMR_BAR_SEC_1_10_0_S6_S3 -100 100
 /begin AXIS_DESCR STD_AXIS zff_atsys._.iSignale._.obj.sig_m_t UMR_NM__1_1_0_S6_S3 4 -400 1640 DEPOSIT ABSOLUTE MONOTONY MON_INCREASE /end AXIS_DESCR
/end CHARACTERISTIC
/begin CHARACTERISTIC KL_PORAKZU_7 "Schaltdruckoffset" CURVE 0x24E4E4 kl_si16_S6_S3 12.75 UMR_BAR__1_1000_0_S6_S3 -6.4 6.35
 /begin AXIS_DESCR STD_AXIS NO_INPUT_QUANTITY UMR_MSEC__10_1_0_S6_S3 3 0 2540 DEPOSIT ABSOLUTE MONOTONY MON_INCREASE /end AXIS_DESCR
/end CHARACTERISTIC
/begin CHARACTERISTIC KF_POFMTN_7 "Kennfeld Fuelldruckoffset(nd_syn, m_t)" MAP 0x24E4F4 kf_si16_S6_S3 12.75 UMR_BAR__1_1000_0_S6_S3 -6.4 6.35
 /begin AXIS_DESCR STD_AXIS iSasZentr.iSchaltend.nd_syn UMR_U_MIN_1_1_0_S6_S3 4 -8000 8000 DEPOSIT ABSOLUTE MONOTONY MON_INCREASE /end AXIS_DESCR
 /begin AXIS_DESCR STD_AXIS zff_atsys._.iSignale._.obj.sig_m_t UMR_NM__1_1_0_S6_S3 6 -400 1640 DEPOSIT ABSOLUTE MONOTONY MON_INCREASE /end AXIS_DESCR
/end CHARACTERISTIC
/begin CHARACTERISTIC KL_PGOKZU_7 "Druckgradient in Abhaengigkeit von m_t" CURVE 0x24E540 kl_si16_S6_S3 200 UMR_BAR_SEC_1_10_0_S6_S3 -100 100
 /begin AXIS_DESCR STD_AXIS zff_atsys._.iSignale._.obj.sig_m_t UMR_NM__1_1_0_S6_S3 6 -400 1640 DEPOSIT ABSOLUTE MONOTONY MON_INCREASE /end AXIS_DESCR
/end CHARACTERISTIC
/begin CHARACTERISTIC KL_PGRASYN_7 "Schliessrampenradient f(m_t)" CURVE 0x24E55C kl_si16_S6_S3 6553.4 UMR_BAR_SEC_1_10_0_S6_S3 -3276.7 3276.7
 /begin AXIS_DESCR STD_AXIS zff_atsys._.iSignale._.obj.sig_m_t UMR_NM__1_1_0_S6_S3 6 -400 1640 DEPOSIT ABSOLUTE MONOTONY MON_INCREASE /end AXIS_DESCR
/end CHARACTERISTIC
/begin CHARACTERISTIC KL_PGRASYNNAB_7 "Schliessrampenradient f(n_ab)" CURVE 0x24E578 kl_si16_S6_S3 200 UMR_BAR_SEC_1_10_0_S6_S3 -100 100
 /begin AXIS_DESCR STD_AXIS zff_atsys._.iSignale._.obj.sig_n_ab UMR_U_MIN_1_1_0_S6_S3 2 0 8160 DEPOSIT ABSOLUTE MONOTONY MON_INCREASE /end AXIS_DESCR
/end CHARACTERISTIC
/begin CHARACTERISTIC KL_PGRASYNV1_7 "Schliessrampenradient 1. nichtkraftschl. Kupplung" CURVE 0x24E584 kl_si16_S6_S3 1000 UMR_BAR_SEC_1_10_0_S6_S3 0 1000
 /begin AXIS_DESCR STD_AXIS zff_atsys._.iSignale._.obj.sig_m_t UMR_NM__1_1_0_S6_S3 6 -400 1640 DEPOSIT ABSOLUTE MONOTONY MON_INCREASE /end AXIS_DESCR
/end CHARACTERISTIC
/begin CHARACTERISTIC KL_PORASYNV1_7 "Schliessrampendruckoffset 1. nichtkraftschl. Kupplung" CURVE 0x24E5A0 kl_si16_S6_S3 12.75 UMR_BAR__1_1000_0_S6_S3 0 12.75
 /begin AXIS_DESCR STD_AXIS NO_INPUT_QUANTITY UMR_MSEC__10_1_0_S6_S3 3 0 2540 DEPOSIT ABSOLUTE MONOTONY MON_INCREASE /end AXIS_DESCR
/end CHARACTERISTIC
/begin CHARACTERISTIC KL_PGRASYNV2_7 "Schliessrampenradient 2. nichtkraftschl. Kupplung" CURVE 0x24E5B0 kl_si16_S6_S3 1000 UMR_BAR_SEC_1_10_0_S6_S3 0 1000
 /begin AXIS_DESCR STD_AXIS zff_atsys._.iSignale._.obj.sig_m_t UMR_NM__1_1_0_S6_S3 6 -400 1640 DEPOSIT ABSOLUTE MONOTONY MON_INCREASE /end AXIS_DESCR
/end CHARACTERISTIC
/begin CHARACTERISTIC KL_PORASYNV2_7 "Schliessrampendruckoffset 2. nichtkraftschl. Kupplung" CURVE 0x24E5CC kl_si16_S6_S3 12.75 UMR_BAR__1_1000_0_S6_S3 0 12.75
 /begin AXIS_DESCR STD_AXIS NO_INPUT_QUANTITY UMR_MSEC__10_1_0_S6_S3 3 0 2540 DEPOSIT ABSOLUTE MONOTONY MON_INCREASE /end AXIS_DESCR
/end CHARACTERISTIC
/begin CHARACTERISTIC KL_TOVKZUCG_7 "Offset auf Verzoegerungszeit kraftschliessende KZU" CURVE 0x24E5DC kl_ui8_S6_S3 2540 UMR_MSEC__10_1_0_S6_S3 0 2540
 /begin AXIS_DESCR STD_AXIS zff_atsys._.iSignale._.obj.sig_c_getr UMR_GRADC__1_1_M40_S6_S3 4 -40 150 DEPOSIT ABSOLUTE MONOTONY MON_INCREASE /end AXIS_DESCR
/end CHARACTERISTIC
/begin CHARACTERISTIC KL_TVKZU_7 "Verzoegerungszeit kraftschliessende KZU" CURVE 0x24E5E8 kl_ui16_S6_S3 2540 UMR_MSEC__10_1_0_S6_S3 0 2540
 /begin AXIS_DESCR STD_AXIS zff_atsys._.iSignale._.obj.sig_n_ab UMR_U_MIN_1_1_0_S6_S3 4 0 8160 DEPOSIT ABSOLUTE MONOTONY MON_INCREASE /end AXIS_DESCR
/end CHARACTERISTIC
/begin CHARACTERISTIC KL_TVKZUCGV2_7 "Verzoegerungszeit 2. nichtkraftschliessende KZU" CURVE 0x24E5FC kl_ui8_S6_S3 2540 UMR_MSEC__10_1_0_S6_S3 0 2540
 /begin AXIS_DESCR STD_AXIS zff_atsys._.iSignale._.obj.sig_c_getr UMR_GRADC__1_1_M40_S6_S3 4 -40 150 DEPOSIT ABSOLUTE MONOTONY MON_INCREASE /end AXIS_DESCR
/end CHARACTERISTIC
/begin CHARACTERISTIC T_VKZUV2_7 "Verzoegerungszeit 2. nicht kraftschliessende KZU" VALUE 0x26E83E kw_ui8_S6_S3 2540 UMR_MSEC__10_1_0_S6_S3 0 2540 /end CHARACTERISTIC
/begin CHARACTERISTIC KL_TFCGGE_7 "Fuellzeit" CURVE 0x24E608 kl_ui8_S6_S3 2540 UMR_MSEC__10_1_0_S6_S3 0 2540
 /begin AXIS_DESCR STD_AXIS zff_atsys._.iSignale._.obj.sig_c_getr UMR_GRADC__1_1_M40_S6_S3 10 -40 210 DEPOSIT ABSOLUTE MONOTONY MON_INCREASE /end AXIS_DESCR
/end CHARACTERISTIC
/begin CHARACTERISTIC KL_TFV1_7 "Fuellzeit GE 1. nicht kraftschl. Kupplung" CURVE 0x24E620 kl_ui16_S6_S3 2540 UMR_MSEC__10_1_0_S6_S3 0 2540
 /begin AXIS_DESCR STD_AXIS zff_atsys._.iSignale._.obj.sig_n_ab UMR_U_MIN_1_1_0_S6_S3 4 0 8160 DEPOSIT ABSOLUTE MONOTONY MON_INCREASE /end AXIS_DESCR
/end CHARACTERISTIC
/begin CHARACTERISTIC KL_TFCGV2_7 "Fuellzeit GE 2. nicht kraftschl. Kupplung" CURVE 0x24E634 kl_ui8_S6_S3 2540 UMR_MSEC__10_1_0_S6_S3 0 2540
 /begin AXIS_DESCR STD_AXIS zff_atsys._.iSignale._.obj.sig_c_getr UMR_GRADC__1_1_M40_S6_S3 4 -40 210 DEPOSIT ABSOLUTE MONOTONY MON_INCREASE /end AXIS_DESCR
/end CHARACTERISTIC
/begin CHARACTERISTIC T_SYN_7 "Verweilzeit in Synchron zum Start Max.Rampe" VALUE 0x26E83F kw_ui8_S6_S3 2540 UMR_MSEC__10_1_0_S6_S3 0 2540 /end CHARACTERISTIC
/begin CHARACTERISTIC KL_POFCG_7 "Kennlinie Fuelldruckoffset" CURVE 0x24E640 kl_si16_S6_S3 12.75 UMR_BAR__1_1000_0_S6_S3 -6.4 6.35
 /begin AXIS_DESCR STD_AXIS zff_atsys._.iSignale._.obj.sig_c_getr UMR_GRADC__1_1_M40_S6_S3 10 -40 150 DEPOSIT ABSOLUTE MONOTONY MON_INCREASE /end AXIS_DESCR
/end CHARACTERISTIC
/begin CHARACTERISTIC KL_POFCGV1_7 "Kennlinie Fuelldruckoffset" CURVE 0x24E66C kl_si16_S6_S3 12.75 UMR_BAR__1_1000_0_S6_S3 -6.4 6.35
 /begin AXIS_DESCR STD_AXIS zff_atsys._.iSignale._.obj.sig_c_getr UMR_GRADC__1_1_M40_S6_S3 10 -40 150 DEPOSIT ABSOLUTE MONOTONY MON_INCREASE /end AXIS_DESCR
/end CHARACTERISTIC
/begin CHARACTERISTIC KL_POFCGV2_7 "Kennlinie Fuelldruckoffset" CURVE 0x24E698 kl_si16_S6_S3 12.75 UMR_BAR__1_1000_0_S6_S3 -6.4 6.35
 /begin AXIS_DESCR STD_AXIS zff_atsys._.iSignale._.obj.sig_c_getr UMR_GRADC__1_1_M40_S6_S3 10 -40 150 DEPOSIT ABSOLUTE MONOTONY MON_INCREASE /end AXIS_DESCR
/end CHARACTERISTIC
/begin CHARACTERISTIC KL_POKZUCG_7 "Schaltdruckoffset" CURVE 0x24E6C4 kl_si16_S6_S3 12.75 UMR_BAR__1_1000_0_S6_S3 -6.4 6.35
 /begin AXIS_DESCR STD_AXIS zff_atsys._.iSignale._.obj.sig_c_getr UMR_GRADC__1_1_M40_S6_S3 10 -40 150 DEPOSIT ABSOLUTE MONOTONY MON_INCREASE /end AXIS_DESCR
/end CHARACTERISTIC
/begin CHARACTERISTIC KL_PORASYN_7 "Rampe n.Syn.->letz.Stuetz.y PMAX" CURVE 0x24E6F0 kl_si16_S6_S3 12.75 UMR_BAR__1_1000_0_S6_S3 0 12.75
 /begin AXIS_DESCR STD_AXIS NO_INPUT_QUANTITY UMR_MSEC__10_1_0_S6_S3 3 0 2540 DEPOSIT ABSOLUTE MONOTONY MON_INCREASE /end AXIS_DESCR
/end CHARACTERISTIC
/begin CHARACTERISTIC KF_PKZU_7 "Schaltdruck zuschaltende Kupplung" MAP 0x24E700 kf_si16_S6_S3 12.75 UMR_BAR__1_1000_0_S6_S3 0 12.75
 /begin AXIS_DESCR STD_AXIS iSasZentr.iSchaltend.n_tkf UMR_U_MIN_32_1_0_S6_S3 8 0 8160 DEPOSIT ABSOLUTE MONOTONY MON_INCREASE /end AXIS_DESCR
 /begin AXIS_DESCR STD_AXIS zff_atsys._.iSignale._.obj.sig_m_t UMR_NM__1_1_0_S6_S3 10 -400 1640 DEPOSIT ABSOLUTE MONOTONY MON_INCREASE /end AXIS_DESCR
/end CHARACTERISTIC
/begin CHARACTERISTIC KF_TRAMTCG_7 "Kennlinie Zeit 1. Rampe der zuschaltenden Kupplung" MAP 0x24E7CC kf_si16_S6_S3 2540 UMR_MSEC__10_1_0_S6_S3 0 2540
 /begin AXIS_DESCR STD_AXIS zff_atsys._.iSignale._.obj.sig_m_t UMR_NM__1_1_0_S6_S3 4 -400 1640 DEPOSIT ABSOLUTE MONOTONY MON_INCREASE /end AXIS_DESCR
 /begin AXIS_DESCR STD_AXIS zff_atsys._.iSignale._.obj.sig_c_getr UMR_GRADC__1_1_M40_S6_S3 4 -40 150 DEPOSIT ABSOLUTE MONOTONY MON_INCREASE /end AXIS_DESCR
/end CHARACTERISTIC
/begin CHARACTERISTIC T_SYNRAKZU_7 "Zeit vor sync. Ende Schaltdruck/Start 3. Rampe KZU" VALUE 0x26E840 kw_ui8_S6_S3 1280 UMR_MSEC__10_1_M128_S6_S3 -1280 0 /end CHARACTERISTIC
/begin CHARACTERISTIC KL_PGOKZUNAB_7 "Schaltdruckgradienten Offset f(n_ab)" CURVE 0x24E804 kl_si16_S6_S3 200 UMR_BAR_SEC_1_10_0_S6_S3 -100 100
 /begin AXIS_DESCR STD_AXIS zff_atsys._.iSignale._.obj.sig_n_ab UMR_U_MIN_1_1_0_S6_S3 2 0 8160 DEPOSIT ABSOLUTE MONOTONY MON_INCREASE /end AXIS_DESCR
/end CHARACTERISTIC
/begin CHARACTERISTIC KF_POMLASTCGV2_7 "Momentenabhaengiger Druckoffset in FA der 2. nichtkraftschliessende KZU" MAP 0x24E810 kf_si16_S6_S3 3 UMR_BAR__1_1000_0_S6_S3 0 3
 /begin AXIS_DESCR STD_AXIS NO_INPUT_QUANTITY UMR_NM__1_1_0_S6_S3 5 -400 1640 DEPOSIT ABSOLUTE MONOTONY MON_INCREASE /end AXIS_DESCR
 /begin AXIS_DESCR STD_AXIS zff_atsys._.iSignale._.obj.sig_c_getr UMR_GRADC__1_1_M40_S6_S3 4 -40 150 DEPOSIT ABSOLUTE MONOTONY MON_INCREASE /end AXIS_DESCR
/end CHARACTERISTIC
/begin CHARACTERISTIC KF_POTNDSYNV2_7 "Differenzdrehzahlabhaengiger Druckoffset in FA der 2. nichtkraftschliessende KZU" MAP 0x24E854 kf_si16_S6_S3 3 UMR_BAR__1_1000_0_S6_S3 0 3
 /begin AXIS_DESCR STD_AXIS NO_INPUT_QUANTITY UMR_MSEC__10_1_0_S6_S3 6 0 2540 DEPOSIT ABSOLUTE MONOTONY MON_INCREASE /end AXIS_DESCR
 /begin AXIS_DESCR STD_AXIS NO_INPUT_QUANTITY UMR_U_MIN_1_1_0_S6_S3 8 -8160 8160 DEPOSIT ABSOLUTE MONOTONY MON_INCREASE /end AXIS_DESCR
/end CHARACTERISTIC
/begin CHARACTERISTIC KL_FPOTNDSYNV2_7 "Temp. abhaengiger Faktor fuer Druckoffset waehrend FA 2. nichtkraftschliessende KZU" CURVE 0x24E8D8 kl_ui8_S6_S3 1 UMR___1_100_0_S6_S3 0 1
 /begin AXIS_DESCR STD_AXIS zff_atsys._.iSignale._.obj.sig_c_getr UMR_GRADC__1_1_M40_S6_S3 5 -40 150 DEPOSIT ABSOLUTE MONOTONY MON_INCREASE /end AXIS_DESCR
/end CHARACTERISTIC
/begin CHARACTERISTIC NS_GENDSYNIAE_7 "Drehzahlschwelle Endebedingung Fuellausgleich 2. nichtkraftschliessende KZU" VALUE 0x26DE40 kw_si16_S6_S3 8000 UMR_U_MIN_1_1_0_S6_S3 0 8000 /end CHARACTERISTIC
/begin CHARACTERISTIC T_VGEIAE_7 "Verzoegerung Drehzahlschwelle GE Hybrid" VALUE 0x26E841 kw_ui8_S6_S3 2540 UMR_MSEC__10_1_0_S6_S3 0 2540 /end CHARACTERISTIC
/begin CHARACTERISTIC KL_POLASTDKIV2_7 "Druckoffset auf Fülldruck zweites nichtkraftschließendes Schaltelement" CURVE 0x24E8E8 kl_si16_S6_S3 6 UMR_BAR__1_1000_0_S6_S3 0 6
 /begin AXIS_DESCR STD_AXIS zff_atsys._.iSignale._.obj.sig_dki UMR_PROZENT__20_51_0_S6_S3 6 0 100 DEPOSIT ABSOLUTE MONOTONY MON_INCREASE /end AXIS_DESCR
/end CHARACTERISTIC
/begin CHARACTERISTIC PG_OFV1_8 "Gradient Offset Fuelldruck 1.nicht kraftschl. Kup." VALUE 0x26E842 kw_ui8_S6_S3 5 UMR_BAR_SEC_1_10_0_S6_S3 0 5 /end CHARACTERISTIC
/begin CHARACTERISTIC KL_PGOFCGV2_8 "Gradient Offset Fuelldruck 2. nicht kraftschl. Kup." CURVE 0x24E904 kl_ui8_S6_S3 5 UMR_BAR_SEC_1_10_0_S6_S3 0 5
 /begin AXIS_DESCR STD_AXIS zff_atsys._.iSignale._.obj.sig_c_getr UMR_GRADC__1_1_M40_S6_S3 4 -40 150 DEPOSIT ABSOLUTE MONOTONY MON_INCREASE /end AXIS_DESCR
/end CHARACTERISTIC
/begin CHARACTERISTIC KL_PGOFMT_8 "Gradient Druckoffset Fuellphase" CURVE 0x24E910 kl_si16_S6_S3 200 UMR_BAR_SEC_1_10_0_S6_S3 -100 100
 /begin AXIS_DESCR STD_AXIS zff_atsys._.iSignale._.obj.sig_m_t UMR_NM__1_1_0_S6_S3 4 -400 1640 DEPOSIT ABSOLUTE MONOTONY MON_INCREASE /end AXIS_DESCR
/end CHARACTERISTIC
/begin CHARACTERISTIC KL_PORAKZU_8 "Schaltdruckoffset" CURVE 0x24E924 kl_si16_S6_S3 12.75 UMR_BAR__1_1000_0_S6_S3 -6.4 6.35
 /begin AXIS_DESCR STD_AXIS NO_INPUT_QUANTITY UMR_MSEC__10_1_0_S6_S3 3 0 2540 DEPOSIT ABSOLUTE MONOTONY MON_INCREASE /end AXIS_DESCR
/end CHARACTERISTIC
/begin CHARACTERISTIC KF_POFMTN_8 "Kennfeld Fuelldruckoffset(nd_syn, m_t)" MAP 0x24E934 kf_si16_S6_S3 12.75 UMR_BAR__1_1000_0_S6_S3 -6.4 6.35
 /begin AXIS_DESCR STD_AXIS iSasZentr.iSchaltend.nd_syn UMR_U_MIN_1_1_0_S6_S3 4 -8000 8000 DEPOSIT ABSOLUTE MONOTONY MON_INCREASE /end AXIS_DESCR
 /begin AXIS_DESCR STD_AXIS zff_atsys._.iSignale._.obj.sig_m_t UMR_NM__1_1_0_S6_S3 6 -400 1640 DEPOSIT ABSOLUTE MONOTONY MON_INCREASE /end AXIS_DESCR
/end CHARACTERISTIC
/begin CHARACTERISTIC KL_PGOKZU_8 "Druckgradient in Abhaengigkeit von m_t" CURVE 0x24E980 kl_si16_S6_S3 200 UMR_BAR_SEC_1_10_0_S6_S3 -100 100
 /begin AXIS_DESCR STD_AXIS zff_atsys._.iSignale._.obj.sig_m_t UMR_NM__1_1_0_S6_S3 6 -400 1640 DEPOSIT ABSOLUTE MONOTONY MON_INCREASE /end AXIS_DESCR
/end CHARACTERISTIC
/begin CHARACTERISTIC KL_PGRASYN_8 "Schliessrampenradient f(m_t)" CURVE 0x24E99C kl_si16_S6_S3 6553.4 UMR_BAR_SEC_1_10_0_S6_S3 -3276.7 3276.7
 /begin AXIS_DESCR STD_AXIS zff_atsys._.iSignale._.obj.sig_m_t UMR_NM__1_1_0_S6_S3 6 -400 1640 DEPOSIT ABSOLUTE MONOTONY MON_INCREASE /end AXIS_DESCR
/end CHARACTERISTIC
/begin CHARACTERISTIC KL_PGRASYNNAB_8 "Schliessrampenradient f(n_ab)" CURVE 0x24E9B8 kl_si16_S6_S3 200 UMR_BAR_SEC_1_10_0_S6_S3 -100 100
 /begin AXIS_DESCR STD_AXIS zff_atsys._.iSignale._.obj.sig_n_ab UMR_U_MIN_1_1_0_S6_S3 2 0 8160 DEPOSIT ABSOLUTE MONOTONY MON_INCREASE /end AXIS_DESCR
/end CHARACTERISTIC
/begin CHARACTERISTIC KL_PGRASYNV1_8 "Schliessrampenradient 1. nichtkraftschl. Kupplung" CURVE 0x24E9C4 kl_si16_S6_S3 1000 UMR_BAR_SEC_1_10_0_S6_S3 0 1000
 /begin AXIS_DESCR STD_AXIS zff_atsys._.iSignale._.obj.sig_m_t UMR_NM__1_1_0_S6_S3 6 -400 1640 DEPOSIT ABSOLUTE MONOTONY MON_INCREASE /end AXIS_DESCR
/end CHARACTERISTIC
/begin CHARACTERISTIC KL_PORASYNV1_8 "Schliessrampendruckoffset 1. nichtkraftschl. Kupplung" CURVE 0x24E9E0 kl_si16_S6_S3 12.75 UMR_BAR__1_1000_0_S6_S3 0 12.75
 /begin AXIS_DESCR STD_AXIS NO_INPUT_QUANTITY UMR_MSEC__10_1_0_S6_S3 3 0 2540 DEPOSIT ABSOLUTE MONOTONY MON_INCREASE /end AXIS_DESCR
/end CHARACTERISTIC
/begin CHARACTERISTIC KL_PGRASYNV2_8 "Schliessrampenradient 2. nichtkraftschl. Kupplung" CURVE 0x24E9F0 kl_si16_S6_S3 1000 UMR_BAR_SEC_1_10_0_S6_S3 0 1000
 /begin AXIS_DESCR STD_AXIS zff_atsys._.iSignale._.obj.sig_m_t UMR_NM__1_1_0_S6_S3 6 -400 1640 DEPOSIT ABSOLUTE MONOTONY MON_INCREASE /end AXIS_DESCR
/end CHARACTERISTIC
/begin CHARACTERISTIC KL_PORASYNV2_8 "Schliessrampendruckoffset 2. nichtkraftschl. Kupplung" CURVE 0x24EA0C kl_si16_S6_S3 12.75 UMR_BAR__1_1000_0_S6_S3 0 12.75
 /begin AXIS_DESCR STD_AXIS NO_INPUT_QUANTITY UMR_MSEC__10_1_0_S6_S3 3 0 2540 DEPOSIT ABSOLUTE MONOTONY MON_INCREASE /end AXIS_DESCR
/end CHARACTERISTIC
/begin CHARACTERISTIC KL_TOVKZUCG_8 "Offset auf Verzoegerungszeit kraftschliessende KZU" CURVE 0x24EA1C kl_ui8_S6_S3 2540 UMR_MSEC__10_1_0_S6_S3 0 2540
 /begin AXIS_DESCR STD_AXIS zff_atsys._.iSignale._.obj.sig_c_getr UMR_GRADC__1_1_M40_S6_S3 4 -40 150 DEPOSIT ABSOLUTE MONOTONY MON_INCREASE /end AXIS_DESCR
/end CHARACTERISTIC
/begin CHARACTERISTIC KL_TVKZU_8 "Verzoegerungszeit kraftschliessende KZU" CURVE 0x24EA28 kl_ui16_S6_S3 2540 UMR_MSEC__10_1_0_S6_S3 0 2540
 /begin AXIS_DESCR STD_AXIS zff_atsys._.iSignale._.obj.sig_n_ab UMR_U_MIN_1_1_0_S6_S3 4 0 8160 DEPOSIT ABSOLUTE MONOTONY MON_INCREASE /end AXIS_DESCR
/end CHARACTERISTIC
/begin CHARACTERISTIC KL_TVKZUCGV2_8 "Verzoegerungszeit 2. nichtkraftschliessende KZU" CURVE 0x24EA3C kl_ui8_S6_S3 2540 UMR_MSEC__10_1_0_S6_S3 0 2540
 /begin AXIS_DESCR STD_AXIS zff_atsys._.iSignale._.obj.sig_c_getr UMR_GRADC__1_1_M40_S6_S3 4 -40 150 DEPOSIT ABSOLUTE MONOTONY MON_INCREASE /end AXIS_DESCR
/end CHARACTERISTIC
/begin CHARACTERISTIC T_VKZUV2_8 "Verzoegerungszeit 2. nicht kraftschliessende KZU" VALUE 0x26E843 kw_ui8_S6_S3 2540 UMR_MSEC__10_1_0_S6_S3 0 2540 /end CHARACTERISTIC
/begin CHARACTERISTIC KL_TFCGGE_8 "Fuellzeit" CURVE 0x24EA48 kl_ui8_S6_S3 2540 UMR_MSEC__10_1_0_S6_S3 0 2540
 /begin AXIS_DESCR STD_AXIS zff_atsys._.iSignale._.obj.sig_c_getr UMR_GRADC__1_1_M40_S6_S3 10 -40 210 DEPOSIT ABSOLUTE MONOTONY MON_INCREASE /end AXIS_DESCR
/end CHARACTERISTIC
/begin CHARACTERISTIC KL_TFV1_8 "Fuellzeit GE 1. nicht kraftschl. Kupplung" CURVE 0x24EA60 kl_ui16_S6_S3 2540 UMR_MSEC__10_1_0_S6_S3 0 2540
 /begin AXIS_DESCR STD_AXIS zff_atsys._.iSignale._.obj.sig_n_ab UMR_U_MIN_1_1_0_S6_S3 4 0 8160 DEPOSIT ABSOLUTE MONOTONY MON_INCREASE /end AXIS_DESCR
/end CHARACTERISTIC
/begin CHARACTERISTIC KL_TFCGV2_8 "Fuellzeit GE 2. nicht kraftschl. Kupplung" CURVE 0x24EA74 kl_ui8_S6_S3 2540 UMR_MSEC__10_1_0_S6_S3 0 2540
 /begin AXIS_DESCR STD_AXIS zff_atsys._.iSignale._.obj.sig_c_getr UMR_GRADC__1_1_M40_S6_S3 4 -40 210 DEPOSIT ABSOLUTE MONOTONY MON_INCREASE /end AXIS_DESCR
/end CHARACTERISTIC
/begin CHARACTERISTIC T_SYN_8 "Verweilzeit in Synchron zum Start Max.Rampe" VALUE 0x26E844 kw_ui8_S6_S3 2540 UMR_MSEC__10_1_0_S6_S3 0 2540 /end CHARACTERISTIC
/begin CHARACTERISTIC KL_POFCG_8 "Kennlinie Fuelldruckoffset" CURVE 0x24EA80 kl_si16_S6_S3 12.75 UMR_BAR__1_1000_0_S6_S3 -6.4 6.35
 /begin AXIS_DESCR STD_AXIS zff_atsys._.iSignale._.obj.sig_c_getr UMR_GRADC__1_1_M40_S6_S3 10 -40 150 DEPOSIT ABSOLUTE MONOTONY MON_INCREASE /end AXIS_DESCR
/end CHARACTERISTIC
/begin CHARACTERISTIC KL_POFCGV1_8 "Kennlinie Fuelldruckoffset" CURVE 0x24EAAC kl_si16_S6_S3 12.75 UMR_BAR__1_1000_0_S6_S3 -6.4 6.35
 /begin AXIS_DESCR STD_AXIS zff_atsys._.iSignale._.obj.sig_c_getr UMR_GRADC__1_1_M40_S6_S3 10 -40 150 DEPOSIT ABSOLUTE MONOTONY MON_INCREASE /end AXIS_DESCR
/end CHARACTERISTIC
/begin CHARACTERISTIC KL_POFCGV2_8 "Kennlinie Fuelldruckoffset" CURVE 0x24EAD8 kl_si16_S6_S3 12.75 UMR_BAR__1_1000_0_S6_S3 -6.4 6.35
 /begin AXIS_DESCR STD_AXIS zff_atsys._.iSignale._.obj.sig_c_getr UMR_GRADC__1_1_M40_S6_S3 10 -40 150 DEPOSIT ABSOLUTE MONOTONY MON_INCREASE /end AXIS_DESCR
/end CHARACTERISTIC
/begin CHARACTERISTIC KL_POKZUCG_8 "Schaltdruckoffset" CURVE 0x24EB04 kl_si16_S6_S3 12.75 UMR_BAR__1_1000_0_S6_S3 -6.4 6.35
 /begin AXIS_DESCR STD_AXIS zff_atsys._.iSignale._.obj.sig_c_getr UMR_GRADC__1_1_M40_S6_S3 10 -40 150 DEPOSIT ABSOLUTE MONOTONY MON_INCREASE /end AXIS_DESCR
/end CHARACTERISTIC
/begin CHARACTERISTIC KL_PORASYN_8 "Rampe n.Syn.->letz.Stuetz.y PMAX" CURVE 0x24EB30 kl_si16_S6_S3 12.75 UMR_BAR__1_1000_0_S6_S3 0 12.75
 /begin AXIS_DESCR STD_AXIS NO_INPUT_QUANTITY UMR_MSEC__10_1_0_S6_S3 3 0 2540 DEPOSIT ABSOLUTE MONOTONY MON_INCREASE /end AXIS_DESCR
/end CHARACTERISTIC
/begin CHARACTERISTIC KF_PKZU_8 "Schaltdruck zuschaltende Kupplung" MAP 0x24EB40 kf_si16_S6_S3 12.75 UMR_BAR__1_1000_0_S6_S3 0 12.75
 /begin AXIS_DESCR STD_AXIS iSasZentr.iSchaltend.n_tkf UMR_U_MIN_32_1_0_S6_S3 8 0 8160 DEPOSIT ABSOLUTE MONOTONY MON_INCREASE /end AXIS_DESCR
 /begin AXIS_DESCR STD_AXIS zff_atsys._.iSignale._.obj.sig_m_t UMR_NM__1_1_0_S6_S3 10 -400 1640 DEPOSIT ABSOLUTE MONOTONY MON_INCREASE /end AXIS_DESCR
/end CHARACTERISTIC
/begin CHARACTERISTIC KF_TRAMTCG_8 "Kennlinie Zeit 1. Rampe der zuschaltenden Kupplung" MAP 0x24EC0C kf_si16_S6_S3 2540 UMR_MSEC__10_1_0_S6_S3 0 2540
 /begin AXIS_DESCR STD_AXIS zff_atsys._.iSignale._.obj.sig_m_t UMR_NM__1_1_0_S6_S3 4 -400 1640 DEPOSIT ABSOLUTE MONOTONY MON_INCREASE /end AXIS_DESCR
 /begin AXIS_DESCR STD_AXIS zff_atsys._.iSignale._.obj.sig_c_getr UMR_GRADC__1_1_M40_S6_S3 4 -40 150 DEPOSIT ABSOLUTE MONOTONY MON_INCREASE /end AXIS_DESCR
/end CHARACTERISTIC
/begin CHARACTERISTIC T_SYNRAKZU_8 "Zeit vor sync. Ende Schaltdruck/Start 3. Rampe KZU" VALUE 0x26E845 kw_ui8_S6_S3 1280 UMR_MSEC__10_1_M128_S6_S3 -1280 0 /end CHARACTERISTIC
/begin CHARACTERISTIC KL_PGOKZUNAB_8 "Schaltdruckgradienten Offset f(n_ab)" CURVE 0x24EC44 kl_si16_S6_S3 200 UMR_BAR_SEC_1_10_0_S6_S3 -100 100
 /begin AXIS_DESCR STD_AXIS zff_atsys._.iSignale._.obj.sig_n_ab UMR_U_MIN_1_1_0_S6_S3 2 0 8160 DEPOSIT ABSOLUTE MONOTONY MON_INCREASE /end AXIS_DESCR
/end CHARACTERISTIC
/begin CHARACTERISTIC KF_POMLASTCGV2_8 "Momentenabhaengiger Druckoffset in FA der 2. nichtkraftschliessende KZU" MAP 0x24EC50 kf_si16_S6_S3 3 UMR_BAR__1_1000_0_S6_S3 0 3
 /begin AXIS_DESCR STD_AXIS NO_INPUT_QUANTITY UMR_NM__1_1_0_S6_S3 5 -400 1640 DEPOSIT ABSOLUTE MONOTONY MON_INCREASE /end AXIS_DESCR
 /begin AXIS_DESCR STD_AXIS zff_atsys._.iSignale._.obj.sig_c_getr UMR_GRADC__1_1_M40_S6_S3 4 -40 150 DEPOSIT ABSOLUTE MONOTONY MON_INCREASE /end AXIS_DESCR
/end CHARACTERISTIC
/begin CHARACTERISTIC KF_POTNDSYNV2_8 "Differenzdrehzahlabhaengiger Druckoffset in FA der 2. nichtkraftschliessende KZU" MAP 0x24EC94 kf_si16_S6_S3 3 UMR_BAR__1_1000_0_S6_S3 0 3
 /begin AXIS_DESCR STD_AXIS NO_INPUT_QUANTITY UMR_MSEC__10_1_0_S6_S3 6 0 2540 DEPOSIT ABSOLUTE MONOTONY MON_INCREASE /end AXIS_DESCR
 /begin AXIS_DESCR STD_AXIS NO_INPUT_QUANTITY UMR_U_MIN_1_1_0_S6_S3 8 -8160 8160 DEPOSIT ABSOLUTE MONOTONY MON_INCREASE /end AXIS_DESCR
/end CHARACTERISTIC
/begin CHARACTERISTIC KL_FPOTNDSYNV2_8 "Temp. abhaengiger Faktor fuer Druckoffset waehrend FA 2. nichtkraftschliessende KZU" CURVE 0x24ED18 kl_ui8_S6_S3 1 UMR___1_100_0_S6_S3 0 1
 /begin AXIS_DESCR STD_AXIS zff_atsys._.iSignale._.obj.sig_c_getr UMR_GRADC__1_1_M40_S6_S3 5 -40 150 DEPOSIT ABSOLUTE MONOTONY MON_INCREASE /end AXIS_DESCR
/end CHARACTERISTIC
/begin CHARACTERISTIC NS_GENDSYNIAE_8 "Drehzahlschwelle Endebedingung Fuellausgleich 2. nichtkraftschliessende KZU" VALUE 0x26DE42 kw_si16_S6_S3 8000 UMR_U_MIN_1_1_0_S6_S3 0 8000 /end CHARACTERISTIC
/begin CHARACTERISTIC T_VGEIAE_8 "Verzoegerung Drehzahlschwelle GE Hybrid" VALUE 0x26E846 kw_ui8_S6_S3 2540 UMR_MSEC__10_1_0_S6_S3 0 2540 /end CHARACTERISTIC
/begin CHARACTERISTIC KL_POLASTDKIV2_8 "Druckoffset auf Fülldruck zweites nichtkraftschließendes Schaltelement" CURVE 0x24ED28 kl_si16_S6_S3 6 UMR_BAR__1_1000_0_S6_S3 0 6
 /begin AXIS_DESCR STD_AXIS zff_atsys._.iSignale._.obj.sig_dki UMR_PROZENT__20_51_0_S6_S3 6 0 100 DEPOSIT ABSOLUTE MONOTONY MON_INCREASE /end AXIS_DESCR
/end CHARACTERISTIC
/begin CHARACTERISTIC T_VGLSKZU_R "Verzoegerungszeit GLS-Beginn Gangeinlegen" VALUE 0x26E6AF kw_ui8_S6_S3 2540 UMR_MSEC__10_1_0_S6_S3 0 2540 /end CHARACTERISTIC
/begin CHARACTERISTIC KL_MPT_WNGTGLS_INIT_R "Filterkonstante Sollgradient PT1-Filter" CURVE 0x238744 kl_si16_S6_S3 0.99 UMR___1_100_0_S6_S3 0.01 1
 /begin AXIS_DESCR STD_AXIS NO_INPUT_QUANTITY UMR_U_MINSEC_10000_32767_0_S6_S3 3 -9765.92303232 9765.92303232 DEPOSIT ABSOLUTE MONOTONY MON_INCREASE /end AXIS_DESCR
/end CHARACTERISTIC
/begin CHARACTERISTIC KL_KPGLSKZUCG_R "Proportionalfaktor PID-Regler GLS Gangeinlegen" CURVE 0x238754 kl_ui16_S6_S3 10000 UMR_MBARMINSEC__1_1_0_S6_S3 0 10000
 /begin AXIS_DESCR STD_AXIS iSasZentr.c_getr_sas UMR_GRADC__1_1_M40_S6_S3 4 -40 150 DEPOSIT ABSOLUTE MONOTONY MON_INCREASE /end AXIS_DESCR
/end CHARACTERISTIC
/begin CHARACTERISTIC KL_KIGLSKZUCG_R "Integralfaktor PID-Regler GLS Gangeinlegen" CURVE 0x238768 kl_ui16_S6_S3 10000 UMR_MBARMINSEC__1_1_0_S6_S3 0 10000
 /begin AXIS_DESCR STD_AXIS iSasZentr.c_getr_sas UMR_GRADC__1_1_M40_S6_S3 4 -40 150 DEPOSIT ABSOLUTE MONOTONY MON_INCREASE /end AXIS_DESCR
/end CHARACTERISTIC
/begin CHARACTERISTIC KF_WNGTNDSYNCGGE_R "Sollturbinengradient geregeltes Gangeinlegen" MAP 0x23877C kf_si16_S6_S3 20000 UMR_U_MINSEC_1_1_0_S6_S3 -10000 10000
 /begin AXIS_DESCR STD_AXIS NO_INPUT_QUANTITY UMR_U_MIN_1_1_0_S6_S3 6 -8160 8160 DEPOSIT ABSOLUTE MONOTONY MON_INCREASE /end AXIS_DESCR
 /begin AXIS_DESCR STD_AXIS iSasZentr.c_getr_sas UMR_GRADC__1_1_M40_S6_S3 4 -40 150 DEPOSIT ABSOLUTE MONOTONY MON_INCREASE /end AXIS_DESCR
/end CHARACTERISTIC
/begin CHARACTERISTIC ND_GLSGE_R "Drehzahlkriterium Start Regelung Gangeinlegen" VALUE 0x26D9FA kw_ui16_S6_S3 8000 UMR_U_MIN_1_1_0_S6_S3 0 8000 /end CHARACTERISTIC
/begin CHARACTERISTIC T_VGLSKZU_1 "Verzoegerungszeit GLS-Beginn Gangeinlegen" VALUE 0x26E6B0 kw_ui8_S6_S3 2540 UMR_MSEC__10_1_0_S6_S3 0 2540 /end CHARACTERISTIC
/begin CHARACTERISTIC KL_MPT_WNGTGLS_INIT_1 "Filterkonstante Sollgradient PT1-Filter" CURVE 0x2387C8 kl_si16_S6_S3 0.99 UMR___1_100_0_S6_S3 0.01 1
 /begin AXIS_DESCR STD_AXIS NO_INPUT_QUANTITY UMR_U_MINSEC_10000_32767_0_S6_S3 3 -9765.92303232 9765.92303232 DEPOSIT ABSOLUTE MONOTONY MON_INCREASE /end AXIS_DESCR
/end CHARACTERISTIC
/begin CHARACTERISTIC KL_KPGLSKZUCG_1 "Proportionalfaktor PID-Regler GLS Gangeinlegen" CURVE 0x2387D8 kl_ui16_S6_S3 10000 UMR_MBARMINSEC__1_1_0_S6_S3 0 10000
 /begin AXIS_DESCR STD_AXIS iSasZentr.c_getr_sas UMR_GRADC__1_1_M40_S6_S3 4 -40 150 DEPOSIT ABSOLUTE MONOTONY MON_INCREASE /end AXIS_DESCR
/end CHARACTERISTIC
/begin CHARACTERISTIC KL_KIGLSKZUCG_1 "Integralfaktor PID-Regler GLS Gangeinlegen" CURVE 0x2387EC kl_ui16_S6_S3 10000 UMR_MBARMINSEC__1_1_0_S6_S3 0 10000
 /begin AXIS_DESCR STD_AXIS iSasZentr.c_getr_sas UMR_GRADC__1_1_M40_S6_S3 4 -40 150 DEPOSIT ABSOLUTE MONOTONY MON_INCREASE /end AXIS_DESCR
/end CHARACTERISTIC
/begin CHARACTERISTIC KF_WNGTNDSYNCGGE_1 "Sollturbinengradient geregeltes Gangeinlegen" MAP 0x238800 kf_si16_S6_S3 20000 UMR_U_MINSEC_1_1_0_S6_S3 -10000 10000
 /begin AXIS_DESCR STD_AXIS NO_INPUT_QUANTITY UMR_U_MIN_1_1_0_S6_S3 6 -8160 8160 DEPOSIT ABSOLUTE MONOTONY MON_INCREASE /end AXIS_DESCR
 /begin AXIS_DESCR STD_AXIS iSasZentr.c_getr_sas UMR_GRADC__1_1_M40_S6_S3 4 -40 150 DEPOSIT ABSOLUTE MONOTONY MON_INCREASE /end AXIS_DESCR
/end CHARACTERISTIC
/begin CHARACTERISTIC ND_GLSGE_1 "Drehzahlkriterium Start Regelung Gangeinlegen" VALUE 0x26D9FC kw_ui16_S6_S3 8000 UMR_U_MIN_1_1_0_S6_S3 0 8000 /end CHARACTERISTIC
/begin CHARACTERISTIC T_VGLSKZU_2 "Verzoegerungszeit GLS-Beginn Gangeinlegen" VALUE 0x26E6B1 kw_ui8_S6_S3 2540 UMR_MSEC__10_1_0_S6_S3 0 2540 /end CHARACTERISTIC
/begin CHARACTERISTIC KL_MPT_WNGTGLS_INIT_2 "Filterkonstante Sollgradient PT1-Filter" CURVE 0x23884C kl_si16_S6_S3 0.99 UMR___1_100_0_S6_S3 0.01 1
 /begin AXIS_DESCR STD_AXIS NO_INPUT_QUANTITY UMR_U_MINSEC_10000_32767_0_S6_S3 3 -9765.92303232 9765.92303232 DEPOSIT ABSOLUTE MONOTONY MON_INCREASE /end AXIS_DESCR
/end CHARACTERISTIC
/begin CHARACTERISTIC KL_KPGLSKZUCG_2 "Proportionalfaktor PID-Regler GLS Gangeinlegen" CURVE 0x23885C kl_ui16_S6_S3 10000 UMR_MBARMINSEC__1_1_0_S6_S3 0 10000
 /begin AXIS_DESCR STD_AXIS iSasZentr.c_getr_sas UMR_GRADC__1_1_M40_S6_S3 4 -40 150 DEPOSIT ABSOLUTE MONOTONY MON_INCREASE /end AXIS_DESCR
/end CHARACTERISTIC
/begin CHARACTERISTIC KL_KIGLSKZUCG_2 "Integralfaktor PID-Regler GLS Gangeinlegen" CURVE 0x238870 kl_ui16_S6_S3 10000 UMR_MBARMINSEC__1_1_0_S6_S3 0 10000
 /begin AXIS_DESCR STD_AXIS iSasZentr.c_getr_sas UMR_GRADC__1_1_M40_S6_S3 4 -40 150 DEPOSIT ABSOLUTE MONOTONY MON_INCREASE /end AXIS_DESCR
/end CHARACTERISTIC
/begin CHARACTERISTIC KF_WNGTNDSYNCGGE_2 "Sollturbinengradient geregeltes Gangeinlegen" MAP 0x238884 kf_si16_S6_S3 20000 UMR_U_MINSEC_1_1_0_S6_S3 -10000 10000
 /begin AXIS_DESCR STD_AXIS NO_INPUT_QUANTITY UMR_U_MIN_1_1_0_S6_S3 6 -8160 8160 DEPOSIT ABSOLUTE MONOTONY MON_INCREASE /end AXIS_DESCR
 /begin AXIS_DESCR STD_AXIS iSasZentr.c_getr_sas UMR_GRADC__1_1_M40_S6_S3 4 -40 150 DEPOSIT ABSOLUTE MONOTONY MON_INCREASE /end AXIS_DESCR
/end CHARACTERISTIC
/begin CHARACTERISTIC ND_GLSGE_2 "Drehzahlkriterium Start Regelung Gangeinlegen" VALUE 0x26D9FE kw_ui16_S6_S3 8000 UMR_U_MIN_1_1_0_S6_S3 0 8000 /end CHARACTERISTIC
/begin CHARACTERISTIC T_VGLSKZU_3 "Verzoegerungszeit GLS-Beginn Gangeinlegen" VALUE 0x26E6B2 kw_ui8_S6_S3 2540 UMR_MSEC__10_1_0_S6_S3 0 2540 /end CHARACTERISTIC
/begin CHARACTERISTIC KL_MPT_WNGTGLS_INIT_3 "Filterkonstante Sollgradient PT1-Filter" CURVE 0x2388D0 kl_si16_S6_S3 0.99 UMR___1_100_0_S6_S3 0.01 1
 /begin AXIS_DESCR STD_AXIS NO_INPUT_QUANTITY UMR_U_MINSEC_10000_32767_0_S6_S3 3 -9765.92303232 9765.92303232 DEPOSIT ABSOLUTE MONOTONY MON_INCREASE /end AXIS_DESCR
/end CHARACTERISTIC
/begin CHARACTERISTIC KL_KPGLSKZUCG_3 "Proportionalfaktor PID-Regler GLS Gangeinlegen" CURVE 0x2388E0 kl_ui16_S6_S3 10000 UMR_MBARMINSEC__1_1_0_S6_S3 0 10000
 /begin AXIS_DESCR STD_AXIS iSasZentr.c_getr_sas UMR_GRADC__1_1_M40_S6_S3 4 -40 150 DEPOSIT ABSOLUTE MONOTONY MON_INCREASE /end AXIS_DESCR
/end CHARACTERISTIC
/begin CHARACTERISTIC KL_KIGLSKZUCG_3 "Integralfaktor PID-Regler GLS Gangeinlegen" CURVE 0x2388F4 kl_ui16_S6_S3 10000 UMR_MBARMINSEC__1_1_0_S6_S3 0 10000
 /begin AXIS_DESCR STD_AXIS iSasZentr.c_getr_sas UMR_GRADC__1_1_M40_S6_S3 4 -40 150 DEPOSIT ABSOLUTE MONOTONY MON_INCREASE /end AXIS_DESCR
/end CHARACTERISTIC
/begin CHARACTERISTIC KF_WNGTNDSYNCGGE_3 "Sollturbinengradient geregeltes Gangeinlegen" MAP 0x238908 kf_si16_S6_S3 20000 UMR_U_MINSEC_1_1_0_S6_S3 -10000 10000
 /begin AXIS_DESCR STD_AXIS NO_INPUT_QUANTITY UMR_U_MIN_1_1_0_S6_S3 6 -8160 8160 DEPOSIT ABSOLUTE MONOTONY MON_INCREASE /end AXIS_DESCR
 /begin AXIS_DESCR STD_AXIS iSasZentr.c_getr_sas UMR_GRADC__1_1_M40_S6_S3 4 -40 150 DEPOSIT ABSOLUTE MONOTONY MON_INCREASE /end AXIS_DESCR
/end CHARACTERISTIC
/begin CHARACTERISTIC ND_GLSGE_3 "Drehzahlkriterium Start Regelung Gangeinlegen" VALUE 0x26DA00 kw_ui16_S6_S3 8000 UMR_U_MIN_1_1_0_S6_S3 0 8000 /end CHARACTERISTIC
/begin CHARACTERISTIC T_VGLSKZU_4 "Verzoegerungszeit GLS-Beginn Gangeinlegen" VALUE 0x26E6B3 kw_ui8_S6_S3 2540 UMR_MSEC__10_1_0_S6_S3 0 2540 /end CHARACTERISTIC
/begin CHARACTERISTIC KL_MPT_WNGTGLS_INIT_4 "Filterkonstante Sollgradient PT1-Filter" CURVE 0x238954 kl_si16_S6_S3 0.99 UMR___1_100_0_S6_S3 0.01 1
 /begin AXIS_DESCR STD_AXIS NO_INPUT_QUANTITY UMR_U_MINSEC_10000_32767_0_S6_S3 3 -9765.92303232 9765.92303232 DEPOSIT ABSOLUTE MONOTONY MON_INCREASE /end AXIS_DESCR
/end CHARACTERISTIC
/begin CHARACTERISTIC KL_KPGLSKZUCG_4 "Proportionalfaktor PID-Regler GLS Gangeinlegen" CURVE 0x238964 kl_ui16_S6_S3 10000 UMR_MBARMINSEC__1_1_0_S6_S3 0 10000
 /begin AXIS_DESCR STD_AXIS iSasZentr.c_getr_sas UMR_GRADC__1_1_M40_S6_S3 4 -40 150 DEPOSIT ABSOLUTE MONOTONY MON_INCREASE /end AXIS_DESCR
/end CHARACTERISTIC
/begin CHARACTERISTIC KL_KIGLSKZUCG_4 "Integralfaktor PID-Regler GLS Gangeinlegen" CURVE 0x238978 kl_ui16_S6_S3 10000 UMR_MBARMINSEC__1_1_0_S6_S3 0 10000
 /begin AXIS_DESCR STD_AXIS iSasZentr.c_getr_sas UMR_GRADC__1_1_M40_S6_S3 4 -40 150 DEPOSIT ABSOLUTE MONOTONY MON_INCREASE /end AXIS_DESCR
/end CHARACTERISTIC
/begin CHARACTERISTIC KF_WNGTNDSYNCGGE_4 "Sollturbinengradient geregeltes Gangeinlegen" MAP 0x23898C kf_si16_S6_S3 20000 UMR_U_MINSEC_1_1_0_S6_S3 -10000 10000
 /begin AXIS_DESCR STD_AXIS NO_INPUT_QUANTITY UMR_U_MIN_1_1_0_S6_S3 6 -8160 8160 DEPOSIT ABSOLUTE MONOTONY MON_INCREASE /end AXIS_DESCR
 /begin AXIS_DESCR STD_AXIS iSasZentr.c_getr_sas UMR_GRADC__1_1_M40_S6_S3 4 -40 150 DEPOSIT ABSOLUTE MONOTONY MON_INCREASE /end AXIS_DESCR
/end CHARACTERISTIC
/begin CHARACTERISTIC ND_GLSGE_4 "Drehzahlkriterium Start Regelung Gangeinlegen" VALUE 0x26DA02 kw_ui16_S6_S3 8000 UMR_U_MIN_1_1_0_S6_S3 0 8000 /end CHARACTERISTIC
/begin CHARACTERISTIC T_VGLSKZU_5 "Verzoegerungszeit GLS-Beginn Gangeinlegen" VALUE 0x26E6B4 kw_ui8_S6_S3 2540 UMR_MSEC__10_1_0_S6_S3 0 2540 /end CHARACTERISTIC
/begin CHARACTERISTIC KL_MPT_WNGTGLS_INIT_5 "Filterkonstante Sollgradient PT1-Filter" CURVE 0x2389D8 kl_si16_S6_S3 0.99 UMR___1_100_0_S6_S3 0.01 1
 /begin AXIS_DESCR STD_AXIS NO_INPUT_QUANTITY UMR_U_MINSEC_10000_32767_0_S6_S3 3 -9765.92303232 9765.92303232 DEPOSIT ABSOLUTE MONOTONY MON_INCREASE /end AXIS_DESCR
/end CHARACTERISTIC
/begin CHARACTERISTIC KL_KPGLSKZUCG_5 "Proportionalfaktor PID-Regler GLS Gangeinlegen" CURVE 0x2389E8 kl_ui16_S6_S3 10000 UMR_MBARMINSEC__1_1_0_S6_S3 0 10000
 /begin AXIS_DESCR STD_AXIS iSasZentr.c_getr_sas UMR_GRADC__1_1_M40_S6_S3 4 -40 150 DEPOSIT ABSOLUTE MONOTONY MON_INCREASE /end AXIS_DESCR
/end CHARACTERISTIC
/begin CHARACTERISTIC KL_KIGLSKZUCG_5 "Integralfaktor PID-Regler GLS Gangeinlegen" CURVE 0x2389FC kl_ui16_S6_S3 10000 UMR_MBARMINSEC__1_1_0_S6_S3 0 10000
 /begin AXIS_DESCR STD_AXIS iSasZentr.c_getr_sas UMR_GRADC__1_1_M40_S6_S3 4 -40 150 DEPOSIT ABSOLUTE MONOTONY MON_INCREASE /end AXIS_DESCR
/end CHARACTERISTIC
/begin CHARACTERISTIC KF_WNGTNDSYNCGGE_5 "Sollturbinengradient geregeltes Gangeinlegen" MAP 0x238A10 kf_si16_S6_S3 20000 UMR_U_MINSEC_1_1_0_S6_S3 -10000 10000
 /begin AXIS_DESCR STD_AXIS NO_INPUT_QUANTITY UMR_U_MIN_1_1_0_S6_S3 6 -8160 8160 DEPOSIT ABSOLUTE MONOTONY MON_INCREASE /end AXIS_DESCR
 /begin AXIS_DESCR STD_AXIS iSasZentr.c_getr_sas UMR_GRADC__1_1_M40_S6_S3 4 -40 150 DEPOSIT ABSOLUTE MONOTONY MON_INCREASE /end AXIS_DESCR
/end CHARACTERISTIC
/begin CHARACTERISTIC ND_GLSGE_5 "Drehzahlkriterium Start Regelung Gangeinlegen" VALUE 0x26DA04 kw_ui16_S6_S3 8000 UMR_U_MIN_1_1_0_S6_S3 0 8000 /end CHARACTERISTIC
/begin CHARACTERISTIC T_VGLSKZU_6 "Verzoegerungszeit GLS-Beginn Gangeinlegen" VALUE 0x26E6B5 kw_ui8_S6_S3 2540 UMR_MSEC__10_1_0_S6_S3 0 2540 /end CHARACTERISTIC
/begin CHARACTERISTIC KL_MPT_WNGTGLS_INIT_6 "Filterkonstante Sollgradient PT1-Filter" CURVE 0x238A5C kl_si16_S6_S3 0.99 UMR___1_100_0_S6_S3 0.01 1
 /begin AXIS_DESCR STD_AXIS NO_INPUT_QUANTITY UMR_U_MINSEC_10000_32767_0_S6_S3 3 -9765.92303232 9765.92303232 DEPOSIT ABSOLUTE MONOTONY MON_INCREASE /end AXIS_DESCR
/end CHARACTERISTIC
/begin CHARACTERISTIC KL_KPGLSKZUCG_6 "Proportionalfaktor PID-Regler GLS Gangeinlegen" CURVE 0x238A6C kl_ui16_S6_S3 10000 UMR_MBARMINSEC__1_1_0_S6_S3 0 10000
 /begin AXIS_DESCR STD_AXIS iSasZentr.c_getr_sas UMR_GRADC__1_1_M40_S6_S3 4 -40 150 DEPOSIT ABSOLUTE MONOTONY MON_INCREASE /end AXIS_DESCR
/end CHARACTERISTIC
/begin CHARACTERISTIC KL_KIGLSKZUCG_6 "Integralfaktor PID-Regler GLS Gangeinlegen" CURVE 0x238A80 kl_ui16_S6_S3 10000 UMR_MBARMINSEC__1_1_0_S6_S3 0 10000
 /begin AXIS_DESCR STD_AXIS iSasZentr.c_getr_sas UMR_GRADC__1_1_M40_S6_S3 4 -40 150 DEPOSIT ABSOLUTE MONOTONY MON_INCREASE /end AXIS_DESCR
/end CHARACTERISTIC
/begin CHARACTERISTIC KF_WNGTNDSYNCGGE_6 "Sollturbinengradient geregeltes Gangeinlegen" MAP 0x238A94 kf_si16_S6_S3 20000 UMR_U_MINSEC_1_1_0_S6_S3 -10000 10000
 /begin AXIS_DESCR STD_AXIS NO_INPUT_QUANTITY UMR_U_MIN_1_1_0_S6_S3 6 -8160 8160 DEPOSIT ABSOLUTE MONOTONY MON_INCREASE /end AXIS_DESCR
 /begin AXIS_DESCR STD_AXIS iSasZentr.c_getr_sas UMR_GRADC__1_1_M40_S6_S3 4 -40 150 DEPOSIT ABSOLUTE MONOTONY MON_INCREASE /end AXIS_DESCR
/end CHARACTERISTIC
/begin CHARACTERISTIC ND_GLSGE_6 "Drehzahlkriterium Start Regelung Gangeinlegen" VALUE 0x26DA06 kw_ui16_S6_S3 8000 UMR_U_MIN_1_1_0_S6_S3 0 8000 /end CHARACTERISTIC
/begin COMPU_METHOD SAB_T_TIMER_20MS_S2_S3 "int = ((phys * 1) / 20) - (0) ms" RAT_FUNC "%5.3" "ms" COEFFS 0 1 -0 0 0 20 /end COMPU_METHOD
/begin COMPU_METHOD SAB_T_TIMER_S2_S2_S3 "int = ((phys * 2) / 1) - (0) s" RAT_FUNC "%5.3" "s" COEFFS 0 2 -0 0 0 1 /end COMPU_METHOD
/begin COMPU_METHOD SAB_N_2RPM_S2_S3 "int = ((phys * 1) / 2) - (0) 1/min" RAT_FUNC "%5.3" "1/min" COEFFS 0 1 -0 0 0 2 /end COMPU_METHOD
/begin COMPU_METHOD SAB_N_4RPM_S2_S3 "int = ((phys * 1) / 4) - (0) 1/min" RAT_FUNC "%5.3" "1/min" COEFFS 0 1 -0 0 0 4 /end COMPU_METHOD
/begin COMPU_METHOD SAB_N_RPM_M10000_S2_S3 "int = ((phys * 1) / 1) - (-10000) 1/min" RAT_FUNC "%2.0" "1/min" COEFFS 0 1 10000 0 0 1 /end COMPU_METHOD
/begin COMPU_METHOD SAB_N_RPM_M900_S2_S3 "int = ((phys * 1) / 1) - (-900) 1/min" RAT_FUNC "%2.0" "1/min" COEFFS 0 1 900 0 0 1 /end COMPU_METHOD
/begin COMPU_METHOD SAB_N_RPM_M16382_S2_S3 "int = ((phys * 1) / 1) - (-16382) 1/min" RAT_FUNC "%2.0" "1/min" COEFFS 0 1 16382 0 0 1 /end COMPU_METHOD
/begin COMPU_METHOD SAB_N_3RPM_S2_S3 "int = ((phys * 1) / 3) - (0) 1/min" RAT_FUNC "%5.3" "1/min" COEFFS 0 1 -0 0 0 3 /end COMPU_METHOD
/begin COMPU_METHOD SAB_N_8RPM_S2_S3 "int = ((phys * 1) / 8) - (0) 1/min" RAT_FUNC "%5.3" "1/min" COEFFS 0 1 -0 0 0 8 /end COMPU_METHOD
/begin COMPU_METHOD UMR___1_100_0_S6_S3 "int = ((phys * 100) / 1) - (0) [-]" RAT_FUNC "%4.2" "[-]" COEFFS 0 100 -0 0 0 1 /end COMPU_METHOD
/begin COMPU_METHOD UMR___1_1_0_S6_S3 "int = ((phys * 1) / 1) - (0) [-]" RAT_FUNC "%2.0" "[-]" COEFFS 0 1 -0 0 0 1 /end COMPU_METHOD
/begin COMPU_METHOD UMR_NM__1_1_0_S6_S3 "int = ((phys * 1) / 1) - (0) [Nm]" RAT_FUNC "%2.0" "[Nm]" COEFFS 0 1 -0 0 0 1 /end COMPU_METHOD
/begin COMPU_METHOD UMR_NM_SEC_10_1_0_S6_S3 "int = ((phys * 1) / 10) - (0) [Nm/s]" RAT_FUNC "%3.1" "[Nm/s]" COEFFS 0 1 -0 0 0 10 /end COMPU_METHOD
/begin COMPU_METHOD UMR_BAR__1_1000_0_S6_S3 "int = ((phys * 1000) / 1) - (0) [bar]" RAT_FUNC "%5.3" "[bar]" COEFFS 0 1000 -0 0 0 1 /end COMPU_METHOD
/begin COMPU_METHOD UMR_BAR_SEC_1_10_0_S6_S3 "int = ((phys * 10) / 1) - (0) [bar/s]" RAT_FUNC "%3.1" "[bar/s]" COEFFS 0 10 -0 0 0 1 /end COMPU_METHOD
/begin COMPU_METHOD UMR_U_MIN_1_1_0_S6_S3 "int = ((phys * 1) / 1) - (0) [U/min]" RAT_FUNC "%2.0" "[U/min]" COEFFS 0 1 -0 0 0 1 /end COMPU_METHOD
/begin COMPU_METHOD UMR_U_MIN_32_1_0_S6_S3 "int = ((phys * 1) / 32) - (0) [U/min]" RAT_FUNC "%2.0" "[U/min]" COEFFS 0 1 -0 0 0 32 /end COMPU_METHOD
/begin COMPU_METHOD UMR_U_MINSEC_1_1_0_S6_S3 "int = ((phys * 1) / 1) - (0) [U/(min*s)]" RAT_FUNC "%2.0" "[U/(min*s)]" COEFFS 0 1 -0 0 0 1 /end COMPU_METHOD
/begin COMPU_METHOD UMR_U_MINSEC_10000_32767_0_S6_S3 "int = ((phys * 32767) / 10000) - (0) [U/(min*s)]" RAT_FUNC "%6.4" "[U/(min*s)]" COEFFS 0 32767 -0 0 0 10000 /end COMPU_METHOD
/begin COMPU_METHOD UMR_MSEC__1_1_0_S6_S3 "int = ((phys * 1) / 1) - (0) [ms]" RAT_FUNC "%2.0" "[ms]" COEFFS 0 1 -0 0 0 1 /end COMPU_METHOD
/begin COMPU_METHOD UMR_MSEC__10_1_0_S6_S3 "int = ((phys * 1) / 10) - (0) [ms]" RAT_FUNC "%2.0" "[ms]" COEFFS 0 1 -0 0 0 10 /end COMPU_METHOD
/begin COMPU_METHOD UMR_MSEC__10_1_M128_S6_S3 "int = ((phys * 1) / 10) - (-128) [ms]" RAT_FUNC "%2.0" "[ms]" COEFFS 0 1 1280 0 0 10 /end COMPU_METHOD
/begin COMPU_METHOD UMR_MSEC__10_1_M255_S6_S3 "int = ((phys * 1) / 10) - (-255) [ms]" RAT_FUNC "%2.0" "[ms]" COEFFS 0 1 2550 0 0 10 /end COMPU_METHOD
/begin COMPU_METHOD UMR_GRADC__1_1_M40_S6_S3 "int = ((phys * 1) / 1) - (-40) [°C]" RAT_FUNC "%2.0" "[°C]" COEFFS 0 1 40 0 0 1 /end COMPU_METHOD
/begin COMPU_METHOD UMR_PROZENT__20_51_0_S6_S3 "int = ((phys * 51) / 20) - (0) [%]" RAT_FUNC "%6.4" "[%]" COEFFS 0 51 -0 0 0 20 /end COMPU_METHOD
/begin COMPU_METHOD UMR_MBARMINSEC__1_1_0_S6_S3 "int = ((phys * 1) / 1) - (0) [0,02mbar/(1/(min*s))]" RAT_FUNC "%2.0" "[0,02mbar/(1/(min*s))]" COEFFS 0 1 -0 0 0 1 /end COMPU_METHOD
/begin FUNCTION jSasGloRSS64_Fktn "Applikationesgroessen Instanz jSasGloRSS64"
 /begin DEF_CHARACTERISTIC HYS_NGS_VERIAESP64 KF_MOMOTMAXNDCGSP64 KL_MGMOTMAXAUFRSSSP64 KL_MOMOTMAXNDRSSSP64 KL_TMAXCGSP64 KL_TSYNAUSCGRSSSP64 KL_TSYNCGNSYNRSSSP64 KL_TSYNCGRSSSP64 ND_NTNMOTRSSSP64 NGS_VERIAESP64 NS_DKIRSSSP64 NS_SYNISTESP64 NS_VERSIAESP64 T_OTSYNKABVSP64 T_RAMAXSP64 T_RAMOTMAXRSSSP64 /end DEF_CHARACTERISTIC
/end FUNCTION
/begin FUNCTION jSasGloRSS71_Fktn "Applikationesgroessen Instanz jSasGloRSS71"
 /begin DEF_CHARACTERISTIC HYS_NGS_VERIAESP71 KF_MOMOTMAXNDCGSP71 KL_MGMOTMAXAUFRSSSP71 KL_MOMOTMAXNDRSSSP71 KL_TMAXCGSP71 KL_TSYNAUSCGRSSSP71 KL_TSYNCGNSYNRSSSP71 KL_TSYNCGRSSSP71 ND_NTNMOTRSSSP71 NGS_VERIAESP71 NS_DKIRSSSP71 NS_SYNISTESP71 NS_VERSIAESP71 T_OTSYNKABVSP71 T_RAMAXSP71 T_RAMOTMAXRSSSP71 /end DEF_CHARACTERISTIC
/end FUNCTION
/begin FUNCTION jSasGloRSS75_Fktn "Applikationesgroessen Instanz jSasGloRSS75"
 /begin DEF_CHARACTERISTIC HYS_NGS_VERIAESP75 KF_MOMOTMAXNDCGSP75 KL_MGMOTMAXAUFRSSSP75 KL_MOMOTMAXNDRSSSP75 KL_TMAXCGSP75 KL_TSYNAUSCGRSSSP75 KL_TSYNCGNSYNRSSSP75 KL_TSYNCGRSSSP75 ND_NTNMOTRSSSP75 NGS_VERIAESP75 NS_DKIRSSSP75 NS_SYNISTESP75 NS_VERSIAESP75 T_OTSYNKABVSP75 T_RAMAXSP75 T_RAMOTMAXRSSSP75 /end DEF_CHARACTERISTIC
/end FUNCTION
/begin FUNCTION jSasGloRSS82_Fktn "Applikationesgroessen Instanz jSasGloRSS82"
 /begin DEF_CHARACTERISTIC HYS_NGS_VERIAESP82 KF_MOMOTMAXNDCGSP82 KL_MGMOTMAXAUFRSSSP82 KL_MOMOTMAXNDRSSSP82 KL_TMAXCGSP82 KL_TSYNAUSCGRSSSP82 KL_TSYNCGNSYNRSSSP82 KL_TSYNCGRSSSP82 ND_NTNMOTRSSSP82 NGS_VERIAESP82 NS_DKIRSSSP82 NS_SYNISTESP82 NS_VERSIAESP82 T_OTSYNKABVSP82 T_RAMAXSP82 T_RAMOTMAXRSSSP82 /end DEF_CHARACTERISTIC
/end FUNCTION
/begin FUNCTION jSasGloRSS84_Fktn "Applikationesgroessen Instanz jSasGloRSS84"
 /begin DEF_CHARACTERISTIC HYS_NGS_VERIAESP84 KF_MOMOTMAXNDCGSP84 KL_MGMOTMAXAUFRSSSP84 KL_MOMOTMAXNDRSSSP84 KL_TMAXCGSP84 KL_TSYNAUSCGRSSSP84 KL_TSYNCGNSYNRSSSP84 KL_TSYNCGRSSSP84 ND_NTNMOTRSSSP84 NGS_VERIAESP84 NS_DKIRSSSP84 NS_SYNISTESP84 NS_VERSIAESP84 T_OTSYNKABVSP84 T_RAMAXSP84 T_RAMOTMAXRSSSP84 /end DEF_CHARACTERISTIC
/end FUNCTION
/begin FUNCTION jSasGloRSS86_Fktn "Applikationesgroessen Instanz jSasGloRSS86"
 /begin DEF_CHARACTERISTIC HYS_NGS_VERIAESP86 KF_MOMOTMAXNDCGSP86 KL_MGMOTMAXAUFRSSSP86 KL_MOMOTMAXNDRSSSP86 KL_TMAXCGSP86 KL_TSYNAUSCGRSSSP86 KL_TSYNCGNSYNRSSSP86 KL_TSYNCGRSSSP86 ND_NTNMOTRSSSP86 NGS_VERIAESP86 NS_DKIRSSSP86 NS_SYNISTESP86 NS_VERSIAESP86 T_OTSYNKABVSP86 T_RAMAXSP86 T_RAMOTMAXRSSSP86 /end DEF_CHARACTERISTIC
/end FUNCTION
/begin FUNCTION dSasKabGeG_Fktn "Applikationesgroessen der Komponente dSasKabGeG"
 /begin SUB_FUNCTION jSasKabGeGR_Fktn jSasKabGeG1_Fktn jSasKabGeG2_Fktn jSasKabGeG3_Fktn jSasKabGeG4_Fktn jSasKabGeG5_Fktn jSasKabGeG6_Fktn jSasKabGeG7_Fktn jSasKabGeG8_Fktn /end SUB_FUNCTION
/end FUNCTION
/begin FUNCTION jSasKabGeGR_Fktn "Applikationesgroessen Instanz jSasKabGeGR"
 /begin DEF_CHARACTERISTIC KF_POGANDNMOTNTV2_R KF_POGANDNMOTNT_R KF_PRAGACGV2_R KF_PRAGACG_R KL_FCGPOGA_R /end DEF_CHARACTERISTIC
/end FUNCTION
/begin FUNCTION jSasKabGeG1_Fktn "Applikationesgroessen Instanz jSasKabGeG1"
 /begin DEF_CHARACTERISTIC KF_POGANDNMOTNTV2_1 KF_POGANDNMOTNT_1 KF_PRAGACGV2_1 KF_PRAGACG_1 KL_FCGPOGA_1 /end DEF_CHARACTERISTIC
/end FUNCTION
/begin FUNCTION jSasKabGeG2_Fktn "Applikationesgroessen Instanz jSasKabGeG2"
 /begin DEF_CHARACTERISTIC KF_POGANDNMOTNTV2_2 KF_POGANDNMOTNT_2 KF_PRAGACGV2_2 KF_PRAGACG_2 KL_FCGPOGA_2 /end DEF_CHARACTERISTIC
/end FUNCTION
/begin FUNCTION jSasKabGeG3_Fktn "Applikationesgroessen Instanz jSasKabGeG3"
 /begin DEF_CHARACTERISTIC KF_POGANDNMOTNTV2_3 KF_POGANDNMOTNT_3 KF_PRAGACGV2_3 KF_PRAGACG_3 KL_FCGPOGA_3 /end DEF_CHARACTERISTIC
/end FUNCTION
/begin FUNCTION jSasKabGeG4_Fktn "Applikationesgroessen Instanz jSasKabGeG4"
 /begin DEF_CHARACTERISTIC KF_POGANDNMOTNTV2_4 KF_POGANDNMOTNT_4 KF_PRAGACGV2_4 KF_PRAGACG_4 KL_FCGPOGA_4 /end DEF_CHARACTERISTIC
/end FUNCTION
/begin FUNCTION jSasKabGeG5_Fktn "Applikationesgroessen Instanz jSasKabGeG5"
 /begin DEF_CHARACTERISTIC KF_POGANDNMOTNTV2_5 KF_POGANDNMOTNT_5 KF_PRAGACGV2_5 KF_PRAGACG_5 KL_FCGPOGA_5 /end DEF_CHARACTERISTIC
/end FUNCTION
/begin FUNCTION jSasKabGeG6_Fktn "Applikationesgroessen Instanz jSasKabGeG6"
 /begin DEF_CHARACTERISTIC KF_POGANDNMOTNTV2_6 KF_POGANDNMOTNT_6 KF_PRAGACGV2_6 KF_PRAGACG_6 KL_FCGPOGA_6 /end DEF_CHARACTERISTIC
/end FUNCTION
/begin FUNCTION jSasKabGeG7_Fktn "Applikationesgroessen Instanz jSasKabGeG7"
 /begin DEF_CHARACTERISTIC KF_POGANDNMOTNTV2_7 KF_POGANDNMOTNT_7 KF_PRAGACGV2_7 KF_PRAGACG_7 KL_FCGPOGA_7 /end DEF_CHARACTERISTIC
/end FUNCTION
/begin FUNCTION jSasKabGeG8_Fktn "Applikationesgroessen Instanz jSasKabGeG8"
 /begin DEF_CHARACTERISTIC KF_POGANDNMOTNTV2_8 KF_POGANDNMOTNT_8 KF_PRAGACGV2_8 KF_PRAGACG_8 KL_FCGPOGA_8 /end DEF_CHARACTERISTIC
/end FUNCTION
/begin FUNCTION dGeaKzuModeGeG_Fktn "Applikationesgroessen der Komponente dGeaKzuModeGeG"
 /begin SUB_FUNCTION jGeaKzuModeGeGR_Fktn jGeaKzuModeGeG1_Fktn jGeaKzuModeGeG2_Fktn jGeaKzuModeGeG3_Fktn jGeaKzuModeGeG4_Fktn jGeaKzuModeGeG5_Fktn jGeaKzuModeGeG6_Fktn jGeaKzuModeGeG7_Fktn jGeaKzuModeGeG8_Fktn jGeaKzuModeGeGEcoR_Fktn jGeaKzuModeGeGEco1_Fktn jGeaKzuModeGeGEco2_Fktn jGeaKzuModeGeGEco3_Fktn jGeaKzuModeGeGEco4_Fktn jGeaKzuModeGeGEco5_Fktn jGeaKzuModeGeGEco6_Fktn jGeaKzuModeGeGEco7_Fktn jGeaKzuModeGeGEco8_Fktn /end SUB_FUNCTION
/end FUNCTION
/begin FUNCTION jGeaKzuModeGeGR_Fktn "Applikationesgroessen Instanz jGeaKzuModeGeGR" /begin DEF_CHARACTERISTIC KF_PODKIMOTSOLLNMOTGE_R /end DEF_CHARACTERISTIC /end FUNCTION
/begin FUNCTION jGeaKzuModeGeG1_Fktn "Applikationesgroessen Instanz jGeaKzuModeGeG1" /begin DEF_CHARACTERISTIC KF_PODKIMOTSOLLNMOTGE_1 /end DEF_CHARACTERISTIC /end FUNCTION
/begin FUNCTION jGeaKzuModeGeG2_Fktn "Applikationesgroessen Instanz jGeaKzuModeGeG2" /begin DEF_CHARACTERISTIC KF_PODKIMOTSOLLNMOTGE_2 /end DEF_CHARACTERISTIC /end FUNCTION
/begin FUNCTION jGeaKzuModeGeG3_Fktn "Applikationesgroessen Instanz jGeaKzuModeGeG3" /begin DEF_CHARACTERISTIC KF_PODKIMOTSOLLNMOTGE_3 /end DEF_CHARACTERISTIC /end FUNCTION
/begin FUNCTION jGeaKzuModeGeG4_Fktn "Applikationesgroessen Instanz jGeaKzuModeGeG4" /begin DEF_CHARACTERISTIC KF_PODKIMOTSOLLNMOTGE_4 /end DEF_CHARACTERISTIC /end FUNCTION
/begin FUNCTION jGeaKzuModeGeG5_Fktn "Applikationesgroessen Instanz jGeaKzuModeGeG5" /begin DEF_CHARACTERISTIC KF_PODKIMOTSOLLNMOTGE_5 /end DEF_CHARACTERISTIC /end FUNCTION
/begin FUNCTION jGeaKzuModeGeG6_Fktn "Applikationesgroessen Instanz jGeaKzuModeGeG6" /begin DEF_CHARACTERISTIC KF_PODKIMOTSOLLNMOTGE_6 /end DEF_CHARACTERISTIC /end FUNCTION
/begin FUNCTION jGeaKzuModeGeG7_Fktn "Applikationesgroessen Instanz jGeaKzuModeGeG7" /begin DEF_CHARACTERISTIC KF_PODKIMOTSOLLNMOTGE_7 /end DEF_CHARACTERISTIC /end FUNCTION
/begin FUNCTION jGeaKzuModeGeG8_Fktn "Applikationesgroessen Instanz jGeaKzuModeGeG8" /begin DEF_CHARACTERISTIC KF_PODKIMOTSOLLNMOTGE_8 /end DEF_CHARACTERISTIC /end FUNCTION
/begin FUNCTION jGeaKzuModeGeGEcoR_Fktn "Applikationesgroessen Instanz jGeaKzuModeGeGEcoR" /begin DEF_CHARACTERISTIC KF_PODKIMOTSOLLNMOTGE_ECO_R /end DEF_CHARACTERISTIC /end FUNCTION
/begin FUNCTION jGeaKzuModeGeGEco1_Fktn "Applikationesgroessen Instanz jGeaKzuModeGeGEco1" /begin DEF_CHARACTERISTIC KF_PODKIMOTSOLLNMOTGE_ECO_1 /end DEF_CHARACTERISTIC /end FUNCTION
/begin FUNCTION jGeaKzuModeGeGEco2_Fktn "Applikationesgroessen Instanz jGeaKzuModeGeGEco2" /begin DEF_CHARACTERISTIC KF_PODKIMOTSOLLNMOTGE_ECO_2 /end DEF_CHARACTERISTIC /end FUNCTION
/begin FUNCTION jGeaKzuModeGeGEco3_Fktn "Applikationesgroessen Instanz jGeaKzuModeGeGEco3" /begin DEF_CHARACTERISTIC KF_PODKIMOTSOLLNMOTGE_ECO_3 /end DEF_CHARACTERISTIC /end FUNCTION
/begin FUNCTION jGeaKzuModeGeGEco4_Fktn "Applikationesgroessen Instanz jGeaKzuModeGeGEco4" /begin DEF_CHARACTERISTIC KF_PODKIMOTSOLLNMOTGE_ECO_4 /end DEF_CHARACTERISTIC /end FUNCTION
/begin FUNCTION jGeaKzuModeGeGEco5_Fktn "Applikationesgroessen Instanz jGeaKzuModeGeGEco5" /begin DEF_CHARACTERISTIC KF_PODKIMOTSOLLNMOTGE_ECO_5 /end DEF_CHARACTERISTIC /end FUNCTION
/begin FUNCTION jGeaKzuModeGeGEco6_Fktn "Applikationesgroessen Instanz jGeaKzuModeGeGEco6" /begin DEF_CHARACTERISTIC KF_PODKIMOTSOLLNMOTGE_ECO_6 /end DEF_CHARACTERISTIC /end FUNCTION
/begin FUNCTION jGeaKzuModeGeGEco7_Fktn "Applikationesgroessen Instanz jGeaKzuModeGeGEco7" /begin DEF_CHARACTERISTIC KF_PODKIMOTSOLLNMOTGE_ECO_7 /end DEF_CHARACTERISTIC /end FUNCTION
/begin FUNCTION jGeaKzuModeGeGEco8_Fktn "Applikationesgroessen Instanz jGeaKzuModeGeGEco8" /begin DEF_CHARACTERISTIC KF_PODKIMOTSOLLNMOTGE_ECO_8 /end DEF_CHARACTERISTIC /end FUNCTION
/begin FUNCTION dSasGloGeG_Fktn "Applikationesgroessen der Komponente dSasGloGeG"
 /begin SUB_FUNCTION jSasGloGeGR_Fktn jSasGloGeG1_Fktn jSasGloGeG2_Fktn jSasGloGeG3_Fktn jSasGloGeG4_Fktn jSasGloGeG5_Fktn jSasGloGeG6_Fktn jSasGloGeG7_Fktn jSasGloGeG8_Fktn /end SUB_FUNCTION
/end FUNCTION
/begin FUNCTION jSasGloGeGR_Fktn "Applikationesgroessen Instanz jSasGloGeGR" /begin DEF_CHARACTERISTIC KL_TMAXCGGA_R KL_TMAXCG_R T_RAMAX_R /end DEF_CHARACTERISTIC /end FUNCTION
/begin FUNCTION jSasGloGeG1_Fktn "Applikationesgroessen Instanz jSasGloGeG1" /begin DEF_CHARACTERISTIC KL_TMAXCGGA_1 KL_TMAXCG_1 T_RAMAX_1 /end DEF_CHARACTERISTIC /end FUNCTION
/begin FUNCTION jSasGloGeG2_Fktn "Applikationesgroessen Instanz jSasGloGeG2" /begin DEF_CHARACTERISTIC KL_TMAXCGGA_2 KL_TMAXCG_2 T_RAMAX_2 /end DEF_CHARACTERISTIC /end FUNCTION
/begin FUNCTION jSasGloGeG3_Fktn "Applikationesgroessen Instanz jSasGloGeG3" /begin DEF_CHARACTERISTIC KL_TMAXCGGA_3 KL_TMAXCG_3 T_RAMAX_3 /end DEF_CHARACTERISTIC /end FUNCTION
/begin FUNCTION jSasGloGeG4_Fktn "Applikationesgroessen Instanz jSasGloGeG4" /begin DEF_CHARACTERISTIC KL_TMAXCGGA_4 KL_TMAXCG_4 T_RAMAX_4 /end DEF_CHARACTERISTIC /end FUNCTION
/begin FUNCTION jSasGloGeG5_Fktn "Applikationesgroessen Instanz jSasGloGeG5" /begin DEF_CHARACTERISTIC KL_TMAXCGGA_5 KL_TMAXCG_5 T_RAMAX_5 /end DEF_CHARACTERISTIC /end FUNCTION
/begin FUNCTION jSasGloGeG6_Fktn "Applikationesgroessen Instanz jSasGloGeG6" /begin DEF_CHARACTERISTIC KL_TMAXCGGA_6 KL_TMAXCG_6 T_RAMAX_6 /end DEF_CHARACTERISTIC /end FUNCTION
/begin FUNCTION jSasGloGeG7_Fktn "Applikationesgroessen Instanz jSasGloGeG7" /begin DEF_CHARACTERISTIC KL_TMAXCGGA_7 KL_TMAXCG_7 T_RAMAX_7 /end DEF_CHARACTERISTIC /end FUNCTION
/begin FUNCTION jSasGloGeG8_Fktn "Applikationesgroessen Instanz jSasGloGeG8" /begin DEF_CHARACTERISTIC KL_TMAXCGGA_8 KL_TMAXCG_8 T_RAMAX_8 /end DEF_CHARACTERISTIC /end FUNCTION
/begin FUNCTION dSasGeaAl_Fktn "Applikationesgroessen der Komponente dSasGeaAl" /begin SUB_FUNCTION jSasGeaAl_Fktn /end SUB_FUNCTION /end FUNCTION
/begin FUNCTION jSasGeaAl_Fktn "Applikationesgroessen Instanz jSasGeaAl"
 /begin DEF_CHARACTERISTIC KL_PORASASABBRUCHGA KL_TOSFCGD2NR KL_TOSFCGDNR KL_TOSFCGRND ND_SYNABBRGA_D ND_SYNABBRGA_R PO_FDNR PO_FGEDR PO_FGERD PO_FRND PO_SDGEDR PO_SDGERD P_GAKUPPC T_POGERDDR /end DEF_CHARACTERISTIC
/end FUNCTION
/begin FUNCTION dSasKzuGeG_Fktn "Applikationesgroessen der Komponente dSasKzuGeG"
 /begin SUB_FUNCTION jSasKzuGeGR_Fktn jSasKzuGeG1_Fktn jSasKzuGeG2_Fktn jSasKzuGeG3_Fktn jSasKzuGeG4_Fktn jSasKzuGeG5_Fktn jSasKzuGeG6_Fktn jSasKzuGeG7_Fktn jSasKzuGeG8_Fktn /end SUB_FUNCTION
/end FUNCTION
/begin FUNCTION jSasKzuGeGR_Fktn "Applikationesgroessen Instanz jSasKzuGeGR"
 /begin DEF_CHARACTERISTIC KF_PKZU_R KF_POFMTN_R KF_POMLASTCGV2_R KF_POTNDSYNV2_R KF_TRAMTCG_R KL_FPOTNDSYNV2_R KL_PGOFCGV2_R KL_PGOFMT_R KL_PGOKZUNAB_R KL_PGOKZU_R KL_PGRASYNNAB_R KL_PGRASYNV1_R KL_PGRASYNV2_R KL_PGRASYN_R KL_POFCGV1_R KL_POFCGV2_R KL_POFCG_R KL_POKZUCG_R KL_POLASTDKIV2_R KL_PORAKZU_R KL_PORASYNV1_R KL_PORASYNV2_R KL_PORASYN_R KL_TFCGGE_R KL_TFCGV2_R KL_TFV1_R KL_TOVKZUCG_R KL_TVKZUCGV2_R KL_TVKZU_R NS_GENDSYNIAE_R PG_OFV1_R T_SYNRAKZU_R T_SYN_R T_VGEIAE_R T_VKZUV2_R /end DEF_CHARACTERISTIC
/end FUNCTION
/begin FUNCTION jSasKzuGeG1_Fktn "Applikationesgroessen Instanz jSasKzuGeG1"
 /begin DEF_CHARACTERISTIC KF_PKZU_1 KF_POFMTN_1 KF_POMLASTCGV2_1 KF_POTNDSYNV2_1 KF_TRAMTCG_1 KL_FPOTNDSYNV2_1 KL_PGOFCGV2_1 KL_PGOFMT_1 KL_PGOKZUNAB_1 KL_PGOKZU_1 KL_PGRASYNNAB_1 KL_PGRASYNV1_1 KL_PGRASYNV2_1 KL_PGRASYN_1 KL_POFCGV1_1 KL_POFCGV2_1 KL_POFCG_1 KL_POKZUCG_1 KL_POLASTDKIV2_1 KL_PORAKZU_1 KL_PORASYNV1_1 KL_PORASYNV2_1 KL_PORASYN_1 KL_TFCGGE_1 KL_TFCGV2_1 KL_TFV1_1 KL_TOVKZUCG_1 KL_TVKZUCGV2_1 KL_TVKZU_1 NS_GENDSYNIAE_1 PG_OFV1_1 T_SYNRAKZU_1 T_SYN_1 T_VGEIAE_1 T_VKZUV2_1 /end DEF_CHARACTERISTIC
/end FUNCTION
/begin FUNCTION jSasKzuGeG2_Fktn "Applikationesgroessen Instanz jSasKzuGeG2"
 /begin DEF_CHARACTERISTIC KF_PKZU_2 KF_POFMTN_2 KF_POMLASTCGV2_2 KF_POTNDSYNV2_2 KF_TRAMTCG_2 KL_FPOTNDSYNV2_2 KL_PGOFCGV2_2 KL_PGOFMT_2 KL_PGOKZUNAB_2 KL_PGOKZU_2 KL_PGRASYNNAB_2 KL_PGRASYNV1_2 KL_PGRASYNV2_2 KL_PGRASYN_2 KL_POFCGV1_2 KL_POFCGV2_2 KL_POFCG_2 KL_POKZUCG_2 KL_POLASTDKIV2_2 KL_PORAKZU_2 KL_PORASYNV1_2 KL_PORASYNV2_2 KL_PORASYN_2 KL_TFCGGE_2 KL_TFCGV2_2 KL_TFV1_2 KL_TOVKZUCG_2 KL_TVKZUCGV2_2 KL_TVKZU_2 NS_GENDSYNIAE_2 PG_OFV1_2 T_SYNRAKZU_2 T_SYN_2 T_VGEIAE_2 T_VKZUV2_2 /end DEF_CHARACTERISTIC
/end FUNCTION
/begin FUNCTION jSasKzuGeG3_Fktn "Applikationesgroessen Instanz jSasKzuGeG3"
 /begin DEF_CHARACTERISTIC KF_PKZU_3 KF_POFMTN_3 KF_POMLASTCGV2_3 KF_POTNDSYNV2_3 KF_TRAMTCG_3 KL_FPOTNDSYNV2_3 KL_PGOFCGV2_3 KL_PGOFMT_3 KL_PGOKZUNAB_3 KL_PGOKZU_3 KL_PGRASYNNAB_3 KL_PGRASYNV1_3 KL_PGRASYNV2_3 KL_PGRASYN_3 KL_POFCGV1_3 KL_POFCGV2_3 KL_POFCG_3 KL_POKZUCG_3 KL_POLASTDKIV2_3 KL_PORAKZU_3 KL_PORASYNV1_3 KL_PORASYNV2_3 KL_PORASYN_3 KL_TFCGGE_3 KL_TFCGV2_3 KL_TFV1_3 KL_TOVKZUCG_3 KL_TVKZUCGV2_3 KL_TVKZU_3 NS_GENDSYNIAE_3 PG_OFV1_3 T_SYNRAKZU_3 T_SYN_3 T_VGEIAE_3 T_VKZUV2_3 /end DEF_CHARACTERISTIC
/end FUNCTION
/begin FUNCTION jSasKzuGeG4_Fktn "Applikationesgroessen Instanz jSasKzuGeG4"
 /begin DEF_CHARACTERISTIC KF_PKZU_4 KF_POFMTN_4 KF_POMLASTCGV2_4 KF_POTNDSYNV2_4 KF_TRAMTCG_4 KL_FPOTNDSYNV2_4 KL_PGOFCGV2_4 KL_PGOFMT_4 KL_PGOKZUNAB_4 KL_PGOKZU_4 KL_PGRASYNNAB_4 KL_PGRASYNV1_4 KL_PGRASYNV2_4 KL_PGRASYN_4 KL_POFCGV1_4 KL_POFCGV2_4 KL_POFCG_4 KL_POKZUCG_4 KL_POLASTDKIV2_4 KL_PORAKZU_4 KL_PORASYNV1_4 KL_PORASYNV2_4 KL_PORASYN_4 KL_TFCGGE_4 KL_TFCGV2_4 KL_TFV1_4 KL_TOVKZUCG_4 KL_TVKZUCGV2_4 KL_TVKZU_4 NS_GENDSYNIAE_4 PG_OFV1_4 T_SYNRAKZU_4 T_SYN_4 T_VGEIAE_4 T_VKZUV2_4 /end DEF_CHARACTERISTIC
/end FUNCTION
/begin FUNCTION jSasKzuGeG5_Fktn "Applikationesgroessen Instanz jSasKzuGeG5"
 /begin DEF_CHARACTERISTIC KF_PKZU_5 KF_POFMTN_5 KF_POMLASTCGV2_5 KF_POTNDSYNV2_5 KF_TRAMTCG_5 KL_FPOTNDSYNV2_5 KL_PGOFCGV2_5 KL_PGOFMT_5 KL_PGOKZUNAB_5 KL_PGOKZU_5 KL_PGRASYNNAB_5 KL_PGRASYNV1_5 KL_PGRASYNV2_5 KL_PGRASYN_5 KL_POFCGV1_5 KL_POFCGV2_5 KL_POFCG_5 KL_POKZUCG_5 KL_POLASTDKIV2_5 KL_PORAKZU_5 KL_PORASYNV1_5 KL_PORASYNV2_5 KL_PORASYN_5 KL_TFCGGE_5 KL_TFCGV2_5 KL_TFV1_5 KL_TOVKZUCG_5 KL_TVKZUCGV2_5 KL_TVKZU_5 NS_GENDSYNIAE_5 PG_OFV1_5 T_SYNRAKZU_5 T_SYN_5 T_VGEIAE_5 T_VKZUV2_5 /end DEF_CHARACTERISTIC
/end FUNCTION
/begin FUNCTION jSasKzuGeG6_Fktn "Applikationesgroessen Instanz jSasKzuGeG6"
 /begin DEF_CHARACTERISTIC KF_PKZU_6 KF_POFMTN_6 KF_POMLASTCGV2_6 KF_POTNDSYNV2_6 KF_TRAMTCG_6 KL_FPOTNDSYNV2_6 KL_PGOFCGV2_6 KL_PGOFMT_6 KL_PGOKZUNAB_6 KL_PGOKZU_6 KL_PGRASYNNAB_6 KL_PGRASYNV1_6 KL_PGRASYNV2_6 KL_PGRASYN_6 KL_POFCGV1_6 KL_POFCGV2_6 KL_POFCG_6 KL_POKZUCG_6 KL_POLASTDKIV2_6 KL_PORAKZU_6 KL_PORASYNV1_6 KL_PORASYNV2_6 KL_PORASYN_6 KL_TFCGGE_6 KL_TFCGV2_6 KL_TFV1_6 KL_TOVKZUCG_6 KL_TVKZUCGV2_6 KL_TVKZU_6 NS_GENDSYNIAE_6 PG_OFV1_6 T_SYNRAKZU_6 T_SYN_6 T_VGEIAE_6 T_VKZUV2_6 /end DEF_CHARACTERISTIC
/end FUNCTION
/begin FUNCTION jSasKzuGeG7_Fktn "Applikationesgroessen Instanz jSasKzuGeG7"
 /begin DEF_CHARACTERISTIC KF_PKZU_7 KF_POFMTN_7 KF_POMLASTCGV2_7 KF_POTNDSYNV2_7 KF_TRAMTCG_7 KL_FPOTNDSYNV2_7 KL_PGOFCGV2_7 KL_PGOFMT_7 KL_PGOKZUNAB_7 KL_PGOKZU_7 KL_PGRASYNNAB_7 KL_PGRASYNV1_7 KL_PGRASYNV2_7 KL_PGRASYN_7 KL_POFCGV1_7 KL_POFCGV2_7 KL_POFCG_7 KL_POKZUCG_7 KL_POLASTDKIV2_7 KL_PORAKZU_7 KL_PORASYNV1_7 KL_PORASYNV2_7 KL_PORASYN_7 KL_TFCGGE_7 KL_TFCGV2_7 KL_TFV1_7 KL_TOVKZUCG_7 KL_TVKZUCGV2_7 KL_TVKZU_7 NS_GENDSYNIAE_7 PG_OFV1_7 T_SYNRAKZU_7 T_SYN_7 T_VGEIAE_7 T_VKZUV2_7 /end DEF_CHARACTERISTIC
/end FUNCTION
/begin FUNCTION jSasKzuGeG8_Fktn "Applikationesgroessen Instanz jSasKzuGeG8"
 /begin DEF_CHARACTERISTIC KF_PKZU_8 KF_POFMTN_8 KF_POMLASTCGV2_8 KF_POTNDSYNV2_8 KF_TRAMTCG_8 KL_FPOTNDSYNV2_8 KL_PGOFCGV2_8 KL_PGOFMT_8 KL_PGOKZUNAB_8 KL_PGOKZU_8 KL_PGRASYNNAB_8 KL_PGRASYNV1_8 KL_PGRASYNV2_8 KL_PGRASYN_8 KL_POFCGV1_8 KL_POFCGV2_8 KL_POFCG_8 KL_POKZUCG_8 KL_POLASTDKIV2_8 KL_PORAKZU_8 KL_PORASYNV1_8 KL_PORASYNV2_8 KL_PORASYN_8 KL_TFCGGE_8 KL_TFCGV2_8 KL_TFV1_8 KL_TOVKZUCG_8 KL_TVKZUCGV2_8 KL_TVKZU_8 NS_GENDSYNIAE_8 PG_OFV1_8 T_SYNRAKZU_8 T_SYN_8 T_VGEIAE_8 T_VKZUV2_8 /end DEF_CHARACTERISTIC
/end FUNCTION
/begin FUNCTION dSasGlsGeG_Fktn "Applikationesgroessen der Komponente dSasGlsGeG"
 /begin SUB_FUNCTION jSasGlsGeGR_Fktn jSasGlsGeG1_Fktn jSasGlsGeG2_Fktn jSasGlsGeG3_Fktn jSasGlsGeG4_Fktn jSasGlsGeG5_Fktn jSasGlsGeG6_Fktn jSasGlsGeG7_Fktn jSasGlsGeG8_Fktn /end SUB_FUNCTION
/end FUNCTION
/begin FUNCTION jSasGlsGeGR_Fktn "Applikationesgroessen Instanz jSasGlsGeGR"
 /begin DEF_CHARACTERISTIC KF_WNGTNDSYNCGGE_R KL_KIGLSKZUCG_R KL_KPGLSKZUCG_R KL_MPT_WNGTGLS_INIT_R ND_GLSGE_R T_VGLSKZU_R /end DEF_CHARACTERISTIC
/end FUNCTION
/begin FUNCTION jSasGlsGeG1_Fktn "Applikationesgroessen Instanz jSasGlsGeG1"
 /begin DEF_CHARACTERISTIC KF_WNGTNDSYNCGGE_1 KL_KIGLSKZUCG_1 KL_KPGLSKZUCG_1 KL_MPT_WNGTGLS_INIT_1 ND_GLSGE_1 T_VGLSKZU_1 /end DEF_CHARACTERISTIC
/end FUNCTION
/begin FUNCTION jSasGlsGeG2_Fktn "Applikationesgroessen Instanz jSasGlsGeG2"
 /begin DEF_CHARACTERISTIC KF_WNGTNDSYNCGGE_2 KL_KIGLSKZUCG_2 KL_KPGLSKZUCG_2 KL_MPT_WNGTGLS_INIT_2 ND_GLSGE_2 T_VGLSKZU_2 /end DEF_CHARACTERISTIC
/end FUNCTION
/begin FUNCTION jSasGlsGeG3_Fktn "Applikationesgroessen Instanz jSasGlsGeG3"
 /begin DEF_CHARACTERISTIC KF_WNGTNDSYNCGGE_3 KL_KIGLSKZUCG_3 KL_KPGLSKZUCG_3 KL_MPT_WNGTGLS_INIT_3 ND_GLSGE_3 T_VGLSKZU_3 /end DEF_CHARACTERISTIC
/end FUNCTION
/begin FUNCTION jSasGlsGeG4_Fktn "Applikationesgroessen Instanz jSasGlsGeG4"
 /begin DEF_CHARACTERISTIC KF_WNGTNDSYNCGGE_4 KL_KIGLSKZUCG_4 KL_KPGLSKZUCG_4 KL_MPT_WNGTGLS_INIT_4 ND_GLSGE_4 T_VGLSKZU_4 /end DEF_CHARACTERISTIC
/end FUNCTION
/begin FUNCTION jSasGlsGeG5_Fktn "Applikationesgroessen Instanz jSasGlsGeG5"
 /begin DEF_CHARACTERISTIC KF_WNGTNDSYNCGGE_5 KL_KIGLSKZUCG_5 KL_KPGLSKZUCG_5 KL_MPT_WNGTGLS_INIT_5 ND_GLSGE_5 T_VGLSKZU_5 /end DEF_CHARACTERISTIC
/end FUNCTION
/begin FUNCTION jSasGlsGeG6_Fktn "Applikationesgroessen Instanz jSasGlsGeG6"
 /begin DEF_CHARACTERISTIC KF_WNGTNDSYNCGGE_6 KL_KIGLSKZUCG_6 KL_KPGLSKZUCG_6 KL_MPT_WNGTGLS_INIT_6 ND_GLSGE_6 T_VGLSKZU_6 /end DEF_CHARACTERISTIC
/end FUNCTION
/begin RECORD_LAYOUT kw_ui8_S6_S3 FNC_VALUES 1 UBYTE COLUMN_DIR DIRECT /end RECORD_LAYOUT
/begin RECORD_LAYOUT kw_ui16_S6_S3 FNC_VALUES 1 UWORD COLUMN_DIR DIRECT /end RECORD_LAYOUT
/begin RECORD_LAYOUT kw_si16_S6_S3 FNC_VALUES 1 SWORD COLUMN_DIR DIRECT /end RECORD_LAYOUT
/begin RECORD_LAYOUT kl_ui8_S6_S3 FNC_VALUES 3 UBYTE COLUMN_DIR DIRECT AXIS_PTS_X 2 UBYTE INDEX_INCR DIRECT NO_AXIS_PTS_X 1 ULONG /end RECORD_LAYOUT
/begin RECORD_LAYOUT kl_ui16_S6_S3 FNC_VALUES 3 UWORD COLUMN_DIR DIRECT AXIS_PTS_X 2 UWORD INDEX_INCR DIRECT NO_AXIS_PTS_X 1 ULONG /end RECORD_LAYOUT
/begin RECORD_LAYOUT kl_si16_S6_S3 FNC_VALUES 3 SWORD COLUMN_DIR DIRECT AXIS_PTS_X 2 SWORD INDEX_INCR DIRECT NO_AXIS_PTS_X 1 ULONG /end RECORD_LAYOUT
/begin RECORD_LAYOUT kf_si16_S6_S3 FNC_VALUES 5 SWORD ROW_DIR DIRECT AXIS_PTS_X 3 SWORD INDEX_INCR DIRECT AXIS_PTS_Y 4 SWORD INDEX_INCR DIRECT NO_AXIS_PTS_X 1 ULONG NO_AXIS_PTS_Y 2 ULONG /end RECORD_LAYOUT
/end MODULE
/end PROJECT
