ASAP2_VERSION 1 51
/begin PROJECT _929_929 "Gen2_BMW_System_Supplier_Lib"
/begin HEADER "" VERSION "C_03_03" PROJECT_NO _929_929 /end HEADER
/begin MODULE DIM ""
/begin MOD_COMMON "" BYTE_ORDER MSB_FIRST ALIGNMENT_BYTE 1 ALIGNMENT_WORD 2 ALIGNMENT_LONG 4 ALIGNMENT_FLOAT32_IEEE 4 /end MOD_COMMON
/begin MEASUREMENT di_err_state_info[0] "status word of error code [index = KFC-1]" UWORD EH_STANDARD_S5_S3 1 100 0 65535 ECU_ADDRESS 0xFFF8B23C /end MEASUREMENT
/begin MEASUREMENT di_err_state_info[1] "status word of error code [index = KFC-1]" UWORD EH_STANDARD_S5_S3 1 100 0 65535 ECU_ADDRESS 0xFFF8B23E /end MEASUREMENT
/begin MEASUREMENT di_err_state_info[2] "status word of error code [index = KFC-1]" UWORD EH_STANDARD_S5_S3 1 100 0 65535 ECU_ADDRESS 0xFFF8B240 /end MEASUREMENT
/begin MEASUREMENT di_err_state_info[3] "status word of error code [index = KFC-1]" UWORD EH_STANDARD_S5_S3 1 100 0 65535 ECU_ADDRESS 0xFFF8B242 /end MEASUREMENT
/begin MEASUREMENT di_err_state_info[4] "status word of error code [index = KFC-1]" UWORD EH_STANDARD_S5_S3 1 100 0 65535 ECU_ADDRESS 0xFFF8B244 /end MEASUREMENT
/begin MEASUREMENT di_err_state_info[5] "status word of error code [index = KFC-1]" UWORD EH_STANDARD_S5_S3 1 100 0 65535 ECU_ADDRESS 0xFFF8B246 /end MEASUREMENT
/begin MEASUREMENT di_err_state_info[6] "status word of error code [index = KFC-1]" UWORD EH_STANDARD_S5_S3 1 100 0 65535 ECU_ADDRESS 0xFFF8B248 /end MEASUREMENT
/begin MEASUREMENT di_err_state_info[7] "status word of error code [index = KFC-1]" UWORD EH_STANDARD_S5_S3 1 100 0 65535 ECU_ADDRESS 0xFFF8B24A /end MEASUREMENT
/begin MEASUREMENT di_err_state_info[8] "status word of error code [index = KFC-1]" UWORD EH_STANDARD_S5_S3 1 100 0 65535 ECU_ADDRESS 0xFFF8B24C /end MEASUREMENT
/begin MEASUREMENT di_err_state_info[9] "status word of error code [index = KFC-1]" UWORD EH_STANDARD_S5_S3 1 100 0 65535 ECU_ADDRESS 0xFFF8B24E /end MEASUREMENT
/begin MEASUREMENT di_err_state_info[10] "status word of error code [index = KFC-1]" UWORD EH_STANDARD_S5_S3 1 100 0 65535 ECU_ADDRESS 0xFFF8B250 /end MEASUREMENT
/begin MEASUREMENT di_err_state_info[11] "status word of error code [index = KFC-1]" UWORD EH_STANDARD_S5_S3 1 100 0 65535 ECU_ADDRESS 0xFFF8B252 /end MEASUREMENT
/begin MEASUREMENT di_err_state_info[12] "status word of error code [index = KFC-1]" UWORD EH_STANDARD_S5_S3 1 100 0 65535 ECU_ADDRESS 0xFFF8B254 /end MEASUREMENT
/begin MEASUREMENT di_err_state_info[13] "status word of error code [index = KFC-1]" UWORD EH_STANDARD_S5_S3 1 100 0 65535 ECU_ADDRESS 0xFFF8B256 /end MEASUREMENT
/begin MEASUREMENT di_err_state_info[14] "status word of error code [index = KFC-1]" UWORD EH_STANDARD_S5_S3 1 100 0 65535 ECU_ADDRESS 0xFFF8B258 /end MEASUREMENT
/begin MEASUREMENT di_err_state_info[15] "status word of error code [index = KFC-1]" UWORD EH_STANDARD_S5_S3 1 100 0 65535 ECU_ADDRESS 0xFFF8B25A /end MEASUREMENT
/begin MEASUREMENT di_err_state_info[16] "status word of error code [index = KFC-1]" UWORD EH_STANDARD_S5_S3 1 100 0 65535 ECU_ADDRESS 0xFFF8B25C /end MEASUREMENT
/begin MEASUREMENT di_err_state_info[17] "status word of error code [index = KFC-1]" UWORD EH_STANDARD_S5_S3 1 100 0 65535 ECU_ADDRESS 0xFFF8B25E /end MEASUREMENT
/begin MEASUREMENT di_err_state_info[18] "status word of error code [index = KFC-1]" UWORD EH_STANDARD_S5_S3 1 100 0 65535 ECU_ADDRESS 0xFFF8B260 /end MEASUREMENT
/begin MEASUREMENT di_err_state_info[19] "status word of error code [index = KFC-1]" UWORD EH_STANDARD_S5_S3 1 100 0 65535 ECU_ADDRESS 0xFFF8B262 /end MEASUREMENT
/begin MEASUREMENT di_err_state_info[20] "status word of error code [index = KFC-1]" UWORD EH_STANDARD_S5_S3 1 100 0 65535 ECU_ADDRESS 0xFFF8B264 /end MEASUREMENT
/begin MEASUREMENT di_err_state_info[21] "status word of error code [index = KFC-1]" UWORD EH_STANDARD_S5_S3 1 100 0 65535 ECU_ADDRESS 0xFFF8B266 /end MEASUREMENT
/begin MEASUREMENT di_err_state_info[22] "status word of error code [index = KFC-1]" UWORD EH_STANDARD_S5_S3 1 100 0 65535 ECU_ADDRESS 0xFFF8B268 /end MEASUREMENT
/begin MEASUREMENT di_err_state_info[23] "status word of error code [index = KFC-1]" UWORD EH_STANDARD_S5_S3 1 100 0 65535 ECU_ADDRESS 0xFFF8B26A /end MEASUREMENT
/begin MEASUREMENT di_err_state_info[24] "status word of error code [index = KFC-1]" UWORD EH_STANDARD_S5_S3 1 100 0 65535 ECU_ADDRESS 0xFFF8B26C /end MEASUREMENT
/begin MEASUREMENT di_err_state_info[25] "status word of error code [index = KFC-1]" UWORD EH_STANDARD_S5_S3 1 100 0 65535 ECU_ADDRESS 0xFFF8B26E /end MEASUREMENT
/begin MEASUREMENT di_err_state_info[26] "status word of error code [index = KFC-1]" UWORD EH_STANDARD_S5_S3 1 100 0 65535 ECU_ADDRESS 0xFFF8B270 /end MEASUREMENT
/begin MEASUREMENT di_err_state_info[27] "status word of error code [index = KFC-1]" UWORD EH_STANDARD_S5_S3 1 100 0 65535 ECU_ADDRESS 0xFFF8B272 /end MEASUREMENT
/begin MEASUREMENT di_err_state_info[28] "status word of error code [index = KFC-1]" UWORD EH_STANDARD_S5_S3 1 100 0 65535 ECU_ADDRESS 0xFFF8B274 /end MEASUREMENT
/begin MEASUREMENT di_err_state_info[29] "status word of error code [index = KFC-1]" UWORD EH_STANDARD_S5_S3 1 100 0 65535 ECU_ADDRESS 0xFFF8B276 /end MEASUREMENT
/begin MEASUREMENT di_err_state_info[30] "status word of error code [index = KFC-1]" UWORD EH_STANDARD_S5_S3 1 100 0 65535 ECU_ADDRESS 0xFFF8B278 /end MEASUREMENT
/begin MEASUREMENT di_err_state_info[31] "status word of error code [index = KFC-1]" UWORD EH_STANDARD_S5_S3 1 100 0 65535 ECU_ADDRESS 0xFFF8B27A /end MEASUREMENT
/begin MEASUREMENT di_err_state_info[32] "status word of error code [index = KFC-1]" UWORD EH_STANDARD_S5_S3 1 100 0 65535 ECU_ADDRESS 0xFFF8B27C /end MEASUREMENT
/begin MEASUREMENT di_err_state_info[33] "status word of error code [index = KFC-1]" UWORD EH_STANDARD_S5_S3 1 100 0 65535 ECU_ADDRESS 0xFFF8B27E /end MEASUREMENT
/begin MEASUREMENT di_err_state_info[34] "status word of error code [index = KFC-1]" UWORD EH_STANDARD_S5_S3 1 100 0 65535 ECU_ADDRESS 0xFFF8B280 /end MEASUREMENT
/begin MEASUREMENT di_err_state_info[35] "status word of error code [index = KFC-1]" UWORD EH_STANDARD_S5_S3 1 100 0 65535 ECU_ADDRESS 0xFFF8B282 /end MEASUREMENT
/begin MEASUREMENT di_err_state_info[36] "status word of error code [index = KFC-1]" UWORD EH_STANDARD_S5_S3 1 100 0 65535 ECU_ADDRESS 0xFFF8B284 /end MEASUREMENT
/begin MEASUREMENT di_err_state_info[37] "status word of error code [index = KFC-1]" UWORD EH_STANDARD_S5_S3 1 100 0 65535 ECU_ADDRESS 0xFFF8B286 /end MEASUREMENT
/begin MEASUREMENT di_err_state_info[38] "status word of error code [index = KFC-1]" UWORD EH_STANDARD_S5_S3 1 100 0 65535 ECU_ADDRESS 0xFFF8B288 /end MEASUREMENT
/begin MEASUREMENT di_err_state_info[39] "status word of error code [index = KFC-1]" UWORD EH_STANDARD_S5_S3 1 100 0 65535 ECU_ADDRESS 0xFFF8B28A /end MEASUREMENT
/begin MEASUREMENT di_err_state_info[40] "status word of error code [index = KFC-1]" UWORD EH_STANDARD_S5_S3 1 100 0 65535 ECU_ADDRESS 0xFFF8B28C /end MEASUREMENT
/begin MEASUREMENT di_err_state_info[41] "status word of error code [index = KFC-1]" UWORD EH_STANDARD_S5_S3 1 100 0 65535 ECU_ADDRESS 0xFFF8B28E /end MEASUREMENT
/begin MEASUREMENT di_err_state_info[42] "status word of error code [index = KFC-1]" UWORD EH_STANDARD_S5_S3 1 100 0 65535 ECU_ADDRESS 0xFFF8B290 /end MEASUREMENT
/begin MEASUREMENT di_err_state_info[43] "status word of error code [index = KFC-1]" UWORD EH_STANDARD_S5_S3 1 100 0 65535 ECU_ADDRESS 0xFFF8B292 /end MEASUREMENT
/begin MEASUREMENT di_err_state_info[44] "status word of error code [index = KFC-1]" UWORD EH_STANDARD_S5_S3 1 100 0 65535 ECU_ADDRESS 0xFFF8B294 /end MEASUREMENT
/begin MEASUREMENT di_err_state_info[45] "status word of error code [index = KFC-1]" UWORD EH_STANDARD_S5_S3 1 100 0 65535 ECU_ADDRESS 0xFFF8B296 /end MEASUREMENT
/begin MEASUREMENT di_err_state_info[46] "status word of error code [index = KFC-1]" UWORD EH_STANDARD_S5_S3 1 100 0 65535 ECU_ADDRESS 0xFFF8B298 /end MEASUREMENT
/begin MEASUREMENT di_err_state_info[47] "status word of error code [index = KFC-1]" UWORD EH_STANDARD_S5_S3 1 100 0 65535 ECU_ADDRESS 0xFFF8B29A /end MEASUREMENT
/begin MEASUREMENT di_err_state_info[48] "status word of error code [index = KFC-1]" UWORD EH_STANDARD_S5_S3 1 100 0 65535 ECU_ADDRESS 0xFFF8B29C /end MEASUREMENT
/begin MEASUREMENT di_err_state_info[49] "status word of error code [index = KFC-1]" UWORD EH_STANDARD_S5_S3 1 100 0 65535 ECU_ADDRESS 0xFFF8B29E /end MEASUREMENT
/begin MEASUREMENT di_err_state_info[50] "status word of error code [index = KFC-1]" UWORD EH_STANDARD_S5_S3 1 100 0 65535 ECU_ADDRESS 0xFFF8B2A0 /end MEASUREMENT
/begin MEASUREMENT di_err_state_info[51] "status word of error code [index = KFC-1]" UWORD EH_STANDARD_S5_S3 1 100 0 65535 ECU_ADDRESS 0xFFF8B2A2 /end MEASUREMENT
/begin MEASUREMENT di_err_state_info[52] "status word of error code [index = KFC-1]" UWORD EH_STANDARD_S5_S3 1 100 0 65535 ECU_ADDRESS 0xFFF8B2A4 /end MEASUREMENT
/begin MEASUREMENT di_err_state_info[53] "status word of error code [index = KFC-1]" UWORD EH_STANDARD_S5_S3 1 100 0 65535 ECU_ADDRESS 0xFFF8B2A6 /end MEASUREMENT
/begin MEASUREMENT di_err_state_info[54] "status word of error code [index = KFC-1]" UWORD EH_STANDARD_S5_S3 1 100 0 65535 ECU_ADDRESS 0xFFF8B2A8 /end MEASUREMENT
/begin MEASUREMENT di_err_state_info[55] "status word of error code [index = KFC-1]" UWORD EH_STANDARD_S5_S3 1 100 0 65535 ECU_ADDRESS 0xFFF8B2AA /end MEASUREMENT
/begin MEASUREMENT di_err_state_info[56] "status word of error code [index = KFC-1]" UWORD EH_STANDARD_S5_S3 1 100 0 65535 ECU_ADDRESS 0xFFF8B2AC /end MEASUREMENT
/begin MEASUREMENT di_err_state_info[57] "status word of error code [index = KFC-1]" UWORD EH_STANDARD_S5_S3 1 100 0 65535 ECU_ADDRESS 0xFFF8B2AE /end MEASUREMENT
/begin MEASUREMENT di_err_state_info[58] "status word of error code [index = KFC-1]" UWORD EH_STANDARD_S5_S3 1 100 0 65535 ECU_ADDRESS 0xFFF8B2B0 /end MEASUREMENT
/begin MEASUREMENT di_err_state_info[59] "status word of error code [index = KFC-1]" UWORD EH_STANDARD_S5_S3 1 100 0 65535 ECU_ADDRESS 0xFFF8B2B2 /end MEASUREMENT
/begin MEASUREMENT di_err_state_info[60] "status word of error code [index = KFC-1]" UWORD EH_STANDARD_S5_S3 1 100 0 65535 ECU_ADDRESS 0xFFF8B2B4 /end MEASUREMENT
/begin MEASUREMENT di_err_state_info[61] "status word of error code [index = KFC-1]" UWORD EH_STANDARD_S5_S3 1 100 0 65535 ECU_ADDRESS 0xFFF8B2B6 /end MEASUREMENT
/begin MEASUREMENT di_err_state_info[62] "status word of error code [index = KFC-1]" UWORD EH_STANDARD_S5_S3 1 100 0 65535 ECU_ADDRESS 0xFFF8B2B8 /end MEASUREMENT
/begin MEASUREMENT di_err_state_info[63] "status word of error code [index = KFC-1]" UWORD EH_STANDARD_S5_S3 1 100 0 65535 ECU_ADDRESS 0xFFF8B2BA /end MEASUREMENT
/begin MEASUREMENT di_err_state_info[64] "status word of error code [index = KFC-1]" UWORD EH_STANDARD_S5_S3 1 100 0 65535 ECU_ADDRESS 0xFFF8B2BC /end MEASUREMENT
/begin MEASUREMENT di_err_state_info[65] "status word of error code [index = KFC-1]" UWORD EH_STANDARD_S5_S3 1 100 0 65535 ECU_ADDRESS 0xFFF8B2BE /end MEASUREMENT
/begin MEASUREMENT di_err_state_info[66] "status word of error code [index = KFC-1]" UWORD EH_STANDARD_S5_S3 1 100 0 65535 ECU_ADDRESS 0xFFF8B2C0 /end MEASUREMENT
/begin MEASUREMENT di_err_state_info[67] "status word of error code [index = KFC-1]" UWORD EH_STANDARD_S5_S3 1 100 0 65535 ECU_ADDRESS 0xFFF8B2C2 /end MEASUREMENT
/begin MEASUREMENT di_err_state_info[68] "status word of error code [index = KFC-1]" UWORD EH_STANDARD_S5_S3 1 100 0 65535 ECU_ADDRESS 0xFFF8B2C4 /end MEASUREMENT
/begin MEASUREMENT di_err_state_info[69] "status word of error code [index = KFC-1]" UWORD EH_STANDARD_S5_S3 1 100 0 65535 ECU_ADDRESS 0xFFF8B2C6 /end MEASUREMENT
/begin MEASUREMENT di_err_state_info[70] "status word of error code [index = KFC-1]" UWORD EH_STANDARD_S5_S3 1 100 0 65535 ECU_ADDRESS 0xFFF8B2C8 /end MEASUREMENT
/begin MEASUREMENT di_err_state_info[71] "status word of error code [index = KFC-1]" UWORD EH_STANDARD_S5_S3 1 100 0 65535 ECU_ADDRESS 0xFFF8B2CA /end MEASUREMENT
/begin MEASUREMENT di_err_state_info[72] "status word of error code [index = KFC-1]" UWORD EH_STANDARD_S5_S3 1 100 0 65535 ECU_ADDRESS 0xFFF8B2CC /end MEASUREMENT
/begin MEASUREMENT di_err_state_info[73] "status word of error code [index = KFC-1]" UWORD EH_STANDARD_S5_S3 1 100 0 65535 ECU_ADDRESS 0xFFF8B2CE /end MEASUREMENT
/begin MEASUREMENT di_err_state_info[74] "status word of error code [index = KFC-1]" UWORD EH_STANDARD_S5_S3 1 100 0 65535 ECU_ADDRESS 0xFFF8B2D0 /end MEASUREMENT
/begin MEASUREMENT di_err_state_info[75] "status word of error code [index = KFC-1]" UWORD EH_STANDARD_S5_S3 1 100 0 65535 ECU_ADDRESS 0xFFF8B2D2 /end MEASUREMENT
/begin MEASUREMENT di_err_state_info[76] "status word of error code [index = KFC-1]" UWORD EH_STANDARD_S5_S3 1 100 0 65535 ECU_ADDRESS 0xFFF8B2D4 /end MEASUREMENT
/begin MEASUREMENT di_err_state_info[77] "status word of error code [index = KFC-1]" UWORD EH_STANDARD_S5_S3 1 100 0 65535 ECU_ADDRESS 0xFFF8B2D6 /end MEASUREMENT
/begin MEASUREMENT di_err_state_info[78] "status word of error code [index = KFC-1]" UWORD EH_STANDARD_S5_S3 1 100 0 65535 ECU_ADDRESS 0xFFF8B2D8 /end MEASUREMENT
/begin MEASUREMENT di_err_state_info[79] "status word of error code [index = KFC-1]" UWORD EH_STANDARD_S5_S3 1 100 0 65535 ECU_ADDRESS 0xFFF8B2DA /end MEASUREMENT
/begin MEASUREMENT di_err_state_info[80] "status word of error code [index = KFC-1]" UWORD EH_STANDARD_S5_S3 1 100 0 65535 ECU_ADDRESS 0xFFF8B2DC /end MEASUREMENT
/begin MEASUREMENT di_err_state_info[81] "status word of error code [index = KFC-1]" UWORD EH_STANDARD_S5_S3 1 100 0 65535 ECU_ADDRESS 0xFFF8B2DE /end MEASUREMENT
/begin MEASUREMENT di_err_state_info[82] "status word of error code [index = KFC-1]" UWORD EH_STANDARD_S5_S3 1 100 0 65535 ECU_ADDRESS 0xFFF8B2E0 /end MEASUREMENT
/begin MEASUREMENT di_err_state_info[83] "status word of error code [index = KFC-1]" UWORD EH_STANDARD_S5_S3 1 100 0 65535 ECU_ADDRESS 0xFFF8B2E2 /end MEASUREMENT
/begin MEASUREMENT di_err_state_info[84] "status word of error code [index = KFC-1]" UWORD EH_STANDARD_S5_S3 1 100 0 65535 ECU_ADDRESS 0xFFF8B2E4 /end MEASUREMENT
/begin MEASUREMENT di_err_state_info[85] "status word of error code [index = KFC-1]" UWORD EH_STANDARD_S5_S3 1 100 0 65535 ECU_ADDRESS 0xFFF8B2E6 /end MEASUREMENT
/begin MEASUREMENT di_err_state_info[86] "status word of error code [index = KFC-1]" UWORD EH_STANDARD_S5_S3 1 100 0 65535 ECU_ADDRESS 0xFFF8B2E8 /end MEASUREMENT
/begin MEASUREMENT di_err_state_info[87] "status word of error code [index = KFC-1]" UWORD EH_STANDARD_S5_S3 1 100 0 65535 ECU_ADDRESS 0xFFF8B2EA /end MEASUREMENT
/begin MEASUREMENT di_err_state_info[88] "status word of error code [index = KFC-1]" UWORD EH_STANDARD_S5_S3 1 100 0 65535 ECU_ADDRESS 0xFFF8B2EC /end MEASUREMENT
/begin MEASUREMENT di_err_state_info[89] "status word of error code [index = KFC-1]" UWORD EH_STANDARD_S5_S3 1 100 0 65535 ECU_ADDRESS 0xFFF8B2EE /end MEASUREMENT
/begin MEASUREMENT di_err_state_info[90] "status word of error code [index = KFC-1]" UWORD EH_STANDARD_S5_S3 1 100 0 65535 ECU_ADDRESS 0xFFF8B2F0 /end MEASUREMENT
/begin MEASUREMENT di_err_state_info[91] "status word of error code [index = KFC-1]" UWORD EH_STANDARD_S5_S3 1 100 0 65535 ECU_ADDRESS 0xFFF8B2F2 /end MEASUREMENT
/begin MEASUREMENT di_err_state_info[92] "status word of error code [index = KFC-1]" UWORD EH_STANDARD_S5_S3 1 100 0 65535 ECU_ADDRESS 0xFFF8B2F4 /end MEASUREMENT
/begin MEASUREMENT di_err_state_info[93] "status word of error code [index = KFC-1]" UWORD EH_STANDARD_S5_S3 1 100 0 65535 ECU_ADDRESS 0xFFF8B2F6 /end MEASUREMENT
/begin MEASUREMENT di_err_state_info[94] "status word of error code [index = KFC-1]" UWORD EH_STANDARD_S5_S3 1 100 0 65535 ECU_ADDRESS 0xFFF8B2F8 /end MEASUREMENT
/begin MEASUREMENT di_err_state_info[95] "status word of error code [index = KFC-1]" UWORD EH_STANDARD_S5_S3 1 100 0 65535 ECU_ADDRESS 0xFFF8B2FA /end MEASUREMENT
/begin MEASUREMENT di_err_state_info[96] "status word of error code [index = KFC-1]" UWORD EH_STANDARD_S5_S3 1 100 0 65535 ECU_ADDRESS 0xFFF8B2FC /end MEASUREMENT
/begin MEASUREMENT di_err_state_info[97] "status word of error code [index = KFC-1]" UWORD EH_STANDARD_S5_S3 1 100 0 65535 ECU_ADDRESS 0xFFF8B2FE /end MEASUREMENT
/begin MEASUREMENT di_err_state_info[98] "status word of error code [index = KFC-1]" UWORD EH_STANDARD_S5_S3 1 100 0 65535 ECU_ADDRESS 0xFFF8B300 /end MEASUREMENT
/begin MEASUREMENT di_err_state_info[99] "status word of error code [index = KFC-1]" UWORD EH_STANDARD_S5_S3 1 100 0 65535 ECU_ADDRESS 0xFFF8B302 /end MEASUREMENT
/begin MEASUREMENT di_err_state_info[100] "status word of error code [index = KFC-1]" UWORD EH_STANDARD_S5_S3 1 100 0 65535 ECU_ADDRESS 0xFFF8B304 /end MEASUREMENT
/begin MEASUREMENT di_err_state_info[101] "status word of error code [index = KFC-1]" UWORD EH_STANDARD_S5_S3 1 100 0 65535 ECU_ADDRESS 0xFFF8B306 /end MEASUREMENT
/begin MEASUREMENT di_err_state_info[102] "status word of error code [index = KFC-1]" UWORD EH_STANDARD_S5_S3 1 100 0 65535 ECU_ADDRESS 0xFFF8B308 /end MEASUREMENT
/begin MEASUREMENT di_err_state_info[103] "status word of error code [index = KFC-1]" UWORD EH_STANDARD_S5_S3 1 100 0 65535 ECU_ADDRESS 0xFFF8B30A /end MEASUREMENT
/begin MEASUREMENT di_err_state_info[104] "status word of error code [index = KFC-1]" UWORD EH_STANDARD_S5_S3 1 100 0 65535 ECU_ADDRESS 0xFFF8B30C /end MEASUREMENT
/begin MEASUREMENT di_err_state_info[105] "status word of error code [index = KFC-1]" UWORD EH_STANDARD_S5_S3 1 100 0 65535 ECU_ADDRESS 0xFFF8B30E /end MEASUREMENT
/begin MEASUREMENT di_err_state_info[106] "status word of error code [index = KFC-1]" UWORD EH_STANDARD_S5_S3 1 100 0 65535 ECU_ADDRESS 0xFFF8B310 /end MEASUREMENT
/begin MEASUREMENT di_err_state_info[107] "status word of error code [index = KFC-1]" UWORD EH_STANDARD_S5_S3 1 100 0 65535 ECU_ADDRESS 0xFFF8B312 /end MEASUREMENT
/begin MEASUREMENT di_err_state_info[108] "status word of error code [index = KFC-1]" UWORD EH_STANDARD_S5_S3 1 100 0 65535 ECU_ADDRESS 0xFFF8B314 /end MEASUREMENT
/begin MEASUREMENT di_err_state_info[109] "status word of error code [index = KFC-1]" UWORD EH_STANDARD_S5_S3 1 100 0 65535 ECU_ADDRESS 0xFFF8B316 /end MEASUREMENT
/begin MEASUREMENT di_err_state_info[110] "status word of error code [index = KFC-1]" UWORD EH_STANDARD_S5_S3 1 100 0 65535 ECU_ADDRESS 0xFFF8B318 /end MEASUREMENT
/begin MEASUREMENT di_err_state_info[111] "status word of error code [index = KFC-1]" UWORD EH_STANDARD_S5_S3 1 100 0 65535 ECU_ADDRESS 0xFFF8B31A /end MEASUREMENT
/begin MEASUREMENT di_err_state_info[112] "status word of error code [index = KFC-1]" UWORD EH_STANDARD_S5_S3 1 100 0 65535 ECU_ADDRESS 0xFFF8B31C /end MEASUREMENT
/begin MEASUREMENT di_err_state_info[113] "status word of error code [index = KFC-1]" UWORD EH_STANDARD_S5_S3 1 100 0 65535 ECU_ADDRESS 0xFFF8B31E /end MEASUREMENT
/begin MEASUREMENT di_err_state_info[114] "status word of error code [index = KFC-1]" UWORD EH_STANDARD_S5_S3 1 100 0 65535 ECU_ADDRESS 0xFFF8B320 /end MEASUREMENT
/begin MEASUREMENT di_err_state_info[115] "status word of error code [index = KFC-1]" UWORD EH_STANDARD_S5_S3 1 100 0 65535 ECU_ADDRESS 0xFFF8B322 /end MEASUREMENT
/begin MEASUREMENT di_err_state_info[116] "status word of error code [index = KFC-1]" UWORD EH_STANDARD_S5_S3 1 100 0 65535 ECU_ADDRESS 0xFFF8B324 /end MEASUREMENT
/begin MEASUREMENT di_err_state_info[117] "status word of error code [index = KFC-1]" UWORD EH_STANDARD_S5_S3 1 100 0 65535 ECU_ADDRESS 0xFFF8B326 /end MEASUREMENT
/begin MEASUREMENT di_err_state_info[118] "status word of error code [index = KFC-1]" UWORD EH_STANDARD_S5_S3 1 100 0 65535 ECU_ADDRESS 0xFFF8B328 /end MEASUREMENT
/begin MEASUREMENT di_err_state_info[119] "status word of error code [index = KFC-1]" UWORD EH_STANDARD_S5_S3 1 100 0 65535 ECU_ADDRESS 0xFFF8B32A /end MEASUREMENT
/begin MEASUREMENT di_err_state_info[120] "status word of error code [index = KFC-1]" UWORD EH_STANDARD_S5_S3 1 100 0 65535 ECU_ADDRESS 0xFFF8B32C /end MEASUREMENT
/begin MEASUREMENT di_err_state_info[121] "status word of error code [index = KFC-1]" UWORD EH_STANDARD_S5_S3 1 100 0 65535 ECU_ADDRESS 0xFFF8B32E /end MEASUREMENT
/begin MEASUREMENT di_err_state_info[122] "status word of error code [index = KFC-1]" UWORD EH_STANDARD_S5_S3 1 100 0 65535 ECU_ADDRESS 0xFFF8B330 /end MEASUREMENT
/begin MEASUREMENT di_err_state_info[123] "status word of error code [index = KFC-1]" UWORD EH_STANDARD_S5_S3 1 100 0 65535 ECU_ADDRESS 0xFFF8B332 /end MEASUREMENT
/begin MEASUREMENT di_err_state_info[124] "status word of error code [index = KFC-1]" UWORD EH_STANDARD_S5_S3 1 100 0 65535 ECU_ADDRESS 0xFFF8B334 /end MEASUREMENT
/begin MEASUREMENT di_err_state_info[125] "status word of error code [index = KFC-1]" UWORD EH_STANDARD_S5_S3 1 100 0 65535 ECU_ADDRESS 0xFFF8B336 /end MEASUREMENT
/begin MEASUREMENT di_err_state_info[126] "status word of error code [index = KFC-1]" UWORD EH_STANDARD_S5_S3 1 100 0 65535 ECU_ADDRESS 0xFFF8B338 /end MEASUREMENT
/begin MEASUREMENT di_err_state_info[127] "status word of error code [index = KFC-1]" UWORD EH_STANDARD_S5_S3 1 100 0 65535 ECU_ADDRESS 0xFFF8B33A /end MEASUREMENT
/begin MEASUREMENT di_err_state_info[128] "status word of error code [index = KFC-1]" UWORD EH_STANDARD_S5_S3 1 100 0 65535 ECU_ADDRESS 0xFFF8B33C /end MEASUREMENT
/begin MEASUREMENT di_err_state_info[129] "status word of error code [index = KFC-1]" UWORD EH_STANDARD_S5_S3 1 100 0 65535 ECU_ADDRESS 0xFFF8B33E /end MEASUREMENT
/begin MEASUREMENT di_err_state_info[130] "status word of error code [index = KFC-1]" UWORD EH_STANDARD_S5_S3 1 100 0 65535 ECU_ADDRESS 0xFFF8B340 /end MEASUREMENT
/begin MEASUREMENT di_err_state_info[131] "status word of error code [index = KFC-1]" UWORD EH_STANDARD_S5_S3 1 100 0 65535 ECU_ADDRESS 0xFFF8B342 /end MEASUREMENT
/begin MEASUREMENT di_err_state_info[132] "status word of error code [index = KFC-1]" UWORD EH_STANDARD_S5_S3 1 100 0 65535 ECU_ADDRESS 0xFFF8B344 /end MEASUREMENT
/begin MEASUREMENT di_err_state_info[133] "status word of error code [index = KFC-1]" UWORD EH_STANDARD_S5_S3 1 100 0 65535 ECU_ADDRESS 0xFFF8B346 /end MEASUREMENT
/begin MEASUREMENT di_err_state_info[134] "status word of error code [index = KFC-1]" UWORD EH_STANDARD_S5_S3 1 100 0 65535 ECU_ADDRESS 0xFFF8B348 /end MEASUREMENT
/begin MEASUREMENT di_err_state_info[135] "status word of error code [index = KFC-1]" UWORD EH_STANDARD_S5_S3 1 100 0 65535 ECU_ADDRESS 0xFFF8B34A /end MEASUREMENT
/begin MEASUREMENT di_err_state_info[136] "status word of error code [index = KFC-1]" UWORD EH_STANDARD_S5_S3 1 100 0 65535 ECU_ADDRESS 0xFFF8B34C /end MEASUREMENT
/begin MEASUREMENT di_err_state_info[137] "status word of error code [index = KFC-1]" UWORD EH_STANDARD_S5_S3 1 100 0 65535 ECU_ADDRESS 0xFFF8B34E /end MEASUREMENT
/begin MEASUREMENT di_err_state_info[138] "status word of error code [index = KFC-1]" UWORD EH_STANDARD_S5_S3 1 100 0 65535 ECU_ADDRESS 0xFFF8B350 /end MEASUREMENT
/begin MEASUREMENT di_err_state_info[139] "status word of error code [index = KFC-1]" UWORD EH_STANDARD_S5_S3 1 100 0 65535 ECU_ADDRESS 0xFFF8B352 /end MEASUREMENT
/begin MEASUREMENT di_err_state_info[140] "status word of error code [index = KFC-1]" UWORD EH_STANDARD_S5_S3 1 100 0 65535 ECU_ADDRESS 0xFFF8B354 /end MEASUREMENT
/begin MEASUREMENT di_err_state_info[141] "status word of error code [index = KFC-1]" UWORD EH_STANDARD_S5_S3 1 100 0 65535 ECU_ADDRESS 0xFFF8B356 /end MEASUREMENT
/begin MEASUREMENT di_err_state_info[142] "status word of error code [index = KFC-1]" UWORD EH_STANDARD_S5_S3 1 100 0 65535 ECU_ADDRESS 0xFFF8B358 /end MEASUREMENT
/begin MEASUREMENT di_err_state_info[143] "status word of error code [index = KFC-1]" UWORD EH_STANDARD_S5_S3 1 100 0 65535 ECU_ADDRESS 0xFFF8B35A /end MEASUREMENT
/begin MEASUREMENT di_err_state_info[144] "status word of error code [index = KFC-1]" UWORD EH_STANDARD_S5_S3 1 100 0 65535 ECU_ADDRESS 0xFFF8B35C /end MEASUREMENT
/begin MEASUREMENT di_err_state_info[145] "status word of error code [index = KFC-1]" UWORD EH_STANDARD_S5_S3 1 100 0 65535 ECU_ADDRESS 0xFFF8B35E /end MEASUREMENT
/begin MEASUREMENT di_err_state_info[146] "status word of error code [index = KFC-1]" UWORD EH_STANDARD_S5_S3 1 100 0 65535 ECU_ADDRESS 0xFFF8B360 /end MEASUREMENT
/begin MEASUREMENT di_err_state_info[147] "status word of error code [index = KFC-1]" UWORD EH_STANDARD_S5_S3 1 100 0 65535 ECU_ADDRESS 0xFFF8B362 /end MEASUREMENT
/begin MEASUREMENT di_err_state_info[148] "status word of error code [index = KFC-1]" UWORD EH_STANDARD_S5_S3 1 100 0 65535 ECU_ADDRESS 0xFFF8B364 /end MEASUREMENT
/begin MEASUREMENT di_err_state_info[149] "status word of error code [index = KFC-1]" UWORD EH_STANDARD_S5_S3 1 100 0 65535 ECU_ADDRESS 0xFFF8B366 /end MEASUREMENT
/begin MEASUREMENT di_err_state_info[150] "status word of error code [index = KFC-1]" UWORD EH_STANDARD_S5_S3 1 100 0 65535 ECU_ADDRESS 0xFFF8B368 /end MEASUREMENT
/begin MEASUREMENT di_err_state_info[151] "status word of error code [index = KFC-1]" UWORD EH_STANDARD_S5_S3 1 100 0 65535 ECU_ADDRESS 0xFFF8B36A /end MEASUREMENT
/begin MEASUREMENT di_err_state_info[152] "status word of error code [index = KFC-1]" UWORD EH_STANDARD_S5_S3 1 100 0 65535 ECU_ADDRESS 0xFFF8B36C /end MEASUREMENT
/begin MEASUREMENT di_err_state_info[153] "status word of error code [index = KFC-1]" UWORD EH_STANDARD_S5_S3 1 100 0 65535 ECU_ADDRESS 0xFFF8B36E /end MEASUREMENT
/begin MEASUREMENT di_err_state_info[154] "status word of error code [index = KFC-1]" UWORD EH_STANDARD_S5_S3 1 100 0 65535 ECU_ADDRESS 0xFFF8B370 /end MEASUREMENT
/begin MEASUREMENT di_err_state_info[155] "status word of error code [index = KFC-1]" UWORD EH_STANDARD_S5_S3 1 100 0 65535 ECU_ADDRESS 0xFFF8B372 /end MEASUREMENT
/begin MEASUREMENT di_err_state_info[156] "status word of error code [index = KFC-1]" UWORD EH_STANDARD_S5_S3 1 100 0 65535 ECU_ADDRESS 0xFFF8B374 /end MEASUREMENT
/begin MEASUREMENT di_err_state_info[157] "status word of error code [index = KFC-1]" UWORD EH_STANDARD_S5_S3 1 100 0 65535 ECU_ADDRESS 0xFFF8B376 /end MEASUREMENT
/begin MEASUREMENT di_err_state_info[158] "status word of error code [index = KFC-1]" UWORD EH_STANDARD_S5_S3 1 100 0 65535 ECU_ADDRESS 0xFFF8B378 /end MEASUREMENT
/begin MEASUREMENT di_err_state_info[159] "status word of error code [index = KFC-1]" UWORD EH_STANDARD_S5_S3 1 100 0 65535 ECU_ADDRESS 0xFFF8B37A /end MEASUREMENT
/begin MEASUREMENT di_err_state_info[160] "status word of error code [index = KFC-1]" UWORD EH_STANDARD_S5_S3 1 100 0 65535 ECU_ADDRESS 0xFFF8B37C /end MEASUREMENT
/begin MEASUREMENT di_err_state_info[161] "status word of error code [index = KFC-1]" UWORD EH_STANDARD_S5_S3 1 100 0 65535 ECU_ADDRESS 0xFFF8B37E /end MEASUREMENT
/begin MEASUREMENT di_err_state_info[162] "status word of error code [index = KFC-1]" UWORD EH_STANDARD_S5_S3 1 100 0 65535 ECU_ADDRESS 0xFFF8B380 /end MEASUREMENT
/begin MEASUREMENT di_err_state_info[163] "status word of error code [index = KFC-1]" UWORD EH_STANDARD_S5_S3 1 100 0 65535 ECU_ADDRESS 0xFFF8B382 /end MEASUREMENT
/begin MEASUREMENT di_err_state_info[164] "status word of error code [index = KFC-1]" UWORD EH_STANDARD_S5_S3 1 100 0 65535 ECU_ADDRESS 0xFFF8B384 /end MEASUREMENT
/begin MEASUREMENT di_err_state_info[165] "status word of error code [index = KFC-1]" UWORD EH_STANDARD_S5_S3 1 100 0 65535 ECU_ADDRESS 0xFFF8B386 /end MEASUREMENT
/begin MEASUREMENT di_err_state_info[166] "status word of error code [index = KFC-1]" UWORD EH_STANDARD_S5_S3 1 100 0 65535 ECU_ADDRESS 0xFFF8B388 /end MEASUREMENT
/begin MEASUREMENT di_err_state_info[167] "status word of error code [index = KFC-1]" UWORD EH_STANDARD_S5_S3 1 100 0 65535 ECU_ADDRESS 0xFFF8B38A /end MEASUREMENT
/begin MEASUREMENT di_err_state_info[168] "status word of error code [index = KFC-1]" UWORD EH_STANDARD_S5_S3 1 100 0 65535 ECU_ADDRESS 0xFFF8B38C /end MEASUREMENT
/begin MEASUREMENT di_err_state_info[169] "status word of error code [index = KFC-1]" UWORD EH_STANDARD_S5_S3 1 100 0 65535 ECU_ADDRESS 0xFFF8B38E /end MEASUREMENT
/begin MEASUREMENT di_err_state_info[170] "status word of error code [index = KFC-1]" UWORD EH_STANDARD_S5_S3 1 100 0 65535 ECU_ADDRESS 0xFFF8B390 /end MEASUREMENT
/begin MEASUREMENT di_err_state_info[171] "status word of error code [index = KFC-1]" UWORD EH_STANDARD_S5_S3 1 100 0 65535 ECU_ADDRESS 0xFFF8B392 /end MEASUREMENT
/begin MEASUREMENT di_err_state_info[172] "status word of error code [index = KFC-1]" UWORD EH_STANDARD_S5_S3 1 100 0 65535 ECU_ADDRESS 0xFFF8B394 /end MEASUREMENT
/begin MEASUREMENT di_err_state_info[173] "status word of error code [index = KFC-1]" UWORD EH_STANDARD_S5_S3 1 100 0 65535 ECU_ADDRESS 0xFFF8B396 /end MEASUREMENT
/begin MEASUREMENT di_err_state_info[174] "status word of error code [index = KFC-1]" UWORD EH_STANDARD_S5_S3 1 100 0 65535 ECU_ADDRESS 0xFFF8B398 /end MEASUREMENT
/begin MEASUREMENT di_err_state_info[175] "status word of error code [index = KFC-1]" UWORD EH_STANDARD_S5_S3 1 100 0 65535 ECU_ADDRESS 0xFFF8B39A /end MEASUREMENT
/begin MEASUREMENT di_err_state_info[176] "status word of error code [index = KFC-1]" UWORD EH_STANDARD_S5_S3 1 100 0 65535 ECU_ADDRESS 0xFFF8B39C /end MEASUREMENT
/begin MEASUREMENT di_err_state_info[177] "status word of error code [index = KFC-1]" UWORD EH_STANDARD_S5_S3 1 100 0 65535 ECU_ADDRESS 0xFFF8B39E /end MEASUREMENT
/begin MEASUREMENT di_err_state_info[178] "status word of error code [index = KFC-1]" UWORD EH_STANDARD_S5_S3 1 100 0 65535 ECU_ADDRESS 0xFFF8B3A0 /end MEASUREMENT
/begin MEASUREMENT di_err_state_info[179] "status word of error code [index = KFC-1]" UWORD EH_STANDARD_S5_S3 1 100 0 65535 ECU_ADDRESS 0xFFF8B3A2 /end MEASUREMENT
/begin MEASUREMENT di_err_state_info[180] "status word of error code [index = KFC-1]" UWORD EH_STANDARD_S5_S3 1 100 0 65535 ECU_ADDRESS 0xFFF8B3A4 /end MEASUREMENT
/begin MEASUREMENT di_err_state_info[181] "status word of error code [index = KFC-1]" UWORD EH_STANDARD_S5_S3 1 100 0 65535 ECU_ADDRESS 0xFFF8B3A6 /end MEASUREMENT
/begin MEASUREMENT di_err_state_info[182] "status word of error code [index = KFC-1]" UWORD EH_STANDARD_S5_S3 1 100 0 65535 ECU_ADDRESS 0xFFF8B3A8 /end MEASUREMENT
/begin MEASUREMENT di_err_state_info[183] "status word of error code [index = KFC-1]" UWORD EH_STANDARD_S5_S3 1 100 0 65535 ECU_ADDRESS 0xFFF8B3AA /end MEASUREMENT
/begin MEASUREMENT di_err_state_info[184] "status word of error code [index = KFC-1]" UWORD EH_STANDARD_S5_S3 1 100 0 65535 ECU_ADDRESS 0xFFF8B3AC /end MEASUREMENT
/begin MEASUREMENT di_err_state_info[185] "status word of error code [index = KFC-1]" UWORD EH_STANDARD_S5_S3 1 100 0 65535 ECU_ADDRESS 0xFFF8B3AE /end MEASUREMENT
/begin MEASUREMENT di_err_state_info[186] "status word of error code [index = KFC-1]" UWORD EH_STANDARD_S5_S3 1 100 0 65535 ECU_ADDRESS 0xFFF8B3B0 /end MEASUREMENT
/begin MEASUREMENT di_err_state_info[187] "status word of error code [index = KFC-1]" UWORD EH_STANDARD_S5_S3 1 100 0 65535 ECU_ADDRESS 0xFFF8B3B2 /end MEASUREMENT
/begin MEASUREMENT di_err_state_info[188] "status word of error code [index = KFC-1]" UWORD EH_STANDARD_S5_S3 1 100 0 65535 ECU_ADDRESS 0xFFF8B3B4 /end MEASUREMENT
/begin MEASUREMENT di_err_state_info[189] "status word of error code [index = KFC-1]" UWORD EH_STANDARD_S5_S3 1 100 0 65535 ECU_ADDRESS 0xFFF8B3B6 /end MEASUREMENT
/begin MEASUREMENT di_err_state_info[190] "status word of error code [index = KFC-1]" UWORD EH_STANDARD_S5_S3 1 100 0 65535 ECU_ADDRESS 0xFFF8B3B8 /end MEASUREMENT
/begin MEASUREMENT di_err_state_info[191] "status word of error code [index = KFC-1]" UWORD EH_STANDARD_S5_S3 1 100 0 65535 ECU_ADDRESS 0xFFF8B3BA /end MEASUREMENT
/begin MEASUREMENT di_err_state_info[192] "status word of error code [index = KFC-1]" UWORD EH_STANDARD_S5_S3 1 100 0 65535 ECU_ADDRESS 0xFFF8B3BC /end MEASUREMENT
/begin MEASUREMENT di_err_state_info[193] "status word of error code [index = KFC-1]" UWORD EH_STANDARD_S5_S3 1 100 0 65535 ECU_ADDRESS 0xFFF8B3BE /end MEASUREMENT
/begin MEASUREMENT di_err_state_info[194] "status word of error code [index = KFC-1]" UWORD EH_STANDARD_S5_S3 1 100 0 65535 ECU_ADDRESS 0xFFF8B3C0 /end MEASUREMENT
/begin MEASUREMENT di_err_state_info[195] "status word of error code [index = KFC-1]" UWORD EH_STANDARD_S5_S3 1 100 0 65535 ECU_ADDRESS 0xFFF8B3C2 /end MEASUREMENT
/begin MEASUREMENT di_err_state_info[196] "status word of error code [index = KFC-1]" UWORD EH_STANDARD_S5_S3 1 100 0 65535 ECU_ADDRESS 0xFFF8B3C4 /end MEASUREMENT
/begin MEASUREMENT di_err_state_info[197] "status word of error code [index = KFC-1]" UWORD EH_STANDARD_S5_S3 1 100 0 65535 ECU_ADDRESS 0xFFF8B3C6 /end MEASUREMENT
/begin MEASUREMENT di_err_state_info[198] "status word of error code [index = KFC-1]" UWORD EH_STANDARD_S5_S3 1 100 0 65535 ECU_ADDRESS 0xFFF8B3C8 /end MEASUREMENT
/begin MEASUREMENT di_err_state_info[199] "status word of error code [index = KFC-1]" UWORD EH_STANDARD_S5_S3 1 100 0 65535 ECU_ADDRESS 0xFFF8B3CA /end MEASUREMENT
/begin MEASUREMENT di_err_state_info[200] "status word of error code [index = KFC-1]" UWORD EH_STANDARD_S5_S3 1 100 0 65535 ECU_ADDRESS 0xFFF8B3CC /end MEASUREMENT
/begin MEASUREMENT di_err_state_info[201] "status word of error code [index = KFC-1]" UWORD EH_STANDARD_S5_S3 1 100 0 65535 ECU_ADDRESS 0xFFF8B3CE /end MEASUREMENT
/begin MEASUREMENT di_err_state_info[202] "status word of error code [index = KFC-1]" UWORD EH_STANDARD_S5_S3 1 100 0 65535 ECU_ADDRESS 0xFFF8B3D0 /end MEASUREMENT
/begin MEASUREMENT di_err_state_info[203] "status word of error code [index = KFC-1]" UWORD EH_STANDARD_S5_S3 1 100 0 65535 ECU_ADDRESS 0xFFF8B3D2 /end MEASUREMENT
/begin MEASUREMENT di_err_state_info[204] "status word of error code [index = KFC-1]" UWORD EH_STANDARD_S5_S3 1 100 0 65535 ECU_ADDRESS 0xFFF8B3D4 /end MEASUREMENT
/begin MEASUREMENT di_err_state_info[205] "status word of error code [index = KFC-1]" UWORD EH_STANDARD_S5_S3 1 100 0 65535 ECU_ADDRESS 0xFFF8B3D6 /end MEASUREMENT
/begin MEASUREMENT di_err_state_info[206] "status word of error code [index = KFC-1]" UWORD EH_STANDARD_S5_S3 1 100 0 65535 ECU_ADDRESS 0xFFF8B3D8 /end MEASUREMENT
/begin MEASUREMENT di_err_state_info[207] "status word of error code [index = KFC-1]" UWORD EH_STANDARD_S5_S3 1 100 0 65535 ECU_ADDRESS 0xFFF8B3DA /end MEASUREMENT
/begin MEASUREMENT di_err_state_info[208] "status word of error code [index = KFC-1]" UWORD EH_STANDARD_S5_S3 1 100 0 65535 ECU_ADDRESS 0xFFF8B3DC /end MEASUREMENT
/begin MEASUREMENT di_err_state_info[209] "status word of error code [index = KFC-1]" UWORD EH_STANDARD_S5_S3 1 100 0 65535 ECU_ADDRESS 0xFFF8B3DE /end MEASUREMENT
/begin MEASUREMENT di_err_state_info[210] "status word of error code [index = KFC-1]" UWORD EH_STANDARD_S5_S3 1 100 0 65535 ECU_ADDRESS 0xFFF8B3E0 /end MEASUREMENT
/begin MEASUREMENT di_err_state_info[211] "status word of error code [index = KFC-1]" UWORD EH_STANDARD_S5_S3 1 100 0 65535 ECU_ADDRESS 0xFFF8B3E2 /end MEASUREMENT
/begin MEASUREMENT di_err_state_info[212] "status word of error code [index = KFC-1]" UWORD EH_STANDARD_S5_S3 1 100 0 65535 ECU_ADDRESS 0xFFF8B3E4 /end MEASUREMENT
/begin MEASUREMENT di_err_state_info[213] "status word of error code [index = KFC-1]" UWORD EH_STANDARD_S5_S3 1 100 0 65535 ECU_ADDRESS 0xFFF8B3E6 /end MEASUREMENT
/begin MEASUREMENT di_err_state_info[214] "status word of error code [index = KFC-1]" UWORD EH_STANDARD_S5_S3 1 100 0 65535 ECU_ADDRESS 0xFFF8B3E8 /end MEASUREMENT
/begin MEASUREMENT di_err_state_info[215] "status word of error code [index = KFC-1]" UWORD EH_STANDARD_S5_S3 1 100 0 65535 ECU_ADDRESS 0xFFF8B3EA /end MEASUREMENT
/begin MEASUREMENT di_err_state_info[216] "status word of error code [index = KFC-1]" UWORD EH_STANDARD_S5_S3 1 100 0 65535 ECU_ADDRESS 0xFFF8B3EC /end MEASUREMENT
/begin MEASUREMENT di_err_state_info[217] "status word of error code [index = KFC-1]" UWORD EH_STANDARD_S5_S3 1 100 0 65535 ECU_ADDRESS 0xFFF8B3EE /end MEASUREMENT
/begin MEASUREMENT di_err_state_info[218] "status word of error code [index = KFC-1]" UWORD EH_STANDARD_S5_S3 1 100 0 65535 ECU_ADDRESS 0xFFF8B3F0 /end MEASUREMENT
/begin MEASUREMENT di_err_state_info[219] "status word of error code [index = KFC-1]" UWORD EH_STANDARD_S5_S3 1 100 0 65535 ECU_ADDRESS 0xFFF8B3F2 /end MEASUREMENT
/begin MEASUREMENT di_err_state_info[220] "status word of error code [index = KFC-1]" UWORD EH_STANDARD_S5_S3 1 100 0 65535 ECU_ADDRESS 0xFFF8B3F4 /end MEASUREMENT
/begin MEASUREMENT di_err_state_info[221] "status word of error code [index = KFC-1]" UWORD EH_STANDARD_S5_S3 1 100 0 65535 ECU_ADDRESS 0xFFF8B3F6 /end MEASUREMENT
/begin MEASUREMENT di_err_state_info[222] "status word of error code [index = KFC-1]" UWORD EH_STANDARD_S5_S3 1 100 0 65535 ECU_ADDRESS 0xFFF8B3F8 /end MEASUREMENT
/begin MEASUREMENT di_err_state_info[223] "status word of error code [index = KFC-1]" UWORD EH_STANDARD_S5_S3 1 100 0 65535 ECU_ADDRESS 0xFFF8B3FA /end MEASUREMENT
/begin MEASUREMENT di_err_state_info[224] "status word of error code [index = KFC-1]" UWORD EH_STANDARD_S5_S3 1 100 0 65535 ECU_ADDRESS 0xFFF8B3FC /end MEASUREMENT
/begin MEASUREMENT di_err_state_info[225] "status word of error code [index = KFC-1]" UWORD EH_STANDARD_S5_S3 1 100 0 65535 ECU_ADDRESS 0xFFF8B3FE /end MEASUREMENT
/begin MEASUREMENT di_err_state_info[226] "status word of error code [index = KFC-1]" UWORD EH_STANDARD_S5_S3 1 100 0 65535 ECU_ADDRESS 0xFFF8B400 /end MEASUREMENT
/begin MEASUREMENT di_err_state_info[227] "status word of error code [index = KFC-1]" UWORD EH_STANDARD_S5_S3 1 100 0 65535 ECU_ADDRESS 0xFFF8B402 /end MEASUREMENT
/begin MEASUREMENT di_err_state_info[228] "status word of error code [index = KFC-1]" UWORD EH_STANDARD_S5_S3 1 100 0 65535 ECU_ADDRESS 0xFFF8B404 /end MEASUREMENT
/begin MEASUREMENT di_err_state_info[229] "status word of error code [index = KFC-1]" UWORD EH_STANDARD_S5_S3 1 100 0 65535 ECU_ADDRESS 0xFFF8B406 /end MEASUREMENT
/begin MEASUREMENT di_err_state_info[230] "status word of error code [index = KFC-1]" UWORD EH_STANDARD_S5_S3 1 100 0 65535 ECU_ADDRESS 0xFFF8B408 /end MEASUREMENT
/begin MEASUREMENT di_err_state_info[231] "status word of error code [index = KFC-1]" UWORD EH_STANDARD_S5_S3 1 100 0 65535 ECU_ADDRESS 0xFFF8B40A /end MEASUREMENT
/begin MEASUREMENT di_err_state_info[232] "status word of error code [index = KFC-1]" UWORD EH_STANDARD_S5_S3 1 100 0 65535 ECU_ADDRESS 0xFFF8B40C /end MEASUREMENT
/begin MEASUREMENT di_err_state_info[233] "status word of error code [index = KFC-1]" UWORD EH_STANDARD_S5_S3 1 100 0 65535 ECU_ADDRESS 0xFFF8B40E /end MEASUREMENT
/begin MEASUREMENT di_err_state_info[234] "status word of error code [index = KFC-1]" UWORD EH_STANDARD_S5_S3 1 100 0 65535 ECU_ADDRESS 0xFFF8B410 /end MEASUREMENT
/begin MEASUREMENT di_err_state_info[235] "status word of error code [index = KFC-1]" UWORD EH_STANDARD_S5_S3 1 100 0 65535 ECU_ADDRESS 0xFFF8B412 /end MEASUREMENT
/begin MEASUREMENT di_err_state_info[236] "status word of error code [index = KFC-1]" UWORD EH_STANDARD_S5_S3 1 100 0 65535 ECU_ADDRESS 0xFFF8B414 /end MEASUREMENT
/begin MEASUREMENT di_err_state_info[237] "status word of error code [index = KFC-1]" UWORD EH_STANDARD_S5_S3 1 100 0 65535 ECU_ADDRESS 0xFFF8B416 /end MEASUREMENT
/begin MEASUREMENT di_err_state_info[238] "status word of error code [index = KFC-1]" UWORD EH_STANDARD_S5_S3 1 100 0 65535 ECU_ADDRESS 0xFFF8B418 /end MEASUREMENT
/begin MEASUREMENT di_err_state_info[239] "status word of error code [index = KFC-1]" UWORD EH_STANDARD_S5_S3 1 100 0 65535 ECU_ADDRESS 0xFFF8B41A /end MEASUREMENT
/begin MEASUREMENT di_err_state_info[240] "status word of error code [index = KFC-1]" UWORD EH_STANDARD_S5_S3 1 100 0 65535 ECU_ADDRESS 0xFFF8B41C /end MEASUREMENT
/begin MEASUREMENT di_err_state_info[241] "status word of error code [index = KFC-1]" UWORD EH_STANDARD_S5_S3 1 100 0 65535 ECU_ADDRESS 0xFFF8B41E /end MEASUREMENT
/begin MEASUREMENT di_err_state_info[242] "status word of error code [index = KFC-1]" UWORD EH_STANDARD_S5_S3 1 100 0 65535 ECU_ADDRESS 0xFFF8B420 /end MEASUREMENT
/begin MEASUREMENT di_err_state_info[243] "status word of error code [index = KFC-1]" UWORD EH_STANDARD_S5_S3 1 100 0 65535 ECU_ADDRESS 0xFFF8B422 /end MEASUREMENT
/begin MEASUREMENT di_err_state_info[244] "status word of error code [index = KFC-1]" UWORD EH_STANDARD_S5_S3 1 100 0 65535 ECU_ADDRESS 0xFFF8B424 /end MEASUREMENT
/begin MEASUREMENT di_err_state_info[245] "status word of error code [index = KFC-1]" UWORD EH_STANDARD_S5_S3 1 100 0 65535 ECU_ADDRESS 0xFFF8B426 /end MEASUREMENT
/begin MEASUREMENT di_err_state_info[246] "status word of error code [index = KFC-1]" UWORD EH_STANDARD_S5_S3 1 100 0 65535 ECU_ADDRESS 0xFFF8B428 /end MEASUREMENT
/begin MEASUREMENT di_err_state_info[247] "status word of error code [index = KFC-1]" UWORD EH_STANDARD_S5_S3 1 100 0 65535 ECU_ADDRESS 0xFFF8B42A /end MEASUREMENT
/begin MEASUREMENT di_err_state_info[248] "status word of error code [index = KFC-1]" UWORD EH_STANDARD_S5_S3 1 100 0 65535 ECU_ADDRESS 0xFFF8B42C /end MEASUREMENT
/begin MEASUREMENT di_err_state_info[249] "status word of error code [index = KFC-1]" UWORD EH_STANDARD_S5_S3 1 100 0 65535 ECU_ADDRESS 0xFFF8B42E /end MEASUREMENT
/begin MEASUREMENT di_err_state_info[250] "status word of error code [index = KFC-1]" UWORD EH_STANDARD_S5_S3 1 100 0 65535 ECU_ADDRESS 0xFFF8B430 /end MEASUREMENT
/begin MEASUREMENT di_err_state_info[251] "status word of error code [index = KFC-1]" UWORD EH_STANDARD_S5_S3 1 100 0 65535 ECU_ADDRESS 0xFFF8B432 /end MEASUREMENT
/begin MEASUREMENT di_err_state_info[252] "status word of error code [index = KFC-1]" UWORD EH_STANDARD_S5_S3 1 100 0 65535 ECU_ADDRESS 0xFFF8B434 /end MEASUREMENT
/begin MEASUREMENT di_err_state_info[253] "status word of error code [index = KFC-1]" UWORD EH_STANDARD_S5_S3 1 100 0 65535 ECU_ADDRESS 0xFFF8B436 /end MEASUREMENT
/begin MEASUREMENT di_filter_max_val[0] "maximum reached filter value of error code [index = KFC-1]" UWORD EH_STANDARD_S5_S3 1 100 0 65535 ECU_ADDRESS 0xFFF8B440 /end MEASUREMENT
/begin MEASUREMENT di_filter_max_val[10] "maximum reached filter value of error code [index = KFC-1]" UWORD EH_STANDARD_S5_S3 1 100 0 65535 ECU_ADDRESS 0xFFF8B454 /end MEASUREMENT
/begin MEASUREMENT di_filter_max_val[11] "maximum reached filter value of error code [index = KFC-1]" UWORD EH_STANDARD_S5_S3 1 100 0 65535 ECU_ADDRESS 0xFFF8B456 /end MEASUREMENT
/begin MEASUREMENT di_filter_max_val[12] "maximum reached filter value of error code [index = KFC-1]" UWORD EH_STANDARD_S5_S3 1 100 0 65535 ECU_ADDRESS 0xFFF8B458 /end MEASUREMENT
/begin MEASUREMENT di_filter_max_val[13] "maximum reached filter value of error code [index = KFC-1]" UWORD EH_STANDARD_S5_S3 1 100 0 65535 ECU_ADDRESS 0xFFF8B45A /end MEASUREMENT
/begin MEASUREMENT di_filter_max_val[14] "maximum reached filter value of error code [index = KFC-1]" UWORD EH_STANDARD_S5_S3 1 100 0 65535 ECU_ADDRESS 0xFFF8B45C /end MEASUREMENT
/begin MEASUREMENT di_filter_max_val[15] "maximum reached filter value of error code [index = KFC-1]" UWORD EH_STANDARD_S5_S3 1 100 0 65535 ECU_ADDRESS 0xFFF8B45E /end MEASUREMENT
/begin MEASUREMENT di_filter_max_val[16] "maximum reached filter value of error code [index = KFC-1]" UWORD EH_STANDARD_S5_S3 1 100 0 65535 ECU_ADDRESS 0xFFF8B460 /end MEASUREMENT
/begin MEASUREMENT di_filter_max_val[100] "maximum reached filter value of error code [index = KFC-1]" UWORD EH_STANDARD_S5_S3 1 100 0 65535 ECU_ADDRESS 0xFFF8B508 /end MEASUREMENT
/begin MEASUREMENT di_filter_max_val[101] "maximum reached filter value of error code [index = KFC-1]" UWORD EH_STANDARD_S5_S3 1 100 0 65535 ECU_ADDRESS 0xFFF8B50A /end MEASUREMENT
/begin MEASUREMENT di_filter_max_val[102] "maximum reached filter value of error code [index = KFC-1]" UWORD EH_STANDARD_S5_S3 1 100 0 65535 ECU_ADDRESS 0xFFF8B50C /end MEASUREMENT
/begin MEASUREMENT di_filter_max_val[103] "maximum reached filter value of error code [index = KFC-1]" UWORD EH_STANDARD_S5_S3 1 100 0 65535 ECU_ADDRESS 0xFFF8B50E /end MEASUREMENT
/begin MEASUREMENT di_filter_max_val[104] "maximum reached filter value of error code [index = KFC-1]" UWORD EH_STANDARD_S5_S3 1 100 0 65535 ECU_ADDRESS 0xFFF8B510 /end MEASUREMENT
/begin MEASUREMENT di_filter_max_val[105] "maximum reached filter value of error code [index = KFC-1]" UWORD EH_STANDARD_S5_S3 1 100 0 65535 ECU_ADDRESS 0xFFF8B512 /end MEASUREMENT
/begin MEASUREMENT di_filter_max_val[106] "maximum reached filter value of error code [index = KFC-1]" UWORD EH_STANDARD_S5_S3 1 100 0 65535 ECU_ADDRESS 0xFFF8B514 /end MEASUREMENT
/begin MEASUREMENT di_filter_max_val[107] "maximum reached filter value of error code [index = KFC-1]" UWORD EH_STANDARD_S5_S3 1 100 0 65535 ECU_ADDRESS 0xFFF8B516 /end MEASUREMENT
/begin MEASUREMENT di_filter_max_val[108] "maximum reached filter value of error code [index = KFC-1]" UWORD EH_STANDARD_S5_S3 1 100 0 65535 ECU_ADDRESS 0xFFF8B518 /end MEASUREMENT
/begin MEASUREMENT di_filter_max_val[109] "maximum reached filter value of error code [index = KFC-1]" UWORD EH_STANDARD_S5_S3 1 100 0 65535 ECU_ADDRESS 0xFFF8B51A /end MEASUREMENT
/begin MEASUREMENT di_filter_max_val[110] "maximum reached filter value of error code [index = KFC-1]" UWORD EH_STANDARD_S5_S3 1 100 0 65535 ECU_ADDRESS 0xFFF8B51C /end MEASUREMENT
/begin MEASUREMENT di_filter_max_val[111] "maximum reached filter value of error code [index = KFC-1]" UWORD EH_STANDARD_S5_S3 1 100 0 65535 ECU_ADDRESS 0xFFF8B51E /end MEASUREMENT
/begin MEASUREMENT di_filter_max_val[112] "maximum reached filter value of error code [index = KFC-1]" UWORD EH_STANDARD_S5_S3 1 100 0 65535 ECU_ADDRESS 0xFFF8B520 /end MEASUREMENT
/begin MEASUREMENT di_filter_max_val[113] "maximum reached filter value of error code [index = KFC-1]" UWORD EH_STANDARD_S5_S3 1 100 0 65535 ECU_ADDRESS 0xFFF8B522 /end MEASUREMENT
/begin MEASUREMENT di_filter_max_val[114] "maximum reached filter value of error code [index = KFC-1]" UWORD EH_STANDARD_S5_S3 1 100 0 65535 ECU_ADDRESS 0xFFF8B524 /end MEASUREMENT
/begin MEASUREMENT di_filter_max_val[115] "maximum reached filter value of error code [index = KFC-1]" UWORD EH_STANDARD_S5_S3 1 100 0 65535 ECU_ADDRESS 0xFFF8B526 /end MEASUREMENT
/begin MEASUREMENT di_filter_max_val[116] "maximum reached filter value of error code [index = KFC-1]" UWORD EH_STANDARD_S5_S3 1 100 0 65535 ECU_ADDRESS 0xFFF8B528 /end MEASUREMENT
/begin MEASUREMENT di_filter_max_val[117] "maximum reached filter value of error code [index = KFC-1]" UWORD EH_STANDARD_S5_S3 1 100 0 65535 ECU_ADDRESS 0xFFF8B52A /end MEASUREMENT
/begin MEASUREMENT di_filter_max_val[118] "maximum reached filter value of error code [index = KFC-1]" UWORD EH_STANDARD_S5_S3 1 100 0 65535 ECU_ADDRESS 0xFFF8B52C /end MEASUREMENT
/begin MEASUREMENT di_filter_max_val[119] "maximum reached filter value of error code [index = KFC-1]" UWORD EH_STANDARD_S5_S3 1 100 0 65535 ECU_ADDRESS 0xFFF8B52E /end MEASUREMENT
/begin MEASUREMENT di_filter_max_val[120] "maximum reached filter value of error code [index = KFC-1]" UWORD EH_STANDARD_S5_S3 1 100 0 65535 ECU_ADDRESS 0xFFF8B530 /end MEASUREMENT
/begin MEASUREMENT di_filter_max_val[121] "maximum reached filter value of error code [index = KFC-1]" UWORD EH_STANDARD_S5_S3 1 100 0 65535 ECU_ADDRESS 0xFFF8B532 /end MEASUREMENT
/begin MEASUREMENT di_filter_max_val[122] "maximum reached filter value of error code [index = KFC-1]" UWORD EH_STANDARD_S5_S3 1 100 0 65535 ECU_ADDRESS 0xFFF8B534 /end MEASUREMENT
/begin MEASUREMENT di_filter_max_val[123] "maximum reached filter value of error code [index = KFC-1]" UWORD EH_STANDARD_S5_S3 1 100 0 65535 ECU_ADDRESS 0xFFF8B536 /end MEASUREMENT
/begin MEASUREMENT di_filter_max_val[124] "maximum reached filter value of error code [index = KFC-1]" UWORD EH_STANDARD_S5_S3 1 100 0 65535 ECU_ADDRESS 0xFFF8B538 /end MEASUREMENT
/begin MEASUREMENT di_filter_max_val[125] "maximum reached filter value of error code [index = KFC-1]" UWORD EH_STANDARD_S5_S3 1 100 0 65535 ECU_ADDRESS 0xFFF8B53A /end MEASUREMENT
/begin MEASUREMENT di_filter_max_val[126] "maximum reached filter value of error code [index = KFC-1]" UWORD EH_STANDARD_S5_S3 1 100 0 65535 ECU_ADDRESS 0xFFF8B53C /end MEASUREMENT
/begin MEASUREMENT di_filter_max_val[127] "maximum reached filter value of error code [index = KFC-1]" UWORD EH_STANDARD_S5_S3 1 100 0 65535 ECU_ADDRESS 0xFFF8B53E /end MEASUREMENT
/begin MEASUREMENT di_filter_max_val[128] "maximum reached filter value of error code [index = KFC-1]" UWORD EH_STANDARD_S5_S3 1 100 0 65535 ECU_ADDRESS 0xFFF8B540 /end MEASUREMENT
/begin MEASUREMENT di_filter_max_val[129] "maximum reached filter value of error code [index = KFC-1]" UWORD EH_STANDARD_S5_S3 1 100 0 65535 ECU_ADDRESS 0xFFF8B542 /end MEASUREMENT
/begin MEASUREMENT di_filter_max_val[130] "maximum reached filter value of error code [index = KFC-1]" UWORD EH_STANDARD_S5_S3 1 100 0 65535 ECU_ADDRESS 0xFFF8B544 /end MEASUREMENT
/begin MEASUREMENT di_filter_max_val[131] "maximum reached filter value of error code [index = KFC-1]" UWORD EH_STANDARD_S5_S3 1 100 0 65535 ECU_ADDRESS 0xFFF8B546 /end MEASUREMENT
/begin MEASUREMENT di_filter_max_val[132] "maximum reached filter value of error code [index = KFC-1]" UWORD EH_STANDARD_S5_S3 1 100 0 65535 ECU_ADDRESS 0xFFF8B548 /end MEASUREMENT
/begin MEASUREMENT di_filter_max_val[133] "maximum reached filter value of error code [index = KFC-1]" UWORD EH_STANDARD_S5_S3 1 100 0 65535 ECU_ADDRESS 0xFFF8B54A /end MEASUREMENT
/begin MEASUREMENT di_filter_max_val[134] "maximum reached filter value of error code [index = KFC-1]" UWORD EH_STANDARD_S5_S3 1 100 0 65535 ECU_ADDRESS 0xFFF8B54C /end MEASUREMENT
/begin MEASUREMENT di_filter_max_val[135] "maximum reached filter value of error code [index = KFC-1]" UWORD EH_STANDARD_S5_S3 1 100 0 65535 ECU_ADDRESS 0xFFF8B54E /end MEASUREMENT
/begin MEASUREMENT di_filter_max_val[136] "maximum reached filter value of error code [index = KFC-1]" UWORD EH_STANDARD_S5_S3 1 100 0 65535 ECU_ADDRESS 0xFFF8B550 /end MEASUREMENT
/begin MEASUREMENT di_filter_max_val[137] "maximum reached filter value of error code [index = KFC-1]" UWORD EH_STANDARD_S5_S3 1 100 0 65535 ECU_ADDRESS 0xFFF8B552 /end MEASUREMENT
/begin MEASUREMENT di_filter_max_val[138] "maximum reached filter value of error code [index = KFC-1]" UWORD EH_STANDARD_S5_S3 1 100 0 65535 ECU_ADDRESS 0xFFF8B554 /end MEASUREMENT
/begin MEASUREMENT di_filter_max_val[139] "maximum reached filter value of error code [index = KFC-1]" UWORD EH_STANDARD_S5_S3 1 100 0 65535 ECU_ADDRESS 0xFFF8B556 /end MEASUREMENT
/begin MEASUREMENT di_filter_max_val[140] "maximum reached filter value of error code [index = KFC-1]" UWORD EH_STANDARD_S5_S3 1 100 0 65535 ECU_ADDRESS 0xFFF8B558 /end MEASUREMENT
/begin MEASUREMENT di_filter_max_val[141] "maximum reached filter value of error code [index = KFC-1]" UWORD EH_STANDARD_S5_S3 1 100 0 65535 ECU_ADDRESS 0xFFF8B55A /end MEASUREMENT
/begin MEASUREMENT di_filter_max_val[142] "maximum reached filter value of error code [index = KFC-1]" UWORD EH_STANDARD_S5_S3 1 100 0 65535 ECU_ADDRESS 0xFFF8B55C /end MEASUREMENT
/begin MEASUREMENT di_filter_max_val[143] "maximum reached filter value of error code [index = KFC-1]" UWORD EH_STANDARD_S5_S3 1 100 0 65535 ECU_ADDRESS 0xFFF8B55E /end MEASUREMENT
/begin MEASUREMENT di_filter_max_val[144] "maximum reached filter value of error code [index = KFC-1]" UWORD EH_STANDARD_S5_S3 1 100 0 65535 ECU_ADDRESS 0xFFF8B560 /end MEASUREMENT
/begin MEASUREMENT di_filter_max_val[145] "maximum reached filter value of error code [index = KFC-1]" UWORD EH_STANDARD_S5_S3 1 100 0 65535 ECU_ADDRESS 0xFFF8B562 /end MEASUREMENT
/begin MEASUREMENT di_filter_max_val[146] "maximum reached filter value of error code [index = KFC-1]" UWORD EH_STANDARD_S5_S3 1 100 0 65535 ECU_ADDRESS 0xFFF8B564 /end MEASUREMENT
/begin MEASUREMENT di_filter_max_val[147] "maximum reached filter value of error code [index = KFC-1]" UWORD EH_STANDARD_S5_S3 1 100 0 65535 ECU_ADDRESS 0xFFF8B566 /end MEASUREMENT
/begin MEASUREMENT di_filter_max_val[148] "maximum reached filter value of error code [index = KFC-1]" UWORD EH_STANDARD_S5_S3 1 100 0 65535 ECU_ADDRESS 0xFFF8B568 /end MEASUREMENT
/begin MEASUREMENT di_filter_max_val[149] "maximum reached filter value of error code [index = KFC-1]" UWORD EH_STANDARD_S5_S3 1 100 0 65535 ECU_ADDRESS 0xFFF8B56A /end MEASUREMENT
/begin MEASUREMENT di_filter_max_val[150] "maximum reached filter value of error code [index = KFC-1]" UWORD EH_STANDARD_S5_S3 1 100 0 65535 ECU_ADDRESS 0xFFF8B56C /end MEASUREMENT
/begin MEASUREMENT di_filter_max_val[151] "maximum reached filter value of error code [index = KFC-1]" UWORD EH_STANDARD_S5_S3 1 100 0 65535 ECU_ADDRESS 0xFFF8B56E /end MEASUREMENT
/begin MEASUREMENT di_filter_max_val[152] "maximum reached filter value of error code [index = KFC-1]" UWORD EH_STANDARD_S5_S3 1 100 0 65535 ECU_ADDRESS 0xFFF8B570 /end MEASUREMENT
/begin MEASUREMENT di_filter_max_val[153] "maximum reached filter value of error code [index = KFC-1]" UWORD EH_STANDARD_S5_S3 1 100 0 65535 ECU_ADDRESS 0xFFF8B572 /end MEASUREMENT
/begin MEASUREMENT di_filter_max_val[154] "maximum reached filter value of error code [index = KFC-1]" UWORD EH_STANDARD_S5_S3 1 100 0 65535 ECU_ADDRESS 0xFFF8B574 /end MEASUREMENT
/begin MEASUREMENT di_filter_max_val[155] "maximum reached filter value of error code [index = KFC-1]" UWORD EH_STANDARD_S5_S3 1 100 0 65535 ECU_ADDRESS 0xFFF8B576 /end MEASUREMENT
/begin MEASUREMENT di_filter_max_val[156] "maximum reached filter value of error code [index = KFC-1]" UWORD EH_STANDARD_S5_S3 1 100 0 65535 ECU_ADDRESS 0xFFF8B578 /end MEASUREMENT
/begin MEASUREMENT di_filter_max_val[157] "maximum reached filter value of error code [index = KFC-1]" UWORD EH_STANDARD_S5_S3 1 100 0 65535 ECU_ADDRESS 0xFFF8B57A /end MEASUREMENT
/begin MEASUREMENT di_filter_max_val[158] "maximum reached filter value of error code [index = KFC-1]" UWORD EH_STANDARD_S5_S3 1 100 0 65535 ECU_ADDRESS 0xFFF8B57C /end MEASUREMENT
/begin MEASUREMENT di_filter_max_val[159] "maximum reached filter value of error code [index = KFC-1]" UWORD EH_STANDARD_S5_S3 1 100 0 65535 ECU_ADDRESS 0xFFF8B57E /end MEASUREMENT
/begin MEASUREMENT di_filter_max_val[160] "maximum reached filter value of error code [index = KFC-1]" UWORD EH_STANDARD_S5_S3 1 100 0 65535 ECU_ADDRESS 0xFFF8B580 /end MEASUREMENT
/begin MEASUREMENT di_filter_max_val[161] "maximum reached filter value of error code [index = KFC-1]" UWORD EH_STANDARD_S5_S3 1 100 0 65535 ECU_ADDRESS 0xFFF8B582 /end MEASUREMENT
/begin MEASUREMENT di_filter_max_val[162] "maximum reached filter value of error code [index = KFC-1]" UWORD EH_STANDARD_S5_S3 1 100 0 65535 ECU_ADDRESS 0xFFF8B584 /end MEASUREMENT
/begin MEASUREMENT di_filter_max_val[163] "maximum reached filter value of error code [index = KFC-1]" UWORD EH_STANDARD_S5_S3 1 100 0 65535 ECU_ADDRESS 0xFFF8B586 /end MEASUREMENT
/begin MEASUREMENT di_filter_max_val[164] "maximum reached filter value of error code [index = KFC-1]" UWORD EH_STANDARD_S5_S3 1 100 0 65535 ECU_ADDRESS 0xFFF8B588 /end MEASUREMENT
/begin MEASUREMENT di_filter_max_val[165] "maximum reached filter value of error code [index = KFC-1]" UWORD EH_STANDARD_S5_S3 1 100 0 65535 ECU_ADDRESS 0xFFF8B58A /end MEASUREMENT
/begin MEASUREMENT di_filter_max_val[166] "maximum reached filter value of error code [index = KFC-1]" UWORD EH_STANDARD_S5_S3 1 100 0 65535 ECU_ADDRESS 0xFFF8B58C /end MEASUREMENT
/begin MEASUREMENT di_filter_max_val[167] "maximum reached filter value of error code [index = KFC-1]" UWORD EH_STANDARD_S5_S3 1 100 0 65535 ECU_ADDRESS 0xFFF8B58E /end MEASUREMENT
/begin MEASUREMENT di_filter_max_val[168] "maximum reached filter value of error code [index = KFC-1]" UWORD EH_STANDARD_S5_S3 1 100 0 65535 ECU_ADDRESS 0xFFF8B590 /end MEASUREMENT
/begin MEASUREMENT di_filter_max_val[169] "maximum reached filter value of error code [index = KFC-1]" UWORD EH_STANDARD_S5_S3 1 100 0 65535 ECU_ADDRESS 0xFFF8B592 /end MEASUREMENT
/begin MEASUREMENT di_filter_max_val[170] "maximum reached filter value of error code [index = KFC-1]" UWORD EH_STANDARD_S5_S3 1 100 0 65535 ECU_ADDRESS 0xFFF8B594 /end MEASUREMENT
/begin MEASUREMENT di_filter_max_val[171] "maximum reached filter value of error code [index = KFC-1]" UWORD EH_STANDARD_S5_S3 1 100 0 65535 ECU_ADDRESS 0xFFF8B596 /end MEASUREMENT
/begin MEASUREMENT di_filter_max_val[172] "maximum reached filter value of error code [index = KFC-1]" UWORD EH_STANDARD_S5_S3 1 100 0 65535 ECU_ADDRESS 0xFFF8B598 /end MEASUREMENT
/begin MEASUREMENT di_filter_max_val[173] "maximum reached filter value of error code [index = KFC-1]" UWORD EH_STANDARD_S5_S3 1 100 0 65535 ECU_ADDRESS 0xFFF8B59A /end MEASUREMENT
/begin MEASUREMENT di_filter_max_val[174] "maximum reached filter value of error code [index = KFC-1]" UWORD EH_STANDARD_S5_S3 1 100 0 65535 ECU_ADDRESS 0xFFF8B59C /end MEASUREMENT
/begin MEASUREMENT di_err_det[0] "detected active errors (bitcoded) [0 .. 16-1]" UWORD EH_STANDARD_S5_S3 1 100 0 65535 ECU_ADDRESS 0xFFF8B63C /end MEASUREMENT
/begin MEASUREMENT di_err_det[1] "detected active errors (bitcoded) [0 .. 16-1]" UWORD EH_STANDARD_S5_S3 1 100 0 65535 ECU_ADDRESS 0xFFF8B63E /end MEASUREMENT
/begin MEASUREMENT di_err_det[2] "detected active errors (bitcoded) [0 .. 16-1]" UWORD EH_STANDARD_S5_S3 1 100 0 65535 ECU_ADDRESS 0xFFF8B640 /end MEASUREMENT
/begin MEASUREMENT di_err_det[3] "detected active errors (bitcoded) [0 .. 16-1]" UWORD EH_STANDARD_S5_S3 1 100 0 65535 ECU_ADDRESS 0xFFF8B642 /end MEASUREMENT
/begin MEASUREMENT di_err_det[4] "detected active errors (bitcoded) [0 .. 16-1]" UWORD EH_STANDARD_S5_S3 1 100 0 65535 ECU_ADDRESS 0xFFF8B644 /end MEASUREMENT
/begin MEASUREMENT di_err_det[5] "detected active errors (bitcoded) [0 .. 16-1]" UWORD EH_STANDARD_S5_S3 1 100 0 65535 ECU_ADDRESS 0xFFF8B646 /end MEASUREMENT
/begin MEASUREMENT di_err_det[6] "detected active errors (bitcoded) [0 .. 16-1]" UWORD EH_STANDARD_S5_S3 1 100 0 65535 ECU_ADDRESS 0xFFF8B648 /end MEASUREMENT
/begin MEASUREMENT di_err_det[7] "detected active errors (bitcoded) [0 .. 16-1]" UWORD EH_STANDARD_S5_S3 1 100 0 65535 ECU_ADDRESS 0xFFF8B64A /end MEASUREMENT
/begin MEASUREMENT di_err_det[8] "detected active errors (bitcoded) [0 .. 16-1]" UWORD EH_STANDARD_S5_S3 1 100 0 65535 ECU_ADDRESS 0xFFF8B64C /end MEASUREMENT
/begin MEASUREMENT di_err_det[9] "detected active errors (bitcoded) [0 .. 16-1]" UWORD EH_STANDARD_S5_S3 1 100 0 65535 ECU_ADDRESS 0xFFF8B64E /end MEASUREMENT
/begin MEASUREMENT di_err_det[10] "detected active errors (bitcoded) [0 .. 16-1]" UWORD EH_STANDARD_S5_S3 1 100 0 65535 ECU_ADDRESS 0xFFF8B650 /end MEASUREMENT
/begin MEASUREMENT di_err_det[11] "detected active errors (bitcoded) [0 .. 16-1]" UWORD EH_STANDARD_S5_S3 1 100 0 65535 ECU_ADDRESS 0xFFF8B652 /end MEASUREMENT
/begin MEASUREMENT di_err_det[12] "detected active errors (bitcoded) [0 .. 16-1]" UWORD EH_STANDARD_S5_S3 1 100 0 65535 ECU_ADDRESS 0xFFF8B654 /end MEASUREMENT
/begin MEASUREMENT di_err_det[13] "detected active errors (bitcoded) [0 .. 16-1]" UWORD EH_STANDARD_S5_S3 1 100 0 65535 ECU_ADDRESS 0xFFF8B656 /end MEASUREMENT
/begin MEASUREMENT di_err_det[14] "detected active errors (bitcoded) [0 .. 16-1]" UWORD EH_STANDARD_S5_S3 1 100 0 65535 ECU_ADDRESS 0xFFF8B658 /end MEASUREMENT
/begin MEASUREMENT di_err_det[15] "detected active errors (bitcoded) [0 .. 16-1]" UWORD EH_STANDARD_S5_S3 1 100 0 65535 ECU_ADDRESS 0xFFF8B65A /end MEASUREMENT
/begin MEASUREMENT di_err_deb[0] "debounced errors (bitcoded) [0 .. 16-1]" UWORD EH_STANDARD_S5_S3 1 100 0 65535 ECU_ADDRESS 0xFFF8B65C /end MEASUREMENT
/begin MEASUREMENT di_err_deb[1] "debounced errors (bitcoded) [0 .. 16-1]" UWORD EH_STANDARD_S5_S3 1 100 0 65535 ECU_ADDRESS 0xFFF8B65E /end MEASUREMENT
/begin MEASUREMENT di_err_deb[2] "debounced errors (bitcoded) [0 .. 16-1]" UWORD EH_STANDARD_S5_S3 1 100 0 65535 ECU_ADDRESS 0xFFF8B660 /end MEASUREMENT
/begin MEASUREMENT di_err_deb[3] "debounced errors (bitcoded) [0 .. 16-1]" UWORD EH_STANDARD_S5_S3 1 100 0 65535 ECU_ADDRESS 0xFFF8B662 /end MEASUREMENT
/begin MEASUREMENT di_err_deb[4] "debounced errors (bitcoded) [0 .. 16-1]" UWORD EH_STANDARD_S5_S3 1 100 0 65535 ECU_ADDRESS 0xFFF8B664 /end MEASUREMENT
/begin MEASUREMENT di_err_deb[5] "debounced errors (bitcoded) [0 .. 16-1]" UWORD EH_STANDARD_S5_S3 1 100 0 65535 ECU_ADDRESS 0xFFF8B666 /end MEASUREMENT
/begin MEASUREMENT di_err_deb[6] "debounced errors (bitcoded) [0 .. 16-1]" UWORD EH_STANDARD_S5_S3 1 100 0 65535 ECU_ADDRESS 0xFFF8B668 /end MEASUREMENT
/begin MEASUREMENT di_err_deb[7] "debounced errors (bitcoded) [0 .. 16-1]" UWORD EH_STANDARD_S5_S3 1 100 0 65535 ECU_ADDRESS 0xFFF8B66A /end MEASUREMENT
/begin MEASUREMENT di_err_deb[8] "debounced errors (bitcoded) [0 .. 16-1]" UWORD EH_STANDARD_S5_S3 1 100 0 65535 ECU_ADDRESS 0xFFF8B66C /end MEASUREMENT
/begin MEASUREMENT di_err_deb[9] "debounced errors (bitcoded) [0 .. 16-1]" UWORD EH_STANDARD_S5_S3 1 100 0 65535 ECU_ADDRESS 0xFFF8B66E /end MEASUREMENT
/begin MEASUREMENT di_err_deb[10] "debounced errors (bitcoded) [0 .. 16-1]" UWORD EH_STANDARD_S5_S3 1 100 0 65535 ECU_ADDRESS 0xFFF8B670 /end MEASUREMENT
/begin MEASUREMENT di_err_deb[11] "debounced errors (bitcoded) [0 .. 16-1]" UWORD EH_STANDARD_S5_S3 1 100 0 65535 ECU_ADDRESS 0xFFF8B672 /end MEASUREMENT
/begin MEASUREMENT di_err_deb[12] "debounced errors (bitcoded) [0 .. 16-1]" UWORD EH_STANDARD_S5_S3 1 100 0 65535 ECU_ADDRESS 0xFFF8B674 /end MEASUREMENT
/begin MEASUREMENT di_err_deb[13] "debounced errors (bitcoded) [0 .. 16-1]" UWORD EH_STANDARD_S5_S3 1 100 0 65535 ECU_ADDRESS 0xFFF8B676 /end MEASUREMENT
/begin MEASUREMENT di_err_deb[14] "debounced errors (bitcoded) [0 .. 16-1]" UWORD EH_STANDARD_S5_S3 1 100 0 65535 ECU_ADDRESS 0xFFF8B678 /end MEASUREMENT
/begin MEASUREMENT di_err_deb[15] "debounced errors (bitcoded) [0 .. 16-1]" UWORD EH_STANDARD_S5_S3 1 100 0 65535 ECU_ADDRESS 0xFFF8B67A /end MEASUREMENT
/begin MEASUREMENT ZFEH_Diagnosis.gl_err_rea "all active fault-reactions and protection-reactions (0..31)" ULONG EH_STANDARD_S5_S3 1 100 0 4294967295 DISPLAY_IDENTIFIER gl_err_rea.ZFEH_Diagnosis ECU_ADDRESS 0xFFF8BB64 /end MEASUREMENT
/begin MEASUREMENT ZFEH_Diagnosis.gl_err_rea_hi "all active fault-reactions and protection-reactions (32..63)" ULONG EH_STANDARD_S5_S3 1 100 0 4294967295 DISPLAY_IDENTIFIER gl_err_rea_hi.ZFEH_Diagnosis ECU_ADDRESS 0xFFF8BB68 /end MEASUREMENT
/begin MEASUREMENT ZFEH_Diagnosis.disabled_errors[0] "statusinfo for locked errors (bitcoded, 1 = error disabled, KFC_1=Bit0) [0 .. 16-1]" UWORD EH_STANDARD_S5_S3 1 100 0 65535 DISPLAY_IDENTIFIER disabled_errors[0].ZFEH_Diagnosis ECU_ADDRESS 0xFFF8BB6E /end MEASUREMENT
/begin MEASUREMENT ZFEH_Diagnosis.disabled_errors[1] "statusinfo for locked errors (bitcoded, 1 = error disabled, KFC_1=Bit0) [0 .. 16-1]" UWORD EH_STANDARD_S5_S3 1 100 0 65535 DISPLAY_IDENTIFIER disabled_errors[1].ZFEH_Diagnosis ECU_ADDRESS 0xFFF8BB70 /end MEASUREMENT
/begin MEASUREMENT ZFEH_Diagnosis.disabled_errors[2] "statusinfo for locked errors (bitcoded, 1 = error disabled, KFC_1=Bit0) [0 .. 16-1]" UWORD EH_STANDARD_S5_S3 1 100 0 65535 DISPLAY_IDENTIFIER disabled_errors[2].ZFEH_Diagnosis ECU_ADDRESS 0xFFF8BB72 /end MEASUREMENT
/begin MEASUREMENT ZFEH_Diagnosis.disabled_errors[3] "statusinfo for locked errors (bitcoded, 1 = error disabled, KFC_1=Bit0) [0 .. 16-1]" UWORD EH_STANDARD_S5_S3 1 100 0 65535 DISPLAY_IDENTIFIER disabled_errors[3].ZFEH_Diagnosis ECU_ADDRESS 0xFFF8BB74 /end MEASUREMENT
/begin MEASUREMENT ZFEH_Diagnosis.disabled_errors[4] "statusinfo for locked errors (bitcoded, 1 = error disabled, KFC_1=Bit0) [0 .. 16-1]" UWORD EH_STANDARD_S5_S3 1 100 0 65535 DISPLAY_IDENTIFIER disabled_errors[4].ZFEH_Diagnosis ECU_ADDRESS 0xFFF8BB76 /end MEASUREMENT
/begin MEASUREMENT ZFEH_Diagnosis.disabled_errors[5] "statusinfo for locked errors (bitcoded, 1 = error disabled, KFC_1=Bit0) [0 .. 16-1]" UWORD EH_STANDARD_S5_S3 1 100 0 65535 DISPLAY_IDENTIFIER disabled_errors[5].ZFEH_Diagnosis ECU_ADDRESS 0xFFF8BB78 /end MEASUREMENT
/begin MEASUREMENT ZFEH_Diagnosis.disabled_errors[6] "statusinfo for locked errors (bitcoded, 1 = error disabled, KFC_1=Bit0) [0 .. 16-1]" UWORD EH_STANDARD_S5_S3 1 100 0 65535 DISPLAY_IDENTIFIER disabled_errors[6].ZFEH_Diagnosis ECU_ADDRESS 0xFFF8BB7A /end MEASUREMENT
/begin MEASUREMENT ZFEH_Diagnosis.disabled_errors[7] "statusinfo for locked errors (bitcoded, 1 = error disabled, KFC_1=Bit0) [0 .. 16-1]" UWORD EH_STANDARD_S5_S3 1 100 0 65535 DISPLAY_IDENTIFIER disabled_errors[7].ZFEH_Diagnosis ECU_ADDRESS 0xFFF8BB7C /end MEASUREMENT
/begin MEASUREMENT ZFEH_Diagnosis.disabled_errors[8] "statusinfo for locked errors (bitcoded, 1 = error disabled, KFC_1=Bit0) [0 .. 16-1]" UWORD EH_STANDARD_S5_S3 1 100 0 65535 DISPLAY_IDENTIFIER disabled_errors[8].ZFEH_Diagnosis ECU_ADDRESS 0xFFF8BB7E /end MEASUREMENT
/begin MEASUREMENT ZFEH_Diagnosis.disabled_errors[9] "statusinfo for locked errors (bitcoded, 1 = error disabled, KFC_1=Bit0) [0 .. 16-1]" UWORD EH_STANDARD_S5_S3 1 100 0 65535 DISPLAY_IDENTIFIER disabled_errors[9].ZFEH_Diagnosis ECU_ADDRESS 0xFFF8BB80 /end MEASUREMENT
/begin MEASUREMENT ZFEH_Diagnosis.disabled_errors[10] "statusinfo for locked errors (bitcoded, 1 = error disabled, KFC_1=Bit0) [0 .. 16-1]" UWORD EH_STANDARD_S5_S3 1 100 0 65535 DISPLAY_IDENTIFIER disabled_errors[10].ZFEH_Diagnosis ECU_ADDRESS 0xFFF8BB82 /end MEASUREMENT
/begin MEASUREMENT ZFEH_Diagnosis.disabled_errors[11] "statusinfo for locked errors (bitcoded, 1 = error disabled, KFC_1=Bit0) [0 .. 16-1]" UWORD EH_STANDARD_S5_S3 1 100 0 65535 DISPLAY_IDENTIFIER disabled_errors[11].ZFEH_Diagnosis ECU_ADDRESS 0xFFF8BB84 /end MEASUREMENT
/begin MEASUREMENT ZFEH_Diagnosis.disabled_errors[12] "statusinfo for locked errors (bitcoded, 1 = error disabled, KFC_1=Bit0) [0 .. 16-1]" UWORD EH_STANDARD_S5_S3 1 100 0 65535 DISPLAY_IDENTIFIER disabled_errors[12].ZFEH_Diagnosis ECU_ADDRESS 0xFFF8BB86 /end MEASUREMENT
/begin MEASUREMENT ZFEH_Diagnosis.disabled_errors[13] "statusinfo for locked errors (bitcoded, 1 = error disabled, KFC_1=Bit0) [0 .. 16-1]" UWORD EH_STANDARD_S5_S3 1 100 0 65535 DISPLAY_IDENTIFIER disabled_errors[13].ZFEH_Diagnosis ECU_ADDRESS 0xFFF8BB88 /end MEASUREMENT
/begin MEASUREMENT ZFEH_Diagnosis.disabled_errors[14] "statusinfo for locked errors (bitcoded, 1 = error disabled, KFC_1=Bit0) [0 .. 16-1]" UWORD EH_STANDARD_S5_S3 1 100 0 65535 DISPLAY_IDENTIFIER disabled_errors[14].ZFEH_Diagnosis ECU_ADDRESS 0xFFF8BB8A /end MEASUREMENT
/begin MEASUREMENT ZFEH_Diagnosis.disabled_errors[15] "statusinfo for locked errors (bitcoded, 1 = error disabled, KFC_1=Bit0) [0 .. 16-1]" UWORD EH_STANDARD_S5_S3 1 100 0 65535 DISPLAY_IDENTIFIER disabled_errors[15].ZFEH_Diagnosis ECU_ADDRESS 0xFFF8BB8C /end MEASUREMENT
/begin MEASUREMENT ZFEH_Diagnosis.ctl_CalibrateableTestCond "conditions for global calibratable testconditions fulfilled" UWORD EH_STANDARD_S5_S3 1 100 0 65535 DISPLAY_IDENTIFIER ctl_CalibrateableTestCond.ZFEH_Diagnosis ECU_ADDRESS 0xFFF8BB90 /end MEASUREMENT
/begin MEASUREMENT ZFEH_EepromData.ydiMemory_xau16[8].status_word "status word of error code stored in error memory slot" UWORD EH_STANDARD_S5_S3 1 100 0 65535 DISPLAY_IDENTIFIER status_word.ydiMemory_xau16[8].ZFEH_EepromData ECU_ADDRESS 0xFFF82A50 /end MEASUREMENT
/begin MEASUREMENT ZFEH_EepromData.ydiMemory_xau16[8].permanent_counter "counter of permanent error codes stored in error memory slot" UBYTE EH_STANDARD_S5_S3 1 100 0 255 DISPLAY_IDENTIFIER permanent_counter.ydiMemory_xau16[8].ZFEH_EepromData ECU_ADDRESS 0xFFF82A54 /end MEASUREMENT
/begin MEASUREMENT ZFEH_EepromData.ydiMemory_xau16[8].sequence_counter "sequence counter of error code stored in error memory slot" UBYTE EH_STANDARD_S5_S3 1 100 0 255 DISPLAY_IDENTIFIER sequence_counter.ydiMemory_xau16[8].ZFEH_EepromData ECU_ADDRESS 0xFFF82A55 /end MEASUREMENT
/begin MEASUREMENT ZFEH_EepromData.ydiMemory_xau16[9].amb_cond.ambient_condition[0][0] "ambient condition shot [0 .. 2-1] with 25 data bytes [0 .. 25-1] for the error code stored in this error memory slot" UBYTE EH_STANDARD_S5_S3 1 100 0 255 DISPLAY_IDENTIFIER ambient_condition[0][0].amb_cond.ydiMemory_xau16[9].ZFEH_EepromData ECU_ADDRESS 0xFFF82AA8 /end MEASUREMENT
/begin MEASUREMENT ZFEH_EepromData.ydiMemory_xau16[9].amb_cond.ambient_condition[0][1] "ambient condition shot [0 .. 2-1] with 25 data bytes [0 .. 25-1] for the error code stored in this error memory slot" UBYTE EH_STANDARD_S5_S3 1 100 0 255 DISPLAY_IDENTIFIER ambient_condition[0][1].amb_cond.ydiMemory_xau16[9].ZFEH_EepromData ECU_ADDRESS 0xFFF82AA9 /end MEASUREMENT
/begin MEASUREMENT ZFEH_EepromData.ydiMemory_xau16[9].amb_cond.ambient_condition[0][2] "ambient condition shot [0 .. 2-1] with 25 data bytes [0 .. 25-1] for the error code stored in this error memory slot" UBYTE EH_STANDARD_S5_S3 1 100 0 255 DISPLAY_IDENTIFIER ambient_condition[0][2].amb_cond.ydiMemory_xau16[9].ZFEH_EepromData ECU_ADDRESS 0xFFF82AAA /end MEASUREMENT
/begin MEASUREMENT ZFEH_EepromData.ydiMemory_xau16[9].amb_cond.ambient_condition[0][3] "ambient condition shot [0 .. 2-1] with 25 data bytes [0 .. 25-1] for the error code stored in this error memory slot" UBYTE EH_STANDARD_S5_S3 1 100 0 255 DISPLAY_IDENTIFIER ambient_condition[0][3].amb_cond.ydiMemory_xau16[9].ZFEH_EepromData ECU_ADDRESS 0xFFF82AAB /end MEASUREMENT
/begin MEASUREMENT ZFEH_EepromData.ydiMemory_xau16[9].amb_cond.ambient_condition[0][4] "ambient condition shot [0 .. 2-1] with 25 data bytes [0 .. 25-1] for the error code stored in this error memory slot" UBYTE EH_STANDARD_S5_S3 1 100 0 255 DISPLAY_IDENTIFIER ambient_condition[0][4].amb_cond.ydiMemory_xau16[9].ZFEH_EepromData ECU_ADDRESS 0xFFF82AAC /end MEASUREMENT
/begin MEASUREMENT ZFEH_EepromData.ydiMemory_xau16[9].amb_cond.ambient_condition[0][5] "ambient condition shot [0 .. 2-1] with 25 data bytes [0 .. 25-1] for the error code stored in this error memory slot" UBYTE EH_STANDARD_S5_S3 1 100 0 255 DISPLAY_IDENTIFIER ambient_condition[0][5].amb_cond.ydiMemory_xau16[9].ZFEH_EepromData ECU_ADDRESS 0xFFF82AAD /end MEASUREMENT
/begin MEASUREMENT ZFEH_EepromData.ydiMemory_xau16[9].amb_cond.ambient_condition[0][6] "ambient condition shot [0 .. 2-1] with 25 data bytes [0 .. 25-1] for the error code stored in this error memory slot" UBYTE EH_STANDARD_S5_S3 1 100 0 255 DISPLAY_IDENTIFIER ambient_condition[0][6].amb_cond.ydiMemory_xau16[9].ZFEH_EepromData ECU_ADDRESS 0xFFF82AAE /end MEASUREMENT
/begin MEASUREMENT ZFEH_EepromData.ydiMemory_xau16[9].amb_cond.ambient_condition[0][7] "ambient condition shot [0 .. 2-1] with 25 data bytes [0 .. 25-1] for the error code stored in this error memory slot" UBYTE EH_STANDARD_S5_S3 1 100 0 255 DISPLAY_IDENTIFIER ambient_condition[0][7].amb_cond.ydiMemory_xau16[9].ZFEH_EepromData ECU_ADDRESS 0xFFF82AAF /end MEASUREMENT
/begin MEASUREMENT ZFEH_EepromData.ydiMemory_xau16[9].amb_cond.ambient_condition[0][8] "ambient condition shot [0 .. 2-1] with 25 data bytes [0 .. 25-1] for the error code stored in this error memory slot" UBYTE EH_STANDARD_S5_S3 1 100 0 255 DISPLAY_IDENTIFIER ambient_condition[0][8].amb_cond.ydiMemory_xau16[9].ZFEH_EepromData ECU_ADDRESS 0xFFF82AB0 /end MEASUREMENT
/begin MEASUREMENT ZFEH_EepromData.ydiMemory_xau16[9].amb_cond.ambient_condition[0][9] "ambient condition shot [0 .. 2-1] with 25 data bytes [0 .. 25-1] for the error code stored in this error memory slot" UBYTE EH_STANDARD_S5_S3 1 100 0 255 DISPLAY_IDENTIFIER ambient_condition[0][9].amb_cond.ydiMemory_xau16[9].ZFEH_EepromData ECU_ADDRESS 0xFFF82AB1 /end MEASUREMENT
/begin MEASUREMENT ZFEH_EepromData.ydiMemory_xau16[9].amb_cond.ambient_condition[0][10] "ambient condition shot [0 .. 2-1] with 25 data bytes [0 .. 25-1] for the error code stored in this error memory slot" UBYTE EH_STANDARD_S5_S3 1 100 0 255 DISPLAY_IDENTIFIER ambient_condition[0][10].amb_cond.ydiMemory_xau16[9].ZFEH_EepromData ECU_ADDRESS 0xFFF82AB2 /end MEASUREMENT
/begin MEASUREMENT ZFEH_EepromData.ydiMemory_xau16[9].amb_cond.ambient_condition[0][11] "ambient condition shot [0 .. 2-1] with 25 data bytes [0 .. 25-1] for the error code stored in this error memory slot" UBYTE EH_STANDARD_S5_S3 1 100 0 255 DISPLAY_IDENTIFIER ambient_condition[0][11].amb_cond.ydiMemory_xau16[9].ZFEH_EepromData ECU_ADDRESS 0xFFF82AB3 /end MEASUREMENT
/begin MEASUREMENT ZFEH_EepromData.ydiMemory_xau16[9].amb_cond.ambient_condition[0][12] "ambient condition shot [0 .. 2-1] with 25 data bytes [0 .. 25-1] for the error code stored in this error memory slot" UBYTE EH_STANDARD_S5_S3 1 100 0 255 DISPLAY_IDENTIFIER ambient_condition[0][12].amb_cond.ydiMemory_xau16[9].ZFEH_EepromData ECU_ADDRESS 0xFFF82AB4 /end MEASUREMENT
/begin MEASUREMENT ZFEH_EepromData.ydiMemory_xau16[9].amb_cond.ambient_condition[0][13] "ambient condition shot [0 .. 2-1] with 25 data bytes [0 .. 25-1] for the error code stored in this error memory slot" UBYTE EH_STANDARD_S5_S3 1 100 0 255 DISPLAY_IDENTIFIER ambient_condition[0][13].amb_cond.ydiMemory_xau16[9].ZFEH_EepromData ECU_ADDRESS 0xFFF82AB5 /end MEASUREMENT
/begin MEASUREMENT ZFEH_EepromData.ydiMemory_xau16[9].amb_cond.ambient_condition[0][14] "ambient condition shot [0 .. 2-1] with 25 data bytes [0 .. 25-1] for the error code stored in this error memory slot" UBYTE EH_STANDARD_S5_S3 1 100 0 255 DISPLAY_IDENTIFIER ambient_condition[0][14].amb_cond.ydiMemory_xau16[9].ZFEH_EepromData ECU_ADDRESS 0xFFF82AB6 /end MEASUREMENT
/begin MEASUREMENT ZFEH_EepromData.ydiMemory_xau16[9].amb_cond.ambient_condition[0][15] "ambient condition shot [0 .. 2-1] with 25 data bytes [0 .. 25-1] for the error code stored in this error memory slot" UBYTE EH_STANDARD_S5_S3 1 100 0 255 DISPLAY_IDENTIFIER ambient_condition[0][15].amb_cond.ydiMemory_xau16[9].ZFEH_EepromData ECU_ADDRESS 0xFFF82AB7 /end MEASUREMENT
/begin MEASUREMENT ZFEH_EepromData.ydiMemory_xau16[9].amb_cond.ambient_condition[0][16] "ambient condition shot [0 .. 2-1] with 25 data bytes [0 .. 25-1] for the error code stored in this error memory slot" UBYTE EH_STANDARD_S5_S3 1 100 0 255 DISPLAY_IDENTIFIER ambient_condition[0][16].amb_cond.ydiMemory_xau16[9].ZFEH_EepromData ECU_ADDRESS 0xFFF82AB8 /end MEASUREMENT
/begin MEASUREMENT ZFEH_EepromData.ydiMemory_xau16[9].amb_cond.ambient_condition[0][17] "ambient condition shot [0 .. 2-1] with 25 data bytes [0 .. 25-1] for the error code stored in this error memory slot" UBYTE EH_STANDARD_S5_S3 1 100 0 255 DISPLAY_IDENTIFIER ambient_condition[0][17].amb_cond.ydiMemory_xau16[9].ZFEH_EepromData ECU_ADDRESS 0xFFF82AB9 /end MEASUREMENT
/begin MEASUREMENT ZFEH_EepromData.ydiMemory_xau16[9].amb_cond.ambient_condition[0][18] "ambient condition shot [0 .. 2-1] with 25 data bytes [0 .. 25-1] for the error code stored in this error memory slot" UBYTE EH_STANDARD_S5_S3 1 100 0 255 DISPLAY_IDENTIFIER ambient_condition[0][18].amb_cond.ydiMemory_xau16[9].ZFEH_EepromData ECU_ADDRESS 0xFFF82ABA /end MEASUREMENT
/begin MEASUREMENT ZFEH_EepromData.ydiMemory_xau16[9].amb_cond.ambient_condition[0][19] "ambient condition shot [0 .. 2-1] with 25 data bytes [0 .. 25-1] for the error code stored in this error memory slot" UBYTE EH_STANDARD_S5_S3 1 100 0 255 DISPLAY_IDENTIFIER ambient_condition[0][19].amb_cond.ydiMemory_xau16[9].ZFEH_EepromData ECU_ADDRESS 0xFFF82ABB /end MEASUREMENT
/begin MEASUREMENT ZFEH_EepromData.ydiMemory_xau16[9].amb_cond.ambient_condition[0][20] "ambient condition shot [0 .. 2-1] with 25 data bytes [0 .. 25-1] for the error code stored in this error memory slot" UBYTE EH_STANDARD_S5_S3 1 100 0 255 DISPLAY_IDENTIFIER ambient_condition[0][20].amb_cond.ydiMemory_xau16[9].ZFEH_EepromData ECU_ADDRESS 0xFFF82ABC /end MEASUREMENT
/begin MEASUREMENT ZFEH_EepromData.ydiMemory_xau16[9].amb_cond.ambient_condition[0][21] "ambient condition shot [0 .. 2-1] with 25 data bytes [0 .. 25-1] for the error code stored in this error memory slot" UBYTE EH_STANDARD_S5_S3 1 100 0 255 DISPLAY_IDENTIFIER ambient_condition[0][21].amb_cond.ydiMemory_xau16[9].ZFEH_EepromData ECU_ADDRESS 0xFFF82ABD /end MEASUREMENT
/begin MEASUREMENT ZFEH_EepromData.ydiMemory_xau16[9].amb_cond.ambient_condition[0][22] "ambient condition shot [0 .. 2-1] with 25 data bytes [0 .. 25-1] for the error code stored in this error memory slot" UBYTE EH_STANDARD_S5_S3 1 100 0 255 DISPLAY_IDENTIFIER ambient_condition[0][22].amb_cond.ydiMemory_xau16[9].ZFEH_EepromData ECU_ADDRESS 0xFFF82ABE /end MEASUREMENT
/begin MEASUREMENT ZFEH_EepromData.ydiMemory_xau16[9].amb_cond.ambient_condition[0][23] "ambient condition shot [0 .. 2-1] with 25 data bytes [0 .. 25-1] for the error code stored in this error memory slot" UBYTE EH_STANDARD_S5_S3 1 100 0 255 DISPLAY_IDENTIFIER ambient_condition[0][23].amb_cond.ydiMemory_xau16[9].ZFEH_EepromData ECU_ADDRESS 0xFFF82ABF /end MEASUREMENT
/begin MEASUREMENT ZFEH_EepromData.ydiMemory_xau16[9].amb_cond.ambient_condition[0][24] "ambient condition shot [0 .. 2-1] with 25 data bytes [0 .. 25-1] for the error code stored in this error memory slot" UBYTE EH_STANDARD_S5_S3 1 100 0 255 DISPLAY_IDENTIFIER ambient_condition[0][24].amb_cond.ydiMemory_xau16[9].ZFEH_EepromData ECU_ADDRESS 0xFFF82AC0 /end MEASUREMENT
/begin MEASUREMENT ZFEH_EepromData.ydiMemory_xau16[9].amb_cond.ambient_condition[1][0] "ambient condition shot [0 .. 2-1] with 25 data bytes [0 .. 25-1] for the error code stored in this error memory slot" UBYTE EH_STANDARD_S5_S3 1 100 0 255 DISPLAY_IDENTIFIER ambient_condition[1][0].amb_cond.ydiMemory_xau16[9].ZFEH_EepromData ECU_ADDRESS 0xFFF82AC1 /end MEASUREMENT
/begin MEASUREMENT ZFEH_EepromData.ydiMemory_xau16[9].amb_cond.ambient_condition[1][1] "ambient condition shot [0 .. 2-1] with 25 data bytes [0 .. 25-1] for the error code stored in this error memory slot" UBYTE EH_STANDARD_S5_S3 1 100 0 255 DISPLAY_IDENTIFIER ambient_condition[1][1].amb_cond.ydiMemory_xau16[9].ZFEH_EepromData ECU_ADDRESS 0xFFF82AC2 /end MEASUREMENT
/begin MEASUREMENT ZFEH_EepromData.ydiMemory_xau16[9].amb_cond.ambient_condition[1][2] "ambient condition shot [0 .. 2-1] with 25 data bytes [0 .. 25-1] for the error code stored in this error memory slot" UBYTE EH_STANDARD_S5_S3 1 100 0 255 DISPLAY_IDENTIFIER ambient_condition[1][2].amb_cond.ydiMemory_xau16[9].ZFEH_EepromData ECU_ADDRESS 0xFFF82AC3 /end MEASUREMENT
/begin MEASUREMENT ZFEH_EepromData.ydiMemory_xau16[9].amb_cond.ambient_condition[1][3] "ambient condition shot [0 .. 2-1] with 25 data bytes [0 .. 25-1] for the error code stored in this error memory slot" UBYTE EH_STANDARD_S5_S3 1 100 0 255 DISPLAY_IDENTIFIER ambient_condition[1][3].amb_cond.ydiMemory_xau16[9].ZFEH_EepromData ECU_ADDRESS 0xFFF82AC4 /end MEASUREMENT
/begin MEASUREMENT ZFEH_EepromData.ydiMemory_xau16[9].amb_cond.ambient_condition[1][4] "ambient condition shot [0 .. 2-1] with 25 data bytes [0 .. 25-1] for the error code stored in this error memory slot" UBYTE EH_STANDARD_S5_S3 1 100 0 255 DISPLAY_IDENTIFIER ambient_condition[1][4].amb_cond.ydiMemory_xau16[9].ZFEH_EepromData ECU_ADDRESS 0xFFF82AC5 /end MEASUREMENT
/begin MEASUREMENT ZFEH_EepromData.ydiMemory_xau16[9].amb_cond.ambient_condition[1][5] "ambient condition shot [0 .. 2-1] with 25 data bytes [0 .. 25-1] for the error code stored in this error memory slot" UBYTE EH_STANDARD_S5_S3 1 100 0 255 DISPLAY_IDENTIFIER ambient_condition[1][5].amb_cond.ydiMemory_xau16[9].ZFEH_EepromData ECU_ADDRESS 0xFFF82AC6 /end MEASUREMENT
/begin MEASUREMENT ZFEH_EepromData.ydiMemory_xau16[9].amb_cond.ambient_condition[1][6] "ambient condition shot [0 .. 2-1] with 25 data bytes [0 .. 25-1] for the error code stored in this error memory slot" UBYTE EH_STANDARD_S5_S3 1 100 0 255 DISPLAY_IDENTIFIER ambient_condition[1][6].amb_cond.ydiMemory_xau16[9].ZFEH_EepromData ECU_ADDRESS 0xFFF82AC7 /end MEASUREMENT
/begin MEASUREMENT ZFEH_EepromData.ydiMemory_xau16[9].amb_cond.ambient_condition[1][7] "ambient condition shot [0 .. 2-1] with 25 data bytes [0 .. 25-1] for the error code stored in this error memory slot" UBYTE EH_STANDARD_S5_S3 1 100 0 255 DISPLAY_IDENTIFIER ambient_condition[1][7].amb_cond.ydiMemory_xau16[9].ZFEH_EepromData ECU_ADDRESS 0xFFF82AC8 /end MEASUREMENT
/begin MEASUREMENT ZFEH_EepromData.ydiMemory_xau16[9].amb_cond.ambient_condition[1][8] "ambient condition shot [0 .. 2-1] with 25 data bytes [0 .. 25-1] for the error code stored in this error memory slot" UBYTE EH_STANDARD_S5_S3 1 100 0 255 DISPLAY_IDENTIFIER ambient_condition[1][8].amb_cond.ydiMemory_xau16[9].ZFEH_EepromData ECU_ADDRESS 0xFFF82AC9 /end MEASUREMENT
/begin MEASUREMENT ZFEH_EepromData.ydiMemory_xau16[9].amb_cond.ambient_condition[1][9] "ambient condition shot [0 .. 2-1] with 25 data bytes [0 .. 25-1] for the error code stored in this error memory slot" UBYTE EH_STANDARD_S5_S3 1 100 0 255 DISPLAY_IDENTIFIER ambient_condition[1][9].amb_cond.ydiMemory_xau16[9].ZFEH_EepromData ECU_ADDRESS 0xFFF82ACA /end MEASUREMENT
/begin MEASUREMENT ZFEH_EepromData.ydiMemory_xau16[9].amb_cond.ambient_condition[1][10] "ambient condition shot [0 .. 2-1] with 25 data bytes [0 .. 25-1] for the error code stored in this error memory slot" UBYTE EH_STANDARD_S5_S3 1 100 0 255 DISPLAY_IDENTIFIER ambient_condition[1][10].amb_cond.ydiMemory_xau16[9].ZFEH_EepromData ECU_ADDRESS 0xFFF82ACB /end MEASUREMENT
/begin MEASUREMENT ZFEH_EepromData.ydiMemory_xau16[9].amb_cond.ambient_condition[1][11] "ambient condition shot [0 .. 2-1] with 25 data bytes [0 .. 25-1] for the error code stored in this error memory slot" UBYTE EH_STANDARD_S5_S3 1 100 0 255 DISPLAY_IDENTIFIER ambient_condition[1][11].amb_cond.ydiMemory_xau16[9].ZFEH_EepromData ECU_ADDRESS 0xFFF82ACC /end MEASUREMENT
/begin MEASUREMENT ZFEH_EepromData.ydiMemory_xau16[9].amb_cond.ambient_condition[1][12] "ambient condition shot [0 .. 2-1] with 25 data bytes [0 .. 25-1] for the error code stored in this error memory slot" UBYTE EH_STANDARD_S5_S3 1 100 0 255 DISPLAY_IDENTIFIER ambient_condition[1][12].amb_cond.ydiMemory_xau16[9].ZFEH_EepromData ECU_ADDRESS 0xFFF82ACD /end MEASUREMENT
/begin MEASUREMENT ZFEH_EepromData.ydiMemory_xau16[9].amb_cond.ambient_condition[1][13] "ambient condition shot [0 .. 2-1] with 25 data bytes [0 .. 25-1] for the error code stored in this error memory slot" UBYTE EH_STANDARD_S5_S3 1 100 0 255 DISPLAY_IDENTIFIER ambient_condition[1][13].amb_cond.ydiMemory_xau16[9].ZFEH_EepromData ECU_ADDRESS 0xFFF82ACE /end MEASUREMENT
/begin MEASUREMENT ZFEH_EepromData.ydiMemory_xau16[9].amb_cond.ambient_condition[1][14] "ambient condition shot [0 .. 2-1] with 25 data bytes [0 .. 25-1] for the error code stored in this error memory slot" UBYTE EH_STANDARD_S5_S3 1 100 0 255 DISPLAY_IDENTIFIER ambient_condition[1][14].amb_cond.ydiMemory_xau16[9].ZFEH_EepromData ECU_ADDRESS 0xFFF82ACF /end MEASUREMENT
/begin MEASUREMENT ZFEH_EepromData.ydiMemory_xau16[9].amb_cond.ambient_condition[1][15] "ambient condition shot [0 .. 2-1] with 25 data bytes [0 .. 25-1] for the error code stored in this error memory slot" UBYTE EH_STANDARD_S5_S3 1 100 0 255 DISPLAY_IDENTIFIER ambient_condition[1][15].amb_cond.ydiMemory_xau16[9].ZFEH_EepromData ECU_ADDRESS 0xFFF82AD0 /end MEASUREMENT
/begin MEASUREMENT ZFEH_EepromData.ydiMemory_xau16[9].amb_cond.ambient_condition[1][16] "ambient condition shot [0 .. 2-1] with 25 data bytes [0 .. 25-1] for the error code stored in this error memory slot" UBYTE EH_STANDARD_S5_S3 1 100 0 255 DISPLAY_IDENTIFIER ambient_condition[1][16].amb_cond.ydiMemory_xau16[9].ZFEH_EepromData ECU_ADDRESS 0xFFF82AD1 /end MEASUREMENT
/begin MEASUREMENT ZFEH_EepromData.ydiMemory_xau16[9].amb_cond.ambient_condition[1][17] "ambient condition shot [0 .. 2-1] with 25 data bytes [0 .. 25-1] for the error code stored in this error memory slot" UBYTE EH_STANDARD_S5_S3 1 100 0 255 DISPLAY_IDENTIFIER ambient_condition[1][17].amb_cond.ydiMemory_xau16[9].ZFEH_EepromData ECU_ADDRESS 0xFFF82AD2 /end MEASUREMENT
/begin MEASUREMENT ZFEH_EepromData.ydiMemory_xau16[9].amb_cond.ambient_condition[1][18] "ambient condition shot [0 .. 2-1] with 25 data bytes [0 .. 25-1] for the error code stored in this error memory slot" UBYTE EH_STANDARD_S5_S3 1 100 0 255 DISPLAY_IDENTIFIER ambient_condition[1][18].amb_cond.ydiMemory_xau16[9].ZFEH_EepromData ECU_ADDRESS 0xFFF82AD3 /end MEASUREMENT
/begin MEASUREMENT ZFEH_EepromData.ydiMemory_xau16[9].amb_cond.ambient_condition[1][19] "ambient condition shot [0 .. 2-1] with 25 data bytes [0 .. 25-1] for the error code stored in this error memory slot" UBYTE EH_STANDARD_S5_S3 1 100 0 255 DISPLAY_IDENTIFIER ambient_condition[1][19].amb_cond.ydiMemory_xau16[9].ZFEH_EepromData ECU_ADDRESS 0xFFF82AD4 /end MEASUREMENT
/begin MEASUREMENT ZFEH_EepromData.ydiMemory_xau16[9].amb_cond.ambient_condition[1][20] "ambient condition shot [0 .. 2-1] with 25 data bytes [0 .. 25-1] for the error code stored in this error memory slot" UBYTE EH_STANDARD_S5_S3 1 100 0 255 DISPLAY_IDENTIFIER ambient_condition[1][20].amb_cond.ydiMemory_xau16[9].ZFEH_EepromData ECU_ADDRESS 0xFFF82AD5 /end MEASUREMENT
/begin MEASUREMENT ZFEH_EepromData.ydiMemory_xau16[9].amb_cond.ambient_condition[1][21] "ambient condition shot [0 .. 2-1] with 25 data bytes [0 .. 25-1] for the error code stored in this error memory slot" UBYTE EH_STANDARD_S5_S3 1 100 0 255 DISPLAY_IDENTIFIER ambient_condition[1][21].amb_cond.ydiMemory_xau16[9].ZFEH_EepromData ECU_ADDRESS 0xFFF82AD6 /end MEASUREMENT
/begin MEASUREMENT ZFEH_EepromData.ydiMemory_xau16[9].amb_cond.ambient_condition[1][22] "ambient condition shot [0 .. 2-1] with 25 data bytes [0 .. 25-1] for the error code stored in this error memory slot" UBYTE EH_STANDARD_S5_S3 1 100 0 255 DISPLAY_IDENTIFIER ambient_condition[1][22].amb_cond.ydiMemory_xau16[9].ZFEH_EepromData ECU_ADDRESS 0xFFF82AD7 /end MEASUREMENT
/begin MEASUREMENT ZFEH_EepromData.ydiMemory_xau16[9].amb_cond.ambient_condition[1][23] "ambient condition shot [0 .. 2-1] with 25 data bytes [0 .. 25-1] for the error code stored in this error memory slot" UBYTE EH_STANDARD_S5_S3 1 100 0 255 DISPLAY_IDENTIFIER ambient_condition[1][23].amb_cond.ydiMemory_xau16[9].ZFEH_EepromData ECU_ADDRESS 0xFFF82AD8 /end MEASUREMENT
/begin MEASUREMENT ZFEH_EepromData.ydiMemory_xau16[9].amb_cond.ambient_condition[1][24] "ambient condition shot [0 .. 2-1] with 25 data bytes [0 .. 25-1] for the error code stored in this error memory slot" UBYTE EH_STANDARD_S5_S3 1 100 0 255 DISPLAY_IDENTIFIER ambient_condition[1][24].amb_cond.ydiMemory_xau16[9].ZFEH_EepromData ECU_ADDRESS 0xFFF82AD9 /end MEASUREMENT
/begin MEASUREMENT ZFEH_EepromData.ydiMemory_xau16[9].amb_cond.status_of_ambient_conditions[0] "status of ambient condition shot x: 0=invalid 1=valid" UBYTE EH_STANDARD_S5_S3 1 100 0 1 DISPLAY_IDENTIFIER status_of_ambient_conditions[0].amb_cond.ydiMemory_xau16[9].ZFEH_EepromData ECU_ADDRESS 0xFFF82ADA /end MEASUREMENT
/begin MEASUREMENT ZFEH_EepromData.ydiMemory_xau16[9].amb_cond.status_of_ambient_conditions[1] "status of ambient condition shot x: 0=invalid 1=valid" UBYTE EH_STANDARD_S5_S3 1 100 0 1 DISPLAY_IDENTIFIER status_of_ambient_conditions[1].amb_cond.ydiMemory_xau16[9].ZFEH_EepromData ECU_ADDRESS 0xFFF82ADB /end MEASUREMENT
/begin MEASUREMENT ZFEH_EepromData.ydiMemory_xau16[9].error_code "error code stored in error memory slot" UWORD CONV_KFC_NAME 0 255 0 65535 DISPLAY_IDENTIFIER error_code.ydiMemory_xau16[9].ZFEH_EepromData ECU_ADDRESS 0xFFF82A94 /end MEASUREMENT
/begin MEASUREMENT ZFEH_EepromData.ydiMemory_xau16[9].error_type "error type of error code stored in error memory slot" UWORD EH_STANDARD_S5_S3 1 100 0 65535 DISPLAY_IDENTIFIER error_type.ydiMemory_xau16[9].ZFEH_EepromData ECU_ADDRESS 0xFFF82A96 /end MEASUREMENT
/begin MEASUREMENT ZFEH_EepromData.ydiMemory_xau16[9].status_word "status word of error code stored in error memory slot" UWORD EH_STANDARD_S5_S3 1 100 0 65535 DISPLAY_IDENTIFIER status_word.ydiMemory_xau16[9].ZFEH_EepromData ECU_ADDRESS 0xFFF82A98 /end MEASUREMENT
/begin MEASUREMENT ZFEH_EepromData.ydiMemory_xau16[9].frequency_counter "frequency counter of error code stored in error memory slot" UBYTE EH_STANDARD_S5_S3 1 100 0 255 DISPLAY_IDENTIFIER frequency_counter.ydiMemory_xau16[9].ZFEH_EepromData ECU_ADDRESS 0xFFF82A9A /end MEASUREMENT
/begin MEASUREMENT ZFEH_EepromData.ydiMemory_xau16[9].backwards_counter "backwards counter of error code stored in error memory slot" UBYTE EH_STANDARD_S5_S3 1 100 0 255 DISPLAY_IDENTIFIER backwards_counter.ydiMemory_xau16[9].ZFEH_EepromData ECU_ADDRESS 0xFFF82A9B /end MEASUREMENT
/begin MEASUREMENT ZFEH_EepromData.ydiMemory_xau16[9].permanent_counter "counter of permanent error codes stored in error memory slot" UBYTE EH_STANDARD_S5_S3 1 100 0 255 DISPLAY_IDENTIFIER permanent_counter.ydiMemory_xau16[9].ZFEH_EepromData ECU_ADDRESS 0xFFF82A9C /end MEASUREMENT
/begin MEASUREMENT ZFEH_EepromData.ydiMemory_xau16[9].sequence_counter "sequence counter of error code stored in error memory slot" UBYTE EH_STANDARD_S5_S3 1 100 0 255 DISPLAY_IDENTIFIER sequence_counter.ydiMemory_xau16[9].ZFEH_EepromData ECU_ADDRESS 0xFFF82A9D /end MEASUREMENT
/begin MEASUREMENT ZFEH_EepromData.ydiMemory_xau16[9].master_time "master time of error code stored in error memory slot" ULONG EH_STANDARD_S5_S3 1 100 0 4294967295 DISPLAY_IDENTIFIER master_time.ydiMemory_xau16[9].ZFEH_EepromData ECU_ADDRESS 0xFFF82AA0 /end MEASUREMENT
/begin MEASUREMENT ZFEH_EepromData.ydiMemory_xau16[9].condition_byte "condition byte of error code stored in error memory slot" UBYTE EH_STANDARD_S5_S3 1 100 0 255 DISPLAY_IDENTIFIER condition_byte.ydiMemory_xau16[9].ZFEH_EepromData ECU_ADDRESS 0xFFF82AA5 /end MEASUREMENT
/begin MEASUREMENT ZFEH_EepromData.ydiMemory_xau16[9].obd_driving_cycle_counter "obd driving cycle counter of error code stored in error memory slot" UWORD EH_STANDARD_S5_S3 1 100 0 65535 DISPLAY_IDENTIFIER obd_driving_cycle_counter.ydiMemory_xau16[9].ZFEH_EepromData ECU_ADDRESS 0xFFF82AA6 /end MEASUREMENT
/begin MEASUREMENT ZFEH_EepromData.ydiObdMemory_xau16.obd_errorcode "OBD relevant error code number stored in OBD freeze frame data storage" UWORD EH_STANDARD_S5_S3 1 100 0 65535 DISPLAY_IDENTIFIER obd_errorcode.ydiObdMemory_xau16.ZFEH_EepromData ECU_ADDRESS 0xFFF8317E /end MEASUREMENT
/begin MEASUREMENT ZFEH_EepromData.ydiObdMemory_xau16.obd_errortype "error type of error code stored in OBD freeze frame data storage" UWORD EH_STANDARD_S5_S3 1 100 0 65535 DISPLAY_IDENTIFIER obd_errortype.ydiObdMemory_xau16.ZFEH_EepromData ECU_ADDRESS 0xFFF83180 /end MEASUREMENT
/begin MEASUREMENT ZFEH_EepromData.ydiObdMemory_xau16.obd_freezeframes[0] "freeze frame byte [0 .. 20-1] of error code stored in OBD freeze frame data storage" UBYTE EH_STANDARD_S5_S3 1 100 0 255 DISPLAY_IDENTIFIER obd_freezeframes[0].ydiObdMemory_xau16.ZFEH_EepromData ECU_ADDRESS 0xFFF83182 /end MEASUREMENT
/begin MEASUREMENT ZFEH_EepromData.ydiObdMemory_xau16.obd_freezeframes[1] "freeze frame byte [0 .. 20-1] of error code stored in OBD freeze frame data storage" UBYTE EH_STANDARD_S5_S3 1 100 0 255 DISPLAY_IDENTIFIER obd_freezeframes[1].ydiObdMemory_xau16.ZFEH_EepromData ECU_ADDRESS 0xFFF83183 /end MEASUREMENT
/begin MEASUREMENT ZFEH_EepromData.ydiObdMemory_xau16.obd_freezeframes[2] "freeze frame byte [0 .. 20-1] of error code stored in OBD freeze frame data storage" UBYTE EH_STANDARD_S5_S3 1 100 0 255 DISPLAY_IDENTIFIER obd_freezeframes[2].ydiObdMemory_xau16.ZFEH_EepromData ECU_ADDRESS 0xFFF83184 /end MEASUREMENT
/begin MEASUREMENT ZFEH_EepromData.ydiObdMemory_xau16.obd_freezeframes[3] "freeze frame byte [0 .. 20-1] of error code stored in OBD freeze frame data storage" UBYTE EH_STANDARD_S5_S3 1 100 0 255 DISPLAY_IDENTIFIER obd_freezeframes[3].ydiObdMemory_xau16.ZFEH_EepromData ECU_ADDRESS 0xFFF83185 /end MEASUREMENT
/begin MEASUREMENT ZFEH_EepromData.ydiObdMemory_xau16.obd_freezeframes[4] "freeze frame byte [0 .. 20-1] of error code stored in OBD freeze frame data storage" UBYTE EH_STANDARD_S5_S3 1 100 0 255 DISPLAY_IDENTIFIER obd_freezeframes[4].ydiObdMemory_xau16.ZFEH_EepromData ECU_ADDRESS 0xFFF83186 /end MEASUREMENT
/begin MEASUREMENT ZFEH_EepromData.ydiObdMemory_xau16.obd_freezeframes[5] "freeze frame byte [0 .. 20-1] of error code stored in OBD freeze frame data storage" UBYTE EH_STANDARD_S5_S3 1 100 0 255 DISPLAY_IDENTIFIER obd_freezeframes[5].ydiObdMemory_xau16.ZFEH_EepromData ECU_ADDRESS 0xFFF83187 /end MEASUREMENT
/begin MEASUREMENT ZFEH_EepromData.ydiObdMemory_xau16.obd_freezeframes[6] "freeze frame byte [0 .. 20-1] of error code stored in OBD freeze frame data storage" UBYTE EH_STANDARD_S5_S3 1 100 0 255 DISPLAY_IDENTIFIER obd_freezeframes[6].ydiObdMemory_xau16.ZFEH_EepromData ECU_ADDRESS 0xFFF83188 /end MEASUREMENT
/begin MEASUREMENT ZFEH_EepromData.ydiObdMemory_xau16.obd_freezeframes[7] "freeze frame byte [0 .. 20-1] of error code stored in OBD freeze frame data storage" UBYTE EH_STANDARD_S5_S3 1 100 0 255 DISPLAY_IDENTIFIER obd_freezeframes[7].ydiObdMemory_xau16.ZFEH_EepromData ECU_ADDRESS 0xFFF83189 /end MEASUREMENT
/begin MEASUREMENT ZFEH_EepromData.ydiObdMemory_xau16.obd_freezeframes[8] "freeze frame byte [0 .. 20-1] of error code stored in OBD freeze frame data storage" UBYTE EH_STANDARD_S5_S3 1 100 0 255 DISPLAY_IDENTIFIER obd_freezeframes[8].ydiObdMemory_xau16.ZFEH_EepromData ECU_ADDRESS 0xFFF8318A /end MEASUREMENT
/begin MEASUREMENT ZFEH_EepromData.ydiObdMemory_xau16.obd_freezeframes[9] "freeze frame byte [0 .. 20-1] of error code stored in OBD freeze frame data storage" UBYTE EH_STANDARD_S5_S3 1 100 0 255 DISPLAY_IDENTIFIER obd_freezeframes[9].ydiObdMemory_xau16.ZFEH_EepromData ECU_ADDRESS 0xFFF8318B /end MEASUREMENT
/begin MEASUREMENT ZFEH_EepromData.ydiObdMemory_xau16.obd_freezeframes[10] "freeze frame byte [0 .. 20-1] of error code stored in OBD freeze frame data storage" UBYTE EH_STANDARD_S5_S3 1 100 0 255 DISPLAY_IDENTIFIER obd_freezeframes[10].ydiObdMemory_xau16.ZFEH_EepromData ECU_ADDRESS 0xFFF8318C /end MEASUREMENT
/begin MEASUREMENT ZFEH_EepromData.ydiObdMemory_xau16.obd_freezeframes[11] "freeze frame byte [0 .. 20-1] of error code stored in OBD freeze frame data storage" UBYTE EH_STANDARD_S5_S3 1 100 0 255 DISPLAY_IDENTIFIER obd_freezeframes[11].ydiObdMemory_xau16.ZFEH_EepromData ECU_ADDRESS 0xFFF8318D /end MEASUREMENT
/begin MEASUREMENT ZFEH_EepromData.ydiObdMemory_xau16.obd_freezeframes[12] "freeze frame byte [0 .. 20-1] of error code stored in OBD freeze frame data storage" UBYTE EH_STANDARD_S5_S3 1 100 0 255 DISPLAY_IDENTIFIER obd_freezeframes[12].ydiObdMemory_xau16.ZFEH_EepromData ECU_ADDRESS 0xFFF8318E /end MEASUREMENT
/begin MEASUREMENT ZFEH_EepromData.ydiObdMemory_xau16.obd_freezeframes[13] "freeze frame byte [0 .. 20-1] of error code stored in OBD freeze frame data storage" UBYTE EH_STANDARD_S5_S3 1 100 0 255 DISPLAY_IDENTIFIER obd_freezeframes[13].ydiObdMemory_xau16.ZFEH_EepromData ECU_ADDRESS 0xFFF8318F /end MEASUREMENT
/begin MEASUREMENT ZFEH_EepromData.ydiObdMemory_xau16.obd_freezeframes[14] "freeze frame byte [0 .. 20-1] of error code stored in OBD freeze frame data storage" UBYTE EH_STANDARD_S5_S3 1 100 0 255 DISPLAY_IDENTIFIER obd_freezeframes[14].ydiObdMemory_xau16.ZFEH_EepromData ECU_ADDRESS 0xFFF83190 /end MEASUREMENT
/begin MEASUREMENT ZFEH_EepromData.ydiObdMemory_xau16.obd_freezeframes[15] "freeze frame byte [0 .. 20-1] of error code stored in OBD freeze frame data storage" UBYTE EH_STANDARD_S5_S3 1 100 0 255 DISPLAY_IDENTIFIER obd_freezeframes[15].ydiObdMemory_xau16.ZFEH_EepromData ECU_ADDRESS 0xFFF83191 /end MEASUREMENT
/begin MEASUREMENT ZFEH_EepromData.ydiObdMemory_xau16.obd_freezeframes[16] "freeze frame byte [0 .. 20-1] of error code stored in OBD freeze frame data storage" UBYTE EH_STANDARD_S5_S3 1 100 0 255 DISPLAY_IDENTIFIER obd_freezeframes[16].ydiObdMemory_xau16.ZFEH_EepromData ECU_ADDRESS 0xFFF83192 /end MEASUREMENT
/begin MEASUREMENT ZFEH_EepromData.ydiObdMemory_xau16.obd_freezeframes[17] "freeze frame byte [0 .. 20-1] of error code stored in OBD freeze frame data storage" UBYTE EH_STANDARD_S5_S3 1 100 0 255 DISPLAY_IDENTIFIER obd_freezeframes[17].ydiObdMemory_xau16.ZFEH_EepromData ECU_ADDRESS 0xFFF83193 /end MEASUREMENT
/begin MEASUREMENT ZFEH_EepromData.ydiObdMemory_xau16.obd_freezeframes[18] "freeze frame byte [0 .. 20-1] of error code stored in OBD freeze frame data storage" UBYTE EH_STANDARD_S5_S3 1 100 0 255 DISPLAY_IDENTIFIER obd_freezeframes[18].ydiObdMemory_xau16.ZFEH_EepromData ECU_ADDRESS 0xFFF83194 /end MEASUREMENT
/begin MEASUREMENT ZFEH_EepromData.ydiObdMemory_xau16.obd_freezeframes[19] "freeze frame byte [0 .. 20-1] of error code stored in OBD freeze frame data storage" UBYTE EH_STANDARD_S5_S3 1 100 0 255 DISPLAY_IDENTIFIER obd_freezeframes[19].ydiObdMemory_xau16.ZFEH_EepromData ECU_ADDRESS 0xFFF83195 /end MEASUREMENT
/begin MEASUREMENT ZFEH_EepromData.di_statusOfDTC[0] "status of DTC of error code [index = KFC-1]" UBYTE EH_STANDARD_S5_S3 1 100 0 255 DISPLAY_IDENTIFIER di_statusOfDTC[0].ZFEH_EepromData ECU_ADDRESS 0xFFF83080 /end MEASUREMENT
/begin MEASUREMENT ZFEH_EepromData.di_statusOfDTC[1] "status of DTC of error code [index = KFC-1]" UBYTE EH_STANDARD_S5_S3 1 100 0 255 DISPLAY_IDENTIFIER di_statusOfDTC[1].ZFEH_EepromData ECU_ADDRESS 0xFFF83081 /end MEASUREMENT
/begin MEASUREMENT ZFEH_EepromData.di_statusOfDTC[2] "status of DTC of error code [index = KFC-1]" UBYTE EH_STANDARD_S5_S3 1 100 0 255 DISPLAY_IDENTIFIER di_statusOfDTC[2].ZFEH_EepromData ECU_ADDRESS 0xFFF83082 /end MEASUREMENT
/begin MEASUREMENT ZFEH_EepromData.di_statusOfDTC[3] "status of DTC of error code [index = KFC-1]" UBYTE EH_STANDARD_S5_S3 1 100 0 255 DISPLAY_IDENTIFIER di_statusOfDTC[3].ZFEH_EepromData ECU_ADDRESS 0xFFF83083 /end MEASUREMENT
/begin MEASUREMENT ZFEH_EepromData.di_statusOfDTC[4] "status of DTC of error code [index = KFC-1]" UBYTE EH_STANDARD_S5_S3 1 100 0 255 DISPLAY_IDENTIFIER di_statusOfDTC[4].ZFEH_EepromData ECU_ADDRESS 0xFFF83084 /end MEASUREMENT
/begin MEASUREMENT ZFEH_EepromData.di_statusOfDTC[5] "status of DTC of error code [index = KFC-1]" UBYTE EH_STANDARD_S5_S3 1 100 0 255 DISPLAY_IDENTIFIER di_statusOfDTC[5].ZFEH_EepromData ECU_ADDRESS 0xFFF83085 /end MEASUREMENT
/begin MEASUREMENT ZFEH_EepromData.di_statusOfDTC[6] "status of DTC of error code [index = KFC-1]" UBYTE EH_STANDARD_S5_S3 1 100 0 255 DISPLAY_IDENTIFIER di_statusOfDTC[6].ZFEH_EepromData ECU_ADDRESS 0xFFF83086 /end MEASUREMENT
/begin MEASUREMENT ZFEH_EepromData.di_statusOfDTC[7] "status of DTC of error code [index = KFC-1]" UBYTE EH_STANDARD_S5_S3 1 100 0 255 DISPLAY_IDENTIFIER di_statusOfDTC[7].ZFEH_EepromData ECU_ADDRESS 0xFFF83087 /end MEASUREMENT
/begin MEASUREMENT ZFEH_EepromData.di_statusOfDTC[8] "status of DTC of error code [index = KFC-1]" UBYTE EH_STANDARD_S5_S3 1 100 0 255 DISPLAY_IDENTIFIER di_statusOfDTC[8].ZFEH_EepromData ECU_ADDRESS 0xFFF83088 /end MEASUREMENT
/begin MEASUREMENT ZFEH_EepromData.di_statusOfDTC[9] "status of DTC of error code [index = KFC-1]" UBYTE EH_STANDARD_S5_S3 1 100 0 255 DISPLAY_IDENTIFIER di_statusOfDTC[9].ZFEH_EepromData ECU_ADDRESS 0xFFF83089 /end MEASUREMENT
/begin MEASUREMENT ZFEH_EepromData.di_statusOfDTC[10] "status of DTC of error code [index = KFC-1]" UBYTE EH_STANDARD_S5_S3 1 100 0 255 DISPLAY_IDENTIFIER di_statusOfDTC[10].ZFEH_EepromData ECU_ADDRESS 0xFFF8308A /end MEASUREMENT
/begin MEASUREMENT ZFEH_EepromData.di_statusOfDTC[11] "status of DTC of error code [index = KFC-1]" UBYTE EH_STANDARD_S5_S3 1 100 0 255 DISPLAY_IDENTIFIER di_statusOfDTC[11].ZFEH_EepromData ECU_ADDRESS 0xFFF8308B /end MEASUREMENT
/begin MEASUREMENT ZFEH_EepromData.di_statusOfDTC[12] "status of DTC of error code [index = KFC-1]" UBYTE EH_STANDARD_S5_S3 1 100 0 255 DISPLAY_IDENTIFIER di_statusOfDTC[12].ZFEH_EepromData ECU_ADDRESS 0xFFF8308C /end MEASUREMENT
/begin MEASUREMENT ZFEH_EepromData.di_statusOfDTC[13] "status of DTC of error code [index = KFC-1]" UBYTE EH_STANDARD_S5_S3 1 100 0 255 DISPLAY_IDENTIFIER di_statusOfDTC[13].ZFEH_EepromData ECU_ADDRESS 0xFFF8308D /end MEASUREMENT
/begin MEASUREMENT ZFEH_EepromData.di_statusOfDTC[14] "status of DTC of error code [index = KFC-1]" UBYTE EH_STANDARD_S5_S3 1 100 0 255 DISPLAY_IDENTIFIER di_statusOfDTC[14].ZFEH_EepromData ECU_ADDRESS 0xFFF8308E /end MEASUREMENT
/begin MEASUREMENT ZFEH_EepromData.di_statusOfDTC[15] "status of DTC of error code [index = KFC-1]" UBYTE EH_STANDARD_S5_S3 1 100 0 255 DISPLAY_IDENTIFIER di_statusOfDTC[15].ZFEH_EepromData ECU_ADDRESS 0xFFF8308F /end MEASUREMENT
/begin MEASUREMENT ZFEH_EepromData.di_statusOfDTC[16] "status of DTC of error code [index = KFC-1]" UBYTE EH_STANDARD_S5_S3 1 100 0 255 DISPLAY_IDENTIFIER di_statusOfDTC[16].ZFEH_EepromData ECU_ADDRESS 0xFFF83090 /end MEASUREMENT
/begin MEASUREMENT ZFEH_EepromData.di_statusOfDTC[17] "status of DTC of error code [index = KFC-1]" UBYTE EH_STANDARD_S5_S3 1 100 0 255 DISPLAY_IDENTIFIER di_statusOfDTC[17].ZFEH_EepromData ECU_ADDRESS 0xFFF83091 /end MEASUREMENT
/begin MEASUREMENT ZFEH_EepromData.di_statusOfDTC[18] "status of DTC of error code [index = KFC-1]" UBYTE EH_STANDARD_S5_S3 1 100 0 255 DISPLAY_IDENTIFIER di_statusOfDTC[18].ZFEH_EepromData ECU_ADDRESS 0xFFF83092 /end MEASUREMENT
/begin MEASUREMENT ZFEH_EepromData.di_statusOfDTC[19] "status of DTC of error code [index = KFC-1]" UBYTE EH_STANDARD_S5_S3 1 100 0 255 DISPLAY_IDENTIFIER di_statusOfDTC[19].ZFEH_EepromData ECU_ADDRESS 0xFFF83093 /end MEASUREMENT
/begin MEASUREMENT ZFEH_EepromData.di_statusOfDTC[20] "status of DTC of error code [index = KFC-1]" UBYTE EH_STANDARD_S5_S3 1 100 0 255 DISPLAY_IDENTIFIER di_statusOfDTC[20].ZFEH_EepromData ECU_ADDRESS 0xFFF83094 /end MEASUREMENT
/begin MEASUREMENT ZFEH_EepromData.di_statusOfDTC[21] "status of DTC of error code [index = KFC-1]" UBYTE EH_STANDARD_S5_S3 1 100 0 255 DISPLAY_IDENTIFIER di_statusOfDTC[21].ZFEH_EepromData ECU_ADDRESS 0xFFF83095 /end MEASUREMENT
/begin MEASUREMENT ZFEH_EepromData.di_statusOfDTC[22] "status of DTC of error code [index = KFC-1]" UBYTE EH_STANDARD_S5_S3 1 100 0 255 DISPLAY_IDENTIFIER di_statusOfDTC[22].ZFEH_EepromData ECU_ADDRESS 0xFFF83096 /end MEASUREMENT
/begin MEASUREMENT ZFEH_EepromData.di_statusOfDTC[23] "status of DTC of error code [index = KFC-1]" UBYTE EH_STANDARD_S5_S3 1 100 0 255 DISPLAY_IDENTIFIER di_statusOfDTC[23].ZFEH_EepromData ECU_ADDRESS 0xFFF83097 /end MEASUREMENT
/begin MEASUREMENT ZFEH_EepromData.di_statusOfDTC[24] "status of DTC of error code [index = KFC-1]" UBYTE EH_STANDARD_S5_S3 1 100 0 255 DISPLAY_IDENTIFIER di_statusOfDTC[24].ZFEH_EepromData ECU_ADDRESS 0xFFF83098 /end MEASUREMENT
/begin MEASUREMENT ZFEH_EepromData.di_statusOfDTC[25] "status of DTC of error code [index = KFC-1]" UBYTE EH_STANDARD_S5_S3 1 100 0 255 DISPLAY_IDENTIFIER di_statusOfDTC[25].ZFEH_EepromData ECU_ADDRESS 0xFFF83099 /end MEASUREMENT
/begin MEASUREMENT ZFEH_EepromData.di_statusOfDTC[26] "status of DTC of error code [index = KFC-1]" UBYTE EH_STANDARD_S5_S3 1 100 0 255 DISPLAY_IDENTIFIER di_statusOfDTC[26].ZFEH_EepromData ECU_ADDRESS 0xFFF8309A /end MEASUREMENT
/begin MEASUREMENT ZFEH_EepromData.di_statusOfDTC[27] "status of DTC of error code [index = KFC-1]" UBYTE EH_STANDARD_S5_S3 1 100 0 255 DISPLAY_IDENTIFIER di_statusOfDTC[27].ZFEH_EepromData ECU_ADDRESS 0xFFF8309B /end MEASUREMENT
/begin MEASUREMENT ZFEH_EepromData.di_statusOfDTC[28] "status of DTC of error code [index = KFC-1]" UBYTE EH_STANDARD_S5_S3 1 100 0 255 DISPLAY_IDENTIFIER di_statusOfDTC[28].ZFEH_EepromData ECU_ADDRESS 0xFFF8309C /end MEASUREMENT
/begin MEASUREMENT ZFEH_EepromData.di_statusOfDTC[29] "status of DTC of error code [index = KFC-1]" UBYTE EH_STANDARD_S5_S3 1 100 0 255 DISPLAY_IDENTIFIER di_statusOfDTC[29].ZFEH_EepromData ECU_ADDRESS 0xFFF8309D /end MEASUREMENT
/begin MEASUREMENT ZFEH_EepromData.di_statusOfDTC[30] "status of DTC of error code [index = KFC-1]" UBYTE EH_STANDARD_S5_S3 1 100 0 255 DISPLAY_IDENTIFIER di_statusOfDTC[30].ZFEH_EepromData ECU_ADDRESS 0xFFF8309E /end MEASUREMENT
/begin MEASUREMENT ZFEH_EepromData.di_statusOfDTC[31] "status of DTC of error code [index = KFC-1]" UBYTE EH_STANDARD_S5_S3 1 100 0 255 DISPLAY_IDENTIFIER di_statusOfDTC[31].ZFEH_EepromData ECU_ADDRESS 0xFFF8309F /end MEASUREMENT
/begin MEASUREMENT ZFEH_EepromData.di_statusOfDTC[32] "status of DTC of error code [index = KFC-1]" UBYTE EH_STANDARD_S5_S3 1 100 0 255 DISPLAY_IDENTIFIER di_statusOfDTC[32].ZFEH_EepromData ECU_ADDRESS 0xFFF830A0 /end MEASUREMENT
/begin MEASUREMENT ZFEH_EepromData.di_statusOfDTC[33] "status of DTC of error code [index = KFC-1]" UBYTE EH_STANDARD_S5_S3 1 100 0 255 DISPLAY_IDENTIFIER di_statusOfDTC[33].ZFEH_EepromData ECU_ADDRESS 0xFFF830A1 /end MEASUREMENT
/begin MEASUREMENT ZFEH_EepromData.di_statusOfDTC[34] "status of DTC of error code [index = KFC-1]" UBYTE EH_STANDARD_S5_S3 1 100 0 255 DISPLAY_IDENTIFIER di_statusOfDTC[34].ZFEH_EepromData ECU_ADDRESS 0xFFF830A2 /end MEASUREMENT
/begin MEASUREMENT ZFEH_EepromData.di_statusOfDTC[35] "status of DTC of error code [index = KFC-1]" UBYTE EH_STANDARD_S5_S3 1 100 0 255 DISPLAY_IDENTIFIER di_statusOfDTC[35].ZFEH_EepromData ECU_ADDRESS 0xFFF830A3 /end MEASUREMENT
/begin MEASUREMENT ZFEH_EepromData.di_statusOfDTC[36] "status of DTC of error code [index = KFC-1]" UBYTE EH_STANDARD_S5_S3 1 100 0 255 DISPLAY_IDENTIFIER di_statusOfDTC[36].ZFEH_EepromData ECU_ADDRESS 0xFFF830A4 /end MEASUREMENT
/begin MEASUREMENT ZFEH_EepromData.di_statusOfDTC[37] "status of DTC of error code [index = KFC-1]" UBYTE EH_STANDARD_S5_S3 1 100 0 255 DISPLAY_IDENTIFIER di_statusOfDTC[37].ZFEH_EepromData ECU_ADDRESS 0xFFF830A5 /end MEASUREMENT
/begin MEASUREMENT ZFEH_EepromData.di_statusOfDTC[38] "status of DTC of error code [index = KFC-1]" UBYTE EH_STANDARD_S5_S3 1 100 0 255 DISPLAY_IDENTIFIER di_statusOfDTC[38].ZFEH_EepromData ECU_ADDRESS 0xFFF830A6 /end MEASUREMENT
/begin MEASUREMENT ZFEH_EepromData.di_statusOfDTC[39] "status of DTC of error code [index = KFC-1]" UBYTE EH_STANDARD_S5_S3 1 100 0 255 DISPLAY_IDENTIFIER di_statusOfDTC[39].ZFEH_EepromData ECU_ADDRESS 0xFFF830A7 /end MEASUREMENT
/begin MEASUREMENT ZFEH_EepromData.di_statusOfDTC[40] "status of DTC of error code [index = KFC-1]" UBYTE EH_STANDARD_S5_S3 1 100 0 255 DISPLAY_IDENTIFIER di_statusOfDTC[40].ZFEH_EepromData ECU_ADDRESS 0xFFF830A8 /end MEASUREMENT
/begin MEASUREMENT ZFEH_EepromData.di_statusOfDTC[41] "status of DTC of error code [index = KFC-1]" UBYTE EH_STANDARD_S5_S3 1 100 0 255 DISPLAY_IDENTIFIER di_statusOfDTC[41].ZFEH_EepromData ECU_ADDRESS 0xFFF830A9 /end MEASUREMENT
/begin MEASUREMENT ZFEH_EepromData.di_statusOfDTC[42] "status of DTC of error code [index = KFC-1]" UBYTE EH_STANDARD_S5_S3 1 100 0 255 DISPLAY_IDENTIFIER di_statusOfDTC[42].ZFEH_EepromData ECU_ADDRESS 0xFFF830AA /end MEASUREMENT
/begin MEASUREMENT ZFEH_EepromData.di_statusOfDTC[43] "status of DTC of error code [index = KFC-1]" UBYTE EH_STANDARD_S5_S3 1 100 0 255 DISPLAY_IDENTIFIER di_statusOfDTC[43].ZFEH_EepromData ECU_ADDRESS 0xFFF830AB /end MEASUREMENT
/begin MEASUREMENT ZFEH_EepromData.di_statusOfDTC[44] "status of DTC of error code [index = KFC-1]" UBYTE EH_STANDARD_S5_S3 1 100 0 255 DISPLAY_IDENTIFIER di_statusOfDTC[44].ZFEH_EepromData ECU_ADDRESS 0xFFF830AC /end MEASUREMENT
/begin MEASUREMENT ZFEH_EepromData.di_statusOfDTC[45] "status of DTC of error code [index = KFC-1]" UBYTE EH_STANDARD_S5_S3 1 100 0 255 DISPLAY_IDENTIFIER di_statusOfDTC[45].ZFEH_EepromData ECU_ADDRESS 0xFFF830AD /end MEASUREMENT
/begin MEASUREMENT ZFEH_EepromData.di_statusOfDTC[46] "status of DTC of error code [index = KFC-1]" UBYTE EH_STANDARD_S5_S3 1 100 0 255 DISPLAY_IDENTIFIER di_statusOfDTC[46].ZFEH_EepromData ECU_ADDRESS 0xFFF830AE /end MEASUREMENT
/begin MEASUREMENT ZFEH_EepromData.di_statusOfDTC[47] "status of DTC of error code [index = KFC-1]" UBYTE EH_STANDARD_S5_S3 1 100 0 255 DISPLAY_IDENTIFIER di_statusOfDTC[47].ZFEH_EepromData ECU_ADDRESS 0xFFF830AF /end MEASUREMENT
/begin MEASUREMENT ZFEH_EepromData.di_statusOfDTC[48] "status of DTC of error code [index = KFC-1]" UBYTE EH_STANDARD_S5_S3 1 100 0 255 DISPLAY_IDENTIFIER di_statusOfDTC[48].ZFEH_EepromData ECU_ADDRESS 0xFFF830B0 /end MEASUREMENT
/begin MEASUREMENT ZFEH_EepromData.di_statusOfDTC[49] "status of DTC of error code [index = KFC-1]" UBYTE EH_STANDARD_S5_S3 1 100 0 255 DISPLAY_IDENTIFIER di_statusOfDTC[49].ZFEH_EepromData ECU_ADDRESS 0xFFF830B1 /end MEASUREMENT
/begin MEASUREMENT ZFEH_EepromData.di_statusOfDTC[50] "status of DTC of error code [index = KFC-1]" UBYTE EH_STANDARD_S5_S3 1 100 0 255 DISPLAY_IDENTIFIER di_statusOfDTC[50].ZFEH_EepromData ECU_ADDRESS 0xFFF830B2 /end MEASUREMENT
/begin MEASUREMENT ZFEH_EepromData.di_statusOfDTC[51] "status of DTC of error code [index = KFC-1]" UBYTE EH_STANDARD_S5_S3 1 100 0 255 DISPLAY_IDENTIFIER di_statusOfDTC[51].ZFEH_EepromData ECU_ADDRESS 0xFFF830B3 /end MEASUREMENT
/begin MEASUREMENT ZFEH_EepromData.di_statusOfDTC[52] "status of DTC of error code [index = KFC-1]" UBYTE EH_STANDARD_S5_S3 1 100 0 255 DISPLAY_IDENTIFIER di_statusOfDTC[52].ZFEH_EepromData ECU_ADDRESS 0xFFF830B4 /end MEASUREMENT
/begin MEASUREMENT ZFEH_EepromData.di_statusOfDTC[53] "status of DTC of error code [index = KFC-1]" UBYTE EH_STANDARD_S5_S3 1 100 0 255 DISPLAY_IDENTIFIER di_statusOfDTC[53].ZFEH_EepromData ECU_ADDRESS 0xFFF830B5 /end MEASUREMENT
/begin MEASUREMENT ZFEH_EepromData.di_statusOfDTC[54] "status of DTC of error code [index = KFC-1]" UBYTE EH_STANDARD_S5_S3 1 100 0 255 DISPLAY_IDENTIFIER di_statusOfDTC[54].ZFEH_EepromData ECU_ADDRESS 0xFFF830B6 /end MEASUREMENT
/begin MEASUREMENT ZFEH_EepromData.di_statusOfDTC[55] "status of DTC of error code [index = KFC-1]" UBYTE EH_STANDARD_S5_S3 1 100 0 255 DISPLAY_IDENTIFIER di_statusOfDTC[55].ZFEH_EepromData ECU_ADDRESS 0xFFF830B7 /end MEASUREMENT
/begin MEASUREMENT ZFEH_EepromData.di_statusOfDTC[56] "status of DTC of error code [index = KFC-1]" UBYTE EH_STANDARD_S5_S3 1 100 0 255 DISPLAY_IDENTIFIER di_statusOfDTC[56].ZFEH_EepromData ECU_ADDRESS 0xFFF830B8 /end MEASUREMENT
/begin MEASUREMENT ZFEH_EepromData.di_statusOfDTC[57] "status of DTC of error code [index = KFC-1]" UBYTE EH_STANDARD_S5_S3 1 100 0 255 DISPLAY_IDENTIFIER di_statusOfDTC[57].ZFEH_EepromData ECU_ADDRESS 0xFFF830B9 /end MEASUREMENT
/begin MEASUREMENT ZFEH_EepromData.di_statusOfDTC[58] "status of DTC of error code [index = KFC-1]" UBYTE EH_STANDARD_S5_S3 1 100 0 255 DISPLAY_IDENTIFIER di_statusOfDTC[58].ZFEH_EepromData ECU_ADDRESS 0xFFF830BA /end MEASUREMENT
/begin MEASUREMENT ZFEH_EepromData.di_statusOfDTC[59] "status of DTC of error code [index = KFC-1]" UBYTE EH_STANDARD_S5_S3 1 100 0 255 DISPLAY_IDENTIFIER di_statusOfDTC[59].ZFEH_EepromData ECU_ADDRESS 0xFFF830BB /end MEASUREMENT
/begin MEASUREMENT ZFEH_EepromData.di_statusOfDTC[60] "status of DTC of error code [index = KFC-1]" UBYTE EH_STANDARD_S5_S3 1 100 0 255 DISPLAY_IDENTIFIER di_statusOfDTC[60].ZFEH_EepromData ECU_ADDRESS 0xFFF830BC /end MEASUREMENT
/begin MEASUREMENT ZFEH_EepromData.di_statusOfDTC[61] "status of DTC of error code [index = KFC-1]" UBYTE EH_STANDARD_S5_S3 1 100 0 255 DISPLAY_IDENTIFIER di_statusOfDTC[61].ZFEH_EepromData ECU_ADDRESS 0xFFF830BD /end MEASUREMENT
/begin MEASUREMENT ZFEH_EepromData.di_statusOfDTC[62] "status of DTC of error code [index = KFC-1]" UBYTE EH_STANDARD_S5_S3 1 100 0 255 DISPLAY_IDENTIFIER di_statusOfDTC[62].ZFEH_EepromData ECU_ADDRESS 0xFFF830BE /end MEASUREMENT
/begin MEASUREMENT ZFEH_EepromData.di_statusOfDTC[63] "status of DTC of error code [index = KFC-1]" UBYTE EH_STANDARD_S5_S3 1 100 0 255 DISPLAY_IDENTIFIER di_statusOfDTC[63].ZFEH_EepromData ECU_ADDRESS 0xFFF830BF /end MEASUREMENT
/begin MEASUREMENT ZFEH_EepromData.di_statusOfDTC[64] "status of DTC of error code [index = KFC-1]" UBYTE EH_STANDARD_S5_S3 1 100 0 255 DISPLAY_IDENTIFIER di_statusOfDTC[64].ZFEH_EepromData ECU_ADDRESS 0xFFF830C0 /end MEASUREMENT
/begin MEASUREMENT ZFEH_EepromData.di_statusOfDTC[65] "status of DTC of error code [index = KFC-1]" UBYTE EH_STANDARD_S5_S3 1 100 0 255 DISPLAY_IDENTIFIER di_statusOfDTC[65].ZFEH_EepromData ECU_ADDRESS 0xFFF830C1 /end MEASUREMENT
/begin MEASUREMENT ZFEH_EepromData.di_statusOfDTC[66] "status of DTC of error code [index = KFC-1]" UBYTE EH_STANDARD_S5_S3 1 100 0 255 DISPLAY_IDENTIFIER di_statusOfDTC[66].ZFEH_EepromData ECU_ADDRESS 0xFFF830C2 /end MEASUREMENT
/begin MEASUREMENT ZFEH_EepromData.di_statusOfDTC[67] "status of DTC of error code [index = KFC-1]" UBYTE EH_STANDARD_S5_S3 1 100 0 255 DISPLAY_IDENTIFIER di_statusOfDTC[67].ZFEH_EepromData ECU_ADDRESS 0xFFF830C3 /end MEASUREMENT
/begin MEASUREMENT ZFEH_EepromData.di_statusOfDTC[68] "status of DTC of error code [index = KFC-1]" UBYTE EH_STANDARD_S5_S3 1 100 0 255 DISPLAY_IDENTIFIER di_statusOfDTC[68].ZFEH_EepromData ECU_ADDRESS 0xFFF830C4 /end MEASUREMENT
/begin MEASUREMENT ZFEH_EepromData.di_statusOfDTC[69] "status of DTC of error code [index = KFC-1]" UBYTE EH_STANDARD_S5_S3 1 100 0 255 DISPLAY_IDENTIFIER di_statusOfDTC[69].ZFEH_EepromData ECU_ADDRESS 0xFFF830C5 /end MEASUREMENT
/begin MEASUREMENT ZFEH_EepromData.di_statusOfDTC[70] "status of DTC of error code [index = KFC-1]" UBYTE EH_STANDARD_S5_S3 1 100 0 255 DISPLAY_IDENTIFIER di_statusOfDTC[70].ZFEH_EepromData ECU_ADDRESS 0xFFF830C6 /end MEASUREMENT
/begin MEASUREMENT ZFEH_EepromData.di_statusOfDTC[71] "status of DTC of error code [index = KFC-1]" UBYTE EH_STANDARD_S5_S3 1 100 0 255 DISPLAY_IDENTIFIER di_statusOfDTC[71].ZFEH_EepromData ECU_ADDRESS 0xFFF830C7 /end MEASUREMENT
/begin MEASUREMENT ZFEH_EepromData.di_statusOfDTC[72] "status of DTC of error code [index = KFC-1]" UBYTE EH_STANDARD_S5_S3 1 100 0 255 DISPLAY_IDENTIFIER di_statusOfDTC[72].ZFEH_EepromData ECU_ADDRESS 0xFFF830C8 /end MEASUREMENT
/begin MEASUREMENT ZFEH_EepromData.di_statusOfDTC[73] "status of DTC of error code [index = KFC-1]" UBYTE EH_STANDARD_S5_S3 1 100 0 255 DISPLAY_IDENTIFIER di_statusOfDTC[73].ZFEH_EepromData ECU_ADDRESS 0xFFF830C9 /end MEASUREMENT
/begin MEASUREMENT ZFEH_EepromData.di_statusOfDTC[74] "status of DTC of error code [index = KFC-1]" UBYTE EH_STANDARD_S5_S3 1 100 0 255 DISPLAY_IDENTIFIER di_statusOfDTC[74].ZFEH_EepromData ECU_ADDRESS 0xFFF830CA /end MEASUREMENT
/begin MEASUREMENT ZFEH_EepromData.di_statusOfDTC[75] "status of DTC of error code [index = KFC-1]" UBYTE EH_STANDARD_S5_S3 1 100 0 255 DISPLAY_IDENTIFIER di_statusOfDTC[75].ZFEH_EepromData ECU_ADDRESS 0xFFF830CB /end MEASUREMENT
/begin MEASUREMENT ZFEH_EepromData.di_statusOfDTC[76] "status of DTC of error code [index = KFC-1]" UBYTE EH_STANDARD_S5_S3 1 100 0 255 DISPLAY_IDENTIFIER di_statusOfDTC[76].ZFEH_EepromData ECU_ADDRESS 0xFFF830CC /end MEASUREMENT
/begin MEASUREMENT ZFEH_EepromData.di_statusOfDTC[77] "status of DTC of error code [index = KFC-1]" UBYTE EH_STANDARD_S5_S3 1 100 0 255 DISPLAY_IDENTIFIER di_statusOfDTC[77].ZFEH_EepromData ECU_ADDRESS 0xFFF830CD /end MEASUREMENT
/begin MEASUREMENT ZFEH_EepromData.di_statusOfDTC[78] "status of DTC of error code [index = KFC-1]" UBYTE EH_STANDARD_S5_S3 1 100 0 255 DISPLAY_IDENTIFIER di_statusOfDTC[78].ZFEH_EepromData ECU_ADDRESS 0xFFF830CE /end MEASUREMENT
/begin MEASUREMENT ZFEH_EepromData.di_statusOfDTC[79] "status of DTC of error code [index = KFC-1]" UBYTE EH_STANDARD_S5_S3 1 100 0 255 DISPLAY_IDENTIFIER di_statusOfDTC[79].ZFEH_EepromData ECU_ADDRESS 0xFFF830CF /end MEASUREMENT
/begin MEASUREMENT ZFEH_EepromData.di_statusOfDTC[80] "status of DTC of error code [index = KFC-1]" UBYTE EH_STANDARD_S5_S3 1 100 0 255 DISPLAY_IDENTIFIER di_statusOfDTC[80].ZFEH_EepromData ECU_ADDRESS 0xFFF830D0 /end MEASUREMENT
/begin MEASUREMENT ZFEH_EepromData.di_statusOfDTC[81] "status of DTC of error code [index = KFC-1]" UBYTE EH_STANDARD_S5_S3 1 100 0 255 DISPLAY_IDENTIFIER di_statusOfDTC[81].ZFEH_EepromData ECU_ADDRESS 0xFFF830D1 /end MEASUREMENT
/begin MEASUREMENT ZFEH_EepromData.di_statusOfDTC[82] "status of DTC of error code [index = KFC-1]" UBYTE EH_STANDARD_S5_S3 1 100 0 255 DISPLAY_IDENTIFIER di_statusOfDTC[82].ZFEH_EepromData ECU_ADDRESS 0xFFF830D2 /end MEASUREMENT
/begin MEASUREMENT ZFEH_EepromData.di_statusOfDTC[83] "status of DTC of error code [index = KFC-1]" UBYTE EH_STANDARD_S5_S3 1 100 0 255 DISPLAY_IDENTIFIER di_statusOfDTC[83].ZFEH_EepromData ECU_ADDRESS 0xFFF830D3 /end MEASUREMENT
/begin MEASUREMENT ZFEH_EepromData.di_statusOfDTC[84] "status of DTC of error code [index = KFC-1]" UBYTE EH_STANDARD_S5_S3 1 100 0 255 DISPLAY_IDENTIFIER di_statusOfDTC[84].ZFEH_EepromData ECU_ADDRESS 0xFFF830D4 /end MEASUREMENT
/begin MEASUREMENT ZFEH_EepromData.di_statusOfDTC[85] "status of DTC of error code [index = KFC-1]" UBYTE EH_STANDARD_S5_S3 1 100 0 255 DISPLAY_IDENTIFIER di_statusOfDTC[85].ZFEH_EepromData ECU_ADDRESS 0xFFF830D5 /end MEASUREMENT
/begin MEASUREMENT ZFEH_EepromData.di_statusOfDTC[86] "status of DTC of error code [index = KFC-1]" UBYTE EH_STANDARD_S5_S3 1 100 0 255 DISPLAY_IDENTIFIER di_statusOfDTC[86].ZFEH_EepromData ECU_ADDRESS 0xFFF830D6 /end MEASUREMENT
/begin MEASUREMENT ZFEH_EepromData.di_statusOfDTC[87] "status of DTC of error code [index = KFC-1]" UBYTE EH_STANDARD_S5_S3 1 100 0 255 DISPLAY_IDENTIFIER di_statusOfDTC[87].ZFEH_EepromData ECU_ADDRESS 0xFFF830D7 /end MEASUREMENT
/begin MEASUREMENT ZFEH_EepromData.di_statusOfDTC[88] "status of DTC of error code [index = KFC-1]" UBYTE EH_STANDARD_S5_S3 1 100 0 255 DISPLAY_IDENTIFIER di_statusOfDTC[88].ZFEH_EepromData ECU_ADDRESS 0xFFF830D8 /end MEASUREMENT
/begin MEASUREMENT ZFEH_EepromData.di_statusOfDTC[89] "status of DTC of error code [index = KFC-1]" UBYTE EH_STANDARD_S5_S3 1 100 0 255 DISPLAY_IDENTIFIER di_statusOfDTC[89].ZFEH_EepromData ECU_ADDRESS 0xFFF830D9 /end MEASUREMENT
/begin MEASUREMENT ZFEH_EepromData.di_statusOfDTC[90] "status of DTC of error code [index = KFC-1]" UBYTE EH_STANDARD_S5_S3 1 100 0 255 DISPLAY_IDENTIFIER di_statusOfDTC[90].ZFEH_EepromData ECU_ADDRESS 0xFFF830DA /end MEASUREMENT
/begin MEASUREMENT ZFEH_EepromData.di_statusOfDTC[91] "status of DTC of error code [index = KFC-1]" UBYTE EH_STANDARD_S5_S3 1 100 0 255 DISPLAY_IDENTIFIER di_statusOfDTC[91].ZFEH_EepromData ECU_ADDRESS 0xFFF830DB /end MEASUREMENT
/begin MEASUREMENT ZFEH_EepromData.di_statusOfDTC[92] "status of DTC of error code [index = KFC-1]" UBYTE EH_STANDARD_S5_S3 1 100 0 255 DISPLAY_IDENTIFIER di_statusOfDTC[92].ZFEH_EepromData ECU_ADDRESS 0xFFF830DC /end MEASUREMENT
/begin MEASUREMENT ZFEH_EepromData.di_statusOfDTC[93] "status of DTC of error code [index = KFC-1]" UBYTE EH_STANDARD_S5_S3 1 100 0 255 DISPLAY_IDENTIFIER di_statusOfDTC[93].ZFEH_EepromData ECU_ADDRESS 0xFFF830DD /end MEASUREMENT
/begin MEASUREMENT ZFEH_EepromData.di_statusOfDTC[94] "status of DTC of error code [index = KFC-1]" UBYTE EH_STANDARD_S5_S3 1 100 0 255 DISPLAY_IDENTIFIER di_statusOfDTC[94].ZFEH_EepromData ECU_ADDRESS 0xFFF830DE /end MEASUREMENT
/begin MEASUREMENT ZFEH_EepromData.di_statusOfDTC[95] "status of DTC of error code [index = KFC-1]" UBYTE EH_STANDARD_S5_S3 1 100 0 255 DISPLAY_IDENTIFIER di_statusOfDTC[95].ZFEH_EepromData ECU_ADDRESS 0xFFF830DF /end MEASUREMENT
/begin MEASUREMENT ZFEH_EepromData.di_statusOfDTC[96] "status of DTC of error code [index = KFC-1]" UBYTE EH_STANDARD_S5_S3 1 100 0 255 DISPLAY_IDENTIFIER di_statusOfDTC[96].ZFEH_EepromData ECU_ADDRESS 0xFFF830E0 /end MEASUREMENT
/begin MEASUREMENT ZFEH_EepromData.di_statusOfDTC[97] "status of DTC of error code [index = KFC-1]" UBYTE EH_STANDARD_S5_S3 1 100 0 255 DISPLAY_IDENTIFIER di_statusOfDTC[97].ZFEH_EepromData ECU_ADDRESS 0xFFF830E1 /end MEASUREMENT
/begin MEASUREMENT ZFEH_EepromData.di_statusOfDTC[98] "status of DTC of error code [index = KFC-1]" UBYTE EH_STANDARD_S5_S3 1 100 0 255 DISPLAY_IDENTIFIER di_statusOfDTC[98].ZFEH_EepromData ECU_ADDRESS 0xFFF830E2 /end MEASUREMENT
/begin MEASUREMENT ZFEH_EepromData.di_statusOfDTC[99] "status of DTC of error code [index = KFC-1]" UBYTE EH_STANDARD_S5_S3 1 100 0 255 DISPLAY_IDENTIFIER di_statusOfDTC[99].ZFEH_EepromData ECU_ADDRESS 0xFFF830E3 /end MEASUREMENT
/begin MEASUREMENT ZFEH_EepromData.di_statusOfDTC[100] "status of DTC of error code [index = KFC-1]" UBYTE EH_STANDARD_S5_S3 1 100 0 255 DISPLAY_IDENTIFIER di_statusOfDTC[100].ZFEH_EepromData ECU_ADDRESS 0xFFF830E4 /end MEASUREMENT
/begin MEASUREMENT ZFEH_EepromData.di_statusOfDTC[101] "status of DTC of error code [index = KFC-1]" UBYTE EH_STANDARD_S5_S3 1 100 0 255 DISPLAY_IDENTIFIER di_statusOfDTC[101].ZFEH_EepromData ECU_ADDRESS 0xFFF830E5 /end MEASUREMENT
/begin MEASUREMENT ZFEH_EepromData.di_statusOfDTC[102] "status of DTC of error code [index = KFC-1]" UBYTE EH_STANDARD_S5_S3 1 100 0 255 DISPLAY_IDENTIFIER di_statusOfDTC[102].ZFEH_EepromData ECU_ADDRESS 0xFFF830E6 /end MEASUREMENT
/begin MEASUREMENT ZFEH_EepromData.di_statusOfDTC[103] "status of DTC of error code [index = KFC-1]" UBYTE EH_STANDARD_S5_S3 1 100 0 255 DISPLAY_IDENTIFIER di_statusOfDTC[103].ZFEH_EepromData ECU_ADDRESS 0xFFF830E7 /end MEASUREMENT
/begin MEASUREMENT ZFEH_EepromData.di_statusOfDTC[104] "status of DTC of error code [index = KFC-1]" UBYTE EH_STANDARD_S5_S3 1 100 0 255 DISPLAY_IDENTIFIER di_statusOfDTC[104].ZFEH_EepromData ECU_ADDRESS 0xFFF830E8 /end MEASUREMENT
/begin MEASUREMENT ZFEH_EepromData.di_statusOfDTC[105] "status of DTC of error code [index = KFC-1]" UBYTE EH_STANDARD_S5_S3 1 100 0 255 DISPLAY_IDENTIFIER di_statusOfDTC[105].ZFEH_EepromData ECU_ADDRESS 0xFFF830E9 /end MEASUREMENT
/begin MEASUREMENT ZFEH_EepromData.di_statusOfDTC[106] "status of DTC of error code [index = KFC-1]" UBYTE EH_STANDARD_S5_S3 1 100 0 255 DISPLAY_IDENTIFIER di_statusOfDTC[106].ZFEH_EepromData ECU_ADDRESS 0xFFF830EA /end MEASUREMENT
/begin MEASUREMENT ZFEH_EepromData.di_statusOfDTC[107] "status of DTC of error code [index = KFC-1]" UBYTE EH_STANDARD_S5_S3 1 100 0 255 DISPLAY_IDENTIFIER di_statusOfDTC[107].ZFEH_EepromData ECU_ADDRESS 0xFFF830EB /end MEASUREMENT
/begin MEASUREMENT ZFEH_EepromData.di_statusOfDTC[108] "status of DTC of error code [index = KFC-1]" UBYTE EH_STANDARD_S5_S3 1 100 0 255 DISPLAY_IDENTIFIER di_statusOfDTC[108].ZFEH_EepromData ECU_ADDRESS 0xFFF830EC /end MEASUREMENT
/begin MEASUREMENT ZFEH_EepromData.di_statusOfDTC[109] "status of DTC of error code [index = KFC-1]" UBYTE EH_STANDARD_S5_S3 1 100 0 255 DISPLAY_IDENTIFIER di_statusOfDTC[109].ZFEH_EepromData ECU_ADDRESS 0xFFF830ED /end MEASUREMENT
/begin MEASUREMENT ZFEH_EepromData.di_statusOfDTC[110] "status of DTC of error code [index = KFC-1]" UBYTE EH_STANDARD_S5_S3 1 100 0 255 DISPLAY_IDENTIFIER di_statusOfDTC[110].ZFEH_EepromData ECU_ADDRESS 0xFFF830EE /end MEASUREMENT
/begin MEASUREMENT ZFEH_EepromData.di_statusOfDTC[111] "status of DTC of error code [index = KFC-1]" UBYTE EH_STANDARD_S5_S3 1 100 0 255 DISPLAY_IDENTIFIER di_statusOfDTC[111].ZFEH_EepromData ECU_ADDRESS 0xFFF830EF /end MEASUREMENT
/begin MEASUREMENT ZFEH_EepromData.di_statusOfDTC[112] "status of DTC of error code [index = KFC-1]" UBYTE EH_STANDARD_S5_S3 1 100 0 255 DISPLAY_IDENTIFIER di_statusOfDTC[112].ZFEH_EepromData ECU_ADDRESS 0xFFF830F0 /end MEASUREMENT
/begin MEASUREMENT ZFEH_EepromData.di_statusOfDTC[113] "status of DTC of error code [index = KFC-1]" UBYTE EH_STANDARD_S5_S3 1 100 0 255 DISPLAY_IDENTIFIER di_statusOfDTC[113].ZFEH_EepromData ECU_ADDRESS 0xFFF830F1 /end MEASUREMENT
/begin MEASUREMENT ZFEH_EepromData.di_statusOfDTC[114] "status of DTC of error code [index = KFC-1]" UBYTE EH_STANDARD_S5_S3 1 100 0 255 DISPLAY_IDENTIFIER di_statusOfDTC[114].ZFEH_EepromData ECU_ADDRESS 0xFFF830F2 /end MEASUREMENT
/begin MEASUREMENT ZFEH_EepromData.di_statusOfDTC[115] "status of DTC of error code [index = KFC-1]" UBYTE EH_STANDARD_S5_S3 1 100 0 255 DISPLAY_IDENTIFIER di_statusOfDTC[115].ZFEH_EepromData ECU_ADDRESS 0xFFF830F3 /end MEASUREMENT
/begin MEASUREMENT ZFEH_EepromData.di_statusOfDTC[116] "status of DTC of error code [index = KFC-1]" UBYTE EH_STANDARD_S5_S3 1 100 0 255 DISPLAY_IDENTIFIER di_statusOfDTC[116].ZFEH_EepromData ECU_ADDRESS 0xFFF830F4 /end MEASUREMENT
/begin MEASUREMENT ZFEH_EepromData.di_statusOfDTC[117] "status of DTC of error code [index = KFC-1]" UBYTE EH_STANDARD_S5_S3 1 100 0 255 DISPLAY_IDENTIFIER di_statusOfDTC[117].ZFEH_EepromData ECU_ADDRESS 0xFFF830F5 /end MEASUREMENT
/begin MEASUREMENT ZFEH_EepromData.di_statusOfDTC[118] "status of DTC of error code [index = KFC-1]" UBYTE EH_STANDARD_S5_S3 1 100 0 255 DISPLAY_IDENTIFIER di_statusOfDTC[118].ZFEH_EepromData ECU_ADDRESS 0xFFF830F6 /end MEASUREMENT
/begin MEASUREMENT ZFEH_EepromData.di_statusOfDTC[119] "status of DTC of error code [index = KFC-1]" UBYTE EH_STANDARD_S5_S3 1 100 0 255 DISPLAY_IDENTIFIER di_statusOfDTC[119].ZFEH_EepromData ECU_ADDRESS 0xFFF830F7 /end MEASUREMENT
/begin MEASUREMENT ZFEH_EepromData.di_statusOfDTC[120] "status of DTC of error code [index = KFC-1]" UBYTE EH_STANDARD_S5_S3 1 100 0 255 DISPLAY_IDENTIFIER di_statusOfDTC[120].ZFEH_EepromData ECU_ADDRESS 0xFFF830F8 /end MEASUREMENT
/begin MEASUREMENT ZFEH_EepromData.di_statusOfDTC[121] "status of DTC of error code [index = KFC-1]" UBYTE EH_STANDARD_S5_S3 1 100 0 255 DISPLAY_IDENTIFIER di_statusOfDTC[121].ZFEH_EepromData ECU_ADDRESS 0xFFF830F9 /end MEASUREMENT
/begin MEASUREMENT ZFEH_EepromData.di_statusOfDTC[122] "status of DTC of error code [index = KFC-1]" UBYTE EH_STANDARD_S5_S3 1 100 0 255 DISPLAY_IDENTIFIER di_statusOfDTC[122].ZFEH_EepromData ECU_ADDRESS 0xFFF830FA /end MEASUREMENT
/begin MEASUREMENT ZFEH_EepromData.di_statusOfDTC[123] "status of DTC of error code [index = KFC-1]" UBYTE EH_STANDARD_S5_S3 1 100 0 255 DISPLAY_IDENTIFIER di_statusOfDTC[123].ZFEH_EepromData ECU_ADDRESS 0xFFF830FB /end MEASUREMENT
/begin MEASUREMENT ZFEH_EepromData.di_statusOfDTC[124] "status of DTC of error code [index = KFC-1]" UBYTE EH_STANDARD_S5_S3 1 100 0 255 DISPLAY_IDENTIFIER di_statusOfDTC[124].ZFEH_EepromData ECU_ADDRESS 0xFFF830FC /end MEASUREMENT
/begin MEASUREMENT ZFEH_EepromData.di_statusOfDTC[125] "status of DTC of error code [index = KFC-1]" UBYTE EH_STANDARD_S5_S3 1 100 0 255 DISPLAY_IDENTIFIER di_statusOfDTC[125].ZFEH_EepromData ECU_ADDRESS 0xFFF830FD /end MEASUREMENT
/begin MEASUREMENT ZFEH_EepromData.di_statusOfDTC[126] "status of DTC of error code [index = KFC-1]" UBYTE EH_STANDARD_S5_S3 1 100 0 255 DISPLAY_IDENTIFIER di_statusOfDTC[126].ZFEH_EepromData ECU_ADDRESS 0xFFF830FE /end MEASUREMENT
/begin MEASUREMENT ZFEH_EepromData.di_statusOfDTC[127] "status of DTC of error code [index = KFC-1]" UBYTE EH_STANDARD_S5_S3 1 100 0 255 DISPLAY_IDENTIFIER di_statusOfDTC[127].ZFEH_EepromData ECU_ADDRESS 0xFFF830FF /end MEASUREMENT
/begin MEASUREMENT ZFEH_EepromData.di_statusOfDTC[128] "status of DTC of error code [index = KFC-1]" UBYTE EH_STANDARD_S5_S3 1 100 0 255 DISPLAY_IDENTIFIER di_statusOfDTC[128].ZFEH_EepromData ECU_ADDRESS 0xFFF83100 /end MEASUREMENT
/begin MEASUREMENT ZFEH_EepromData.di_statusOfDTC[129] "status of DTC of error code [index = KFC-1]" UBYTE EH_STANDARD_S5_S3 1 100 0 255 DISPLAY_IDENTIFIER di_statusOfDTC[129].ZFEH_EepromData ECU_ADDRESS 0xFFF83101 /end MEASUREMENT
/begin MEASUREMENT ZFEH_EepromData.di_statusOfDTC[130] "status of DTC of error code [index = KFC-1]" UBYTE EH_STANDARD_S5_S3 1 100 0 255 DISPLAY_IDENTIFIER di_statusOfDTC[130].ZFEH_EepromData ECU_ADDRESS 0xFFF83102 /end MEASUREMENT
/begin MEASUREMENT ZFEH_EepromData.di_statusOfDTC[131] "status of DTC of error code [index = KFC-1]" UBYTE EH_STANDARD_S5_S3 1 100 0 255 DISPLAY_IDENTIFIER di_statusOfDTC[131].ZFEH_EepromData ECU_ADDRESS 0xFFF83103 /end MEASUREMENT
/begin MEASUREMENT ZFEH_EepromData.di_statusOfDTC[132] "status of DTC of error code [index = KFC-1]" UBYTE EH_STANDARD_S5_S3 1 100 0 255 DISPLAY_IDENTIFIER di_statusOfDTC[132].ZFEH_EepromData ECU_ADDRESS 0xFFF83104 /end MEASUREMENT
/begin MEASUREMENT ZFEH_EepromData.di_statusOfDTC[133] "status of DTC of error code [index = KFC-1]" UBYTE EH_STANDARD_S5_S3 1 100 0 255 DISPLAY_IDENTIFIER di_statusOfDTC[133].ZFEH_EepromData ECU_ADDRESS 0xFFF83105 /end MEASUREMENT
/begin MEASUREMENT ZFEH_EepromData.di_statusOfDTC[134] "status of DTC of error code [index = KFC-1]" UBYTE EH_STANDARD_S5_S3 1 100 0 255 DISPLAY_IDENTIFIER di_statusOfDTC[134].ZFEH_EepromData ECU_ADDRESS 0xFFF83106 /end MEASUREMENT
/begin MEASUREMENT ZFEH_EepromData.di_statusOfDTC[135] "status of DTC of error code [index = KFC-1]" UBYTE EH_STANDARD_S5_S3 1 100 0 255 DISPLAY_IDENTIFIER di_statusOfDTC[135].ZFEH_EepromData ECU_ADDRESS 0xFFF83107 /end MEASUREMENT
/begin MEASUREMENT ZFEH_EepromData.di_statusOfDTC[136] "status of DTC of error code [index = KFC-1]" UBYTE EH_STANDARD_S5_S3 1 100 0 255 DISPLAY_IDENTIFIER di_statusOfDTC[136].ZFEH_EepromData ECU_ADDRESS 0xFFF83108 /end MEASUREMENT
/begin MEASUREMENT ZFEH_EepromData.di_statusOfDTC[137] "status of DTC of error code [index = KFC-1]" UBYTE EH_STANDARD_S5_S3 1 100 0 255 DISPLAY_IDENTIFIER di_statusOfDTC[137].ZFEH_EepromData ECU_ADDRESS 0xFFF83109 /end MEASUREMENT
/begin MEASUREMENT ZFEH_EepromData.di_statusOfDTC[138] "status of DTC of error code [index = KFC-1]" UBYTE EH_STANDARD_S5_S3 1 100 0 255 DISPLAY_IDENTIFIER di_statusOfDTC[138].ZFEH_EepromData ECU_ADDRESS 0xFFF8310A /end MEASUREMENT
/begin MEASUREMENT ZFEH_EepromData.di_statusOfDTC[139] "status of DTC of error code [index = KFC-1]" UBYTE EH_STANDARD_S5_S3 1 100 0 255 DISPLAY_IDENTIFIER di_statusOfDTC[139].ZFEH_EepromData ECU_ADDRESS 0xFFF8310B /end MEASUREMENT
/begin MEASUREMENT ZFEH_EepromData.di_statusOfDTC[140] "status of DTC of error code [index = KFC-1]" UBYTE EH_STANDARD_S5_S3 1 100 0 255 DISPLAY_IDENTIFIER di_statusOfDTC[140].ZFEH_EepromData ECU_ADDRESS 0xFFF8310C /end MEASUREMENT
/begin MEASUREMENT ZFEH_EepromData.di_statusOfDTC[141] "status of DTC of error code [index = KFC-1]" UBYTE EH_STANDARD_S5_S3 1 100 0 255 DISPLAY_IDENTIFIER di_statusOfDTC[141].ZFEH_EepromData ECU_ADDRESS 0xFFF8310D /end MEASUREMENT
/begin MEASUREMENT ZFEH_EepromData.di_statusOfDTC[142] "status of DTC of error code [index = KFC-1]" UBYTE EH_STANDARD_S5_S3 1 100 0 255 DISPLAY_IDENTIFIER di_statusOfDTC[142].ZFEH_EepromData ECU_ADDRESS 0xFFF8310E /end MEASUREMENT
/begin MEASUREMENT ZFEH_EepromData.di_statusOfDTC[143] "status of DTC of error code [index = KFC-1]" UBYTE EH_STANDARD_S5_S3 1 100 0 255 DISPLAY_IDENTIFIER di_statusOfDTC[143].ZFEH_EepromData ECU_ADDRESS 0xFFF8310F /end MEASUREMENT
/begin MEASUREMENT ZFEH_EepromData.di_statusOfDTC[144] "status of DTC of error code [index = KFC-1]" UBYTE EH_STANDARD_S5_S3 1 100 0 255 DISPLAY_IDENTIFIER di_statusOfDTC[144].ZFEH_EepromData ECU_ADDRESS 0xFFF83110 /end MEASUREMENT
/begin MEASUREMENT ZFEH_EepromData.di_statusOfDTC[145] "status of DTC of error code [index = KFC-1]" UBYTE EH_STANDARD_S5_S3 1 100 0 255 DISPLAY_IDENTIFIER di_statusOfDTC[145].ZFEH_EepromData ECU_ADDRESS 0xFFF83111 /end MEASUREMENT
/begin MEASUREMENT ZFEH_EepromData.di_statusOfDTC[146] "status of DTC of error code [index = KFC-1]" UBYTE EH_STANDARD_S5_S3 1 100 0 255 DISPLAY_IDENTIFIER di_statusOfDTC[146].ZFEH_EepromData ECU_ADDRESS 0xFFF83112 /end MEASUREMENT
/begin MEASUREMENT ZFEH_EepromData.di_statusOfDTC[147] "status of DTC of error code [index = KFC-1]" UBYTE EH_STANDARD_S5_S3 1 100 0 255 DISPLAY_IDENTIFIER di_statusOfDTC[147].ZFEH_EepromData ECU_ADDRESS 0xFFF83113 /end MEASUREMENT
/begin MEASUREMENT ZFEH_EepromData.di_statusOfDTC[148] "status of DTC of error code [index = KFC-1]" UBYTE EH_STANDARD_S5_S3 1 100 0 255 DISPLAY_IDENTIFIER di_statusOfDTC[148].ZFEH_EepromData ECU_ADDRESS 0xFFF83114 /end MEASUREMENT
/begin MEASUREMENT ZFEH_EepromData.di_statusOfDTC[149] "status of DTC of error code [index = KFC-1]" UBYTE EH_STANDARD_S5_S3 1 100 0 255 DISPLAY_IDENTIFIER di_statusOfDTC[149].ZFEH_EepromData ECU_ADDRESS 0xFFF83115 /end MEASUREMENT
/begin MEASUREMENT ZFEH_EepromData.di_statusOfDTC[150] "status of DTC of error code [index = KFC-1]" UBYTE EH_STANDARD_S5_S3 1 100 0 255 DISPLAY_IDENTIFIER di_statusOfDTC[150].ZFEH_EepromData ECU_ADDRESS 0xFFF83116 /end MEASUREMENT
/begin MEASUREMENT ZFEH_EepromData.di_statusOfDTC[151] "status of DTC of error code [index = KFC-1]" UBYTE EH_STANDARD_S5_S3 1 100 0 255 DISPLAY_IDENTIFIER di_statusOfDTC[151].ZFEH_EepromData ECU_ADDRESS 0xFFF83117 /end MEASUREMENT
/begin MEASUREMENT ZFEH_EepromData.di_statusOfDTC[152] "status of DTC of error code [index = KFC-1]" UBYTE EH_STANDARD_S5_S3 1 100 0 255 DISPLAY_IDENTIFIER di_statusOfDTC[152].ZFEH_EepromData ECU_ADDRESS 0xFFF83118 /end MEASUREMENT
/begin MEASUREMENT ZFEH_EepromData.di_statusOfDTC[153] "status of DTC of error code [index = KFC-1]" UBYTE EH_STANDARD_S5_S3 1 100 0 255 DISPLAY_IDENTIFIER di_statusOfDTC[153].ZFEH_EepromData ECU_ADDRESS 0xFFF83119 /end MEASUREMENT
/begin MEASUREMENT ZFEH_EepromData.di_statusOfDTC[154] "status of DTC of error code [index = KFC-1]" UBYTE EH_STANDARD_S5_S3 1 100 0 255 DISPLAY_IDENTIFIER di_statusOfDTC[154].ZFEH_EepromData ECU_ADDRESS 0xFFF8311A /end MEASUREMENT
/begin MEASUREMENT ZFEH_EepromData.di_statusOfDTC[155] "status of DTC of error code [index = KFC-1]" UBYTE EH_STANDARD_S5_S3 1 100 0 255 DISPLAY_IDENTIFIER di_statusOfDTC[155].ZFEH_EepromData ECU_ADDRESS 0xFFF8311B /end MEASUREMENT
/begin MEASUREMENT ZFEH_EepromData.di_statusOfDTC[156] "status of DTC of error code [index = KFC-1]" UBYTE EH_STANDARD_S5_S3 1 100 0 255 DISPLAY_IDENTIFIER di_statusOfDTC[156].ZFEH_EepromData ECU_ADDRESS 0xFFF8311C /end MEASUREMENT
/begin MEASUREMENT ZFEH_EepromData.di_statusOfDTC[157] "status of DTC of error code [index = KFC-1]" UBYTE EH_STANDARD_S5_S3 1 100 0 255 DISPLAY_IDENTIFIER di_statusOfDTC[157].ZFEH_EepromData ECU_ADDRESS 0xFFF8311D /end MEASUREMENT
/begin MEASUREMENT ZFEH_EepromData.di_statusOfDTC[158] "status of DTC of error code [index = KFC-1]" UBYTE EH_STANDARD_S5_S3 1 100 0 255 DISPLAY_IDENTIFIER di_statusOfDTC[158].ZFEH_EepromData ECU_ADDRESS 0xFFF8311E /end MEASUREMENT
/begin MEASUREMENT ZFEH_EepromData.di_statusOfDTC[159] "status of DTC of error code [index = KFC-1]" UBYTE EH_STANDARD_S5_S3 1 100 0 255 DISPLAY_IDENTIFIER di_statusOfDTC[159].ZFEH_EepromData ECU_ADDRESS 0xFFF8311F /end MEASUREMENT
/begin MEASUREMENT ZFEH_EepromData.di_statusOfDTC[160] "status of DTC of error code [index = KFC-1]" UBYTE EH_STANDARD_S5_S3 1 100 0 255 DISPLAY_IDENTIFIER di_statusOfDTC[160].ZFEH_EepromData ECU_ADDRESS 0xFFF83120 /end MEASUREMENT
/begin MEASUREMENT ZFEH_EepromData.di_statusOfDTC[161] "status of DTC of error code [index = KFC-1]" UBYTE EH_STANDARD_S5_S3 1 100 0 255 DISPLAY_IDENTIFIER di_statusOfDTC[161].ZFEH_EepromData ECU_ADDRESS 0xFFF83121 /end MEASUREMENT
/begin MEASUREMENT ZFEH_EepromData.di_statusOfDTC[162] "status of DTC of error code [index = KFC-1]" UBYTE EH_STANDARD_S5_S3 1 100 0 255 DISPLAY_IDENTIFIER di_statusOfDTC[162].ZFEH_EepromData ECU_ADDRESS 0xFFF83122 /end MEASUREMENT
/begin MEASUREMENT ZFEH_EepromData.di_statusOfDTC[163] "status of DTC of error code [index = KFC-1]" UBYTE EH_STANDARD_S5_S3 1 100 0 255 DISPLAY_IDENTIFIER di_statusOfDTC[163].ZFEH_EepromData ECU_ADDRESS 0xFFF83123 /end MEASUREMENT
/begin MEASUREMENT ZFEH_EepromData.di_statusOfDTC[164] "status of DTC of error code [index = KFC-1]" UBYTE EH_STANDARD_S5_S3 1 100 0 255 DISPLAY_IDENTIFIER di_statusOfDTC[164].ZFEH_EepromData ECU_ADDRESS 0xFFF83124 /end MEASUREMENT
/begin MEASUREMENT ZFEH_EepromData.di_statusOfDTC[165] "status of DTC of error code [index = KFC-1]" UBYTE EH_STANDARD_S5_S3 1 100 0 255 DISPLAY_IDENTIFIER di_statusOfDTC[165].ZFEH_EepromData ECU_ADDRESS 0xFFF83125 /end MEASUREMENT
/begin MEASUREMENT ZFEH_EepromData.di_statusOfDTC[166] "status of DTC of error code [index = KFC-1]" UBYTE EH_STANDARD_S5_S3 1 100 0 255 DISPLAY_IDENTIFIER di_statusOfDTC[166].ZFEH_EepromData ECU_ADDRESS 0xFFF83126 /end MEASUREMENT
/begin MEASUREMENT ZFEH_EepromData.di_statusOfDTC[167] "status of DTC of error code [index = KFC-1]" UBYTE EH_STANDARD_S5_S3 1 100 0 255 DISPLAY_IDENTIFIER di_statusOfDTC[167].ZFEH_EepromData ECU_ADDRESS 0xFFF83127 /end MEASUREMENT
/begin MEASUREMENT ZFEH_EepromData.di_statusOfDTC[168] "status of DTC of error code [index = KFC-1]" UBYTE EH_STANDARD_S5_S3 1 100 0 255 DISPLAY_IDENTIFIER di_statusOfDTC[168].ZFEH_EepromData ECU_ADDRESS 0xFFF83128 /end MEASUREMENT
/begin MEASUREMENT ZFEH_EepromData.di_statusOfDTC[169] "status of DTC of error code [index = KFC-1]" UBYTE EH_STANDARD_S5_S3 1 100 0 255 DISPLAY_IDENTIFIER di_statusOfDTC[169].ZFEH_EepromData ECU_ADDRESS 0xFFF83129 /end MEASUREMENT
/begin MEASUREMENT ZFEH_EepromData.di_statusOfDTC[170] "status of DTC of error code [index = KFC-1]" UBYTE EH_STANDARD_S5_S3 1 100 0 255 DISPLAY_IDENTIFIER di_statusOfDTC[170].ZFEH_EepromData ECU_ADDRESS 0xFFF8312A /end MEASUREMENT
/begin MEASUREMENT ZFEH_EepromData.di_statusOfDTC[171] "status of DTC of error code [index = KFC-1]" UBYTE EH_STANDARD_S5_S3 1 100 0 255 DISPLAY_IDENTIFIER di_statusOfDTC[171].ZFEH_EepromData ECU_ADDRESS 0xFFF8312B /end MEASUREMENT
/begin MEASUREMENT ZFEH_EepromData.di_statusOfDTC[172] "status of DTC of error code [index = KFC-1]" UBYTE EH_STANDARD_S5_S3 1 100 0 255 DISPLAY_IDENTIFIER di_statusOfDTC[172].ZFEH_EepromData ECU_ADDRESS 0xFFF8312C /end MEASUREMENT
/begin MEASUREMENT ZFEH_EepromData.di_statusOfDTC[173] "status of DTC of error code [index = KFC-1]" UBYTE EH_STANDARD_S5_S3 1 100 0 255 DISPLAY_IDENTIFIER di_statusOfDTC[173].ZFEH_EepromData ECU_ADDRESS 0xFFF8312D /end MEASUREMENT
/begin MEASUREMENT ZFEH_EepromData.di_statusOfDTC[174] "status of DTC of error code [index = KFC-1]" UBYTE EH_STANDARD_S5_S3 1 100 0 255 DISPLAY_IDENTIFIER di_statusOfDTC[174].ZFEH_EepromData ECU_ADDRESS 0xFFF8312E /end MEASUREMENT
/begin MEASUREMENT ZFEH_EepromData.di_statusOfDTC[175] "status of DTC of error code [index = KFC-1]" UBYTE EH_STANDARD_S5_S3 1 100 0 255 DISPLAY_IDENTIFIER di_statusOfDTC[175].ZFEH_EepromData ECU_ADDRESS 0xFFF8312F /end MEASUREMENT
/begin MEASUREMENT ZFEH_EepromData.di_statusOfDTC[176] "status of DTC of error code [index = KFC-1]" UBYTE EH_STANDARD_S5_S3 1 100 0 255 DISPLAY_IDENTIFIER di_statusOfDTC[176].ZFEH_EepromData ECU_ADDRESS 0xFFF83130 /end MEASUREMENT
/begin MEASUREMENT ZFEH_EepromData.di_statusOfDTC[177] "status of DTC of error code [index = KFC-1]" UBYTE EH_STANDARD_S5_S3 1 100 0 255 DISPLAY_IDENTIFIER di_statusOfDTC[177].ZFEH_EepromData ECU_ADDRESS 0xFFF83131 /end MEASUREMENT
/begin MEASUREMENT ZFEH_EepromData.di_statusOfDTC[178] "status of DTC of error code [index = KFC-1]" UBYTE EH_STANDARD_S5_S3 1 100 0 255 DISPLAY_IDENTIFIER di_statusOfDTC[178].ZFEH_EepromData ECU_ADDRESS 0xFFF83132 /end MEASUREMENT
/begin MEASUREMENT ZFEH_EepromData.di_statusOfDTC[179] "status of DTC of error code [index = KFC-1]" UBYTE EH_STANDARD_S5_S3 1 100 0 255 DISPLAY_IDENTIFIER di_statusOfDTC[179].ZFEH_EepromData ECU_ADDRESS 0xFFF83133 /end MEASUREMENT
/begin MEASUREMENT ZFEH_EepromData.di_statusOfDTC[180] "status of DTC of error code [index = KFC-1]" UBYTE EH_STANDARD_S5_S3 1 100 0 255 DISPLAY_IDENTIFIER di_statusOfDTC[180].ZFEH_EepromData ECU_ADDRESS 0xFFF83134 /end MEASUREMENT
/begin MEASUREMENT ZFEH_EepromData.di_statusOfDTC[181] "status of DTC of error code [index = KFC-1]" UBYTE EH_STANDARD_S5_S3 1 100 0 255 DISPLAY_IDENTIFIER di_statusOfDTC[181].ZFEH_EepromData ECU_ADDRESS 0xFFF83135 /end MEASUREMENT
/begin MEASUREMENT ZFEH_EepromData.di_statusOfDTC[182] "status of DTC of error code [index = KFC-1]" UBYTE EH_STANDARD_S5_S3 1 100 0 255 DISPLAY_IDENTIFIER di_statusOfDTC[182].ZFEH_EepromData ECU_ADDRESS 0xFFF83136 /end MEASUREMENT
/begin MEASUREMENT ZFEH_EepromData.di_statusOfDTC[183] "status of DTC of error code [index = KFC-1]" UBYTE EH_STANDARD_S5_S3 1 100 0 255 DISPLAY_IDENTIFIER di_statusOfDTC[183].ZFEH_EepromData ECU_ADDRESS 0xFFF83137 /end MEASUREMENT
/begin MEASUREMENT ZFEH_EepromData.di_statusOfDTC[184] "status of DTC of error code [index = KFC-1]" UBYTE EH_STANDARD_S5_S3 1 100 0 255 DISPLAY_IDENTIFIER di_statusOfDTC[184].ZFEH_EepromData ECU_ADDRESS 0xFFF83138 /end MEASUREMENT
/begin MEASUREMENT ZFEH_EepromData.di_statusOfDTC[185] "status of DTC of error code [index = KFC-1]" UBYTE EH_STANDARD_S5_S3 1 100 0 255 DISPLAY_IDENTIFIER di_statusOfDTC[185].ZFEH_EepromData ECU_ADDRESS 0xFFF83139 /end MEASUREMENT
/begin MEASUREMENT ZFEH_EepromData.di_statusOfDTC[186] "status of DTC of error code [index = KFC-1]" UBYTE EH_STANDARD_S5_S3 1 100 0 255 DISPLAY_IDENTIFIER di_statusOfDTC[186].ZFEH_EepromData ECU_ADDRESS 0xFFF8313A /end MEASUREMENT
/begin MEASUREMENT ZFEH_EepromData.di_statusOfDTC[187] "status of DTC of error code [index = KFC-1]" UBYTE EH_STANDARD_S5_S3 1 100 0 255 DISPLAY_IDENTIFIER di_statusOfDTC[187].ZFEH_EepromData ECU_ADDRESS 0xFFF8313B /end MEASUREMENT
/begin MEASUREMENT ZFEH_EepromData.di_statusOfDTC[188] "status of DTC of error code [index = KFC-1]" UBYTE EH_STANDARD_S5_S3 1 100 0 255 DISPLAY_IDENTIFIER di_statusOfDTC[188].ZFEH_EepromData ECU_ADDRESS 0xFFF8313C /end MEASUREMENT
/begin MEASUREMENT ZFEH_EepromData.di_statusOfDTC[189] "status of DTC of error code [index = KFC-1]" UBYTE EH_STANDARD_S5_S3 1 100 0 255 DISPLAY_IDENTIFIER di_statusOfDTC[189].ZFEH_EepromData ECU_ADDRESS 0xFFF8313D /end MEASUREMENT
/begin MEASUREMENT ZFEH_EepromData.di_statusOfDTC[190] "status of DTC of error code [index = KFC-1]" UBYTE EH_STANDARD_S5_S3 1 100 0 255 DISPLAY_IDENTIFIER di_statusOfDTC[190].ZFEH_EepromData ECU_ADDRESS 0xFFF8313E /end MEASUREMENT
/begin MEASUREMENT ZFEH_EepromData.di_statusOfDTC[191] "status of DTC of error code [index = KFC-1]" UBYTE EH_STANDARD_S5_S3 1 100 0 255 DISPLAY_IDENTIFIER di_statusOfDTC[191].ZFEH_EepromData ECU_ADDRESS 0xFFF8313F /end MEASUREMENT
/begin MEASUREMENT ZFEH_EepromData.di_statusOfDTC[192] "status of DTC of error code [index = KFC-1]" UBYTE EH_STANDARD_S5_S3 1 100 0 255 DISPLAY_IDENTIFIER di_statusOfDTC[192].ZFEH_EepromData ECU_ADDRESS 0xFFF83140 /end MEASUREMENT
/begin MEASUREMENT ZFEH_EepromData.di_statusOfDTC[193] "status of DTC of error code [index = KFC-1]" UBYTE EH_STANDARD_S5_S3 1 100 0 255 DISPLAY_IDENTIFIER di_statusOfDTC[193].ZFEH_EepromData ECU_ADDRESS 0xFFF83141 /end MEASUREMENT
/begin MEASUREMENT ZFEH_EepromData.di_statusOfDTC[194] "status of DTC of error code [index = KFC-1]" UBYTE EH_STANDARD_S5_S3 1 100 0 255 DISPLAY_IDENTIFIER di_statusOfDTC[194].ZFEH_EepromData ECU_ADDRESS 0xFFF83142 /end MEASUREMENT
/begin MEASUREMENT ZFEH_EepromData.di_statusOfDTC[195] "status of DTC of error code [index = KFC-1]" UBYTE EH_STANDARD_S5_S3 1 100 0 255 DISPLAY_IDENTIFIER di_statusOfDTC[195].ZFEH_EepromData ECU_ADDRESS 0xFFF83143 /end MEASUREMENT
/begin MEASUREMENT ZFEH_EepromData.di_statusOfDTC[196] "status of DTC of error code [index = KFC-1]" UBYTE EH_STANDARD_S5_S3 1 100 0 255 DISPLAY_IDENTIFIER di_statusOfDTC[196].ZFEH_EepromData ECU_ADDRESS 0xFFF83144 /end MEASUREMENT
/begin MEASUREMENT ZFEH_EepromData.di_statusOfDTC[197] "status of DTC of error code [index = KFC-1]" UBYTE EH_STANDARD_S5_S3 1 100 0 255 DISPLAY_IDENTIFIER di_statusOfDTC[197].ZFEH_EepromData ECU_ADDRESS 0xFFF83145 /end MEASUREMENT
/begin MEASUREMENT ZFEH_EepromData.di_statusOfDTC[198] "status of DTC of error code [index = KFC-1]" UBYTE EH_STANDARD_S5_S3 1 100 0 255 DISPLAY_IDENTIFIER di_statusOfDTC[198].ZFEH_EepromData ECU_ADDRESS 0xFFF83146 /end MEASUREMENT
/begin MEASUREMENT ZFEH_EepromData.di_statusOfDTC[199] "status of DTC of error code [index = KFC-1]" UBYTE EH_STANDARD_S5_S3 1 100 0 255 DISPLAY_IDENTIFIER di_statusOfDTC[199].ZFEH_EepromData ECU_ADDRESS 0xFFF83147 /end MEASUREMENT
/begin MEASUREMENT ZFEH_EepromData.di_statusOfDTC[200] "status of DTC of error code [index = KFC-1]" UBYTE EH_STANDARD_S5_S3 1 100 0 255 DISPLAY_IDENTIFIER di_statusOfDTC[200].ZFEH_EepromData ECU_ADDRESS 0xFFF83148 /end MEASUREMENT
/begin MEASUREMENT ZFEH_EepromData.di_statusOfDTC[201] "status of DTC of error code [index = KFC-1]" UBYTE EH_STANDARD_S5_S3 1 100 0 255 DISPLAY_IDENTIFIER di_statusOfDTC[201].ZFEH_EepromData ECU_ADDRESS 0xFFF83149 /end MEASUREMENT
/begin MEASUREMENT ZFEH_EepromData.di_statusOfDTC[202] "status of DTC of error code [index = KFC-1]" UBYTE EH_STANDARD_S5_S3 1 100 0 255 DISPLAY_IDENTIFIER di_statusOfDTC[202].ZFEH_EepromData ECU_ADDRESS 0xFFF8314A /end MEASUREMENT
/begin MEASUREMENT ZFEH_EepromData.di_statusOfDTC[203] "status of DTC of error code [index = KFC-1]" UBYTE EH_STANDARD_S5_S3 1 100 0 255 DISPLAY_IDENTIFIER di_statusOfDTC[203].ZFEH_EepromData ECU_ADDRESS 0xFFF8314B /end MEASUREMENT
/begin MEASUREMENT ZFEH_EepromData.di_statusOfDTC[204] "status of DTC of error code [index = KFC-1]" UBYTE EH_STANDARD_S5_S3 1 100 0 255 DISPLAY_IDENTIFIER di_statusOfDTC[204].ZFEH_EepromData ECU_ADDRESS 0xFFF8314C /end MEASUREMENT
/begin MEASUREMENT ZFEH_EepromData.di_statusOfDTC[205] "status of DTC of error code [index = KFC-1]" UBYTE EH_STANDARD_S5_S3 1 100 0 255 DISPLAY_IDENTIFIER di_statusOfDTC[205].ZFEH_EepromData ECU_ADDRESS 0xFFF8314D /end MEASUREMENT
/begin MEASUREMENT ZFEH_EepromData.di_statusOfDTC[206] "status of DTC of error code [index = KFC-1]" UBYTE EH_STANDARD_S5_S3 1 100 0 255 DISPLAY_IDENTIFIER di_statusOfDTC[206].ZFEH_EepromData ECU_ADDRESS 0xFFF8314E /end MEASUREMENT
/begin MEASUREMENT ZFEH_EepromData.di_statusOfDTC[207] "status of DTC of error code [index = KFC-1]" UBYTE EH_STANDARD_S5_S3 1 100 0 255 DISPLAY_IDENTIFIER di_statusOfDTC[207].ZFEH_EepromData ECU_ADDRESS 0xFFF8314F /end MEASUREMENT
/begin MEASUREMENT ZFEH_EepromData.di_statusOfDTC[208] "status of DTC of error code [index = KFC-1]" UBYTE EH_STANDARD_S5_S3 1 100 0 255 DISPLAY_IDENTIFIER di_statusOfDTC[208].ZFEH_EepromData ECU_ADDRESS 0xFFF83150 /end MEASUREMENT
/begin MEASUREMENT ZFEH_EepromData.di_statusOfDTC[209] "status of DTC of error code [index = KFC-1]" UBYTE EH_STANDARD_S5_S3 1 100 0 255 DISPLAY_IDENTIFIER di_statusOfDTC[209].ZFEH_EepromData ECU_ADDRESS 0xFFF83151 /end MEASUREMENT
/begin MEASUREMENT ZFEH_EepromData.di_statusOfDTC[210] "status of DTC of error code [index = KFC-1]" UBYTE EH_STANDARD_S5_S3 1 100 0 255 DISPLAY_IDENTIFIER di_statusOfDTC[210].ZFEH_EepromData ECU_ADDRESS 0xFFF83152 /end MEASUREMENT
/begin MEASUREMENT ZFEH_EepromData.di_statusOfDTC[211] "status of DTC of error code [index = KFC-1]" UBYTE EH_STANDARD_S5_S3 1 100 0 255 DISPLAY_IDENTIFIER di_statusOfDTC[211].ZFEH_EepromData ECU_ADDRESS 0xFFF83153 /end MEASUREMENT
/begin MEASUREMENT ZFEH_EepromData.di_statusOfDTC[212] "status of DTC of error code [index = KFC-1]" UBYTE EH_STANDARD_S5_S3 1 100 0 255 DISPLAY_IDENTIFIER di_statusOfDTC[212].ZFEH_EepromData ECU_ADDRESS 0xFFF83154 /end MEASUREMENT
/begin MEASUREMENT ZFEH_EepromData.di_statusOfDTC[213] "status of DTC of error code [index = KFC-1]" UBYTE EH_STANDARD_S5_S3 1 100 0 255 DISPLAY_IDENTIFIER di_statusOfDTC[213].ZFEH_EepromData ECU_ADDRESS 0xFFF83155 /end MEASUREMENT
/begin MEASUREMENT ZFEH_EepromData.di_statusOfDTC[214] "status of DTC of error code [index = KFC-1]" UBYTE EH_STANDARD_S5_S3 1 100 0 255 DISPLAY_IDENTIFIER di_statusOfDTC[214].ZFEH_EepromData ECU_ADDRESS 0xFFF83156 /end MEASUREMENT
/begin MEASUREMENT ZFEH_EepromData.di_statusOfDTC[215] "status of DTC of error code [index = KFC-1]" UBYTE EH_STANDARD_S5_S3 1 100 0 255 DISPLAY_IDENTIFIER di_statusOfDTC[215].ZFEH_EepromData ECU_ADDRESS 0xFFF83157 /end MEASUREMENT
/begin MEASUREMENT ZFEH_EepromData.di_statusOfDTC[216] "status of DTC of error code [index = KFC-1]" UBYTE EH_STANDARD_S5_S3 1 100 0 255 DISPLAY_IDENTIFIER di_statusOfDTC[216].ZFEH_EepromData ECU_ADDRESS 0xFFF83158 /end MEASUREMENT
/begin MEASUREMENT ZFEH_EepromData.di_statusOfDTC[217] "status of DTC of error code [index = KFC-1]" UBYTE EH_STANDARD_S5_S3 1 100 0 255 DISPLAY_IDENTIFIER di_statusOfDTC[217].ZFEH_EepromData ECU_ADDRESS 0xFFF83159 /end MEASUREMENT
/begin MEASUREMENT ZFEH_EepromData.di_statusOfDTC[218] "status of DTC of error code [index = KFC-1]" UBYTE EH_STANDARD_S5_S3 1 100 0 255 DISPLAY_IDENTIFIER di_statusOfDTC[218].ZFEH_EepromData ECU_ADDRESS 0xFFF8315A /end MEASUREMENT
/begin MEASUREMENT ZFEH_EepromData.di_statusOfDTC[219] "status of DTC of error code [index = KFC-1]" UBYTE EH_STANDARD_S5_S3 1 100 0 255 DISPLAY_IDENTIFIER di_statusOfDTC[219].ZFEH_EepromData ECU_ADDRESS 0xFFF8315B /end MEASUREMENT
/begin MEASUREMENT ZFEH_EepromData.di_statusOfDTC[220] "status of DTC of error code [index = KFC-1]" UBYTE EH_STANDARD_S5_S3 1 100 0 255 DISPLAY_IDENTIFIER di_statusOfDTC[220].ZFEH_EepromData ECU_ADDRESS 0xFFF8315C /end MEASUREMENT
/begin MEASUREMENT ZFEH_EepromData.di_statusOfDTC[221] "status of DTC of error code [index = KFC-1]" UBYTE EH_STANDARD_S5_S3 1 100 0 255 DISPLAY_IDENTIFIER di_statusOfDTC[221].ZFEH_EepromData ECU_ADDRESS 0xFFF8315D /end MEASUREMENT
/begin MEASUREMENT ZFEH_EepromData.di_statusOfDTC[222] "status of DTC of error code [index = KFC-1]" UBYTE EH_STANDARD_S5_S3 1 100 0 255 DISPLAY_IDENTIFIER di_statusOfDTC[222].ZFEH_EepromData ECU_ADDRESS 0xFFF8315E /end MEASUREMENT
/begin MEASUREMENT ZFEH_EepromData.di_statusOfDTC[223] "status of DTC of error code [index = KFC-1]" UBYTE EH_STANDARD_S5_S3 1 100 0 255 DISPLAY_IDENTIFIER di_statusOfDTC[223].ZFEH_EepromData ECU_ADDRESS 0xFFF8315F /end MEASUREMENT
/begin MEASUREMENT ZFEH_EepromData.di_statusOfDTC[224] "status of DTC of error code [index = KFC-1]" UBYTE EH_STANDARD_S5_S3 1 100 0 255 DISPLAY_IDENTIFIER di_statusOfDTC[224].ZFEH_EepromData ECU_ADDRESS 0xFFF83160 /end MEASUREMENT
/begin MEASUREMENT ZFEH_EepromData.di_statusOfDTC[225] "status of DTC of error code [index = KFC-1]" UBYTE EH_STANDARD_S5_S3 1 100 0 255 DISPLAY_IDENTIFIER di_statusOfDTC[225].ZFEH_EepromData ECU_ADDRESS 0xFFF83161 /end MEASUREMENT
/begin MEASUREMENT ZFEH_EepromData.di_statusOfDTC[226] "status of DTC of error code [index = KFC-1]" UBYTE EH_STANDARD_S5_S3 1 100 0 255 DISPLAY_IDENTIFIER di_statusOfDTC[226].ZFEH_EepromData ECU_ADDRESS 0xFFF83162 /end MEASUREMENT
/begin MEASUREMENT ZFEH_EepromData.di_statusOfDTC[227] "status of DTC of error code [index = KFC-1]" UBYTE EH_STANDARD_S5_S3 1 100 0 255 DISPLAY_IDENTIFIER di_statusOfDTC[227].ZFEH_EepromData ECU_ADDRESS 0xFFF83163 /end MEASUREMENT
/begin MEASUREMENT ZFEH_EepromData.di_statusOfDTC[228] "status of DTC of error code [index = KFC-1]" UBYTE EH_STANDARD_S5_S3 1 100 0 255 DISPLAY_IDENTIFIER di_statusOfDTC[228].ZFEH_EepromData ECU_ADDRESS 0xFFF83164 /end MEASUREMENT
/begin MEASUREMENT ZFEH_EepromData.di_statusOfDTC[229] "status of DTC of error code [index = KFC-1]" UBYTE EH_STANDARD_S5_S3 1 100 0 255 DISPLAY_IDENTIFIER di_statusOfDTC[229].ZFEH_EepromData ECU_ADDRESS 0xFFF83165 /end MEASUREMENT
/begin MEASUREMENT ZFEH_EepromData.di_statusOfDTC[230] "status of DTC of error code [index = KFC-1]" UBYTE EH_STANDARD_S5_S3 1 100 0 255 DISPLAY_IDENTIFIER di_statusOfDTC[230].ZFEH_EepromData ECU_ADDRESS 0xFFF83166 /end MEASUREMENT
/begin MEASUREMENT ZFEH_EepromData.di_statusOfDTC[231] "status of DTC of error code [index = KFC-1]" UBYTE EH_STANDARD_S5_S3 1 100 0 255 DISPLAY_IDENTIFIER di_statusOfDTC[231].ZFEH_EepromData ECU_ADDRESS 0xFFF83167 /end MEASUREMENT
/begin MEASUREMENT ZFEH_EepromData.di_statusOfDTC[232] "status of DTC of error code [index = KFC-1]" UBYTE EH_STANDARD_S5_S3 1 100 0 255 DISPLAY_IDENTIFIER di_statusOfDTC[232].ZFEH_EepromData ECU_ADDRESS 0xFFF83168 /end MEASUREMENT
/begin MEASUREMENT ZFEH_EepromData.di_statusOfDTC[233] "status of DTC of error code [index = KFC-1]" UBYTE EH_STANDARD_S5_S3 1 100 0 255 DISPLAY_IDENTIFIER di_statusOfDTC[233].ZFEH_EepromData ECU_ADDRESS 0xFFF83169 /end MEASUREMENT
/begin MEASUREMENT ZFEH_EepromData.di_statusOfDTC[234] "status of DTC of error code [index = KFC-1]" UBYTE EH_STANDARD_S5_S3 1 100 0 255 DISPLAY_IDENTIFIER di_statusOfDTC[234].ZFEH_EepromData ECU_ADDRESS 0xFFF8316A /end MEASUREMENT
/begin MEASUREMENT ZFEH_EepromData.di_statusOfDTC[235] "status of DTC of error code [index = KFC-1]" UBYTE EH_STANDARD_S5_S3 1 100 0 255 DISPLAY_IDENTIFIER di_statusOfDTC[235].ZFEH_EepromData ECU_ADDRESS 0xFFF8316B /end MEASUREMENT
/begin MEASUREMENT ZFEH_EepromData.di_statusOfDTC[236] "status of DTC of error code [index = KFC-1]" UBYTE EH_STANDARD_S5_S3 1 100 0 255 DISPLAY_IDENTIFIER di_statusOfDTC[236].ZFEH_EepromData ECU_ADDRESS 0xFFF8316C /end MEASUREMENT
/begin MEASUREMENT ZFEH_EepromData.di_statusOfDTC[237] "status of DTC of error code [index = KFC-1]" UBYTE EH_STANDARD_S5_S3 1 100 0 255 DISPLAY_IDENTIFIER di_statusOfDTC[237].ZFEH_EepromData ECU_ADDRESS 0xFFF8316D /end MEASUREMENT
/begin MEASUREMENT ZFEH_EepromData.di_statusOfDTC[238] "status of DTC of error code [index = KFC-1]" UBYTE EH_STANDARD_S5_S3 1 100 0 255 DISPLAY_IDENTIFIER di_statusOfDTC[238].ZFEH_EepromData ECU_ADDRESS 0xFFF8316E /end MEASUREMENT
/begin MEASUREMENT ZFEH_EepromData.di_statusOfDTC[239] "status of DTC of error code [index = KFC-1]" UBYTE EH_STANDARD_S5_S3 1 100 0 255 DISPLAY_IDENTIFIER di_statusOfDTC[239].ZFEH_EepromData ECU_ADDRESS 0xFFF8316F /end MEASUREMENT
/begin MEASUREMENT ZFEH_EepromData.di_statusOfDTC[240] "status of DTC of error code [index = KFC-1]" UBYTE EH_STANDARD_S5_S3 1 100 0 255 DISPLAY_IDENTIFIER di_statusOfDTC[240].ZFEH_EepromData ECU_ADDRESS 0xFFF83170 /end MEASUREMENT
/begin MEASUREMENT ZFEH_EepromData.di_statusOfDTC[241] "status of DTC of error code [index = KFC-1]" UBYTE EH_STANDARD_S5_S3 1 100 0 255 DISPLAY_IDENTIFIER di_statusOfDTC[241].ZFEH_EepromData ECU_ADDRESS 0xFFF83171 /end MEASUREMENT
/begin MEASUREMENT ZFEH_EepromData.di_statusOfDTC[242] "status of DTC of error code [index = KFC-1]" UBYTE EH_STANDARD_S5_S3 1 100 0 255 DISPLAY_IDENTIFIER di_statusOfDTC[242].ZFEH_EepromData ECU_ADDRESS 0xFFF83172 /end MEASUREMENT
/begin MEASUREMENT ZFEH_EepromData.di_statusOfDTC[243] "status of DTC of error code [index = KFC-1]" UBYTE EH_STANDARD_S5_S3 1 100 0 255 DISPLAY_IDENTIFIER di_statusOfDTC[243].ZFEH_EepromData ECU_ADDRESS 0xFFF83173 /end MEASUREMENT
/begin MEASUREMENT ZFEH_EepromData.di_statusOfDTC[244] "status of DTC of error code [index = KFC-1]" UBYTE EH_STANDARD_S5_S3 1 100 0 255 DISPLAY_IDENTIFIER di_statusOfDTC[244].ZFEH_EepromData ECU_ADDRESS 0xFFF83174 /end MEASUREMENT
/begin MEASUREMENT ZFEH_EepromData.di_statusOfDTC[245] "status of DTC of error code [index = KFC-1]" UBYTE EH_STANDARD_S5_S3 1 100 0 255 DISPLAY_IDENTIFIER di_statusOfDTC[245].ZFEH_EepromData ECU_ADDRESS 0xFFF83175 /end MEASUREMENT
/begin MEASUREMENT ZFEH_EepromData.di_statusOfDTC[246] "status of DTC of error code [index = KFC-1]" UBYTE EH_STANDARD_S5_S3 1 100 0 255 DISPLAY_IDENTIFIER di_statusOfDTC[246].ZFEH_EepromData ECU_ADDRESS 0xFFF83176 /end MEASUREMENT
/begin MEASUREMENT ZFEH_EepromData.di_statusOfDTC[247] "status of DTC of error code [index = KFC-1]" UBYTE EH_STANDARD_S5_S3 1 100 0 255 DISPLAY_IDENTIFIER di_statusOfDTC[247].ZFEH_EepromData ECU_ADDRESS 0xFFF83177 /end MEASUREMENT
/begin MEASUREMENT ZFEH_EepromData.di_statusOfDTC[248] "status of DTC of error code [index = KFC-1]" UBYTE EH_STANDARD_S5_S3 1 100 0 255 DISPLAY_IDENTIFIER di_statusOfDTC[248].ZFEH_EepromData ECU_ADDRESS 0xFFF83178 /end MEASUREMENT
/begin MEASUREMENT ZFEH_EepromData.di_statusOfDTC[249] "status of DTC of error code [index = KFC-1]" UBYTE EH_STANDARD_S5_S3 1 100 0 255 DISPLAY_IDENTIFIER di_statusOfDTC[249].ZFEH_EepromData ECU_ADDRESS 0xFFF83179 /end MEASUREMENT
/begin MEASUREMENT ZFEH_EepromData.di_statusOfDTC[250] "status of DTC of error code [index = KFC-1]" UBYTE EH_STANDARD_S5_S3 1 100 0 255 DISPLAY_IDENTIFIER di_statusOfDTC[250].ZFEH_EepromData ECU_ADDRESS 0xFFF8317A /end MEASUREMENT
/begin MEASUREMENT ZFEH_EepromData.di_statusOfDTC[251] "status of DTC of error code [index = KFC-1]" UBYTE EH_STANDARD_S5_S3 1 100 0 255 DISPLAY_IDENTIFIER di_statusOfDTC[251].ZFEH_EepromData ECU_ADDRESS 0xFFF8317B /end MEASUREMENT
/begin MEASUREMENT ZFEH_EepromData.di_statusOfDTC[252] "status of DTC of error code [index = KFC-1]" UBYTE EH_STANDARD_S5_S3 1 100 0 255 DISPLAY_IDENTIFIER di_statusOfDTC[252].ZFEH_EepromData ECU_ADDRESS 0xFFF8317C /end MEASUREMENT
/begin MEASUREMENT ZFEH_EepromData.di_statusOfDTC[253] "status of DTC of error code [index = KFC-1]" UBYTE EH_STANDARD_S5_S3 1 100 0 255 DISPLAY_IDENTIFIER di_statusOfDTC[253].ZFEH_EepromData ECU_ADDRESS 0xFFF8317D /end MEASUREMENT
/begin MEASUREMENT ZFEH_EepromData.di_obd_readiness[0] "general readiness information of the errors (bitcoded) [0 .. 16-1]" UWORD EH_STANDARD_S5_S3 1 100 0 65535 DISPLAY_IDENTIFIER di_obd_readiness[0].ZFEH_EepromData ECU_ADDRESS 0xFFF831F8 /end MEASUREMENT
/begin MEASUREMENT ZFEH_EepromData.di_obd_readiness[1] "general readiness information of the errors (bitcoded) [0 .. 16-1]" UWORD EH_STANDARD_S5_S3 1 100 0 65535 DISPLAY_IDENTIFIER di_obd_readiness[1].ZFEH_EepromData ECU_ADDRESS 0xFFF831FA /end MEASUREMENT
/begin MEASUREMENT ZFEH_EepromData.di_obd_readiness[2] "general readiness information of the errors (bitcoded) [0 .. 16-1]" UWORD EH_STANDARD_S5_S3 1 100 0 65535 DISPLAY_IDENTIFIER di_obd_readiness[2].ZFEH_EepromData ECU_ADDRESS 0xFFF831FC /end MEASUREMENT
/begin MEASUREMENT ZFEH_EepromData.di_obd_readiness[3] "general readiness information of the errors (bitcoded) [0 .. 16-1]" UWORD EH_STANDARD_S5_S3 1 100 0 65535 DISPLAY_IDENTIFIER di_obd_readiness[3].ZFEH_EepromData ECU_ADDRESS 0xFFF831FE /end MEASUREMENT
/begin MEASUREMENT ZFEH_EepromData.di_obd_readiness[4] "general readiness information of the errors (bitcoded) [0 .. 16-1]" UWORD EH_STANDARD_S5_S3 1 100 0 65535 DISPLAY_IDENTIFIER di_obd_readiness[4].ZFEH_EepromData ECU_ADDRESS 0xFFF83200 /end MEASUREMENT
/begin MEASUREMENT ZFEH_EepromData.di_obd_readiness[5] "general readiness information of the errors (bitcoded) [0 .. 16-1]" UWORD EH_STANDARD_S5_S3 1 100 0 65535 DISPLAY_IDENTIFIER di_obd_readiness[5].ZFEH_EepromData ECU_ADDRESS 0xFFF83202 /end MEASUREMENT
/begin MEASUREMENT ZFEH_EepromData.di_obd_readiness[6] "general readiness information of the errors (bitcoded) [0 .. 16-1]" UWORD EH_STANDARD_S5_S3 1 100 0 65535 DISPLAY_IDENTIFIER di_obd_readiness[6].ZFEH_EepromData ECU_ADDRESS 0xFFF83204 /end MEASUREMENT
/begin MEASUREMENT ZFEH_EepromData.di_obd_readiness[7] "general readiness information of the errors (bitcoded) [0 .. 16-1]" UWORD EH_STANDARD_S5_S3 1 100 0 65535 DISPLAY_IDENTIFIER di_obd_readiness[7].ZFEH_EepromData ECU_ADDRESS 0xFFF83206 /end MEASUREMENT
/begin MEASUREMENT ZFEH_EepromData.di_obd_readiness[8] "general readiness information of the errors (bitcoded) [0 .. 16-1]" UWORD EH_STANDARD_S5_S3 1 100 0 65535 DISPLAY_IDENTIFIER di_obd_readiness[8].ZFEH_EepromData ECU_ADDRESS 0xFFF83208 /end MEASUREMENT
/begin MEASUREMENT ZFEH_EepromData.di_obd_readiness[9] "general readiness information of the errors (bitcoded) [0 .. 16-1]" UWORD EH_STANDARD_S5_S3 1 100 0 65535 DISPLAY_IDENTIFIER di_obd_readiness[9].ZFEH_EepromData ECU_ADDRESS 0xFFF8320A /end MEASUREMENT
/begin MEASUREMENT ZFEH_EepromData.di_obd_readiness[10] "general readiness information of the errors (bitcoded) [0 .. 16-1]" UWORD EH_STANDARD_S5_S3 1 100 0 65535 DISPLAY_IDENTIFIER di_obd_readiness[10].ZFEH_EepromData ECU_ADDRESS 0xFFF8320C /end MEASUREMENT
/begin MEASUREMENT ZFEH_EepromData.di_obd_readiness[11] "general readiness information of the errors (bitcoded) [0 .. 16-1]" UWORD EH_STANDARD_S5_S3 1 100 0 65535 DISPLAY_IDENTIFIER di_obd_readiness[11].ZFEH_EepromData ECU_ADDRESS 0xFFF8320E /end MEASUREMENT
/begin MEASUREMENT ZFEH_EepromData.di_obd_readiness[12] "general readiness information of the errors (bitcoded) [0 .. 16-1]" UWORD EH_STANDARD_S5_S3 1 100 0 65535 DISPLAY_IDENTIFIER di_obd_readiness[12].ZFEH_EepromData ECU_ADDRESS 0xFFF83210 /end MEASUREMENT
/begin MEASUREMENT ZFEH_EepromData.di_obd_readiness[13] "general readiness information of the errors (bitcoded) [0 .. 16-1]" UWORD EH_STANDARD_S5_S3 1 100 0 65535 DISPLAY_IDENTIFIER di_obd_readiness[13].ZFEH_EepromData ECU_ADDRESS 0xFFF83212 /end MEASUREMENT
/begin MEASUREMENT ZFEH_EepromData.di_obd_readiness[14] "general readiness information of the errors (bitcoded) [0 .. 16-1]" UWORD EH_STANDARD_S5_S3 1 100 0 65535 DISPLAY_IDENTIFIER di_obd_readiness[14].ZFEH_EepromData ECU_ADDRESS 0xFFF83214 /end MEASUREMENT
/begin MEASUREMENT ZFEH_EepromData.di_obd_readiness[15] "general readiness information of the errors (bitcoded) [0 .. 16-1]" UWORD EH_STANDARD_S5_S3 1 100 0 65535 DISPLAY_IDENTIFIER di_obd_readiness[15].ZFEH_EepromData ECU_ADDRESS 0xFFF83216 /end MEASUREMENT
/begin MEASUREMENT ZFEH_EepromData.di_obd_dc_specific_readiness[0] "driving cycle specific readiness information of the errors (bitcoded) [0 .. 16-1]" UWORD EH_STANDARD_S5_S3 1 100 0 65535 DISPLAY_IDENTIFIER di_obd_dc_specific_readiness[0].ZFEH_EepromData ECU_ADDRESS 0xFFF83218 /end MEASUREMENT
/begin MEASUREMENT ZFEH_EepromData.di_obd_dc_specific_readiness[1] "driving cycle specific readiness information of the errors (bitcoded) [0 .. 16-1]" UWORD EH_STANDARD_S5_S3 1 100 0 65535 DISPLAY_IDENTIFIER di_obd_dc_specific_readiness[1].ZFEH_EepromData ECU_ADDRESS 0xFFF8321A /end MEASUREMENT
/begin MEASUREMENT ZFEH_EepromData.di_obd_dc_specific_readiness[2] "driving cycle specific readiness information of the errors (bitcoded) [0 .. 16-1]" UWORD EH_STANDARD_S5_S3 1 100 0 65535 DISPLAY_IDENTIFIER di_obd_dc_specific_readiness[2].ZFEH_EepromData ECU_ADDRESS 0xFFF8321C /end MEASUREMENT
/begin MEASUREMENT ZFEH_EepromData.di_obd_dc_specific_readiness[3] "driving cycle specific readiness information of the errors (bitcoded) [0 .. 16-1]" UWORD EH_STANDARD_S5_S3 1 100 0 65535 DISPLAY_IDENTIFIER di_obd_dc_specific_readiness[3].ZFEH_EepromData ECU_ADDRESS 0xFFF8321E /end MEASUREMENT
/begin MEASUREMENT ZFEH_EepromData.di_obd_dc_specific_readiness[4] "driving cycle specific readiness information of the errors (bitcoded) [0 .. 16-1]" UWORD EH_STANDARD_S5_S3 1 100 0 65535 DISPLAY_IDENTIFIER di_obd_dc_specific_readiness[4].ZFEH_EepromData ECU_ADDRESS 0xFFF83220 /end MEASUREMENT
/begin MEASUREMENT ZFEH_EepromData.di_obd_dc_specific_readiness[5] "driving cycle specific readiness information of the errors (bitcoded) [0 .. 16-1]" UWORD EH_STANDARD_S5_S3 1 100 0 65535 DISPLAY_IDENTIFIER di_obd_dc_specific_readiness[5].ZFEH_EepromData ECU_ADDRESS 0xFFF83222 /end MEASUREMENT
/begin MEASUREMENT ZFEH_EepromData.di_obd_dc_specific_readiness[6] "driving cycle specific readiness information of the errors (bitcoded) [0 .. 16-1]" UWORD EH_STANDARD_S5_S3 1 100 0 65535 DISPLAY_IDENTIFIER di_obd_dc_specific_readiness[6].ZFEH_EepromData ECU_ADDRESS 0xFFF83224 /end MEASUREMENT
/begin MEASUREMENT ZFEH_EepromData.di_obd_dc_specific_readiness[7] "driving cycle specific readiness information of the errors (bitcoded) [0 .. 16-1]" UWORD EH_STANDARD_S5_S3 1 100 0 65535 DISPLAY_IDENTIFIER di_obd_dc_specific_readiness[7].ZFEH_EepromData ECU_ADDRESS 0xFFF83226 /end MEASUREMENT
/begin MEASUREMENT ZFEH_EepromData.di_obd_dc_specific_readiness[8] "driving cycle specific readiness information of the errors (bitcoded) [0 .. 16-1]" UWORD EH_STANDARD_S5_S3 1 100 0 65535 DISPLAY_IDENTIFIER di_obd_dc_specific_readiness[8].ZFEH_EepromData ECU_ADDRESS 0xFFF83228 /end MEASUREMENT
/begin MEASUREMENT ZFEH_EepromData.di_obd_dc_specific_readiness[9] "driving cycle specific readiness information of the errors (bitcoded) [0 .. 16-1]" UWORD EH_STANDARD_S5_S3 1 100 0 65535 DISPLAY_IDENTIFIER di_obd_dc_specific_readiness[9].ZFEH_EepromData ECU_ADDRESS 0xFFF8322A /end MEASUREMENT
/begin MEASUREMENT ZFEH_EepromData.di_obd_dc_specific_readiness[10] "driving cycle specific readiness information of the errors (bitcoded) [0 .. 16-1]" UWORD EH_STANDARD_S5_S3 1 100 0 65535 DISPLAY_IDENTIFIER di_obd_dc_specific_readiness[10].ZFEH_EepromData ECU_ADDRESS 0xFFF8322C /end MEASUREMENT
/begin MEASUREMENT ZFEH_EepromData.di_obd_dc_specific_readiness[11] "driving cycle specific readiness information of the errors (bitcoded) [0 .. 16-1]" UWORD EH_STANDARD_S5_S3 1 100 0 65535 DISPLAY_IDENTIFIER di_obd_dc_specific_readiness[11].ZFEH_EepromData ECU_ADDRESS 0xFFF8322E /end MEASUREMENT
/begin MEASUREMENT ZFEH_EepromData.di_obd_dc_specific_readiness[12] "driving cycle specific readiness information of the errors (bitcoded) [0 .. 16-1]" UWORD EH_STANDARD_S5_S3 1 100 0 65535 DISPLAY_IDENTIFIER di_obd_dc_specific_readiness[12].ZFEH_EepromData ECU_ADDRESS 0xFFF83230 /end MEASUREMENT
/begin MEASUREMENT ZFEH_EepromData.di_obd_dc_specific_readiness[13] "driving cycle specific readiness information of the errors (bitcoded) [0 .. 16-1]" UWORD EH_STANDARD_S5_S3 1 100 0 65535 DISPLAY_IDENTIFIER di_obd_dc_specific_readiness[13].ZFEH_EepromData ECU_ADDRESS 0xFFF83232 /end MEASUREMENT
/begin MEASUREMENT ZFEH_EepromData.di_obd_dc_specific_readiness[14] "driving cycle specific readiness information of the errors (bitcoded) [0 .. 16-1]" UWORD EH_STANDARD_S5_S3 1 100 0 65535 DISPLAY_IDENTIFIER di_obd_dc_specific_readiness[14].ZFEH_EepromData ECU_ADDRESS 0xFFF83234 /end MEASUREMENT
/begin MEASUREMENT ZFEH_EepromData.di_obd_dc_specific_readiness[15] "driving cycle specific readiness information of the errors (bitcoded) [0 .. 16-1]" UWORD EH_STANDARD_S5_S3 1 100 0 65535 DISPLAY_IDENTIFIER di_obd_dc_specific_readiness[15].ZFEH_EepromData ECU_ADDRESS 0xFFF83236 /end MEASUREMENT
/begin MEASUREMENT ZFEH_EepromData.di_roe_new_entries_sent[0] "information of already sent RoE information (bitcoded) [0 .. 16-1]" UWORD EH_STANDARD_S5_S3 1 100 0 65535 DISPLAY_IDENTIFIER di_roe_new_entries_sent[0].ZFEH_EepromData ECU_ADDRESS 0xFFF83966 /end MEASUREMENT
/begin MEASUREMENT ZFEH_EepromData.di_roe_new_entries_sent[1] "information of already sent RoE information (bitcoded) [0 .. 16-1]" UWORD EH_STANDARD_S5_S3 1 100 0 65535 DISPLAY_IDENTIFIER di_roe_new_entries_sent[1].ZFEH_EepromData ECU_ADDRESS 0xFFF83968 /end MEASUREMENT
/begin MEASUREMENT ZFEH_EepromData.di_roe_new_entries_sent[2] "information of already sent RoE information (bitcoded) [0 .. 16-1]" UWORD EH_STANDARD_S5_S3 1 100 0 65535 DISPLAY_IDENTIFIER di_roe_new_entries_sent[2].ZFEH_EepromData ECU_ADDRESS 0xFFF8396A /end MEASUREMENT
/begin MEASUREMENT ZFEH_EepromData.di_roe_new_entries_sent[3] "information of already sent RoE information (bitcoded) [0 .. 16-1]" UWORD EH_STANDARD_S5_S3 1 100 0 65535 DISPLAY_IDENTIFIER di_roe_new_entries_sent[3].ZFEH_EepromData ECU_ADDRESS 0xFFF8396C /end MEASUREMENT
/begin MEASUREMENT ZFEH_EepromData.di_roe_new_entries_sent[4] "information of already sent RoE information (bitcoded) [0 .. 16-1]" UWORD EH_STANDARD_S5_S3 1 100 0 65535 DISPLAY_IDENTIFIER di_roe_new_entries_sent[4].ZFEH_EepromData ECU_ADDRESS 0xFFF8396E /end MEASUREMENT
/begin MEASUREMENT ZFEH_EepromData.di_roe_new_entries_sent[5] "information of already sent RoE information (bitcoded) [0 .. 16-1]" UWORD EH_STANDARD_S5_S3 1 100 0 65535 DISPLAY_IDENTIFIER di_roe_new_entries_sent[5].ZFEH_EepromData ECU_ADDRESS 0xFFF83970 /end MEASUREMENT
/begin MEASUREMENT ZFEH_EepromData.di_roe_new_entries_sent[6] "information of already sent RoE information (bitcoded) [0 .. 16-1]" UWORD EH_STANDARD_S5_S3 1 100 0 65535 DISPLAY_IDENTIFIER di_roe_new_entries_sent[6].ZFEH_EepromData ECU_ADDRESS 0xFFF83972 /end MEASUREMENT
/begin MEASUREMENT ZFEH_EepromData.di_roe_new_entries_sent[7] "information of already sent RoE information (bitcoded) [0 .. 16-1]" UWORD EH_STANDARD_S5_S3 1 100 0 65535 DISPLAY_IDENTIFIER di_roe_new_entries_sent[7].ZFEH_EepromData ECU_ADDRESS 0xFFF83974 /end MEASUREMENT
/begin MEASUREMENT ZFEH_EepromData.di_roe_new_entries_sent[8] "information of already sent RoE information (bitcoded) [0 .. 16-1]" UWORD EH_STANDARD_S5_S3 1 100 0 65535 DISPLAY_IDENTIFIER di_roe_new_entries_sent[8].ZFEH_EepromData ECU_ADDRESS 0xFFF83976 /end MEASUREMENT
/begin MEASUREMENT ZFEH_EepromData.di_roe_new_entries_sent[9] "information of already sent RoE information (bitcoded) [0 .. 16-1]" UWORD EH_STANDARD_S5_S3 1 100 0 65535 DISPLAY_IDENTIFIER di_roe_new_entries_sent[9].ZFEH_EepromData ECU_ADDRESS 0xFFF83978 /end MEASUREMENT
/begin MEASUREMENT ZFEH_EepromData.di_roe_new_entries_sent[10] "information of already sent RoE information (bitcoded) [0 .. 16-1]" UWORD EH_STANDARD_S5_S3 1 100 0 65535 DISPLAY_IDENTIFIER di_roe_new_entries_sent[10].ZFEH_EepromData ECU_ADDRESS 0xFFF8397A /end MEASUREMENT
/begin MEASUREMENT ZFEH_EepromData.di_roe_new_entries_sent[11] "information of already sent RoE information (bitcoded) [0 .. 16-1]" UWORD EH_STANDARD_S5_S3 1 100 0 65535 DISPLAY_IDENTIFIER di_roe_new_entries_sent[11].ZFEH_EepromData ECU_ADDRESS 0xFFF8397C /end MEASUREMENT
/begin MEASUREMENT ZFEH_EepromData.di_roe_new_entries_sent[12] "information of already sent RoE information (bitcoded) [0 .. 16-1]" UWORD EH_STANDARD_S5_S3 1 100 0 65535 DISPLAY_IDENTIFIER di_roe_new_entries_sent[12].ZFEH_EepromData ECU_ADDRESS 0xFFF8397E /end MEASUREMENT
/begin MEASUREMENT ZFEH_EepromData.di_roe_new_entries_sent[13] "information of already sent RoE information (bitcoded) [0 .. 16-1]" UWORD EH_STANDARD_S5_S3 1 100 0 65535 DISPLAY_IDENTIFIER di_roe_new_entries_sent[13].ZFEH_EepromData ECU_ADDRESS 0xFFF83980 /end MEASUREMENT
/begin MEASUREMENT ZFEH_EepromData.di_roe_new_entries_sent[14] "information of already sent RoE information (bitcoded) [0 .. 16-1]" UWORD EH_STANDARD_S5_S3 1 100 0 65535 DISPLAY_IDENTIFIER di_roe_new_entries_sent[14].ZFEH_EepromData ECU_ADDRESS 0xFFF83982 /end MEASUREMENT
/begin MEASUREMENT ZFEH_EepromData.di_roe_new_entries_sent[15] "information of already sent RoE information (bitcoded) [0 .. 16-1]" UWORD EH_STANDARD_S5_S3 1 100 0 65535 DISPLAY_IDENTIFIER di_roe_new_entries_sent[15].ZFEH_EepromData ECU_ADDRESS 0xFFF83984 /end MEASUREMENT
/begin COMPU_METHOD CONV_KFC_NAME "" TAB_VERB "%6.3" "" COMPU_TAB_REF CONV_TAB_KFC_NAME /end COMPU_METHOD
/begin COMPU_METHOD EH_STANDARD_S5_S3 "int = ((phys * 1) / 1) - (0) -" RAT_FUNC "%2.0" "-" COEFFS 0 1 -0 0 0 1 /end COMPU_METHOD
/begin COMPU_VTAB CONV_TAB_KFC_NAME "Conversion table" TAB_VERB 256 0 "empty" 1 "KFC1_OUT0" 2 "KFC2_OUT0" 3 "KFC1_OUT1" 4 "KFC2_OUT1" 5 "KFC1_OUT2" 6 "KFC2_OUT2" 7 "KFC1_OUT3" 8 "KFC2_OUT3" 9 "KFC1_OUT4" 10 "KFC2_OUT4" 11 "KFC1_OUT5" 12 "KFC2_OUT5" 13 "KFC1_OUT6" 14 "KFC2_OUT6" 15 "KFC1_OUT7" 16 "KFC2_OUT7" 17 "KFC1_OUT8" 18 "KFC2_OUT8" 19 "KFC1_OUT9" 20 "KFC2_OUT9" 21 "KFC1_OUT10" 22 "KFC2_OUT10" 23 "KFC1_OUT11" 24 "KFC2_OUT11" 25 "KFC1_OUT12" 26 "KFC2_OUT12" 27 "KFC1_OUT13" 28 "KFC2_OUT13" 29 "KFC1_OUT14" 30 "KFC2_OUT14" 31 "KFC_UDRMV1" 32 "KFC_UDRMV2" 33 "KFC_USENS1" 34 "KFC_RESUNDERVOLTAGE" 35 "KFC_RESSUP" 36 "KFC_RESZF" 37 "KFC_EEPROM" 38 "KFC_DISABLEERM" 39 "KFC_EPROM" 40 "KFC_N6PLAUSILEV2" 41 "KFC_TCUHOT" 42 "KFC_SFRM" 43 "KFC1_POSLEV2" 44 "KFC2_POSLEV2" 45 "KFC3_POSLEV2" 46 "KFC4_POSLEV2" 47 "KFC_NTUVIRTLEV2" 48 "KFC_SENSORLEV2" 49 "KFC_WDOG" 50 "KFC_MCCOMP" 51 "KFC_LEV2" 52 "KFC1_LEV2" 53 "KFC_VUNPLAUSILEV2" 54 "KFC3_LEV2" 55 "KFC_RATIOGEAR" 56 "KFC_RATIOA" 57 "KFC_RATIOB" 58 "KFC_RATIOC" 59 "KFC_RATIOD" 60 "KFC_RATIOE" 61 "KFC_RATIOAB" 62 "KFC_RATIOAD" 63 "KFC_RATIOBD" 64 "KFC_RATIOBE" 65 "KFC_RATIOCD" 66 "KFC_RATIOAE" 67 "KFC_RATIOAC" 68 "KFC_RATIOBC" 69 "KFC_RATIOCE" 70 "KFC_RATIODE" 71 "KFC_RATIOABC" 72 "KFC_RATIOABE" 73 "KFC_RATIOBCE" 74 "KFC_RATIOBDE" 75 "KFC_RATIOBCD" 76 "KFC_RATIOCDE" 77 "KFC_RATIOACD" 78 "KFC_RATIOADE" 79 "KFC_RATIOABD" 80 "KFC_RATIOSHIFT" 81 "KFC_RATIOSHIFT1" 82 "KFC_RATIOSHIFT2" 83 "KFC_RATIOSHIFT3" 84 "KFC_RATIOSHIFT4" 85 "KFC_RATIOSHIFT5" 86 "KFC_RATIOSHIFT6" 87 "KFC_RATIOSHIFT7" 88 "KFC_RATIOSHIFT8" 89 "KFC_UBATTU" 90 "KFC_UBATTL" 91 "KFC_UBATTO" 92 "KFC_N6LEV2" 93 "KFC5_CLUTCHOVERHEAT" 94 "KFC_NABLEV2" 95 "KFC_USENS" 96 "KFC_NABPLAUSILEV2" 97 "KFC_NWHEELPLAUSILEV2" 98 "KFC_PARK" 99 "KFC_STADARDY" 100 "KFC_CCHIP1LEV2" 101 "KFC_CGTLEV2" 102 "KFC_NMOUEB" 103 "KFC1_CLUTCHOVERHEAT" 104 "KFC_POSV" 105 "KFC_PEDALF" 106 "KFC_NWHEELLEV2" 107 "KFC_POSINFO1" 108 "KFC_POSINFO2" 109 "KFC_POSSBW" 110 "KFC_TARGETSPEED" 111 "KFC_CANB1" 112 "KFC_CANB2" 113 "KFC_PSIN" 114 "KFC_PSOUT" 115 "KFC_PSABUSE" 116 "KFC2_ENGSIGTRQ" 117 "KFC_ENGSIGEM" 118 "KFC2_CLUTCHOVERHEAT" 119 "KFC3_CLUTCHOVERHEAT" 120 "KFC_NMOE" 121 "KFC4_CLUTCHOVERHEAT" 122 "KFC_ERSATZ" 123 "KFC_TIPP" 124 "KFC_RESUB" 125 "KFC_RATIOGLOBAL" 126 "KFC2_PSOUT" 127 "KFC_TRANSM" 128 "KFC1_POSDISP" 129 "KFC_NMOFLL" 130 "KFC_PRLOGIC" 131 "KFC_CCHIP2LEV2" 132 "KFC_ENGSIG" 133 "KFC_BRAKEF" 134 "KFC_BRAKETRQ" 135 "KFC_DOOR" 136 "KFC_SEAT" 137 "KFC_OBDCYCLES" 138 "KFC_PINFO" 139 "KFC_INFOHOT1" 140 "KFC_INFOHOT2" 141 "KFC_INFO4" 142 "KFC_INFO5" 143 "KFC_CGTELECTRICERRLEV2" 144 "KFC_FEHLBAU" 145 "KFC_ACCELY" 146 "KFC_BRAKETRQDRV" 147 "KFC1_ENGSIGEM" 148 "KFC_FLASHNOTPOS" 149 "KFC_PSHOLDERR" 150 "KFC_PSABSERR" 151 "KFC_TMS" 152 "KFC_KL15" 153 "KFC1_KL15" 154 "KFC_C0SYNCHOT" 155 "KFC1_TRSMTRQ" 156 "KFC_OBD" 157 "KFC_INTME" 158 "KFC1_INTME" 159 "KFC_DMEG1" 160 "KFC_DMEG2" 161 "KFC_DMEG3" 162 "KFC_GWSACAN" 163 "KFC_GWSFACAN" 164 "KFC_INFOHOTWARNING2" 165 "KFC_INFOHOTWARNING3" 166 "KFC_INFO6" 167 "KFC3_ENGSIGTRQ" 168 "KFC_DSCG1" 169 "KFC_DSCG2" 170 "KFC_DSCG3" 171 "KFC_C0DEFECTHOT" 172 "KFC_INFO9" 173 "KFC_INFO10" 174 "KFC_MAXDECELERATION" 175 "KFC_FEMG1" 176 "KFC_FEMG2" 177 "KFC_FEMG3" 178 "KFC1_SENSORLEV2" 179 "KFC2_ENGSIGEM" 180 "KFC_NEMNEGDIR" 181 "KFC_EGNERENABLED" 182 "KFC_EGNERFAILED" 183 "KFC_EGNERMISUSE" 184 "KFC_CIC" 185 "KFC_ICMG1" 186 "KFC_ICMG2" 187 "KFC_ICMG3" 188 "KFC_C0CLOSEASYNC" 189 "KFC_PARKASSIST" 190 "KFC_HASCYCERR" 191 "KFC_HASCYCNEMERR" 192 "KFC_INSTG1" 193 "KFC_INSTG2" 194 "KFC_INSTG3" 195 "KFC_SZL1" 196 "KFC_ACSM1" 197 "KFC1_UBATTU" 198 "KFC_AHM1" 199 "KFC_ENGWATCOOL" 200 "KFC_EWSSCAN" 201 "KFC_EWSDRVRQ" 202 "KFC_NEMPSYS" 203 "KFC_NEGTRQREQHAS" 204 "KFC_TARGETTRQEM" 205 "KFC_HASERROR" 206 "KFC_VEHDYNREG" 207 "KFC_SME" 208 "KFC_TRQ" 209 "KFC_EMEG1" 210 "KFC_EMEG2" 211 "KFC_EMEG3" 212 "KFC_ENGSIGINFO" 213 "KFC_INFON" 214 "KFC_INFOHOTWARNING" 215 "KFC_DMEOBD" 216 "KFC_POSNPLAUSI" 217 "KFC1_ENGSIGTRQ" 218 "KFC_IAENOOPEN" 219 "KFC_IAENOCLOSE" 220 "KFC_IAECLOSE" 221 "KFC_IAEHOT" 222 "KFC_HASCYCNEMERR2" 223 "KFC_C0DEFECT" 224 "KFC_SAFETYPARMISM" 225 "KFC_IEP" 226 "KFC_ZGW" 227 "KFC1_IEPERROR" 228 "KFC_C0NOCLOSE" 229 "KFC_TARGETSPEEDVM" 230 "KFC_TARGETSPEEDEM" 231 "KFC_MINSPEEDEM" 232 "KFC_IEPLEV2" 233 "KFC_HASCYCNVMERR" 234 "KFC_NABGRAD" 235 "KFC_C0HOT" 236 "KFC_C0CLOSELEV2" 237 "KFC_CGTJUMPLEV2" 238 "KFC_CGTPLAUSILEV2" 239 "KFC_CCHIP2PLAUSILEV2" 240 "KFC_CCHIP1PLAUSILEV2" 241 "KFC1_NEGTRQREQ" 242 "KFC_IEPCOM" 243 "KFC_RATIOIEPSYM" 244 "KFC_RATIOIEP" 245 "KFC_C0NOOPEN" 246 "CODING_EVENT_NOT_CODED" 247 "CODING_EVENT_TRANSACTION_FAILED" 248 "CODING_EVENT_SIGNATURE_ERROR" 249 "CODING_EVENT_WRONG_VEHICLE" 250 "CODING_EVENT_INVALID_DATA" 251 "DM_EVENT_ZEITBOTSCHAFTTIMEOUT" 252 "DM_TEST_APPL" 253 "DM_TEST_COM" 254 "VSM_EVENT_OPMODE" 255 "DI_EC_NUMBER_ENTRIES" DEFAULT_VALUE "unknown" /end COMPU_VTAB
/begin FUNCTION zff_EH_ErrorMemoryInformation "desc_en"
 /begin LOC_MEASUREMENT ZFEH_EepromData.ydiMemory_xau16[8].permanent_counter ZFEH_EepromData.ydiMemory_xau16[8].sequence_counter ZFEH_EepromData.ydiMemory_xau16[8].status_word ZFEH_EepromData.ydiMemory_xau16[9].amb_cond.ambient_condition[0][0] ZFEH_EepromData.ydiMemory_xau16[9].amb_cond.ambient_condition[0][10] ZFEH_EepromData.ydiMemory_xau16[9].amb_cond.ambient_condition[0][11] ZFEH_EepromData.ydiMemory_xau16[9].amb_cond.ambient_condition[0][12] ZFEH_EepromData.ydiMemory_xau16[9].amb_cond.ambient_condition[0][13] ZFEH_EepromData.ydiMemory_xau16[9].amb_cond.ambient_condition[0][14] ZFEH_EepromData.ydiMemory_xau16[9].amb_cond.ambient_condition[0][15] ZFEH_EepromData.ydiMemory_xau16[9].amb_cond.ambient_condition[0][16] ZFEH_EepromData.ydiMemory_xau16[9].amb_cond.ambient_condition[0][17] ZFEH_EepromData.ydiMemory_xau16[9].amb_cond.ambient_condition[0][18] ZFEH_EepromData.ydiMemory_xau16[9].amb_cond.ambient_condition[0][19] ZFEH_EepromData.ydiMemory_xau16[9].amb_cond.ambient_condition[0][1] ZFEH_EepromData.ydiMemory_xau16[9].amb_cond.ambient_condition[0][20] ZFEH_EepromData.ydiMemory_xau16[9].amb_cond.ambient_condition[0][21] ZFEH_EepromData.ydiMemory_xau16[9].amb_cond.ambient_condition[0][22] ZFEH_EepromData.ydiMemory_xau16[9].amb_cond.ambient_condition[0][23] ZFEH_EepromData.ydiMemory_xau16[9].amb_cond.ambient_condition[0][24] ZFEH_EepromData.ydiMemory_xau16[9].amb_cond.ambient_condition[0][2] ZFEH_EepromData.ydiMemory_xau16[9].amb_cond.ambient_condition[0][3] ZFEH_EepromData.ydiMemory_xau16[9].amb_cond.ambient_condition[0][4] ZFEH_EepromData.ydiMemory_xau16[9].amb_cond.ambient_condition[0][5] ZFEH_EepromData.ydiMemory_xau16[9].amb_cond.ambient_condition[0][6] ZFEH_EepromData.ydiMemory_xau16[9].amb_cond.ambient_condition[0][7] ZFEH_EepromData.ydiMemory_xau16[9].amb_cond.ambient_condition[0][8] ZFEH_EepromData.ydiMemory_xau16[9].amb_cond.ambient_condition[0][9] ZFEH_EepromData.ydiMemory_xau16[9].amb_cond.ambient_condition[1][0] ZFEH_EepromData.ydiMemory_xau16[9].amb_cond.ambient_condition[1][10] ZFEH_EepromData.ydiMemory_xau16[9].amb_cond.ambient_condition[1][11] ZFEH_EepromData.ydiMemory_xau16[9].amb_cond.ambient_condition[1][12] ZFEH_EepromData.ydiMemory_xau16[9].amb_cond.ambient_condition[1][13] ZFEH_EepromData.ydiMemory_xau16[9].amb_cond.ambient_condition[1][14] ZFEH_EepromData.ydiMemory_xau16[9].amb_cond.ambient_condition[1][15] ZFEH_EepromData.ydiMemory_xau16[9].amb_cond.ambient_condition[1][16] ZFEH_EepromData.ydiMemory_xau16[9].amb_cond.ambient_condition[1][17] ZFEH_EepromData.ydiMemory_xau16[9].amb_cond.ambient_condition[1][18] ZFEH_EepromData.ydiMemory_xau16[9].amb_cond.ambient_condition[1][19] ZFEH_EepromData.ydiMemory_xau16[9].amb_cond.ambient_condition[1][1] ZFEH_EepromData.ydiMemory_xau16[9].amb_cond.ambient_condition[1][20] ZFEH_EepromData.ydiMemory_xau16[9].amb_cond.ambient_condition[1][21] ZFEH_EepromData.ydiMemory_xau16[9].amb_cond.ambient_condition[1][22] ZFEH_EepromData.ydiMemory_xau16[9].amb_cond.ambient_condition[1][23] ZFEH_EepromData.ydiMemory_xau16[9].amb_cond.ambient_condition[1][24] ZFEH_EepromData.ydiMemory_xau16[9].amb_cond.ambient_condition[1][2] ZFEH_EepromData.ydiMemory_xau16[9].amb_cond.ambient_condition[1][3] ZFEH_EepromData.ydiMemory_xau16[9].amb_cond.ambient_condition[1][4] ZFEH_EepromData.ydiMemory_xau16[9].amb_cond.ambient_condition[1][5] ZFEH_EepromData.ydiMemory_xau16[9].amb_cond.ambient_condition[1][6] ZFEH_EepromData.ydiMemory_xau16[9].amb_cond.ambient_condition[1][7] ZFEH_EepromData.ydiMemory_xau16[9].amb_cond.ambient_condition[1][8] ZFEH_EepromData.ydiMemory_xau16[9].amb_cond.ambient_condition[1][9] ZFEH_EepromData.ydiMemory_xau16[9].amb_cond.status_of_ambient_conditions[0] ZFEH_EepromData.ydiMemory_xau16[9].amb_cond.status_of_ambient_conditions[1] ZFEH_EepromData.ydiMemory_xau16[9].backwards_counter ZFEH_EepromData.ydiMemory_xau16[9].condition_byte ZFEH_EepromData.ydiMemory_xau16[9].error_code ZFEH_EepromData.ydiMemory_xau16[9].error_type ZFEH_EepromData.ydiMemory_xau16[9].frequency_counter ZFEH_EepromData.ydiMemory_xau16[9].master_time ZFEH_EepromData.ydiMemory_xau16[9].obd_driving_cycle_counter ZFEH_EepromData.ydiMemory_xau16[9].permanent_counter ZFEH_EepromData.ydiMemory_xau16[9].sequence_counter ZFEH_EepromData.ydiMemory_xau16[9].status_word /end LOC_MEASUREMENT
/end FUNCTION
/begin FUNCTION zff_EH_ObdErrorMemoryInformation "desc_en"
 /begin LOC_MEASUREMENT ZFEH_EepromData.ydiObdMemory_xau16.obd_errorcode ZFEH_EepromData.ydiObdMemory_xau16.obd_errortype ZFEH_EepromData.ydiObdMemory_xau16.obd_freezeframes[0] ZFEH_EepromData.ydiObdMemory_xau16.obd_freezeframes[10] ZFEH_EepromData.ydiObdMemory_xau16.obd_freezeframes[11] ZFEH_EepromData.ydiObdMemory_xau16.obd_freezeframes[12] ZFEH_EepromData.ydiObdMemory_xau16.obd_freezeframes[13] ZFEH_EepromData.ydiObdMemory_xau16.obd_freezeframes[14] ZFEH_EepromData.ydiObdMemory_xau16.obd_freezeframes[15] ZFEH_EepromData.ydiObdMemory_xau16.obd_freezeframes[16] ZFEH_EepromData.ydiObdMemory_xau16.obd_freezeframes[17] ZFEH_EepromData.ydiObdMemory_xau16.obd_freezeframes[18] ZFEH_EepromData.ydiObdMemory_xau16.obd_freezeframes[19] ZFEH_EepromData.ydiObdMemory_xau16.obd_freezeframes[1] ZFEH_EepromData.ydiObdMemory_xau16.obd_freezeframes[2] ZFEH_EepromData.ydiObdMemory_xau16.obd_freezeframes[3] ZFEH_EepromData.ydiObdMemory_xau16.obd_freezeframes[4] ZFEH_EepromData.ydiObdMemory_xau16.obd_freezeframes[5] ZFEH_EepromData.ydiObdMemory_xau16.obd_freezeframes[6] ZFEH_EepromData.ydiObdMemory_xau16.obd_freezeframes[7] ZFEH_EepromData.ydiObdMemory_xau16.obd_freezeframes[8] ZFEH_EepromData.ydiObdMemory_xau16.obd_freezeframes[9] /end LOC_MEASUREMENT
/end FUNCTION
/begin FUNCTION zff_EH_FaultInformation "desc_en"
 /begin LOC_MEASUREMENT ZFEH_Diagnosis.ctl_CalibrateableTestCond ZFEH_Diagnosis.disabled_errors[0] ZFEH_Diagnosis.disabled_errors[10] ZFEH_Diagnosis.disabled_errors[11] ZFEH_Diagnosis.disabled_errors[12] ZFEH_Diagnosis.disabled_errors[13] ZFEH_Diagnosis.disabled_errors[14] ZFEH_Diagnosis.disabled_errors[15] ZFEH_Diagnosis.disabled_errors[1] ZFEH_Diagnosis.disabled_errors[2] ZFEH_Diagnosis.disabled_errors[3] ZFEH_Diagnosis.disabled_errors[4] ZFEH_Diagnosis.disabled_errors[5] ZFEH_Diagnosis.disabled_errors[6] ZFEH_Diagnosis.disabled_errors[7] ZFEH_Diagnosis.disabled_errors[8] ZFEH_Diagnosis.disabled_errors[9] ZFEH_Diagnosis.gl_err_rea ZFEH_Diagnosis.gl_err_rea_hi ZFEH_EepromData.di_obd_dc_specific_readiness[0] ZFEH_EepromData.di_obd_dc_specific_readiness[10] ZFEH_EepromData.di_obd_dc_specific_readiness[11] ZFEH_EepromData.di_obd_dc_specific_readiness[12] ZFEH_EepromData.di_obd_dc_specific_readiness[13] ZFEH_EepromData.di_obd_dc_specific_readiness[14] ZFEH_EepromData.di_obd_dc_specific_readiness[15] ZFEH_EepromData.di_obd_dc_specific_readiness[1] ZFEH_EepromData.di_obd_dc_specific_readiness[2] ZFEH_EepromData.di_obd_dc_specific_readiness[3] ZFEH_EepromData.di_obd_dc_specific_readiness[4] ZFEH_EepromData.di_obd_dc_specific_readiness[5] ZFEH_EepromData.di_obd_dc_specific_readiness[6] ZFEH_EepromData.di_obd_dc_specific_readiness[7] ZFEH_EepromData.di_obd_dc_specific_readiness[8] ZFEH_EepromData.di_obd_dc_specific_readiness[9] ZFEH_EepromData.di_obd_readiness[0] ZFEH_EepromData.di_obd_readiness[10] ZFEH_EepromData.di_obd_readiness[11] ZFEH_EepromData.di_obd_readiness[12] ZFEH_EepromData.di_obd_readiness[13] ZFEH_EepromData.di_obd_readiness[14] ZFEH_EepromData.di_obd_readiness[15] ZFEH_EepromData.di_obd_readiness[1] ZFEH_EepromData.di_obd_readiness[2] ZFEH_EepromData.di_obd_readiness[3] ZFEH_EepromData.di_obd_readiness[4] ZFEH_EepromData.di_obd_readiness[5] ZFEH_EepromData.di_obd_readiness[6] ZFEH_EepromData.di_obd_readiness[7] ZFEH_EepromData.di_obd_readiness[8] ZFEH_EepromData.di_obd_readiness[9] ZFEH_EepromData.di_roe_new_entries_sent[0] ZFEH_EepromData.di_roe_new_entries_sent[10] ZFEH_EepromData.di_roe_new_entries_sent[11] ZFEH_EepromData.di_roe_new_entries_sent[12] ZFEH_EepromData.di_roe_new_entries_sent[13] ZFEH_EepromData.di_roe_new_entries_sent[14] ZFEH_EepromData.di_roe_new_entries_sent[15] ZFEH_EepromData.di_roe_new_entries_sent[1] ZFEH_EepromData.di_roe_new_entries_sent[2] ZFEH_EepromData.di_roe_new_entries_sent[3] ZFEH_EepromData.di_roe_new_entries_sent[4] ZFEH_EepromData.di_roe_new_entries_sent[5] ZFEH_EepromData.di_roe_new_entries_sent[6] ZFEH_EepromData.di_roe_new_entries_sent[7] ZFEH_EepromData.di_roe_new_entries_sent[8] ZFEH_EepromData.di_roe_new_entries_sent[9] ZFEH_EepromData.di_statusOfDTC[0] ZFEH_EepromData.di_statusOfDTC[100] ZFEH_EepromData.di_statusOfDTC[101] ZFEH_EepromData.di_statusOfDTC[102] ZFEH_EepromData.di_statusOfDTC[103] ZFEH_EepromData.di_statusOfDTC[104] ZFEH_EepromData.di_statusOfDTC[105] ZFEH_EepromData.di_statusOfDTC[106] ZFEH_EepromData.di_statusOfDTC[107] ZFEH_EepromData.di_statusOfDTC[108] ZFEH_EepromData.di_statusOfDTC[109] ZFEH_EepromData.di_statusOfDTC[10] ZFEH_EepromData.di_statusOfDTC[110] ZFEH_EepromData.di_statusOfDTC[111] ZFEH_EepromData.di_statusOfDTC[112] ZFEH_EepromData.di_statusOfDTC[113] ZFEH_EepromData.di_statusOfDTC[114] ZFEH_EepromData.di_statusOfDTC[115] ZFEH_EepromData.di_statusOfDTC[116] ZFEH_EepromData.di_statusOfDTC[117] ZFEH_EepromData.di_statusOfDTC[118] ZFEH_EepromData.di_statusOfDTC[119] ZFEH_EepromData.di_statusOfDTC[11] ZFEH_EepromData.di_statusOfDTC[120] ZFEH_EepromData.di_statusOfDTC[121] ZFEH_EepromData.di_statusOfDTC[122] ZFEH_EepromData.di_statusOfDTC[123] ZFEH_EepromData.di_statusOfDTC[124] ZFEH_EepromData.di_statusOfDTC[125] ZFEH_EepromData.di_statusOfDTC[126] ZFEH_EepromData.di_statusOfDTC[127] ZFEH_EepromData.di_statusOfDTC[128] ZFEH_EepromData.di_statusOfDTC[129] ZFEH_EepromData.di_statusOfDTC[12] ZFEH_EepromData.di_statusOfDTC[130] ZFEH_EepromData.di_statusOfDTC[131] ZFEH_EepromData.di_statusOfDTC[132] ZFEH_EepromData.di_statusOfDTC[133] ZFEH_EepromData.di_statusOfDTC[134] ZFEH_EepromData.di_statusOfDTC[135] ZFEH_EepromData.di_statusOfDTC[136] ZFEH_EepromData.di_statusOfDTC[137] ZFEH_EepromData.di_statusOfDTC[138] ZFEH_EepromData.di_statusOfDTC[139] ZFEH_EepromData.di_statusOfDTC[13] ZFEH_EepromData.di_statusOfDTC[140] ZFEH_EepromData.di_statusOfDTC[141] ZFEH_EepromData.di_statusOfDTC[142] ZFEH_EepromData.di_statusOfDTC[143] ZFEH_EepromData.di_statusOfDTC[144] ZFEH_EepromData.di_statusOfDTC[145] ZFEH_EepromData.di_statusOfDTC[146] ZFEH_EepromData.di_statusOfDTC[147] ZFEH_EepromData.di_statusOfDTC[148] ZFEH_EepromData.di_statusOfDTC[149] ZFEH_EepromData.di_statusOfDTC[14] ZFEH_EepromData.di_statusOfDTC[150] ZFEH_EepromData.di_statusOfDTC[151] ZFEH_EepromData.di_statusOfDTC[152] ZFEH_EepromData.di_statusOfDTC[153] ZFEH_EepromData.di_statusOfDTC[154] ZFEH_EepromData.di_statusOfDTC[155] ZFEH_EepromData.di_statusOfDTC[156] ZFEH_EepromData.di_statusOfDTC[157] ZFEH_EepromData.di_statusOfDTC[158] ZFEH_EepromData.di_statusOfDTC[159] ZFEH_EepromData.di_statusOfDTC[15] ZFEH_EepromData.di_statusOfDTC[160] ZFEH_EepromData.di_statusOfDTC[161] ZFEH_EepromData.di_statusOfDTC[162] ZFEH_EepromData.di_statusOfDTC[163] ZFEH_EepromData.di_statusOfDTC[164] ZFEH_EepromData.di_statusOfDTC[165] ZFEH_EepromData.di_statusOfDTC[166] ZFEH_EepromData.di_statusOfDTC[167] ZFEH_EepromData.di_statusOfDTC[168] ZFEH_EepromData.di_statusOfDTC[169] ZFEH_EepromData.di_statusOfDTC[16] ZFEH_EepromData.di_statusOfDTC[170] ZFEH_EepromData.di_statusOfDTC[171] ZFEH_EepromData.di_statusOfDTC[172] ZFEH_EepromData.di_statusOfDTC[173] ZFEH_EepromData.di_statusOfDTC[174] ZFEH_EepromData.di_statusOfDTC[175] ZFEH_EepromData.di_statusOfDTC[176] ZFEH_EepromData.di_statusOfDTC[177] ZFEH_EepromData.di_statusOfDTC[178] ZFEH_EepromData.di_statusOfDTC[179] ZFEH_EepromData.di_statusOfDTC[17] ZFEH_EepromData.di_statusOfDTC[180] ZFEH_EepromData.di_statusOfDTC[181] ZFEH_EepromData.di_statusOfDTC[182] ZFEH_EepromData.di_statusOfDTC[183] ZFEH_EepromData.di_statusOfDTC[184] ZFEH_EepromData.di_statusOfDTC[185] ZFEH_EepromData.di_statusOfDTC[186] ZFEH_EepromData.di_statusOfDTC[187] ZFEH_EepromData.di_statusOfDTC[188] ZFEH_EepromData.di_statusOfDTC[189] ZFEH_EepromData.di_statusOfDTC[18] ZFEH_EepromData.di_statusOfDTC[190] ZFEH_EepromData.di_statusOfDTC[191] ZFEH_EepromData.di_statusOfDTC[192] ZFEH_EepromData.di_statusOfDTC[193] ZFEH_EepromData.di_statusOfDTC[194] ZFEH_EepromData.di_statusOfDTC[195] ZFEH_EepromData.di_statusOfDTC[196] ZFEH_EepromData.di_statusOfDTC[197] ZFEH_EepromData.di_statusOfDTC[198] ZFEH_EepromData.di_statusOfDTC[199] ZFEH_EepromData.di_statusOfDTC[19] ZFEH_EepromData.di_statusOfDTC[1] ZFEH_EepromData.di_statusOfDTC[200] ZFEH_EepromData.di_statusOfDTC[201] ZFEH_EepromData.di_statusOfDTC[202] ZFEH_EepromData.di_statusOfDTC[203] ZFEH_EepromData.di_statusOfDTC[204] ZFEH_EepromData.di_statusOfDTC[205] ZFEH_EepromData.di_statusOfDTC[206] ZFEH_EepromData.di_statusOfDTC[207] ZFEH_EepromData.di_statusOfDTC[208] ZFEH_EepromData.di_statusOfDTC[209] ZFEH_EepromData.di_statusOfDTC[20] ZFEH_EepromData.di_statusOfDTC[210] ZFEH_EepromData.di_statusOfDTC[211] ZFEH_EepromData.di_statusOfDTC[212] ZFEH_EepromData.di_statusOfDTC[213] ZFEH_EepromData.di_statusOfDTC[214] ZFEH_EepromData.di_statusOfDTC[215] ZFEH_EepromData.di_statusOfDTC[216] ZFEH_EepromData.di_statusOfDTC[217] ZFEH_EepromData.di_statusOfDTC[218] ZFEH_EepromData.di_statusOfDTC[219] ZFEH_EepromData.di_statusOfDTC[21] ZFEH_EepromData.di_statusOfDTC[220] ZFEH_EepromData.di_statusOfDTC[221] ZFEH_EepromData.di_statusOfDTC[222] ZFEH_EepromData.di_statusOfDTC[223] ZFEH_EepromData.di_statusOfDTC[224] ZFEH_EepromData.di_statusOfDTC[225] ZFEH_EepromData.di_statusOfDTC[226] ZFEH_EepromData.di_statusOfDTC[227] ZFEH_EepromData.di_statusOfDTC[228] ZFEH_EepromData.di_statusOfDTC[229] ZFEH_EepromData.di_statusOfDTC[22] ZFEH_EepromData.di_statusOfDTC[230] ZFEH_EepromData.di_statusOfDTC[231] ZFEH_EepromData.di_statusOfDTC[232] ZFEH_EepromData.di_statusOfDTC[233] ZFEH_EepromData.di_statusOfDTC[234] ZFEH_EepromData.di_statusOfDTC[235] ZFEH_EepromData.di_statusOfDTC[236] ZFEH_EepromData.di_statusOfDTC[237] ZFEH_EepromData.di_statusOfDTC[238] ZFEH_EepromData.di_statusOfDTC[239] ZFEH_EepromData.di_statusOfDTC[23] ZFEH_EepromData.di_statusOfDTC[240] ZFEH_EepromData.di_statusOfDTC[241] ZFEH_EepromData.di_statusOfDTC[242] ZFEH_EepromData.di_statusOfDTC[243] ZFEH_EepromData.di_statusOfDTC[244] ZFEH_EepromData.di_statusOfDTC[245] ZFEH_EepromData.di_statusOfDTC[246] ZFEH_EepromData.di_statusOfDTC[247] ZFEH_EepromData.di_statusOfDTC[248] ZFEH_EepromData.di_statusOfDTC[249] ZFEH_EepromData.di_statusOfDTC[24] ZFEH_EepromData.di_statusOfDTC[250] ZFEH_EepromData.di_statusOfDTC[251] ZFEH_EepromData.di_statusOfDTC[252] ZFEH_EepromData.di_statusOfDTC[253] ZFEH_EepromData.di_statusOfDTC[25] ZFEH_EepromData.di_statusOfDTC[26] ZFEH_EepromData.di_statusOfDTC[27] ZFEH_EepromData.di_statusOfDTC[28] ZFEH_EepromData.di_statusOfDTC[29] ZFEH_EepromData.di_statusOfDTC[2] ZFEH_EepromData.di_statusOfDTC[30] ZFEH_EepromData.di_statusOfDTC[31] ZFEH_EepromData.di_statusOfDTC[32] ZFEH_EepromData.di_statusOfDTC[33] ZFEH_EepromData.di_statusOfDTC[34] ZFEH_EepromData.di_statusOfDTC[35] ZFEH_EepromData.di_statusOfDTC[36] ZFEH_EepromData.di_statusOfDTC[37] ZFEH_EepromData.di_statusOfDTC[38] ZFEH_EepromData.di_statusOfDTC[39] ZFEH_EepromData.di_statusOfDTC[3] ZFEH_EepromData.di_statusOfDTC[40] ZFEH_EepromData.di_statusOfDTC[41] ZFEH_EepromData.di_statusOfDTC[42] ZFEH_EepromData.di_statusOfDTC[43] ZFEH_EepromData.di_statusOfDTC[44] ZFEH_EepromData.di_statusOfDTC[45] ZFEH_EepromData.di_statusOfDTC[46] ZFEH_EepromData.di_statusOfDTC[47] ZFEH_EepromData.di_statusOfDTC[48] ZFEH_EepromData.di_statusOfDTC[49] ZFEH_EepromData.di_statusOfDTC[4] ZFEH_EepromData.di_statusOfDTC[50] ZFEH_EepromData.di_statusOfDTC[51] ZFEH_EepromData.di_statusOfDTC[52] ZFEH_EepromData.di_statusOfDTC[53] ZFEH_EepromData.di_statusOfDTC[54] ZFEH_EepromData.di_statusOfDTC[55] ZFEH_EepromData.di_statusOfDTC[56] ZFEH_EepromData.di_statusOfDTC[57] ZFEH_EepromData.di_statusOfDTC[58] ZFEH_EepromData.di_statusOfDTC[59] ZFEH_EepromData.di_statusOfDTC[5] ZFEH_EepromData.di_statusOfDTC[60] ZFEH_EepromData.di_statusOfDTC[61] ZFEH_EepromData.di_statusOfDTC[62] ZFEH_EepromData.di_statusOfDTC[63] ZFEH_EepromData.di_statusOfDTC[64] ZFEH_EepromData.di_statusOfDTC[65] ZFEH_EepromData.di_statusOfDTC[66] ZFEH_EepromData.di_statusOfDTC[67] ZFEH_EepromData.di_statusOfDTC[68] ZFEH_EepromData.di_statusOfDTC[69] ZFEH_EepromData.di_statusOfDTC[6] ZFEH_EepromData.di_statusOfDTC[70] ZFEH_EepromData.di_statusOfDTC[71] ZFEH_EepromData.di_statusOfDTC[72] ZFEH_EepromData.di_statusOfDTC[73] ZFEH_EepromData.di_statusOfDTC[74] ZFEH_EepromData.di_statusOfDTC[75] ZFEH_EepromData.di_statusOfDTC[76] ZFEH_EepromData.di_statusOfDTC[77] ZFEH_EepromData.di_statusOfDTC[78] ZFEH_EepromData.di_statusOfDTC[79] ZFEH_EepromData.di_statusOfDTC[7] ZFEH_EepromData.di_statusOfDTC[80] ZFEH_EepromData.di_statusOfDTC[81] ZFEH_EepromData.di_statusOfDTC[82] ZFEH_EepromData.di_statusOfDTC[83] ZFEH_EepromData.di_statusOfDTC[84] ZFEH_EepromData.di_statusOfDTC[85] ZFEH_EepromData.di_statusOfDTC[86] ZFEH_EepromData.di_statusOfDTC[87] ZFEH_EepromData.di_statusOfDTC[88] ZFEH_EepromData.di_statusOfDTC[89] ZFEH_EepromData.di_statusOfDTC[8] ZFEH_EepromData.di_statusOfDTC[90] ZFEH_EepromData.di_statusOfDTC[91] ZFEH_EepromData.di_statusOfDTC[92] ZFEH_EepromData.di_statusOfDTC[93] ZFEH_EepromData.di_statusOfDTC[94] ZFEH_EepromData.di_statusOfDTC[95] ZFEH_EepromData.di_statusOfDTC[96] ZFEH_EepromData.di_statusOfDTC[97] ZFEH_EepromData.di_statusOfDTC[98] ZFEH_EepromData.di_statusOfDTC[99] ZFEH_EepromData.di_statusOfDTC[9] di_err_deb[0] di_err_deb[10] di_err_deb[11] di_err_deb[12] di_err_deb[13] di_err_deb[14] di_err_deb[15] di_err_deb[1] di_err_deb[2] di_err_deb[3] di_err_deb[4] di_err_deb[5] di_err_deb[6] di_err_deb[7] di_err_deb[8] di_err_deb[9] di_err_det[0] di_err_det[10] di_err_det[11] di_err_det[12] di_err_det[13] di_err_det[14] di_err_det[15] di_err_det[1] di_err_det[2] di_err_det[3] di_err_det[4] di_err_det[5] di_err_det[6] di_err_det[7] di_err_det[8] di_err_det[9] di_err_state_info[0] di_err_state_info[100] di_err_state_info[101] di_err_state_info[102] di_err_state_info[103] di_err_state_info[104] di_err_state_info[105] di_err_state_info[106] di_err_state_info[107] di_err_state_info[108] di_err_state_info[109] di_err_state_info[10] di_err_state_info[110] di_err_state_info[111] di_err_state_info[112] di_err_state_info[113] di_err_state_info[114] di_err_state_info[115] di_err_state_info[116] di_err_state_info[117] di_err_state_info[118] di_err_state_info[119] di_err_state_info[11] di_err_state_info[120] di_err_state_info[121] di_err_state_info[122] di_err_state_info[123] di_err_state_info[124] di_err_state_info[125] di_err_state_info[126] di_err_state_info[127] di_err_state_info[128] di_err_state_info[129] di_err_state_info[12] di_err_state_info[130] di_err_state_info[131] di_err_state_info[132] di_err_state_info[133] di_err_state_info[134] di_err_state_info[135] di_err_state_info[136] di_err_state_info[137] di_err_state_info[138] di_err_state_info[139] di_err_state_info[13] di_err_state_info[140] di_err_state_info[141] di_err_state_info[142] di_err_state_info[143] di_err_state_info[144] di_err_state_info[145] di_err_state_info[146] di_err_state_info[147] di_err_state_info[148] di_err_state_info[149] di_err_state_info[14] di_err_state_info[150] di_err_state_info[151] di_err_state_info[152] di_err_state_info[153] di_err_state_info[154] di_err_state_info[155] di_err_state_info[156] di_err_state_info[157] di_err_state_info[158] di_err_state_info[159] di_err_state_info[15] di_err_state_info[160] di_err_state_info[161] di_err_state_info[162] di_err_state_info[163] di_err_state_info[164] di_err_state_info[165] di_err_state_info[166] di_err_state_info[167] di_err_state_info[168] di_err_state_info[169] di_err_state_info[16] di_err_state_info[170] di_err_state_info[171] di_err_state_info[172] di_err_state_info[173] di_err_state_info[174] di_err_state_info[175] di_err_state_info[176] di_err_state_info[177] di_err_state_info[178] di_err_state_info[179] di_err_state_info[17] di_err_state_info[180] di_err_state_info[181] di_err_state_info[182] di_err_state_info[183] di_err_state_info[184] di_err_state_info[185] di_err_state_info[186] di_err_state_info[187] di_err_state_info[188] di_err_state_info[189] di_err_state_info[18] di_err_state_info[190] di_err_state_info[191] di_err_state_info[192] di_err_state_info[193] di_err_state_info[194] di_err_state_info[195] di_err_state_info[196] di_err_state_info[197] di_err_state_info[198] di_err_state_info[199] di_err_state_info[19] di_err_state_info[1] di_err_state_info[200] di_err_state_info[201] di_err_state_info[202] di_err_state_info[203] di_err_state_info[204] di_err_state_info[205] di_err_state_info[206] di_err_state_info[207] di_err_state_info[208] di_err_state_info[209] di_err_state_info[20] di_err_state_info[210] di_err_state_info[211] di_err_state_info[212] di_err_state_info[213] di_err_state_info[214] di_err_state_info[215] di_err_state_info[216] di_err_state_info[217] di_err_state_info[218] di_err_state_info[219] di_err_state_info[21] di_err_state_info[220] di_err_state_info[221] di_err_state_info[222] di_err_state_info[223] di_err_state_info[224] di_err_state_info[225] di_err_state_info[226] di_err_state_info[227] di_err_state_info[228] di_err_state_info[229] di_err_state_info[22] di_err_state_info[230] di_err_state_info[231] di_err_state_info[232] di_err_state_info[233] di_err_state_info[234] di_err_state_info[235] di_err_state_info[236] di_err_state_info[237] di_err_state_info[238] di_err_state_info[239] di_err_state_info[23] di_err_state_info[240] di_err_state_info[241] di_err_state_info[242] di_err_state_info[243] di_err_state_info[244] di_err_state_info[245] di_err_state_info[246] di_err_state_info[247] di_err_state_info[248] di_err_state_info[249] di_err_state_info[24] di_err_state_info[250] di_err_state_info[251] di_err_state_info[252] di_err_state_info[253] di_err_state_info[25] di_err_state_info[26] di_err_state_info[27] di_err_state_info[28] di_err_state_info[29] di_err_state_info[2] di_err_state_info[30] di_err_state_info[31] di_err_state_info[32] di_err_state_info[33] di_err_state_info[34] di_err_state_info[35] di_err_state_info[36] di_err_state_info[37] di_err_state_info[38] di_err_state_info[39] di_err_state_info[3] di_err_state_info[40] di_err_state_info[41] di_err_state_info[42] di_err_state_info[43] di_err_state_info[44] di_err_state_info[45] di_err_state_info[46] di_err_state_info[47] di_err_state_info[48] di_err_state_info[49] di_err_state_info[4] di_err_state_info[50] di_err_state_info[51] di_err_state_info[52] di_err_state_info[53] di_err_state_info[54] di_err_state_info[55] di_err_state_info[56] di_err_state_info[57] di_err_state_info[58] di_err_state_info[59] di_err_state_info[5] di_err_state_info[60] di_err_state_info[61] di_err_state_info[62] di_err_state_info[63] di_err_state_info[64] di_err_state_info[65] di_err_state_info[66] di_err_state_info[67] di_err_state_info[68] di_err_state_info[69] di_err_state_info[6] di_err_state_info[70] di_err_state_info[71] di_err_state_info[72] di_err_state_info[73] di_err_state_info[74] di_err_state_info[75] di_err_state_info[76] di_err_state_info[77] di_err_state_info[78] di_err_state_info[79] di_err_state_info[7] di_err_state_info[80] di_err_state_info[81] di_err_state_info[82] di_err_state_info[83] di_err_state_info[84] di_err_state_info[85] di_err_state_info[86] di_err_state_info[87] di_err_state_info[88] di_err_state_info[89] di_err_state_info[8] di_err_state_info[90] di_err_state_info[91] di_err_state_info[92] di_err_state_info[93] di_err_state_info[94] di_err_state_info[95] di_err_state_info[96] di_err_state_info[97] di_err_state_info[98] di_err_state_info[99] di_err_state_info[9] di_filter_max_val[0] di_filter_max_val[100] di_filter_max_val[101] di_filter_max_val[102] di_filter_max_val[103] di_filter_max_val[104] di_filter_max_val[105] di_filter_max_val[106] di_filter_max_val[107] di_filter_max_val[108] di_filter_max_val[109] di_filter_max_val[10] di_filter_max_val[110] di_filter_max_val[111] di_filter_max_val[112] di_filter_max_val[113] di_filter_max_val[114] di_filter_max_val[115] di_filter_max_val[116] di_filter_max_val[117] di_filter_max_val[118] di_filter_max_val[119] di_filter_max_val[11] di_filter_max_val[120] di_filter_max_val[121] di_filter_max_val[122] di_filter_max_val[123] di_filter_max_val[124] di_filter_max_val[125] di_filter_max_val[126] di_filter_max_val[127] di_filter_max_val[128] di_filter_max_val[129] di_filter_max_val[12] di_filter_max_val[130] di_filter_max_val[131] di_filter_max_val[132] di_filter_max_val[133] di_filter_max_val[134] di_filter_max_val[135] di_filter_max_val[136] di_filter_max_val[137] di_filter_max_val[138] di_filter_max_val[139] di_filter_max_val[13] di_filter_max_val[140] di_filter_max_val[141] di_filter_max_val[142] di_filter_max_val[143] di_filter_max_val[144] di_filter_max_val[145] di_filter_max_val[146] di_filter_max_val[147] di_filter_max_val[148] di_filter_max_val[149] di_filter_max_val[14] di_filter_max_val[150] di_filter_max_val[151] di_filter_max_val[152] di_filter_max_val[153] di_filter_max_val[154] di_filter_max_val[155] di_filter_max_val[156] di_filter_max_val[157] di_filter_max_val[158] di_filter_max_val[159] di_filter_max_val[15] di_filter_max_val[160] di_filter_max_val[161] di_filter_max_val[162] di_filter_max_val[163] di_filter_max_val[164] di_filter_max_val[165] di_filter_max_val[166] di_filter_max_val[167] di_filter_max_val[168] di_filter_max_val[169] di_filter_max_val[16] di_filter_max_val[170] di_filter_max_val[171] di_filter_max_val[172] di_filter_max_val[173] di_filter_max_val[174] /end LOC_MEASUREMENT
/end FUNCTION
/end MODULE
/end PROJECT
