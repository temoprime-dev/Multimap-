ASAP2_VERSION 1 51
/begin PROJECT _929_929 "Gen2_BMW_System_Supplier_Lib"
/begin HEADER "" VERSION "C_03_03" PROJECT_NO _929_929 /end HEADER
/begin MODULE DIM ""
/begin MOD_COMMON "" BYTE_ORDER MSB_FIRST ALIGNMENT_BYTE 1 ALIGNMENT_WORD 2 ALIGNMENT_LONG 4 ALIGNMENT_FLOAT32_IEEE 4 /end MOD_COMMON
/begin MEASUREMENT ZFFSAB._.EEpromZentralHandler.eepromChannel[4].ZFFSAB._.cEEpromChannel._.cnt_GetEEpromValid "Call counter off function" UBYTE SAB_STANDARD_S2_S3 1 100 0 255 DISPLAY_IDENTIFIER cnt_GetEEpromValid._.cEEpromChannel._.ZFFSAB.eepromChannel[4].EEpromZentralHandler._.ZFFSAB ECU_ADDRESS 0xFFF97B70 /end MEASUREMENT
/begin MEASUREMENT ZFFSAB._.EEpromZentralHandler.eepromChannel[4].ZFFSAB._.cEEpromChannel._.ret_GetEEpromValid "Return value off function" UBYTE SAB_STANDARD_S2_S3 1 100 0 255 DISPLAY_IDENTIFIER ret_GetEEpromValid._.cEEpromChannel._.ZFFSAB.eepromChannel[4].EEpromZentralHandler._.ZFFSAB ECU_ADDRESS 0xFFF97B71 /end MEASUREMENT
/begin MEASUREMENT ZFFSAB._.EEpromZentralHandler.eepromChannel[4].ZFFSAB._.cEEpromChannel._.cnt_GetEEpromUpdate "Call counter off function" UBYTE SAB_STANDARD_S2_S3 1 100 0 255 DISPLAY_IDENTIFIER cnt_GetEEpromUpdate._.cEEpromChannel._.ZFFSAB.eepromChannel[4].EEpromZentralHandler._.ZFFSAB ECU_ADDRESS 0xFFF97B72 /end MEASUREMENT
/begin MEASUREMENT ZFFSAB._.EEpromZentralHandler.eepromChannel[4].ZFFSAB._.cEEpromChannel._.ret_GetEEpromUpdate "Return value off function" UBYTE SAB_STANDARD_S2_S3 1 100 0 255 DISPLAY_IDENTIFIER ret_GetEEpromUpdate._.cEEpromChannel._.ZFFSAB.eepromChannel[4].EEpromZentralHandler._.ZFFSAB ECU_ADDRESS 0xFFF97B73 /end MEASUREMENT
/begin MEASUREMENT ZFFSAB._.EEpromZentralHandler.eepromChannel[4].ZFFSAB._.cEEpromChannel._.cnt_SetEEpromInitZyklisch "Call counter off function" UBYTE SAB_STANDARD_S2_S3 1 100 0 255 DISPLAY_IDENTIFIER cnt_SetEEpromInitZyklisch._.cEEpromChannel._.ZFFSAB.eepromChannel[4].EEpromZentralHandler._.ZFFSAB ECU_ADDRESS 0xFFF97B74 /end MEASUREMENT
/begin MEASUREMENT ZFFSAB._.EEpromZentralHandler.eepromChannel[4].ZFFSAB._.cEEpromChannel._.ret_SetEEpromInitZyklisch "Return value off function" UBYTE SAB_STANDARD_S2_S3 1 100 0 255 DISPLAY_IDENTIFIER ret_SetEEpromInitZyklisch._.cEEpromChannel._.ZFFSAB.eepromChannel[4].EEpromZentralHandler._.ZFFSAB ECU_ADDRESS 0xFFF97B75 /end MEASUREMENT
/begin MEASUREMENT ZFFSAB._.EEpromZentralHandler.eepromChannel[4].ZFFSAB._.cEEpromChannel._.eeprom_info "argument of SetEEpromInitZyklisch" UBYTE SAB_STANDARD_S2_S3 1 100 0 255 DISPLAY_IDENTIFIER eeprom_info._.cEEpromChannel._.ZFFSAB.eepromChannel[4].EEpromZentralHandler._.ZFFSAB ECU_ADDRESS 0xFFF97B76 /end MEASUREMENT
/begin MEASUREMENT ZFFSAB._.EEpromZentralHandler.eepromChannel[4].ZFFSAB._.cEEpromChannel._.cnt_GetSizeofEEpromData "Call counter off function" UBYTE SAB_STANDARD_S2_S3 1 100 0 255 DISPLAY_IDENTIFIER cnt_GetSizeofEEpromData._.cEEpromChannel._.ZFFSAB.eepromChannel[4].EEpromZentralHandler._.ZFFSAB ECU_ADDRESS 0xFFF97B77 /end MEASUREMENT
/begin MEASUREMENT ZFFSAB._.EEpromZentralHandler.eepromChannel[4].ZFFSAB._.cEEpromChannel._.ret_GetSizeofEEpromData "Return value off function" UWORD SAB_STANDARD_S2_S3 1 100 0 65535 DISPLAY_IDENTIFIER ret_GetSizeofEEpromData._.cEEpromChannel._.ZFFSAB.eepromChannel[4].EEpromZentralHandler._.ZFFSAB ECU_ADDRESS 0xFFF97B78 /end MEASUREMENT
/begin MEASUREMENT ZFFSAB._.EEpromZentralHandler.eepromChannel[4].cnt_CallEEpromStoreImmediate "Call counter off function" UBYTE SAB_STANDARD_S2_S3 1 100 0 255 DISPLAY_IDENTIFIER cnt_CallEEpromStoreImmediate.eepromChannel[4].EEpromZentralHandler._.ZFFSAB ECU_ADDRESS 0xFFF97B7A /end MEASUREMENT
/begin MEASUREMENT ZFFSAB._.EEpromZentralHandler.eepromChannel[4].ret_CallEEpromStoreImmediate "Return value off function" UBYTE SAB_STANDARD_S2_S3 1 100 0 255 DISPLAY_IDENTIFIER ret_CallEEpromStoreImmediate.eepromChannel[4].EEpromZentralHandler._.ZFFSAB ECU_ADDRESS 0xFFF97B7B /end MEASUREMENT
/begin MEASUREMENT ZFFSAB._.EEpromZentralHandler.eepromChannel[4].cnt_CallEEpromLoadData "Call counter off function" UBYTE SAB_STANDARD_S2_S3 1 100 0 255 DISPLAY_IDENTIFIER cnt_CallEEpromLoadData.eepromChannel[4].EEpromZentralHandler._.ZFFSAB ECU_ADDRESS 0xFFF97B7C /end MEASUREMENT
/begin MEASUREMENT ZFFSAB._.EEpromZentralHandler.eepromChannel[4].ret_CallEEpromLoadData "Return value off function" UBYTE SAB_STANDARD_S2_S3 1 100 0 255 DISPLAY_IDENTIFIER ret_CallEEpromLoadData.eepromChannel[4].EEpromZentralHandler._.ZFFSAB ECU_ADDRESS 0xFFF97B7D /end MEASUREMENT
/begin MEASUREMENT ZFFSAB._.EEpromZentralHandler.eepromChannel[4].cnt_CallEEpromLoadDataState "Call counter off function" UBYTE SAB_STANDARD_S2_S3 1 100 0 255 DISPLAY_IDENTIFIER cnt_CallEEpromLoadDataState.eepromChannel[4].EEpromZentralHandler._.ZFFSAB ECU_ADDRESS 0xFFF97B7E /end MEASUREMENT
/begin MEASUREMENT ZFFSAB._.EEpromZentralHandler.eepromChannel[4].ret_CallEEpromLoadDataState "Return value off function" UBYTE SAB_STANDARD_S2_S3 1 100 0 255 DISPLAY_IDENTIFIER ret_CallEEpromLoadDataState.eepromChannel[4].EEpromZentralHandler._.ZFFSAB ECU_ADDRESS 0xFFF97B7F /end MEASUREMENT
/begin MEASUREMENT ZFFSAB._.EEpromZentralHandler.eepromChannel[4].mode "argument of SetEEpromInitZyklisch" UBYTE SAB_STANDARD_S2_S3 1 100 0 255 DISPLAY_IDENTIFIER mode.eepromChannel[4].EEpromZentralHandler._.ZFFSAB ECU_ADDRESS 0xFFF97B80 /end MEASUREMENT
/begin MEASUREMENT ZFFSAB._.EEpromZentralHandler.eepromChannel[4].cnt_SetEEpromWriteProtect "Call counter off function" UBYTE SAB_STANDARD_S2_S3 1 100 0 255 DISPLAY_IDENTIFIER cnt_SetEEpromWriteProtect.eepromChannel[4].EEpromZentralHandler._.ZFFSAB ECU_ADDRESS 0xFFF97B81 /end MEASUREMENT
/begin MEASUREMENT ZFFSAB._.EEpromZentralHandler.eepromChannel[5].ZFFSAB._.cEEpromChannel._.cnt_GetEEpromValid "Call counter off function" UBYTE SAB_STANDARD_S2_S3 1 100 0 255 DISPLAY_IDENTIFIER cnt_GetEEpromValid._.cEEpromChannel._.ZFFSAB.eepromChannel[5].EEpromZentralHandler._.ZFFSAB ECU_ADDRESS 0xFFF97B82 /end MEASUREMENT
/begin MEASUREMENT ZFFSAB._.EEpromZentralHandler.eepromChannel[5].ZFFSAB._.cEEpromChannel._.ret_GetEEpromValid "Return value off function" UBYTE SAB_STANDARD_S2_S3 1 100 0 255 DISPLAY_IDENTIFIER ret_GetEEpromValid._.cEEpromChannel._.ZFFSAB.eepromChannel[5].EEpromZentralHandler._.ZFFSAB ECU_ADDRESS 0xFFF97B83 /end MEASUREMENT
/begin MEASUREMENT ZFFSAB._.EEpromZentralHandler.eepromChannel[5].ZFFSAB._.cEEpromChannel._.cnt_GetEEpromUpdate "Call counter off function" UBYTE SAB_STANDARD_S2_S3 1 100 0 255 DISPLAY_IDENTIFIER cnt_GetEEpromUpdate._.cEEpromChannel._.ZFFSAB.eepromChannel[5].EEpromZentralHandler._.ZFFSAB ECU_ADDRESS 0xFFF97B84 /end MEASUREMENT
/begin MEASUREMENT ZFFSAB._.EEpromZentralHandler.eepromChannel[5].ZFFSAB._.cEEpromChannel._.ret_GetEEpromUpdate "Return value off function" UBYTE SAB_STANDARD_S2_S3 1 100 0 255 DISPLAY_IDENTIFIER ret_GetEEpromUpdate._.cEEpromChannel._.ZFFSAB.eepromChannel[5].EEpromZentralHandler._.ZFFSAB ECU_ADDRESS 0xFFF97B85 /end MEASUREMENT
/begin MEASUREMENT ZFFSAB._.EEpromZentralHandler.eepromChannel[5].ZFFSAB._.cEEpromChannel._.cnt_SetEEpromInitZyklisch "Call counter off function" UBYTE SAB_STANDARD_S2_S3 1 100 0 255 DISPLAY_IDENTIFIER cnt_SetEEpromInitZyklisch._.cEEpromChannel._.ZFFSAB.eepromChannel[5].EEpromZentralHandler._.ZFFSAB ECU_ADDRESS 0xFFF97B86 /end MEASUREMENT
/begin MEASUREMENT ZFFSAB._.EEpromZentralHandler.eepromChannel[5].ZFFSAB._.cEEpromChannel._.ret_SetEEpromInitZyklisch "Return value off function" UBYTE SAB_STANDARD_S2_S3 1 100 0 255 DISPLAY_IDENTIFIER ret_SetEEpromInitZyklisch._.cEEpromChannel._.ZFFSAB.eepromChannel[5].EEpromZentralHandler._.ZFFSAB ECU_ADDRESS 0xFFF97B87 /end MEASUREMENT
/begin MEASUREMENT ZFFSAB._.EEpromZentralHandler.eepromChannel[5].ZFFSAB._.cEEpromChannel._.eeprom_info "argument of SetEEpromInitZyklisch" UBYTE SAB_STANDARD_S2_S3 1 100 0 255 DISPLAY_IDENTIFIER eeprom_info._.cEEpromChannel._.ZFFSAB.eepromChannel[5].EEpromZentralHandler._.ZFFSAB ECU_ADDRESS 0xFFF97B88 /end MEASUREMENT
/begin MEASUREMENT ZFFSAB._.EEpromZentralHandler.eepromChannel[5].ZFFSAB._.cEEpromChannel._.cnt_GetSizeofEEpromData "Call counter off function" UBYTE SAB_STANDARD_S2_S3 1 100 0 255 DISPLAY_IDENTIFIER cnt_GetSizeofEEpromData._.cEEpromChannel._.ZFFSAB.eepromChannel[5].EEpromZentralHandler._.ZFFSAB ECU_ADDRESS 0xFFF97B89 /end MEASUREMENT
/begin MEASUREMENT ZFFSAB._.EEpromZentralHandler.eepromChannel[5].ZFFSAB._.cEEpromChannel._.ret_GetSizeofEEpromData "Return value off function" UWORD SAB_STANDARD_S2_S3 1 100 0 65535 DISPLAY_IDENTIFIER ret_GetSizeofEEpromData._.cEEpromChannel._.ZFFSAB.eepromChannel[5].EEpromZentralHandler._.ZFFSAB ECU_ADDRESS 0xFFF97B8A /end MEASUREMENT
/begin MEASUREMENT ZFFSAB._.EEpromZentralHandler.eepromChannel[5].cnt_CallEEpromStoreImmediate "Call counter off function" UBYTE SAB_STANDARD_S2_S3 1 100 0 255 DISPLAY_IDENTIFIER cnt_CallEEpromStoreImmediate.eepromChannel[5].EEpromZentralHandler._.ZFFSAB ECU_ADDRESS 0xFFF97B8C /end MEASUREMENT
/begin MEASUREMENT ZFFSAB._.EEpromZentralHandler.eepromChannel[5].ret_CallEEpromStoreImmediate "Return value off function" UBYTE SAB_STANDARD_S2_S3 1 100 0 255 DISPLAY_IDENTIFIER ret_CallEEpromStoreImmediate.eepromChannel[5].EEpromZentralHandler._.ZFFSAB ECU_ADDRESS 0xFFF97B8D /end MEASUREMENT
/begin MEASUREMENT ZFFSAB._.EEpromZentralHandler.eepromChannel[5].cnt_CallEEpromLoadData "Call counter off function" UBYTE SAB_STANDARD_S2_S3 1 100 0 255 DISPLAY_IDENTIFIER cnt_CallEEpromLoadData.eepromChannel[5].EEpromZentralHandler._.ZFFSAB ECU_ADDRESS 0xFFF97B8E /end MEASUREMENT
/begin MEASUREMENT ZFFSAB._.EEpromZentralHandler.eepromChannel[5].ret_CallEEpromLoadData "Return value off function" UBYTE SAB_STANDARD_S2_S3 1 100 0 255 DISPLAY_IDENTIFIER ret_CallEEpromLoadData.eepromChannel[5].EEpromZentralHandler._.ZFFSAB ECU_ADDRESS 0xFFF97B8F /end MEASUREMENT
/begin MEASUREMENT ZFFSAB._.EEpromZentralHandler.eepromChannel[5].cnt_CallEEpromLoadDataState "Call counter off function" UBYTE SAB_STANDARD_S2_S3 1 100 0 255 DISPLAY_IDENTIFIER cnt_CallEEpromLoadDataState.eepromChannel[5].EEpromZentralHandler._.ZFFSAB ECU_ADDRESS 0xFFF97B90 /end MEASUREMENT
/begin MEASUREMENT ZFFSAB._.EEpromZentralHandler.eepromChannel[5].ret_CallEEpromLoadDataState "Return value off function" UBYTE SAB_STANDARD_S2_S3 1 100 0 255 DISPLAY_IDENTIFIER ret_CallEEpromLoadDataState.eepromChannel[5].EEpromZentralHandler._.ZFFSAB ECU_ADDRESS 0xFFF97B91 /end MEASUREMENT
/begin MEASUREMENT ZFFSAB._.EEpromZentralHandler.eepromChannel[5].mode "argument of SetEEpromInitZyklisch" UBYTE SAB_STANDARD_S2_S3 1 100 0 255 DISPLAY_IDENTIFIER mode.eepromChannel[5].EEpromZentralHandler._.ZFFSAB ECU_ADDRESS 0xFFF97B92 /end MEASUREMENT
/begin MEASUREMENT ZFFSAB._.EEpromZentralHandler.eepromChannel[5].cnt_SetEEpromWriteProtect "Call counter off function" UBYTE SAB_STANDARD_S2_S3 1 100 0 255 DISPLAY_IDENTIFIER cnt_SetEEpromWriteProtect.eepromChannel[5].EEpromZentralHandler._.ZFFSAB ECU_ADDRESS 0xFFF97B93 /end MEASUREMENT
/begin MEASUREMENT ZFFSAB._.EEpromZentralHandler.eepromChannel[6].ZFFSAB._.cEEpromChannel._.cnt_GetEEpromValid "Call counter off function" UBYTE SAB_STANDARD_S2_S3 1 100 0 255 DISPLAY_IDENTIFIER cnt_GetEEpromValid._.cEEpromChannel._.ZFFSAB.eepromChannel[6].EEpromZentralHandler._.ZFFSAB ECU_ADDRESS 0xFFF97B94 /end MEASUREMENT
/begin MEASUREMENT ZFFSAB._.EEpromZentralHandler.eepromChannel[6].ZFFSAB._.cEEpromChannel._.ret_GetEEpromValid "Return value off function" UBYTE SAB_STANDARD_S2_S3 1 100 0 255 DISPLAY_IDENTIFIER ret_GetEEpromValid._.cEEpromChannel._.ZFFSAB.eepromChannel[6].EEpromZentralHandler._.ZFFSAB ECU_ADDRESS 0xFFF97B95 /end MEASUREMENT
/begin MEASUREMENT ZFFSAB._.EEpromZentralHandler.eepromChannel[6].ZFFSAB._.cEEpromChannel._.cnt_GetEEpromUpdate "Call counter off function" UBYTE SAB_STANDARD_S2_S3 1 100 0 255 DISPLAY_IDENTIFIER cnt_GetEEpromUpdate._.cEEpromChannel._.ZFFSAB.eepromChannel[6].EEpromZentralHandler._.ZFFSAB ECU_ADDRESS 0xFFF97B96 /end MEASUREMENT
/begin MEASUREMENT ZFFSAB._.EEpromZentralHandler.eepromChannel[6].ZFFSAB._.cEEpromChannel._.ret_GetEEpromUpdate "Return value off function" UBYTE SAB_STANDARD_S2_S3 1 100 0 255 DISPLAY_IDENTIFIER ret_GetEEpromUpdate._.cEEpromChannel._.ZFFSAB.eepromChannel[6].EEpromZentralHandler._.ZFFSAB ECU_ADDRESS 0xFFF97B97 /end MEASUREMENT
/begin MEASUREMENT ZFFSAB._.EEpromZentralHandler.eepromChannel[6].ZFFSAB._.cEEpromChannel._.cnt_SetEEpromInitZyklisch "Call counter off function" UBYTE SAB_STANDARD_S2_S3 1 100 0 255 DISPLAY_IDENTIFIER cnt_SetEEpromInitZyklisch._.cEEpromChannel._.ZFFSAB.eepromChannel[6].EEpromZentralHandler._.ZFFSAB ECU_ADDRESS 0xFFF97B98 /end MEASUREMENT
/begin MEASUREMENT ZFFSAB._.EEpromZentralHandler.eepromChannel[6].ZFFSAB._.cEEpromChannel._.ret_SetEEpromInitZyklisch "Return value off function" UBYTE SAB_STANDARD_S2_S3 1 100 0 255 DISPLAY_IDENTIFIER ret_SetEEpromInitZyklisch._.cEEpromChannel._.ZFFSAB.eepromChannel[6].EEpromZentralHandler._.ZFFSAB ECU_ADDRESS 0xFFF97B99 /end MEASUREMENT
/begin MEASUREMENT ZFFSAB._.EEpromZentralHandler.eepromChannel[6].ZFFSAB._.cEEpromChannel._.eeprom_info "argument of SetEEpromInitZyklisch" UBYTE SAB_STANDARD_S2_S3 1 100 0 255 DISPLAY_IDENTIFIER eeprom_info._.cEEpromChannel._.ZFFSAB.eepromChannel[6].EEpromZentralHandler._.ZFFSAB ECU_ADDRESS 0xFFF97B9A /end MEASUREMENT
/begin MEASUREMENT ZFFSAB._.EEpromZentralHandler.eepromChannel[6].ZFFSAB._.cEEpromChannel._.cnt_GetSizeofEEpromData "Call counter off function" UBYTE SAB_STANDARD_S2_S3 1 100 0 255 DISPLAY_IDENTIFIER cnt_GetSizeofEEpromData._.cEEpromChannel._.ZFFSAB.eepromChannel[6].EEpromZentralHandler._.ZFFSAB ECU_ADDRESS 0xFFF97B9B /end MEASUREMENT
/begin MEASUREMENT ZFFSAB._.EEpromZentralHandler.eepromChannel[6].ZFFSAB._.cEEpromChannel._.ret_GetSizeofEEpromData "Return value off function" UWORD SAB_STANDARD_S2_S3 1 100 0 65535 DISPLAY_IDENTIFIER ret_GetSizeofEEpromData._.cEEpromChannel._.ZFFSAB.eepromChannel[6].EEpromZentralHandler._.ZFFSAB ECU_ADDRESS 0xFFF97B9C /end MEASUREMENT
/begin MEASUREMENT ZFFSAB._.EEpromZentralHandler.eepromChannel[6].cnt_CallEEpromStoreImmediate "Call counter off function" UBYTE SAB_STANDARD_S2_S3 1 100 0 255 DISPLAY_IDENTIFIER cnt_CallEEpromStoreImmediate.eepromChannel[6].EEpromZentralHandler._.ZFFSAB ECU_ADDRESS 0xFFF97B9E /end MEASUREMENT
/begin MEASUREMENT ZFFSAB._.EEpromZentralHandler.eepromChannel[6].ret_CallEEpromStoreImmediate "Return value off function" UBYTE SAB_STANDARD_S2_S3 1 100 0 255 DISPLAY_IDENTIFIER ret_CallEEpromStoreImmediate.eepromChannel[6].EEpromZentralHandler._.ZFFSAB ECU_ADDRESS 0xFFF97B9F /end MEASUREMENT
/begin MEASUREMENT ZFFSAB._.EEpromZentralHandler.eepromChannel[6].cnt_CallEEpromLoadData "Call counter off function" UBYTE SAB_STANDARD_S2_S3 1 100 0 255 DISPLAY_IDENTIFIER cnt_CallEEpromLoadData.eepromChannel[6].EEpromZentralHandler._.ZFFSAB ECU_ADDRESS 0xFFF97BA0 /end MEASUREMENT
/begin MEASUREMENT ZFFSAB._.EEpromZentralHandler.eepromChannel[6].ret_CallEEpromLoadData "Return value off function" UBYTE SAB_STANDARD_S2_S3 1 100 0 255 DISPLAY_IDENTIFIER ret_CallEEpromLoadData.eepromChannel[6].EEpromZentralHandler._.ZFFSAB ECU_ADDRESS 0xFFF97BA1 /end MEASUREMENT
/begin MEASUREMENT ZFFSAB._.EEpromZentralHandler.eepromChannel[6].cnt_CallEEpromLoadDataState "Call counter off function" UBYTE SAB_STANDARD_S2_S3 1 100 0 255 DISPLAY_IDENTIFIER cnt_CallEEpromLoadDataState.eepromChannel[6].EEpromZentralHandler._.ZFFSAB ECU_ADDRESS 0xFFF97BA2 /end MEASUREMENT
/begin MEASUREMENT ZFFSAB._.EEpromZentralHandler.eepromChannel[6].ret_CallEEpromLoadDataState "Return value off function" UBYTE SAB_STANDARD_S2_S3 1 100 0 255 DISPLAY_IDENTIFIER ret_CallEEpromLoadDataState.eepromChannel[6].EEpromZentralHandler._.ZFFSAB ECU_ADDRESS 0xFFF97BA3 /end MEASUREMENT
/begin MEASUREMENT ZFFSAB._.EEpromZentralHandler.eepromChannel[6].mode "argument of SetEEpromInitZyklisch" UBYTE SAB_STANDARD_S2_S3 1 100 0 255 DISPLAY_IDENTIFIER mode.eepromChannel[6].EEpromZentralHandler._.ZFFSAB ECU_ADDRESS 0xFFF97BA4 /end MEASUREMENT
/begin MEASUREMENT ZFFSAB._.EEpromZentralHandler.eepromChannel[6].cnt_SetEEpromWriteProtect "Call counter off function" UBYTE SAB_STANDARD_S2_S3 1 100 0 255 DISPLAY_IDENTIFIER cnt_SetEEpromWriteProtect.eepromChannel[6].EEpromZentralHandler._.ZFFSAB ECU_ADDRESS 0xFFF97BA5 /end MEASUREMENT
/begin MEASUREMENT ZFFSAB._.EEpromZentralHandler.eepromChannel[7].ZFFSAB._.cEEpromChannel._.cnt_GetEEpromValid "Call counter off function" UBYTE SAB_STANDARD_S2_S3 1 100 0 255 DISPLAY_IDENTIFIER cnt_GetEEpromValid._.cEEpromChannel._.ZFFSAB.eepromChannel[7].EEpromZentralHandler._.ZFFSAB ECU_ADDRESS 0xFFF97BA6 /end MEASUREMENT
/begin MEASUREMENT ZFFSAB._.EEpromZentralHandler.eepromChannel[7].ZFFSAB._.cEEpromChannel._.ret_GetEEpromValid "Return value off function" UBYTE SAB_STANDARD_S2_S3 1 100 0 255 DISPLAY_IDENTIFIER ret_GetEEpromValid._.cEEpromChannel._.ZFFSAB.eepromChannel[7].EEpromZentralHandler._.ZFFSAB ECU_ADDRESS 0xFFF97BA7 /end MEASUREMENT
/begin MEASUREMENT ZFFSAB._.EEpromZentralHandler.eepromChannel[7].ZFFSAB._.cEEpromChannel._.cnt_GetEEpromUpdate "Call counter off function" UBYTE SAB_STANDARD_S2_S3 1 100 0 255 DISPLAY_IDENTIFIER cnt_GetEEpromUpdate._.cEEpromChannel._.ZFFSAB.eepromChannel[7].EEpromZentralHandler._.ZFFSAB ECU_ADDRESS 0xFFF97BA8 /end MEASUREMENT
/begin MEASUREMENT ZFFSAB._.EEpromZentralHandler.eepromChannel[7].ZFFSAB._.cEEpromChannel._.ret_GetEEpromUpdate "Return value off function" UBYTE SAB_STANDARD_S2_S3 1 100 0 255 DISPLAY_IDENTIFIER ret_GetEEpromUpdate._.cEEpromChannel._.ZFFSAB.eepromChannel[7].EEpromZentralHandler._.ZFFSAB ECU_ADDRESS 0xFFF97BA9 /end MEASUREMENT
/begin MEASUREMENT ZFFSAB._.EEpromZentralHandler.eepromChannel[7].ZFFSAB._.cEEpromChannel._.cnt_SetEEpromInitZyklisch "Call counter off function" UBYTE SAB_STANDARD_S2_S3 1 100 0 255 DISPLAY_IDENTIFIER cnt_SetEEpromInitZyklisch._.cEEpromChannel._.ZFFSAB.eepromChannel[7].EEpromZentralHandler._.ZFFSAB ECU_ADDRESS 0xFFF97BAA /end MEASUREMENT
/begin MEASUREMENT ZFFSAB._.EEpromZentralHandler.eepromChannel[7].ZFFSAB._.cEEpromChannel._.ret_SetEEpromInitZyklisch "Return value off function" UBYTE SAB_STANDARD_S2_S3 1 100 0 255 DISPLAY_IDENTIFIER ret_SetEEpromInitZyklisch._.cEEpromChannel._.ZFFSAB.eepromChannel[7].EEpromZentralHandler._.ZFFSAB ECU_ADDRESS 0xFFF97BAB /end MEASUREMENT
/begin MEASUREMENT ZFFSAB._.EEpromZentralHandler.eepromChannel[7].ZFFSAB._.cEEpromChannel._.eeprom_info "argument of SetEEpromInitZyklisch" UBYTE SAB_STANDARD_S2_S3 1 100 0 255 DISPLAY_IDENTIFIER eeprom_info._.cEEpromChannel._.ZFFSAB.eepromChannel[7].EEpromZentralHandler._.ZFFSAB ECU_ADDRESS 0xFFF97BAC /end MEASUREMENT
/begin MEASUREMENT ZFFSAB._.EEpromZentralHandler.eepromChannel[7].ZFFSAB._.cEEpromChannel._.cnt_GetSizeofEEpromData "Call counter off function" UBYTE SAB_STANDARD_S2_S3 1 100 0 255 DISPLAY_IDENTIFIER cnt_GetSizeofEEpromData._.cEEpromChannel._.ZFFSAB.eepromChannel[7].EEpromZentralHandler._.ZFFSAB ECU_ADDRESS 0xFFF97BAD /end MEASUREMENT
/begin MEASUREMENT ZFFSAB._.EEpromZentralHandler.eepromChannel[7].ZFFSAB._.cEEpromChannel._.ret_GetSizeofEEpromData "Return value off function" UWORD SAB_STANDARD_S2_S3 1 100 0 65535 DISPLAY_IDENTIFIER ret_GetSizeofEEpromData._.cEEpromChannel._.ZFFSAB.eepromChannel[7].EEpromZentralHandler._.ZFFSAB ECU_ADDRESS 0xFFF97BAE /end MEASUREMENT
/begin MEASUREMENT ZFFSAB._.EEpromZentralHandler.eepromChannel[7].cnt_CallEEpromStoreImmediate "Call counter off function" UBYTE SAB_STANDARD_S2_S3 1 100 0 255 DISPLAY_IDENTIFIER cnt_CallEEpromStoreImmediate.eepromChannel[7].EEpromZentralHandler._.ZFFSAB ECU_ADDRESS 0xFFF97BB0 /end MEASUREMENT
/begin MEASUREMENT ZFFSAB._.EEpromZentralHandler.eepromChannel[7].ret_CallEEpromStoreImmediate "Return value off function" UBYTE SAB_STANDARD_S2_S3 1 100 0 255 DISPLAY_IDENTIFIER ret_CallEEpromStoreImmediate.eepromChannel[7].EEpromZentralHandler._.ZFFSAB ECU_ADDRESS 0xFFF97BB1 /end MEASUREMENT
/begin MEASUREMENT ZFFSAB._.EEpromZentralHandler.eepromChannel[7].cnt_CallEEpromLoadData "Call counter off function" UBYTE SAB_STANDARD_S2_S3 1 100 0 255 DISPLAY_IDENTIFIER cnt_CallEEpromLoadData.eepromChannel[7].EEpromZentralHandler._.ZFFSAB ECU_ADDRESS 0xFFF97BB2 /end MEASUREMENT
/begin MEASUREMENT ZFFSAB._.EEpromZentralHandler.eepromChannel[7].ret_CallEEpromLoadData "Return value off function" UBYTE SAB_STANDARD_S2_S3 1 100 0 255 DISPLAY_IDENTIFIER ret_CallEEpromLoadData.eepromChannel[7].EEpromZentralHandler._.ZFFSAB ECU_ADDRESS 0xFFF97BB3 /end MEASUREMENT
/begin MEASUREMENT ZFFSAB._.EEpromZentralHandler.eepromChannel[7].cnt_CallEEpromLoadDataState "Call counter off function" UBYTE SAB_STANDARD_S2_S3 1 100 0 255 DISPLAY_IDENTIFIER cnt_CallEEpromLoadDataState.eepromChannel[7].EEpromZentralHandler._.ZFFSAB ECU_ADDRESS 0xFFF97BB4 /end MEASUREMENT
/begin MEASUREMENT ZFFSAB._.EEpromZentralHandler.eepromChannel[7].ret_CallEEpromLoadDataState "Return value off function" UBYTE SAB_STANDARD_S2_S3 1 100 0 255 DISPLAY_IDENTIFIER ret_CallEEpromLoadDataState.eepromChannel[7].EEpromZentralHandler._.ZFFSAB ECU_ADDRESS 0xFFF97BB5 /end MEASUREMENT
/begin MEASUREMENT ZFFSAB._.EEpromZentralHandler.eepromChannel[7].mode "argument of SetEEpromInitZyklisch" UBYTE SAB_STANDARD_S2_S3 1 100 0 255 DISPLAY_IDENTIFIER mode.eepromChannel[7].EEpromZentralHandler._.ZFFSAB ECU_ADDRESS 0xFFF97BB6 /end MEASUREMENT
/begin MEASUREMENT ZFFSAB._.EEpromZentralHandler.eepromChannel[7].cnt_SetEEpromWriteProtect "Call counter off function" UBYTE SAB_STANDARD_S2_S3 1 100 0 255 DISPLAY_IDENTIFIER cnt_SetEEpromWriteProtect.eepromChannel[7].EEpromZentralHandler._.ZFFSAB ECU_ADDRESS 0xFFF97BB7 /end MEASUREMENT
/begin MEASUREMENT ZFFSAB._.EEpromZentralHandler.eepromChannel[8].ZFFSAB._.cEEpromChannel._.cnt_GetEEpromValid "Call counter off function" UBYTE SAB_STANDARD_S2_S3 1 100 0 255 DISPLAY_IDENTIFIER cnt_GetEEpromValid._.cEEpromChannel._.ZFFSAB.eepromChannel[8].EEpromZentralHandler._.ZFFSAB ECU_ADDRESS 0xFFF97BB8 /end MEASUREMENT
/begin MEASUREMENT ZFFSAB._.EEpromZentralHandler.eepromChannel[8].ZFFSAB._.cEEpromChannel._.ret_GetEEpromValid "Return value off function" UBYTE SAB_STANDARD_S2_S3 1 100 0 255 DISPLAY_IDENTIFIER ret_GetEEpromValid._.cEEpromChannel._.ZFFSAB.eepromChannel[8].EEpromZentralHandler._.ZFFSAB ECU_ADDRESS 0xFFF97BB9 /end MEASUREMENT
/begin MEASUREMENT ZFFSAB._.EEpromZentralHandler.eepromChannel[8].ZFFSAB._.cEEpromChannel._.cnt_GetEEpromUpdate "Call counter off function" UBYTE SAB_STANDARD_S2_S3 1 100 0 255 DISPLAY_IDENTIFIER cnt_GetEEpromUpdate._.cEEpromChannel._.ZFFSAB.eepromChannel[8].EEpromZentralHandler._.ZFFSAB ECU_ADDRESS 0xFFF97BBA /end MEASUREMENT
/begin MEASUREMENT ZFFSAB._.EEpromZentralHandler.eepromChannel[8].ZFFSAB._.cEEpromChannel._.ret_GetEEpromUpdate "Return value off function" UBYTE SAB_STANDARD_S2_S3 1 100 0 255 DISPLAY_IDENTIFIER ret_GetEEpromUpdate._.cEEpromChannel._.ZFFSAB.eepromChannel[8].EEpromZentralHandler._.ZFFSAB ECU_ADDRESS 0xFFF97BBB /end MEASUREMENT
/begin MEASUREMENT ZFFSAB._.EEpromZentralHandler.eepromChannel[8].ZFFSAB._.cEEpromChannel._.cnt_SetEEpromInitZyklisch "Call counter off function" UBYTE SAB_STANDARD_S2_S3 1 100 0 255 DISPLAY_IDENTIFIER cnt_SetEEpromInitZyklisch._.cEEpromChannel._.ZFFSAB.eepromChannel[8].EEpromZentralHandler._.ZFFSAB ECU_ADDRESS 0xFFF97BBC /end MEASUREMENT
/begin MEASUREMENT ZFFSAB._.EEpromZentralHandler.eepromChannel[8].ZFFSAB._.cEEpromChannel._.ret_SetEEpromInitZyklisch "Return value off function" UBYTE SAB_STANDARD_S2_S3 1 100 0 255 DISPLAY_IDENTIFIER ret_SetEEpromInitZyklisch._.cEEpromChannel._.ZFFSAB.eepromChannel[8].EEpromZentralHandler._.ZFFSAB ECU_ADDRESS 0xFFF97BBD /end MEASUREMENT
/begin MEASUREMENT ZFFSAB._.EEpromZentralHandler.eepromChannel[8].ZFFSAB._.cEEpromChannel._.eeprom_info "argument of SetEEpromInitZyklisch" UBYTE SAB_STANDARD_S2_S3 1 100 0 255 DISPLAY_IDENTIFIER eeprom_info._.cEEpromChannel._.ZFFSAB.eepromChannel[8].EEpromZentralHandler._.ZFFSAB ECU_ADDRESS 0xFFF97BBE /end MEASUREMENT
/begin MEASUREMENT ZFFSAB._.EEpromZentralHandler.eepromChannel[8].ZFFSAB._.cEEpromChannel._.cnt_GetSizeofEEpromData "Call counter off function" UBYTE SAB_STANDARD_S2_S3 1 100 0 255 DISPLAY_IDENTIFIER cnt_GetSizeofEEpromData._.cEEpromChannel._.ZFFSAB.eepromChannel[8].EEpromZentralHandler._.ZFFSAB ECU_ADDRESS 0xFFF97BBF /end MEASUREMENT
/begin MEASUREMENT ZFFSAB._.EEpromZentralHandler.eepromChannel[8].ZFFSAB._.cEEpromChannel._.ret_GetSizeofEEpromData "Return value off function" UWORD SAB_STANDARD_S2_S3 1 100 0 65535 DISPLAY_IDENTIFIER ret_GetSizeofEEpromData._.cEEpromChannel._.ZFFSAB.eepromChannel[8].EEpromZentralHandler._.ZFFSAB ECU_ADDRESS 0xFFF97BC0 /end MEASUREMENT
/begin MEASUREMENT ZFFSAB._.EEpromZentralHandler.eepromChannel[8].cnt_CallEEpromStoreImmediate "Call counter off function" UBYTE SAB_STANDARD_S2_S3 1 100 0 255 DISPLAY_IDENTIFIER cnt_CallEEpromStoreImmediate.eepromChannel[8].EEpromZentralHandler._.ZFFSAB ECU_ADDRESS 0xFFF97BC2 /end MEASUREMENT
/begin MEASUREMENT ZFFSAB._.EEpromZentralHandler.eepromChannel[8].ret_CallEEpromStoreImmediate "Return value off function" UBYTE SAB_STANDARD_S2_S3 1 100 0 255 DISPLAY_IDENTIFIER ret_CallEEpromStoreImmediate.eepromChannel[8].EEpromZentralHandler._.ZFFSAB ECU_ADDRESS 0xFFF97BC3 /end MEASUREMENT
/begin MEASUREMENT ZFFSAB._.EEpromZentralHandler.eepromChannel[8].cnt_CallEEpromLoadData "Call counter off function" UBYTE SAB_STANDARD_S2_S3 1 100 0 255 DISPLAY_IDENTIFIER cnt_CallEEpromLoadData.eepromChannel[8].EEpromZentralHandler._.ZFFSAB ECU_ADDRESS 0xFFF97BC4 /end MEASUREMENT
/begin MEASUREMENT ZFFSAB._.EEpromZentralHandler.eepromChannel[8].ret_CallEEpromLoadData "Return value off function" UBYTE SAB_STANDARD_S2_S3 1 100 0 255 DISPLAY_IDENTIFIER ret_CallEEpromLoadData.eepromChannel[8].EEpromZentralHandler._.ZFFSAB ECU_ADDRESS 0xFFF97BC5 /end MEASUREMENT
/begin MEASUREMENT ZFFSAB._.EEpromZentralHandler.eepromChannel[8].cnt_CallEEpromLoadDataState "Call counter off function" UBYTE SAB_STANDARD_S2_S3 1 100 0 255 DISPLAY_IDENTIFIER cnt_CallEEpromLoadDataState.eepromChannel[8].EEpromZentralHandler._.ZFFSAB ECU_ADDRESS 0xFFF97BC6 /end MEASUREMENT
/begin MEASUREMENT ZFFSAB._.EEpromZentralHandler.eepromChannel[8].ret_CallEEpromLoadDataState "Return value off function" UBYTE SAB_STANDARD_S2_S3 1 100 0 255 DISPLAY_IDENTIFIER ret_CallEEpromLoadDataState.eepromChannel[8].EEpromZentralHandler._.ZFFSAB ECU_ADDRESS 0xFFF97BC7 /end MEASUREMENT
/begin MEASUREMENT ZFFSAB._.EEpromZentralHandler.eepromChannel[8].mode "argument of SetEEpromInitZyklisch" UBYTE SAB_STANDARD_S2_S3 1 100 0 255 DISPLAY_IDENTIFIER mode.eepromChannel[8].EEpromZentralHandler._.ZFFSAB ECU_ADDRESS 0xFFF97BC8 /end MEASUREMENT
/begin MEASUREMENT ZFFSAB._.EEpromZentralHandler.eepromChannel[8].cnt_SetEEpromWriteProtect "Call counter off function" UBYTE SAB_STANDARD_S2_S3 1 100 0 255 DISPLAY_IDENTIFIER cnt_SetEEpromWriteProtect.eepromChannel[8].EEpromZentralHandler._.ZFFSAB ECU_ADDRESS 0xFFF97BC9 /end MEASUREMENT
/begin MEASUREMENT ZFFSAB._.EEpromZentralHandler.eepromChannel[9].ZFFSAB._.cEEpromChannel._.cnt_GetEEpromValid "Call counter off function" UBYTE SAB_STANDARD_S2_S3 1 100 0 255 DISPLAY_IDENTIFIER cnt_GetEEpromValid._.cEEpromChannel._.ZFFSAB.eepromChannel[9].EEpromZentralHandler._.ZFFSAB ECU_ADDRESS 0xFFF97BCA /end MEASUREMENT
/begin MEASUREMENT ZFFSAB._.EEpromZentralHandler.eepromChannel[9].ZFFSAB._.cEEpromChannel._.ret_GetEEpromValid "Return value off function" UBYTE SAB_STANDARD_S2_S3 1 100 0 255 DISPLAY_IDENTIFIER ret_GetEEpromValid._.cEEpromChannel._.ZFFSAB.eepromChannel[9].EEpromZentralHandler._.ZFFSAB ECU_ADDRESS 0xFFF97BCB /end MEASUREMENT
/begin MEASUREMENT ZFFSAB._.EEpromZentralHandler.eepromChannel[9].ZFFSAB._.cEEpromChannel._.cnt_GetEEpromUpdate "Call counter off function" UBYTE SAB_STANDARD_S2_S3 1 100 0 255 DISPLAY_IDENTIFIER cnt_GetEEpromUpdate._.cEEpromChannel._.ZFFSAB.eepromChannel[9].EEpromZentralHandler._.ZFFSAB ECU_ADDRESS 0xFFF97BCC /end MEASUREMENT
/begin MEASUREMENT ZFFSAB._.EEpromZentralHandler.eepromChannel[9].ZFFSAB._.cEEpromChannel._.ret_GetEEpromUpdate "Return value off function" UBYTE SAB_STANDARD_S2_S3 1 100 0 255 DISPLAY_IDENTIFIER ret_GetEEpromUpdate._.cEEpromChannel._.ZFFSAB.eepromChannel[9].EEpromZentralHandler._.ZFFSAB ECU_ADDRESS 0xFFF97BCD /end MEASUREMENT
/begin MEASUREMENT ZFFSAB._.EEpromZentralHandler.eepromChannel[9].ZFFSAB._.cEEpromChannel._.cnt_SetEEpromInitZyklisch "Call counter off function" UBYTE SAB_STANDARD_S2_S3 1 100 0 255 DISPLAY_IDENTIFIER cnt_SetEEpromInitZyklisch._.cEEpromChannel._.ZFFSAB.eepromChannel[9].EEpromZentralHandler._.ZFFSAB ECU_ADDRESS 0xFFF97BCE /end MEASUREMENT
/begin MEASUREMENT ZFFSAB._.EEpromZentralHandler.eepromChannel[9].ZFFSAB._.cEEpromChannel._.ret_SetEEpromInitZyklisch "Return value off function" UBYTE SAB_STANDARD_S2_S3 1 100 0 255 DISPLAY_IDENTIFIER ret_SetEEpromInitZyklisch._.cEEpromChannel._.ZFFSAB.eepromChannel[9].EEpromZentralHandler._.ZFFSAB ECU_ADDRESS 0xFFF97BCF /end MEASUREMENT
/begin MEASUREMENT ZFFSAB._.EEpromZentralHandler.eepromChannel[9].ZFFSAB._.cEEpromChannel._.eeprom_info "argument of SetEEpromInitZyklisch" UBYTE SAB_STANDARD_S2_S3 1 100 0 255 DISPLAY_IDENTIFIER eeprom_info._.cEEpromChannel._.ZFFSAB.eepromChannel[9].EEpromZentralHandler._.ZFFSAB ECU_ADDRESS 0xFFF97BD0 /end MEASUREMENT
/begin MEASUREMENT ZFFSAB._.EEpromZentralHandler.eepromChannel[9].ZFFSAB._.cEEpromChannel._.cnt_GetSizeofEEpromData "Call counter off function" UBYTE SAB_STANDARD_S2_S3 1 100 0 255 DISPLAY_IDENTIFIER cnt_GetSizeofEEpromData._.cEEpromChannel._.ZFFSAB.eepromChannel[9].EEpromZentralHandler._.ZFFSAB ECU_ADDRESS 0xFFF97BD1 /end MEASUREMENT
/begin MEASUREMENT ZFFSAB._.EEpromZentralHandler.eepromChannel[9].ZFFSAB._.cEEpromChannel._.ret_GetSizeofEEpromData "Return value off function" UWORD SAB_STANDARD_S2_S3 1 100 0 65535 DISPLAY_IDENTIFIER ret_GetSizeofEEpromData._.cEEpromChannel._.ZFFSAB.eepromChannel[9].EEpromZentralHandler._.ZFFSAB ECU_ADDRESS 0xFFF97BD2 /end MEASUREMENT
/begin MEASUREMENT ZFFSAB._.EEpromZentralHandler.eepromChannel[9].cnt_CallEEpromStoreImmediate "Call counter off function" UBYTE SAB_STANDARD_S2_S3 1 100 0 255 DISPLAY_IDENTIFIER cnt_CallEEpromStoreImmediate.eepromChannel[9].EEpromZentralHandler._.ZFFSAB ECU_ADDRESS 0xFFF97BD4 /end MEASUREMENT
/begin MEASUREMENT ZFFSAB._.EEpromZentralHandler.eepromChannel[9].ret_CallEEpromStoreImmediate "Return value off function" UBYTE SAB_STANDARD_S2_S3 1 100 0 255 DISPLAY_IDENTIFIER ret_CallEEpromStoreImmediate.eepromChannel[9].EEpromZentralHandler._.ZFFSAB ECU_ADDRESS 0xFFF97BD5 /end MEASUREMENT
/begin MEASUREMENT ZFFSAB._.EEpromZentralHandler.eepromChannel[9].cnt_CallEEpromLoadData "Call counter off function" UBYTE SAB_STANDARD_S2_S3 1 100 0 255 DISPLAY_IDENTIFIER cnt_CallEEpromLoadData.eepromChannel[9].EEpromZentralHandler._.ZFFSAB ECU_ADDRESS 0xFFF97BD6 /end MEASUREMENT
/begin MEASUREMENT ZFFSAB._.EEpromZentralHandler.eepromChannel[9].ret_CallEEpromLoadData "Return value off function" UBYTE SAB_STANDARD_S2_S3 1 100 0 255 DISPLAY_IDENTIFIER ret_CallEEpromLoadData.eepromChannel[9].EEpromZentralHandler._.ZFFSAB ECU_ADDRESS 0xFFF97BD7 /end MEASUREMENT
/begin MEASUREMENT ZFFSAB._.EEpromZentralHandler.eepromChannel[9].cnt_CallEEpromLoadDataState "Call counter off function" UBYTE SAB_STANDARD_S2_S3 1 100 0 255 DISPLAY_IDENTIFIER cnt_CallEEpromLoadDataState.eepromChannel[9].EEpromZentralHandler._.ZFFSAB ECU_ADDRESS 0xFFF97BD8 /end MEASUREMENT
/begin MEASUREMENT ZFFSAB._.EEpromZentralHandler.eepromChannel[9].ret_CallEEpromLoadDataState "Return value off function" UBYTE SAB_STANDARD_S2_S3 1 100 0 255 DISPLAY_IDENTIFIER ret_CallEEpromLoadDataState.eepromChannel[9].EEpromZentralHandler._.ZFFSAB ECU_ADDRESS 0xFFF97BD9 /end MEASUREMENT
/begin MEASUREMENT ZFFSAB._.EEpromZentralHandler.eepromChannel[9].mode "argument of SetEEpromInitZyklisch" UBYTE SAB_STANDARD_S2_S3 1 100 0 255 DISPLAY_IDENTIFIER mode.eepromChannel[9].EEpromZentralHandler._.ZFFSAB ECU_ADDRESS 0xFFF97BDA /end MEASUREMENT
/begin MEASUREMENT ZFFSAB._.EEpromZentralHandler.eepromChannel[9].cnt_SetEEpromWriteProtect "Call counter off function" UBYTE SAB_STANDARD_S2_S3 1 100 0 255 DISPLAY_IDENTIFIER cnt_SetEEpromWriteProtect.eepromChannel[9].EEpromZentralHandler._.ZFFSAB ECU_ADDRESS 0xFFF97BDB /end MEASUREMENT
/begin MEASUREMENT ZFFSAB._.EEpromZentralHandler.eepromChannel[40].ret_CallEEpromStoreImmediate "Return value off function" UBYTE SAB_STANDARD_S2_S3 1 100 0 255 DISPLAY_IDENTIFIER ret_CallEEpromStoreImmediate.eepromChannel[40].EEpromZentralHandler._.ZFFSAB ECU_ADDRESS 0xFFF97E03 /end MEASUREMENT
/begin MEASUREMENT ZFFSAB._.EEpromZentralHandler.eepromChannel[40].ret_CallEEpromLoadData "Return value off function" UBYTE SAB_STANDARD_S2_S3 1 100 0 255 DISPLAY_IDENTIFIER ret_CallEEpromLoadData.eepromChannel[40].EEpromZentralHandler._.ZFFSAB ECU_ADDRESS 0xFFF97E05 /end MEASUREMENT
/begin MEASUREMENT ZFFSAB._.EEpromZentralHandler.eepromChannel[40].ret_CallEEpromLoadDataState "Return value off function" UBYTE SAB_STANDARD_S2_S3 1 100 0 255 DISPLAY_IDENTIFIER ret_CallEEpromLoadDataState.eepromChannel[40].EEpromZentralHandler._.ZFFSAB ECU_ADDRESS 0xFFF97E07 /end MEASUREMENT
/begin MEASUREMENT ZFFSAB._.EEpromZentralHandler.eepromChannel[41].ZFFSAB._.cEEpromChannel._.cnt_GetEEpromValid "Call counter off function" UBYTE SAB_STANDARD_S2_S3 1 100 0 255 DISPLAY_IDENTIFIER cnt_GetEEpromValid._.cEEpromChannel._.ZFFSAB.eepromChannel[41].EEpromZentralHandler._.ZFFSAB ECU_ADDRESS 0xFFF97E0A /end MEASUREMENT
/begin MEASUREMENT ZFFSAB._.EEpromZentralHandler.eepromChannel[41].ZFFSAB._.cEEpromChannel._.ret_GetEEpromValid "Return value off function" UBYTE SAB_STANDARD_S2_S3 1 100 0 255 DISPLAY_IDENTIFIER ret_GetEEpromValid._.cEEpromChannel._.ZFFSAB.eepromChannel[41].EEpromZentralHandler._.ZFFSAB ECU_ADDRESS 0xFFF97E0B /end MEASUREMENT
/begin MEASUREMENT ZFFSAB._.EEpromZentralHandler.eepromChannel[41].ZFFSAB._.cEEpromChannel._.cnt_GetEEpromUpdate "Call counter off function" UBYTE SAB_STANDARD_S2_S3 1 100 0 255 DISPLAY_IDENTIFIER cnt_GetEEpromUpdate._.cEEpromChannel._.ZFFSAB.eepromChannel[41].EEpromZentralHandler._.ZFFSAB ECU_ADDRESS 0xFFF97E0C /end MEASUREMENT
/begin MEASUREMENT ZFFSAB._.EEpromZentralHandler.eepromChannel[41].ZFFSAB._.cEEpromChannel._.ret_GetEEpromUpdate "Return value off function" UBYTE SAB_STANDARD_S2_S3 1 100 0 255 DISPLAY_IDENTIFIER ret_GetEEpromUpdate._.cEEpromChannel._.ZFFSAB.eepromChannel[41].EEpromZentralHandler._.ZFFSAB ECU_ADDRESS 0xFFF97E0D /end MEASUREMENT
/begin MEASUREMENT ZFFSAB._.EEpromZentralHandler.eepromChannel[41].ZFFSAB._.cEEpromChannel._.cnt_SetEEpromInitZyklisch "Call counter off function" UBYTE SAB_STANDARD_S2_S3 1 100 0 255 DISPLAY_IDENTIFIER cnt_SetEEpromInitZyklisch._.cEEpromChannel._.ZFFSAB.eepromChannel[41].EEpromZentralHandler._.ZFFSAB ECU_ADDRESS 0xFFF97E0E /end MEASUREMENT
/begin MEASUREMENT ZFFSAB._.EEpromZentralHandler.eepromChannel[41].ZFFSAB._.cEEpromChannel._.ret_SetEEpromInitZyklisch "Return value off function" UBYTE SAB_STANDARD_S2_S3 1 100 0 255 DISPLAY_IDENTIFIER ret_SetEEpromInitZyklisch._.cEEpromChannel._.ZFFSAB.eepromChannel[41].EEpromZentralHandler._.ZFFSAB ECU_ADDRESS 0xFFF97E0F /end MEASUREMENT
/begin MEASUREMENT ZFFSAB._.EEpromZentralHandler.eepromChannel[41].ZFFSAB._.cEEpromChannel._.eeprom_info "argument of SetEEpromInitZyklisch" UBYTE SAB_STANDARD_S2_S3 1 100 0 255 DISPLAY_IDENTIFIER eeprom_info._.cEEpromChannel._.ZFFSAB.eepromChannel[41].EEpromZentralHandler._.ZFFSAB ECU_ADDRESS 0xFFF97E10 /end MEASUREMENT
/begin MEASUREMENT ZFFSAB._.EEpromZentralHandler.eepromChannel[41].ZFFSAB._.cEEpromChannel._.cnt_GetSizeofEEpromData "Call counter off function" UBYTE SAB_STANDARD_S2_S3 1 100 0 255 DISPLAY_IDENTIFIER cnt_GetSizeofEEpromData._.cEEpromChannel._.ZFFSAB.eepromChannel[41].EEpromZentralHandler._.ZFFSAB ECU_ADDRESS 0xFFF97E11 /end MEASUREMENT
/begin MEASUREMENT ZFFSAB._.EEpromZentralHandler.eepromChannel[41].ZFFSAB._.cEEpromChannel._.ret_GetSizeofEEpromData "Return value off function" UWORD SAB_STANDARD_S2_S3 1 100 0 65535 DISPLAY_IDENTIFIER ret_GetSizeofEEpromData._.cEEpromChannel._.ZFFSAB.eepromChannel[41].EEpromZentralHandler._.ZFFSAB ECU_ADDRESS 0xFFF97E12 /end MEASUREMENT
/begin MEASUREMENT ZFFSAB._.EEpromZentralHandler.eepromChannel[41].cnt_CallEEpromStoreImmediate "Call counter off function" UBYTE SAB_STANDARD_S2_S3 1 100 0 255 DISPLAY_IDENTIFIER cnt_CallEEpromStoreImmediate.eepromChannel[41].EEpromZentralHandler._.ZFFSAB ECU_ADDRESS 0xFFF97E14 /end MEASUREMENT
/begin MEASUREMENT ZFFSAB._.EEpromZentralHandler.eepromChannel[41].ret_CallEEpromStoreImmediate "Return value off function" UBYTE SAB_STANDARD_S2_S3 1 100 0 255 DISPLAY_IDENTIFIER ret_CallEEpromStoreImmediate.eepromChannel[41].EEpromZentralHandler._.ZFFSAB ECU_ADDRESS 0xFFF97E15 /end MEASUREMENT
/begin MEASUREMENT ZFFSAB._.EEpromZentralHandler.eepromChannel[41].cnt_CallEEpromLoadData "Call counter off function" UBYTE SAB_STANDARD_S2_S3 1 100 0 255 DISPLAY_IDENTIFIER cnt_CallEEpromLoadData.eepromChannel[41].EEpromZentralHandler._.ZFFSAB ECU_ADDRESS 0xFFF97E16 /end MEASUREMENT
/begin MEASUREMENT ZFFSAB._.EEpromZentralHandler.eepromChannel[41].ret_CallEEpromLoadData "Return value off function" UBYTE SAB_STANDARD_S2_S3 1 100 0 255 DISPLAY_IDENTIFIER ret_CallEEpromLoadData.eepromChannel[41].EEpromZentralHandler._.ZFFSAB ECU_ADDRESS 0xFFF97E17 /end MEASUREMENT
/begin MEASUREMENT ZFFSAB._.EEpromZentralHandler.eepromChannel[41].cnt_CallEEpromLoadDataState "Call counter off function" UBYTE SAB_STANDARD_S2_S3 1 100 0 255 DISPLAY_IDENTIFIER cnt_CallEEpromLoadDataState.eepromChannel[41].EEpromZentralHandler._.ZFFSAB ECU_ADDRESS 0xFFF97E18 /end MEASUREMENT
/begin MEASUREMENT ZFFSAB._.EEpromZentralHandler.eepromChannel[41].ret_CallEEpromLoadDataState "Return value off function" UBYTE SAB_STANDARD_S2_S3 1 100 0 255 DISPLAY_IDENTIFIER ret_CallEEpromLoadDataState.eepromChannel[41].EEpromZentralHandler._.ZFFSAB ECU_ADDRESS 0xFFF97E19 /end MEASUREMENT
/begin MEASUREMENT ZFFSAB._.EEpromZentralHandler.eepromChannel[41].mode "argument of SetEEpromInitZyklisch" UBYTE SAB_STANDARD_S2_S3 1 100 0 255 DISPLAY_IDENTIFIER mode.eepromChannel[41].EEpromZentralHandler._.ZFFSAB ECU_ADDRESS 0xFFF97E1A /end MEASUREMENT
/begin MEASUREMENT ZFFSAB._.EEpromZentralHandler.eepromChannel[41].cnt_SetEEpromWriteProtect "Call counter off function" UBYTE SAB_STANDARD_S2_S3 1 100 0 255 DISPLAY_IDENTIFIER cnt_SetEEpromWriteProtect.eepromChannel[41].EEpromZentralHandler._.ZFFSAB ECU_ADDRESS 0xFFF97E1B /end MEASUREMENT
/begin MEASUREMENT ZFFSAB._.EEpromZentralHandler.eepromChannel[42].ZFFSAB._.cEEpromChannel._.cnt_GetEEpromValid "Call counter off function" UBYTE SAB_STANDARD_S2_S3 1 100 0 255 DISPLAY_IDENTIFIER cnt_GetEEpromValid._.cEEpromChannel._.ZFFSAB.eepromChannel[42].EEpromZentralHandler._.ZFFSAB ECU_ADDRESS 0xFFF97E1C /end MEASUREMENT
/begin MEASUREMENT ZFFSAB._.EEpromZentralHandler.eepromChannel[42].ZFFSAB._.cEEpromChannel._.ret_GetEEpromValid "Return value off function" UBYTE SAB_STANDARD_S2_S3 1 100 0 255 DISPLAY_IDENTIFIER ret_GetEEpromValid._.cEEpromChannel._.ZFFSAB.eepromChannel[42].EEpromZentralHandler._.ZFFSAB ECU_ADDRESS 0xFFF97E1D /end MEASUREMENT
/begin MEASUREMENT ZFFSAB._.EEpromZentralHandler.eepromChannel[42].ZFFSAB._.cEEpromChannel._.cnt_GetEEpromUpdate "Call counter off function" UBYTE SAB_STANDARD_S2_S3 1 100 0 255 DISPLAY_IDENTIFIER cnt_GetEEpromUpdate._.cEEpromChannel._.ZFFSAB.eepromChannel[42].EEpromZentralHandler._.ZFFSAB ECU_ADDRESS 0xFFF97E1E /end MEASUREMENT
/begin MEASUREMENT ZFFSAB._.EEpromZentralHandler.eepromChannel[42].ZFFSAB._.cEEpromChannel._.ret_GetEEpromUpdate "Return value off function" UBYTE SAB_STANDARD_S2_S3 1 100 0 255 DISPLAY_IDENTIFIER ret_GetEEpromUpdate._.cEEpromChannel._.ZFFSAB.eepromChannel[42].EEpromZentralHandler._.ZFFSAB ECU_ADDRESS 0xFFF97E1F /end MEASUREMENT
/begin MEASUREMENT ZFFSAB._.EEpromZentralHandler.eepromChannel[42].ZFFSAB._.cEEpromChannel._.cnt_SetEEpromInitZyklisch "Call counter off function" UBYTE SAB_STANDARD_S2_S3 1 100 0 255 DISPLAY_IDENTIFIER cnt_SetEEpromInitZyklisch._.cEEpromChannel._.ZFFSAB.eepromChannel[42].EEpromZentralHandler._.ZFFSAB ECU_ADDRESS 0xFFF97E20 /end MEASUREMENT
/begin MEASUREMENT ZFFSAB._.EEpromZentralHandler.eepromChannel[42].ZFFSAB._.cEEpromChannel._.ret_SetEEpromInitZyklisch "Return value off function" UBYTE SAB_STANDARD_S2_S3 1 100 0 255 DISPLAY_IDENTIFIER ret_SetEEpromInitZyklisch._.cEEpromChannel._.ZFFSAB.eepromChannel[42].EEpromZentralHandler._.ZFFSAB ECU_ADDRESS 0xFFF97E21 /end MEASUREMENT
/begin MEASUREMENT ZFFSAB._.EEpromZentralHandler.eepromChannel[42].ZFFSAB._.cEEpromChannel._.eeprom_info "argument of SetEEpromInitZyklisch" UBYTE SAB_STANDARD_S2_S3 1 100 0 255 DISPLAY_IDENTIFIER eeprom_info._.cEEpromChannel._.ZFFSAB.eepromChannel[42].EEpromZentralHandler._.ZFFSAB ECU_ADDRESS 0xFFF97E22 /end MEASUREMENT
/begin MEASUREMENT ZFFSAB._.EEpromZentralHandler.eepromChannel[42].ZFFSAB._.cEEpromChannel._.cnt_GetSizeofEEpromData "Call counter off function" UBYTE SAB_STANDARD_S2_S3 1 100 0 255 DISPLAY_IDENTIFIER cnt_GetSizeofEEpromData._.cEEpromChannel._.ZFFSAB.eepromChannel[42].EEpromZentralHandler._.ZFFSAB ECU_ADDRESS 0xFFF97E23 /end MEASUREMENT
/begin MEASUREMENT ZFFSAB._.EEpromZentralHandler.eepromChannel[42].ZFFSAB._.cEEpromChannel._.ret_GetSizeofEEpromData "Return value off function" UWORD SAB_STANDARD_S2_S3 1 100 0 65535 DISPLAY_IDENTIFIER ret_GetSizeofEEpromData._.cEEpromChannel._.ZFFSAB.eepromChannel[42].EEpromZentralHandler._.ZFFSAB ECU_ADDRESS 0xFFF97E24 /end MEASUREMENT
/begin MEASUREMENT ZFFSAB._.EEpromZentralHandler.eepromChannel[42].cnt_CallEEpromStoreImmediate "Call counter off function" UBYTE SAB_STANDARD_S2_S3 1 100 0 255 DISPLAY_IDENTIFIER cnt_CallEEpromStoreImmediate.eepromChannel[42].EEpromZentralHandler._.ZFFSAB ECU_ADDRESS 0xFFF97E26 /end MEASUREMENT
/begin MEASUREMENT ZFFSAB._.EEpromZentralHandler.eepromChannel[42].ret_CallEEpromStoreImmediate "Return value off function" UBYTE SAB_STANDARD_S2_S3 1 100 0 255 DISPLAY_IDENTIFIER ret_CallEEpromStoreImmediate.eepromChannel[42].EEpromZentralHandler._.ZFFSAB ECU_ADDRESS 0xFFF97E27 /end MEASUREMENT
/begin MEASUREMENT ZFFSAB._.EEpromZentralHandler.eepromChannel[42].cnt_CallEEpromLoadData "Call counter off function" UBYTE SAB_STANDARD_S2_S3 1 100 0 255 DISPLAY_IDENTIFIER cnt_CallEEpromLoadData.eepromChannel[42].EEpromZentralHandler._.ZFFSAB ECU_ADDRESS 0xFFF97E28 /end MEASUREMENT
/begin MEASUREMENT ZFFSAB._.EEpromZentralHandler.eepromChannel[42].ret_CallEEpromLoadData "Return value off function" UBYTE SAB_STANDARD_S2_S3 1 100 0 255 DISPLAY_IDENTIFIER ret_CallEEpromLoadData.eepromChannel[42].EEpromZentralHandler._.ZFFSAB ECU_ADDRESS 0xFFF97E29 /end MEASUREMENT
/begin MEASUREMENT ZFFSAB._.EEpromZentralHandler.eepromChannel[42].cnt_CallEEpromLoadDataState "Call counter off function" UBYTE SAB_STANDARD_S2_S3 1 100 0 255 DISPLAY_IDENTIFIER cnt_CallEEpromLoadDataState.eepromChannel[42].EEpromZentralHandler._.ZFFSAB ECU_ADDRESS 0xFFF97E2A /end MEASUREMENT
/begin MEASUREMENT ZFFSAB._.EEpromZentralHandler.eepromChannel[42].ret_CallEEpromLoadDataState "Return value off function" UBYTE SAB_STANDARD_S2_S3 1 100 0 255 DISPLAY_IDENTIFIER ret_CallEEpromLoadDataState.eepromChannel[42].EEpromZentralHandler._.ZFFSAB ECU_ADDRESS 0xFFF97E2B /end MEASUREMENT
/begin MEASUREMENT ZFFSAB._.EEpromZentralHandler.eepromChannel[42].mode "argument of SetEEpromInitZyklisch" UBYTE SAB_STANDARD_S2_S3 1 100 0 255 DISPLAY_IDENTIFIER mode.eepromChannel[42].EEpromZentralHandler._.ZFFSAB ECU_ADDRESS 0xFFF97E2C /end MEASUREMENT
/begin MEASUREMENT ZFFSAB._.EEpromZentralHandler.eepromChannel[42].cnt_SetEEpromWriteProtect "Call counter off function" UBYTE SAB_STANDARD_S2_S3 1 100 0 255 DISPLAY_IDENTIFIER cnt_SetEEpromWriteProtect.eepromChannel[42].EEpromZentralHandler._.ZFFSAB ECU_ADDRESS 0xFFF97E2D /end MEASUREMENT
/begin MEASUREMENT ZFFSAB._.EEpromZentralHandler.eepromChannel[43].ZFFSAB._.cEEpromChannel._.cnt_GetEEpromValid "Call counter off function" UBYTE SAB_STANDARD_S2_S3 1 100 0 255 DISPLAY_IDENTIFIER cnt_GetEEpromValid._.cEEpromChannel._.ZFFSAB.eepromChannel[43].EEpromZentralHandler._.ZFFSAB ECU_ADDRESS 0xFFF97E2E /end MEASUREMENT
/begin MEASUREMENT ZFFSAB._.EEpromZentralHandler.eepromChannel[43].ZFFSAB._.cEEpromChannel._.ret_GetEEpromValid "Return value off function" UBYTE SAB_STANDARD_S2_S3 1 100 0 255 DISPLAY_IDENTIFIER ret_GetEEpromValid._.cEEpromChannel._.ZFFSAB.eepromChannel[43].EEpromZentralHandler._.ZFFSAB ECU_ADDRESS 0xFFF97E2F /end MEASUREMENT
/begin MEASUREMENT ZFFSAB._.EEpromZentralHandler.eepromChannel[43].ZFFSAB._.cEEpromChannel._.cnt_GetEEpromUpdate "Call counter off function" UBYTE SAB_STANDARD_S2_S3 1 100 0 255 DISPLAY_IDENTIFIER cnt_GetEEpromUpdate._.cEEpromChannel._.ZFFSAB.eepromChannel[43].EEpromZentralHandler._.ZFFSAB ECU_ADDRESS 0xFFF97E30 /end MEASUREMENT
/begin MEASUREMENT ZFFSAB._.EEpromZentralHandler.eepromChannel[43].ZFFSAB._.cEEpromChannel._.ret_GetEEpromUpdate "Return value off function" UBYTE SAB_STANDARD_S2_S3 1 100 0 255 DISPLAY_IDENTIFIER ret_GetEEpromUpdate._.cEEpromChannel._.ZFFSAB.eepromChannel[43].EEpromZentralHandler._.ZFFSAB ECU_ADDRESS 0xFFF97E31 /end MEASUREMENT
/begin MEASUREMENT ZFFSAB._.EEpromZentralHandler.eepromChannel[43].ZFFSAB._.cEEpromChannel._.cnt_SetEEpromInitZyklisch "Call counter off function" UBYTE SAB_STANDARD_S2_S3 1 100 0 255 DISPLAY_IDENTIFIER cnt_SetEEpromInitZyklisch._.cEEpromChannel._.ZFFSAB.eepromChannel[43].EEpromZentralHandler._.ZFFSAB ECU_ADDRESS 0xFFF97E32 /end MEASUREMENT
/begin MEASUREMENT ZFFSAB._.EEpromZentralHandler.eepromChannel[43].ZFFSAB._.cEEpromChannel._.ret_SetEEpromInitZyklisch "Return value off function" UBYTE SAB_STANDARD_S2_S3 1 100 0 255 DISPLAY_IDENTIFIER ret_SetEEpromInitZyklisch._.cEEpromChannel._.ZFFSAB.eepromChannel[43].EEpromZentralHandler._.ZFFSAB ECU_ADDRESS 0xFFF97E33 /end MEASUREMENT
/begin MEASUREMENT ZFFSAB._.EEpromZentralHandler.eepromChannel[43].ZFFSAB._.cEEpromChannel._.eeprom_info "argument of SetEEpromInitZyklisch" UBYTE SAB_STANDARD_S2_S3 1 100 0 255 DISPLAY_IDENTIFIER eeprom_info._.cEEpromChannel._.ZFFSAB.eepromChannel[43].EEpromZentralHandler._.ZFFSAB ECU_ADDRESS 0xFFF97E34 /end MEASUREMENT
/begin MEASUREMENT ZFFSAB._.EEpromZentralHandler.eepromChannel[43].ZFFSAB._.cEEpromChannel._.cnt_GetSizeofEEpromData "Call counter off function" UBYTE SAB_STANDARD_S2_S3 1 100 0 255 DISPLAY_IDENTIFIER cnt_GetSizeofEEpromData._.cEEpromChannel._.ZFFSAB.eepromChannel[43].EEpromZentralHandler._.ZFFSAB ECU_ADDRESS 0xFFF97E35 /end MEASUREMENT
/begin MEASUREMENT ZFFSAB._.EEpromZentralHandler.eepromChannel[43].ZFFSAB._.cEEpromChannel._.ret_GetSizeofEEpromData "Return value off function" UWORD SAB_STANDARD_S2_S3 1 100 0 65535 DISPLAY_IDENTIFIER ret_GetSizeofEEpromData._.cEEpromChannel._.ZFFSAB.eepromChannel[43].EEpromZentralHandler._.ZFFSAB ECU_ADDRESS 0xFFF97E36 /end MEASUREMENT
/begin MEASUREMENT ZFFSAB._.EEpromZentralHandler.eepromChannel[43].cnt_CallEEpromStoreImmediate "Call counter off function" UBYTE SAB_STANDARD_S2_S3 1 100 0 255 DISPLAY_IDENTIFIER cnt_CallEEpromStoreImmediate.eepromChannel[43].EEpromZentralHandler._.ZFFSAB ECU_ADDRESS 0xFFF97E38 /end MEASUREMENT
/begin MEASUREMENT ZFFSAB._.EEpromZentralHandler.eepromChannel[43].ret_CallEEpromStoreImmediate "Return value off function" UBYTE SAB_STANDARD_S2_S3 1 100 0 255 DISPLAY_IDENTIFIER ret_CallEEpromStoreImmediate.eepromChannel[43].EEpromZentralHandler._.ZFFSAB ECU_ADDRESS 0xFFF97E39 /end MEASUREMENT
/begin MEASUREMENT ZFFSAB._.EEpromZentralHandler.eepromChannel[43].cnt_CallEEpromLoadData "Call counter off function" UBYTE SAB_STANDARD_S2_S3 1 100 0 255 DISPLAY_IDENTIFIER cnt_CallEEpromLoadData.eepromChannel[43].EEpromZentralHandler._.ZFFSAB ECU_ADDRESS 0xFFF97E3A /end MEASUREMENT
/begin MEASUREMENT ZFFSAB._.EEpromZentralHandler.eepromChannel[43].ret_CallEEpromLoadData "Return value off function" UBYTE SAB_STANDARD_S2_S3 1 100 0 255 DISPLAY_IDENTIFIER ret_CallEEpromLoadData.eepromChannel[43].EEpromZentralHandler._.ZFFSAB ECU_ADDRESS 0xFFF97E3B /end MEASUREMENT
/begin MEASUREMENT ZFFSAB._.EEpromZentralHandler.eepromChannel[43].cnt_CallEEpromLoadDataState "Call counter off function" UBYTE SAB_STANDARD_S2_S3 1 100 0 255 DISPLAY_IDENTIFIER cnt_CallEEpromLoadDataState.eepromChannel[43].EEpromZentralHandler._.ZFFSAB ECU_ADDRESS 0xFFF97E3C /end MEASUREMENT
/begin MEASUREMENT ZFFSAB._.EEpromZentralHandler.eepromChannel[43].ret_CallEEpromLoadDataState "Return value off function" UBYTE SAB_STANDARD_S2_S3 1 100 0 255 DISPLAY_IDENTIFIER ret_CallEEpromLoadDataState.eepromChannel[43].EEpromZentralHandler._.ZFFSAB ECU_ADDRESS 0xFFF97E3D /end MEASUREMENT
/begin MEASUREMENT ZFFSAB._.EEpromZentralHandler.eepromChannel[43].mode "argument of SetEEpromInitZyklisch" UBYTE SAB_STANDARD_S2_S3 1 100 0 255 DISPLAY_IDENTIFIER mode.eepromChannel[43].EEpromZentralHandler._.ZFFSAB ECU_ADDRESS 0xFFF97E3E /end MEASUREMENT
/begin MEASUREMENT ZFFSAB._.EEpromZentralHandler.eepromChannel[43].cnt_SetEEpromWriteProtect "Call counter off function" UBYTE SAB_STANDARD_S2_S3 1 100 0 255 DISPLAY_IDENTIFIER cnt_SetEEpromWriteProtect.eepromChannel[43].EEpromZentralHandler._.ZFFSAB ECU_ADDRESS 0xFFF97E3F /end MEASUREMENT
/begin MEASUREMENT ZFFSAB._.EEpromZentralHandler.eepromChannel[44].ZFFSAB._.cEEpromChannel._.cnt_GetEEpromValid "Call counter off function" UBYTE SAB_STANDARD_S2_S3 1 100 0 255 DISPLAY_IDENTIFIER cnt_GetEEpromValid._.cEEpromChannel._.ZFFSAB.eepromChannel[44].EEpromZentralHandler._.ZFFSAB ECU_ADDRESS 0xFFF97E40 /end MEASUREMENT
/begin MEASUREMENT ZFFSAB._.EEpromZentralHandler.eepromChannel[44].ZFFSAB._.cEEpromChannel._.ret_GetEEpromValid "Return value off function" UBYTE SAB_STANDARD_S2_S3 1 100 0 255 DISPLAY_IDENTIFIER ret_GetEEpromValid._.cEEpromChannel._.ZFFSAB.eepromChannel[44].EEpromZentralHandler._.ZFFSAB ECU_ADDRESS 0xFFF97E41 /end MEASUREMENT
/begin MEASUREMENT ZFFSAB._.EEpromZentralHandler.eepromChannel[44].ZFFSAB._.cEEpromChannel._.cnt_GetEEpromUpdate "Call counter off function" UBYTE SAB_STANDARD_S2_S3 1 100 0 255 DISPLAY_IDENTIFIER cnt_GetEEpromUpdate._.cEEpromChannel._.ZFFSAB.eepromChannel[44].EEpromZentralHandler._.ZFFSAB ECU_ADDRESS 0xFFF97E42 /end MEASUREMENT
/begin MEASUREMENT ZFFSAB._.EEpromZentralHandler.eepromChannel[44].ZFFSAB._.cEEpromChannel._.ret_GetEEpromUpdate "Return value off function" UBYTE SAB_STANDARD_S2_S3 1 100 0 255 DISPLAY_IDENTIFIER ret_GetEEpromUpdate._.cEEpromChannel._.ZFFSAB.eepromChannel[44].EEpromZentralHandler._.ZFFSAB ECU_ADDRESS 0xFFF97E43 /end MEASUREMENT
/begin MEASUREMENT ZFFSAB._.EEpromZentralHandler.eepromChannel[44].ZFFSAB._.cEEpromChannel._.cnt_SetEEpromInitZyklisch "Call counter off function" UBYTE SAB_STANDARD_S2_S3 1 100 0 255 DISPLAY_IDENTIFIER cnt_SetEEpromInitZyklisch._.cEEpromChannel._.ZFFSAB.eepromChannel[44].EEpromZentralHandler._.ZFFSAB ECU_ADDRESS 0xFFF97E44 /end MEASUREMENT
/begin MEASUREMENT ZFFSAB._.EEpromZentralHandler.eepromChannel[44].ZFFSAB._.cEEpromChannel._.ret_SetEEpromInitZyklisch "Return value off function" UBYTE SAB_STANDARD_S2_S3 1 100 0 255 DISPLAY_IDENTIFIER ret_SetEEpromInitZyklisch._.cEEpromChannel._.ZFFSAB.eepromChannel[44].EEpromZentralHandler._.ZFFSAB ECU_ADDRESS 0xFFF97E45 /end MEASUREMENT
/begin MEASUREMENT ZFFSAB._.EEpromZentralHandler.eepromChannel[44].ZFFSAB._.cEEpromChannel._.eeprom_info "argument of SetEEpromInitZyklisch" UBYTE SAB_STANDARD_S2_S3 1 100 0 255 DISPLAY_IDENTIFIER eeprom_info._.cEEpromChannel._.ZFFSAB.eepromChannel[44].EEpromZentralHandler._.ZFFSAB ECU_ADDRESS 0xFFF97E46 /end MEASUREMENT
/begin MEASUREMENT ZFFSAB._.EEpromZentralHandler.eepromChannel[44].ZFFSAB._.cEEpromChannel._.cnt_GetSizeofEEpromData "Call counter off function" UBYTE SAB_STANDARD_S2_S3 1 100 0 255 DISPLAY_IDENTIFIER cnt_GetSizeofEEpromData._.cEEpromChannel._.ZFFSAB.eepromChannel[44].EEpromZentralHandler._.ZFFSAB ECU_ADDRESS 0xFFF97E47 /end MEASUREMENT
/begin MEASUREMENT ZFFSAB._.EEpromZentralHandler.eepromChannel[44].ZFFSAB._.cEEpromChannel._.ret_GetSizeofEEpromData "Return value off function" UWORD SAB_STANDARD_S2_S3 1 100 0 65535 DISPLAY_IDENTIFIER ret_GetSizeofEEpromData._.cEEpromChannel._.ZFFSAB.eepromChannel[44].EEpromZentralHandler._.ZFFSAB ECU_ADDRESS 0xFFF97E48 /end MEASUREMENT
/begin MEASUREMENT ZFFSAB._.EEpromZentralHandler.eepromChannel[44].cnt_CallEEpromStoreImmediate "Call counter off function" UBYTE SAB_STANDARD_S2_S3 1 100 0 255 DISPLAY_IDENTIFIER cnt_CallEEpromStoreImmediate.eepromChannel[44].EEpromZentralHandler._.ZFFSAB ECU_ADDRESS 0xFFF97E4A /end MEASUREMENT
/begin MEASUREMENT ZFFSAB._.EEpromZentralHandler.eepromChannel[44].ret_CallEEpromStoreImmediate "Return value off function" UBYTE SAB_STANDARD_S2_S3 1 100 0 255 DISPLAY_IDENTIFIER ret_CallEEpromStoreImmediate.eepromChannel[44].EEpromZentralHandler._.ZFFSAB ECU_ADDRESS 0xFFF97E4B /end MEASUREMENT
/begin MEASUREMENT ZFFSAB._.EEpromZentralHandler.eepromChannel[44].cnt_CallEEpromLoadData "Call counter off function" UBYTE SAB_STANDARD_S2_S3 1 100 0 255 DISPLAY_IDENTIFIER cnt_CallEEpromLoadData.eepromChannel[44].EEpromZentralHandler._.ZFFSAB ECU_ADDRESS 0xFFF97E4C /end MEASUREMENT
/begin MEASUREMENT ZFFSAB._.EEpromZentralHandler.eepromChannel[44].ret_CallEEpromLoadData "Return value off function" UBYTE SAB_STANDARD_S2_S3 1 100 0 255 DISPLAY_IDENTIFIER ret_CallEEpromLoadData.eepromChannel[44].EEpromZentralHandler._.ZFFSAB ECU_ADDRESS 0xFFF97E4D /end MEASUREMENT
/begin MEASUREMENT ZFFSAB._.EEpromZentralHandler.eepromChannel[44].cnt_CallEEpromLoadDataState "Call counter off function" UBYTE SAB_STANDARD_S2_S3 1 100 0 255 DISPLAY_IDENTIFIER cnt_CallEEpromLoadDataState.eepromChannel[44].EEpromZentralHandler._.ZFFSAB ECU_ADDRESS 0xFFF97E4E /end MEASUREMENT
/begin MEASUREMENT ZFFSAB._.EEpromZentralHandler.eepromChannel[44].ret_CallEEpromLoadDataState "Return value off function" UBYTE SAB_STANDARD_S2_S3 1 100 0 255 DISPLAY_IDENTIFIER ret_CallEEpromLoadDataState.eepromChannel[44].EEpromZentralHandler._.ZFFSAB ECU_ADDRESS 0xFFF97E4F /end MEASUREMENT
/begin MEASUREMENT ZFFSAB._.EEpromZentralHandler.eepromChannel[44].mode "argument of SetEEpromInitZyklisch" UBYTE SAB_STANDARD_S2_S3 1 100 0 255 DISPLAY_IDENTIFIER mode.eepromChannel[44].EEpromZentralHandler._.ZFFSAB ECU_ADDRESS 0xFFF97E50 /end MEASUREMENT
/begin MEASUREMENT ZFFSAB._.EEpromZentralHandler.eepromChannel[44].cnt_SetEEpromWriteProtect "Call counter off function" UBYTE SAB_STANDARD_S2_S3 1 100 0 255 DISPLAY_IDENTIFIER cnt_SetEEpromWriteProtect.eepromChannel[44].EEpromZentralHandler._.ZFFSAB ECU_ADDRESS 0xFFF97E51 /end MEASUREMENT
/begin MEASUREMENT ZFFSAB._.EEpromZentralHandler.eepromChannel[45].ZFFSAB._.cEEpromChannel._.cnt_GetEEpromValid "Call counter off function" UBYTE SAB_STANDARD_S2_S3 1 100 0 255 DISPLAY_IDENTIFIER cnt_GetEEpromValid._.cEEpromChannel._.ZFFSAB.eepromChannel[45].EEpromZentralHandler._.ZFFSAB ECU_ADDRESS 0xFFF97E52 /end MEASUREMENT
/begin MEASUREMENT ZFFSAB._.EEpromZentralHandler.eepromChannel[45].ZFFSAB._.cEEpromChannel._.ret_GetEEpromValid "Return value off function" UBYTE SAB_STANDARD_S2_S3 1 100 0 255 DISPLAY_IDENTIFIER ret_GetEEpromValid._.cEEpromChannel._.ZFFSAB.eepromChannel[45].EEpromZentralHandler._.ZFFSAB ECU_ADDRESS 0xFFF97E53 /end MEASUREMENT
/begin MEASUREMENT ZFFSAB._.EEpromZentralHandler.eepromChannel[45].ZFFSAB._.cEEpromChannel._.cnt_GetEEpromUpdate "Call counter off function" UBYTE SAB_STANDARD_S2_S3 1 100 0 255 DISPLAY_IDENTIFIER cnt_GetEEpromUpdate._.cEEpromChannel._.ZFFSAB.eepromChannel[45].EEpromZentralHandler._.ZFFSAB ECU_ADDRESS 0xFFF97E54 /end MEASUREMENT
/begin MEASUREMENT ZFFSAB._.EEpromZentralHandler.eepromChannel[45].ZFFSAB._.cEEpromChannel._.ret_GetEEpromUpdate "Return value off function" UBYTE SAB_STANDARD_S2_S3 1 100 0 255 DISPLAY_IDENTIFIER ret_GetEEpromUpdate._.cEEpromChannel._.ZFFSAB.eepromChannel[45].EEpromZentralHandler._.ZFFSAB ECU_ADDRESS 0xFFF97E55 /end MEASUREMENT
/begin MEASUREMENT ZFFSAB._.EEpromZentralHandler.eepromChannel[45].ZFFSAB._.cEEpromChannel._.cnt_SetEEpromInitZyklisch "Call counter off function" UBYTE SAB_STANDARD_S2_S3 1 100 0 255 DISPLAY_IDENTIFIER cnt_SetEEpromInitZyklisch._.cEEpromChannel._.ZFFSAB.eepromChannel[45].EEpromZentralHandler._.ZFFSAB ECU_ADDRESS 0xFFF97E56 /end MEASUREMENT
/begin MEASUREMENT ZFFSAB._.EEpromZentralHandler.eepromChannel[45].ZFFSAB._.cEEpromChannel._.ret_SetEEpromInitZyklisch "Return value off function" UBYTE SAB_STANDARD_S2_S3 1 100 0 255 DISPLAY_IDENTIFIER ret_SetEEpromInitZyklisch._.cEEpromChannel._.ZFFSAB.eepromChannel[45].EEpromZentralHandler._.ZFFSAB ECU_ADDRESS 0xFFF97E57 /end MEASUREMENT
/begin MEASUREMENT ZFFSAB._.EEpromZentralHandler.eepromChannel[45].ZFFSAB._.cEEpromChannel._.eeprom_info "argument of SetEEpromInitZyklisch" UBYTE SAB_STANDARD_S2_S3 1 100 0 255 DISPLAY_IDENTIFIER eeprom_info._.cEEpromChannel._.ZFFSAB.eepromChannel[45].EEpromZentralHandler._.ZFFSAB ECU_ADDRESS 0xFFF97E58 /end MEASUREMENT
/begin MEASUREMENT ZFFSAB._.EEpromZentralHandler.eepromChannel[45].ZFFSAB._.cEEpromChannel._.cnt_GetSizeofEEpromData "Call counter off function" UBYTE SAB_STANDARD_S2_S3 1 100 0 255 DISPLAY_IDENTIFIER cnt_GetSizeofEEpromData._.cEEpromChannel._.ZFFSAB.eepromChannel[45].EEpromZentralHandler._.ZFFSAB ECU_ADDRESS 0xFFF97E59 /end MEASUREMENT
/begin MEASUREMENT ZFFSAB._.EEpromZentralHandler.eepromChannel[45].ZFFSAB._.cEEpromChannel._.ret_GetSizeofEEpromData "Return value off function" UWORD SAB_STANDARD_S2_S3 1 100 0 65535 DISPLAY_IDENTIFIER ret_GetSizeofEEpromData._.cEEpromChannel._.ZFFSAB.eepromChannel[45].EEpromZentralHandler._.ZFFSAB ECU_ADDRESS 0xFFF97E5A /end MEASUREMENT
/begin MEASUREMENT ZFFSAB._.EEpromZentralHandler.eepromChannel[45].cnt_CallEEpromStoreImmediate "Call counter off function" UBYTE SAB_STANDARD_S2_S3 1 100 0 255 DISPLAY_IDENTIFIER cnt_CallEEpromStoreImmediate.eepromChannel[45].EEpromZentralHandler._.ZFFSAB ECU_ADDRESS 0xFFF97E5C /end MEASUREMENT
/begin MEASUREMENT ZFFSAB._.EEpromZentralHandler.eepromChannel[45].ret_CallEEpromStoreImmediate "Return value off function" UBYTE SAB_STANDARD_S2_S3 1 100 0 255 DISPLAY_IDENTIFIER ret_CallEEpromStoreImmediate.eepromChannel[45].EEpromZentralHandler._.ZFFSAB ECU_ADDRESS 0xFFF97E5D /end MEASUREMENT
/begin MEASUREMENT ZFFSAB._.EEpromZentralHandler.eepromChannel[45].cnt_CallEEpromLoadData "Call counter off function" UBYTE SAB_STANDARD_S2_S3 1 100 0 255 DISPLAY_IDENTIFIER cnt_CallEEpromLoadData.eepromChannel[45].EEpromZentralHandler._.ZFFSAB ECU_ADDRESS 0xFFF97E5E /end MEASUREMENT
/begin MEASUREMENT ZFFSAB._.EEpromZentralHandler.eepromChannel[45].ret_CallEEpromLoadData "Return value off function" UBYTE SAB_STANDARD_S2_S3 1 100 0 255 DISPLAY_IDENTIFIER ret_CallEEpromLoadData.eepromChannel[45].EEpromZentralHandler._.ZFFSAB ECU_ADDRESS 0xFFF97E5F /end MEASUREMENT
/begin MEASUREMENT ZFFSAB._.EEpromZentralHandler.eepromChannel[45].cnt_CallEEpromLoadDataState "Call counter off function" UBYTE SAB_STANDARD_S2_S3 1 100 0 255 DISPLAY_IDENTIFIER cnt_CallEEpromLoadDataState.eepromChannel[45].EEpromZentralHandler._.ZFFSAB ECU_ADDRESS 0xFFF97E60 /end MEASUREMENT
/begin MEASUREMENT ZFFSAB._.EEpromZentralHandler.eepromChannel[45].ret_CallEEpromLoadDataState "Return value off function" UBYTE SAB_STANDARD_S2_S3 1 100 0 255 DISPLAY_IDENTIFIER ret_CallEEpromLoadDataState.eepromChannel[45].EEpromZentralHandler._.ZFFSAB ECU_ADDRESS 0xFFF97E61 /end MEASUREMENT
/begin MEASUREMENT ZFFSAB._.EEpromZentralHandler.eepromChannel[45].mode "argument of SetEEpromInitZyklisch" UBYTE SAB_STANDARD_S2_S3 1 100 0 255 DISPLAY_IDENTIFIER mode.eepromChannel[45].EEpromZentralHandler._.ZFFSAB ECU_ADDRESS 0xFFF97E62 /end MEASUREMENT
/begin MEASUREMENT ZFFSAB._.EEpromZentralHandler.eepromChannel[45].cnt_SetEEpromWriteProtect "Call counter off function" UBYTE SAB_STANDARD_S2_S3 1 100 0 255 DISPLAY_IDENTIFIER cnt_SetEEpromWriteProtect.eepromChannel[45].EEpromZentralHandler._.ZFFSAB ECU_ADDRESS 0xFFF97E63 /end MEASUREMENT
/begin MEASUREMENT ZFFSAB._.EEpromZentralHandler.eepromChannel[46].ZFFSAB._.cEEpromChannel._.cnt_GetEEpromValid "Call counter off function" UBYTE SAB_STANDARD_S2_S3 1 100 0 255 DISPLAY_IDENTIFIER cnt_GetEEpromValid._.cEEpromChannel._.ZFFSAB.eepromChannel[46].EEpromZentralHandler._.ZFFSAB ECU_ADDRESS 0xFFF97E64 /end MEASUREMENT
/begin MEASUREMENT ZFFSAB._.EEpromZentralHandler.eepromChannel[46].ZFFSAB._.cEEpromChannel._.ret_GetEEpromValid "Return value off function" UBYTE SAB_STANDARD_S2_S3 1 100 0 255 DISPLAY_IDENTIFIER ret_GetEEpromValid._.cEEpromChannel._.ZFFSAB.eepromChannel[46].EEpromZentralHandler._.ZFFSAB ECU_ADDRESS 0xFFF97E65 /end MEASUREMENT
/begin MEASUREMENT ZFFSAB._.EEpromZentralHandler.eepromChannel[46].ZFFSAB._.cEEpromChannel._.cnt_GetEEpromUpdate "Call counter off function" UBYTE SAB_STANDARD_S2_S3 1 100 0 255 DISPLAY_IDENTIFIER cnt_GetEEpromUpdate._.cEEpromChannel._.ZFFSAB.eepromChannel[46].EEpromZentralHandler._.ZFFSAB ECU_ADDRESS 0xFFF97E66 /end MEASUREMENT
/begin MEASUREMENT ZFFSAB._.EEpromZentralHandler.eepromChannel[46].ZFFSAB._.cEEpromChannel._.ret_GetEEpromUpdate "Return value off function" UBYTE SAB_STANDARD_S2_S3 1 100 0 255 DISPLAY_IDENTIFIER ret_GetEEpromUpdate._.cEEpromChannel._.ZFFSAB.eepromChannel[46].EEpromZentralHandler._.ZFFSAB ECU_ADDRESS 0xFFF97E67 /end MEASUREMENT
/begin MEASUREMENT ZFFSAB._.EEpromZentralHandler.eepromChannel[46].ZFFSAB._.cEEpromChannel._.cnt_SetEEpromInitZyklisch "Call counter off function" UBYTE SAB_STANDARD_S2_S3 1 100 0 255 DISPLAY_IDENTIFIER cnt_SetEEpromInitZyklisch._.cEEpromChannel._.ZFFSAB.eepromChannel[46].EEpromZentralHandler._.ZFFSAB ECU_ADDRESS 0xFFF97E68 /end MEASUREMENT
/begin MEASUREMENT ZFFSAB._.EEpromZentralHandler.eepromChannel[46].ZFFSAB._.cEEpromChannel._.ret_SetEEpromInitZyklisch "Return value off function" UBYTE SAB_STANDARD_S2_S3 1 100 0 255 DISPLAY_IDENTIFIER ret_SetEEpromInitZyklisch._.cEEpromChannel._.ZFFSAB.eepromChannel[46].EEpromZentralHandler._.ZFFSAB ECU_ADDRESS 0xFFF97E69 /end MEASUREMENT
/begin MEASUREMENT ZFFSAB._.EEpromZentralHandler.eepromChannel[46].ZFFSAB._.cEEpromChannel._.eeprom_info "argument of SetEEpromInitZyklisch" UBYTE SAB_STANDARD_S2_S3 1 100 0 255 DISPLAY_IDENTIFIER eeprom_info._.cEEpromChannel._.ZFFSAB.eepromChannel[46].EEpromZentralHandler._.ZFFSAB ECU_ADDRESS 0xFFF97E6A /end MEASUREMENT
/begin MEASUREMENT ZFFSAB._.EEpromZentralHandler.eepromChannel[46].ZFFSAB._.cEEpromChannel._.cnt_GetSizeofEEpromData "Call counter off function" UBYTE SAB_STANDARD_S2_S3 1 100 0 255 DISPLAY_IDENTIFIER cnt_GetSizeofEEpromData._.cEEpromChannel._.ZFFSAB.eepromChannel[46].EEpromZentralHandler._.ZFFSAB ECU_ADDRESS 0xFFF97E6B /end MEASUREMENT
/begin MEASUREMENT ZFFSAB._.EEpromZentralHandler.eepromChannel[46].ZFFSAB._.cEEpromChannel._.ret_GetSizeofEEpromData "Return value off function" UWORD SAB_STANDARD_S2_S3 1 100 0 65535 DISPLAY_IDENTIFIER ret_GetSizeofEEpromData._.cEEpromChannel._.ZFFSAB.eepromChannel[46].EEpromZentralHandler._.ZFFSAB ECU_ADDRESS 0xFFF97E6C /end MEASUREMENT
/begin MEASUREMENT ZFFSAB._.EEpromZentralHandler.eepromChannel[46].cnt_CallEEpromStoreImmediate "Call counter off function" UBYTE SAB_STANDARD_S2_S3 1 100 0 255 DISPLAY_IDENTIFIER cnt_CallEEpromStoreImmediate.eepromChannel[46].EEpromZentralHandler._.ZFFSAB ECU_ADDRESS 0xFFF97E6E /end MEASUREMENT
/begin MEASUREMENT ZFFSAB._.EEpromZentralHandler.eepromChannel[46].ret_CallEEpromStoreImmediate "Return value off function" UBYTE SAB_STANDARD_S2_S3 1 100 0 255 DISPLAY_IDENTIFIER ret_CallEEpromStoreImmediate.eepromChannel[46].EEpromZentralHandler._.ZFFSAB ECU_ADDRESS 0xFFF97E6F /end MEASUREMENT
/begin MEASUREMENT ZFFSAB._.EEpromZentralHandler.eepromChannel[46].cnt_CallEEpromLoadData "Call counter off function" UBYTE SAB_STANDARD_S2_S3 1 100 0 255 DISPLAY_IDENTIFIER cnt_CallEEpromLoadData.eepromChannel[46].EEpromZentralHandler._.ZFFSAB ECU_ADDRESS 0xFFF97E70 /end MEASUREMENT
/begin MEASUREMENT ZFFSAB._.EEpromZentralHandler.eepromChannel[46].ret_CallEEpromLoadData "Return value off function" UBYTE SAB_STANDARD_S2_S3 1 100 0 255 DISPLAY_IDENTIFIER ret_CallEEpromLoadData.eepromChannel[46].EEpromZentralHandler._.ZFFSAB ECU_ADDRESS 0xFFF97E71 /end MEASUREMENT
/begin MEASUREMENT ZFFSAB._.EEpromZentralHandler.eepromChannel[46].cnt_CallEEpromLoadDataState "Call counter off function" UBYTE SAB_STANDARD_S2_S3 1 100 0 255 DISPLAY_IDENTIFIER cnt_CallEEpromLoadDataState.eepromChannel[46].EEpromZentralHandler._.ZFFSAB ECU_ADDRESS 0xFFF97E72 /end MEASUREMENT
/begin MEASUREMENT ZFFSAB._.EEpromZentralHandler.eepromChannel[46].ret_CallEEpromLoadDataState "Return value off function" UBYTE SAB_STANDARD_S2_S3 1 100 0 255 DISPLAY_IDENTIFIER ret_CallEEpromLoadDataState.eepromChannel[46].EEpromZentralHandler._.ZFFSAB ECU_ADDRESS 0xFFF97E73 /end MEASUREMENT
/begin MEASUREMENT ZFFSAB._.EEpromZentralHandler.eepromChannel[46].mode "argument of SetEEpromInitZyklisch" UBYTE SAB_STANDARD_S2_S3 1 100 0 255 DISPLAY_IDENTIFIER mode.eepromChannel[46].EEpromZentralHandler._.ZFFSAB ECU_ADDRESS 0xFFF97E74 /end MEASUREMENT
/begin MEASUREMENT ZFFSAB._.EEpromZentralHandler.eepromChannel[46].cnt_SetEEpromWriteProtect "Call counter off function" UBYTE SAB_STANDARD_S2_S3 1 100 0 255 DISPLAY_IDENTIFIER cnt_SetEEpromWriteProtect.eepromChannel[46].EEpromZentralHandler._.ZFFSAB ECU_ADDRESS 0xFFF97E75 /end MEASUREMENT
/begin MEASUREMENT ZFFSAB._.EEpromZentralHandler.eepromChannel[47].ZFFSAB._.cEEpromChannel._.cnt_GetEEpromValid "Call counter off function" UBYTE SAB_STANDARD_S2_S3 1 100 0 255 DISPLAY_IDENTIFIER cnt_GetEEpromValid._.cEEpromChannel._.ZFFSAB.eepromChannel[47].EEpromZentralHandler._.ZFFSAB ECU_ADDRESS 0xFFF97E76 /end MEASUREMENT
/begin MEASUREMENT ZFFSAB._.EEpromZentralHandler.eepromChannel[47].ZFFSAB._.cEEpromChannel._.ret_GetEEpromValid "Return value off function" UBYTE SAB_STANDARD_S2_S3 1 100 0 255 DISPLAY_IDENTIFIER ret_GetEEpromValid._.cEEpromChannel._.ZFFSAB.eepromChannel[47].EEpromZentralHandler._.ZFFSAB ECU_ADDRESS 0xFFF97E77 /end MEASUREMENT
/begin MEASUREMENT ZFFSAB._.EEpromZentralHandler.eepromChannel[47].ZFFSAB._.cEEpromChannel._.cnt_GetEEpromUpdate "Call counter off function" UBYTE SAB_STANDARD_S2_S3 1 100 0 255 DISPLAY_IDENTIFIER cnt_GetEEpromUpdate._.cEEpromChannel._.ZFFSAB.eepromChannel[47].EEpromZentralHandler._.ZFFSAB ECU_ADDRESS 0xFFF97E78 /end MEASUREMENT
/begin MEASUREMENT ZFFSAB._.EEpromZentralHandler.eepromChannel[47].ZFFSAB._.cEEpromChannel._.ret_GetEEpromUpdate "Return value off function" UBYTE SAB_STANDARD_S2_S3 1 100 0 255 DISPLAY_IDENTIFIER ret_GetEEpromUpdate._.cEEpromChannel._.ZFFSAB.eepromChannel[47].EEpromZentralHandler._.ZFFSAB ECU_ADDRESS 0xFFF97E79 /end MEASUREMENT
/begin MEASUREMENT ZFFSAB._.EEpromZentralHandler.eepromChannel[47].ZFFSAB._.cEEpromChannel._.cnt_SetEEpromInitZyklisch "Call counter off function" UBYTE SAB_STANDARD_S2_S3 1 100 0 255 DISPLAY_IDENTIFIER cnt_SetEEpromInitZyklisch._.cEEpromChannel._.ZFFSAB.eepromChannel[47].EEpromZentralHandler._.ZFFSAB ECU_ADDRESS 0xFFF97E7A /end MEASUREMENT
/begin MEASUREMENT ZFFSAB._.EEpromZentralHandler.eepromChannel[47].ZFFSAB._.cEEpromChannel._.ret_SetEEpromInitZyklisch "Return value off function" UBYTE SAB_STANDARD_S2_S3 1 100 0 255 DISPLAY_IDENTIFIER ret_SetEEpromInitZyklisch._.cEEpromChannel._.ZFFSAB.eepromChannel[47].EEpromZentralHandler._.ZFFSAB ECU_ADDRESS 0xFFF97E7B /end MEASUREMENT
/begin MEASUREMENT ZFFSAB._.EEpromZentralHandler.eepromChannel[47].ZFFSAB._.cEEpromChannel._.eeprom_info "argument of SetEEpromInitZyklisch" UBYTE SAB_STANDARD_S2_S3 1 100 0 255 DISPLAY_IDENTIFIER eeprom_info._.cEEpromChannel._.ZFFSAB.eepromChannel[47].EEpromZentralHandler._.ZFFSAB ECU_ADDRESS 0xFFF97E7C /end MEASUREMENT
/begin MEASUREMENT ZFFSAB._.EEpromZentralHandler.eepromChannel[47].ZFFSAB._.cEEpromChannel._.cnt_GetSizeofEEpromData "Call counter off function" UBYTE SAB_STANDARD_S2_S3 1 100 0 255 DISPLAY_IDENTIFIER cnt_GetSizeofEEpromData._.cEEpromChannel._.ZFFSAB.eepromChannel[47].EEpromZentralHandler._.ZFFSAB ECU_ADDRESS 0xFFF97E7D /end MEASUREMENT
/begin MEASUREMENT ZFFSAB._.EEpromZentralHandler.eepromChannel[47].ZFFSAB._.cEEpromChannel._.ret_GetSizeofEEpromData "Return value off function" UWORD SAB_STANDARD_S2_S3 1 100 0 65535 DISPLAY_IDENTIFIER ret_GetSizeofEEpromData._.cEEpromChannel._.ZFFSAB.eepromChannel[47].EEpromZentralHandler._.ZFFSAB ECU_ADDRESS 0xFFF97E7E /end MEASUREMENT
/begin MEASUREMENT ZFFSAB._.EEpromZentralHandler.eepromChannel[47].cnt_CallEEpromStoreImmediate "Call counter off function" UBYTE SAB_STANDARD_S2_S3 1 100 0 255 DISPLAY_IDENTIFIER cnt_CallEEpromStoreImmediate.eepromChannel[47].EEpromZentralHandler._.ZFFSAB ECU_ADDRESS 0xFFF97E80 /end MEASUREMENT
/begin MEASUREMENT ZFFSAB._.EEpromZentralHandler.eepromChannel[47].ret_CallEEpromStoreImmediate "Return value off function" UBYTE SAB_STANDARD_S2_S3 1 100 0 255 DISPLAY_IDENTIFIER ret_CallEEpromStoreImmediate.eepromChannel[47].EEpromZentralHandler._.ZFFSAB ECU_ADDRESS 0xFFF97E81 /end MEASUREMENT
/begin MEASUREMENT ZFFSAB._.EEpromZentralHandler.eepromChannel[47].cnt_CallEEpromLoadData "Call counter off function" UBYTE SAB_STANDARD_S2_S3 1 100 0 255 DISPLAY_IDENTIFIER cnt_CallEEpromLoadData.eepromChannel[47].EEpromZentralHandler._.ZFFSAB ECU_ADDRESS 0xFFF97E82 /end MEASUREMENT
/begin MEASUREMENT ZFFSAB._.EEpromZentralHandler.eepromChannel[47].ret_CallEEpromLoadData "Return value off function" UBYTE SAB_STANDARD_S2_S3 1 100 0 255 DISPLAY_IDENTIFIER ret_CallEEpromLoadData.eepromChannel[47].EEpromZentralHandler._.ZFFSAB ECU_ADDRESS 0xFFF97E83 /end MEASUREMENT
/begin MEASUREMENT ZFFSAB._.EEpromZentralHandler.eepromChannel[47].cnt_CallEEpromLoadDataState "Call counter off function" UBYTE SAB_STANDARD_S2_S3 1 100 0 255 DISPLAY_IDENTIFIER cnt_CallEEpromLoadDataState.eepromChannel[47].EEpromZentralHandler._.ZFFSAB ECU_ADDRESS 0xFFF97E84 /end MEASUREMENT
/begin MEASUREMENT ZFFSAB._.EEpromZentralHandler.eepromChannel[47].ret_CallEEpromLoadDataState "Return value off function" UBYTE SAB_STANDARD_S2_S3 1 100 0 255 DISPLAY_IDENTIFIER ret_CallEEpromLoadDataState.eepromChannel[47].EEpromZentralHandler._.ZFFSAB ECU_ADDRESS 0xFFF97E85 /end MEASUREMENT
/begin MEASUREMENT ZFFSAB._.EEpromZentralHandler.eepromChannel[47].mode "argument of SetEEpromInitZyklisch" UBYTE SAB_STANDARD_S2_S3 1 100 0 255 DISPLAY_IDENTIFIER mode.eepromChannel[47].EEpromZentralHandler._.ZFFSAB ECU_ADDRESS 0xFFF97E86 /end MEASUREMENT
/begin MEASUREMENT ZFFSAB._.EEpromZentralHandler.eepromChannel[47].cnt_SetEEpromWriteProtect "Call counter off function" UBYTE SAB_STANDARD_S2_S3 1 100 0 255 DISPLAY_IDENTIFIER cnt_SetEEpromWriteProtect.eepromChannel[47].EEpromZentralHandler._.ZFFSAB ECU_ADDRESS 0xFFF97E87 /end MEASUREMENT
/begin MEASUREMENT ZFFSAB._.EEpromZentralHandler.eepromChannel[48].ZFFSAB._.cEEpromChannel._.cnt_GetEEpromValid "Call counter off function" UBYTE SAB_STANDARD_S2_S3 1 100 0 255 DISPLAY_IDENTIFIER cnt_GetEEpromValid._.cEEpromChannel._.ZFFSAB.eepromChannel[48].EEpromZentralHandler._.ZFFSAB ECU_ADDRESS 0xFFF97E88 /end MEASUREMENT
/begin MEASUREMENT ZFFSAB._.EEpromZentralHandler.eepromChannel[48].ZFFSAB._.cEEpromChannel._.ret_GetEEpromValid "Return value off function" UBYTE SAB_STANDARD_S2_S3 1 100 0 255 DISPLAY_IDENTIFIER ret_GetEEpromValid._.cEEpromChannel._.ZFFSAB.eepromChannel[48].EEpromZentralHandler._.ZFFSAB ECU_ADDRESS 0xFFF97E89 /end MEASUREMENT
/begin MEASUREMENT ZFFSAB._.EEpromZentralHandler.eepromChannel[48].ZFFSAB._.cEEpromChannel._.cnt_GetEEpromUpdate "Call counter off function" UBYTE SAB_STANDARD_S2_S3 1 100 0 255 DISPLAY_IDENTIFIER cnt_GetEEpromUpdate._.cEEpromChannel._.ZFFSAB.eepromChannel[48].EEpromZentralHandler._.ZFFSAB ECU_ADDRESS 0xFFF97E8A /end MEASUREMENT
/begin MEASUREMENT ZFFSAB._.EEpromZentralHandler.eepromChannel[48].ZFFSAB._.cEEpromChannel._.ret_GetEEpromUpdate "Return value off function" UBYTE SAB_STANDARD_S2_S3 1 100 0 255 DISPLAY_IDENTIFIER ret_GetEEpromUpdate._.cEEpromChannel._.ZFFSAB.eepromChannel[48].EEpromZentralHandler._.ZFFSAB ECU_ADDRESS 0xFFF97E8B /end MEASUREMENT
/begin MEASUREMENT ZFFSAB._.EEpromZentralHandler.eepromChannel[48].ZFFSAB._.cEEpromChannel._.cnt_SetEEpromInitZyklisch "Call counter off function" UBYTE SAB_STANDARD_S2_S3 1 100 0 255 DISPLAY_IDENTIFIER cnt_SetEEpromInitZyklisch._.cEEpromChannel._.ZFFSAB.eepromChannel[48].EEpromZentralHandler._.ZFFSAB ECU_ADDRESS 0xFFF97E8C /end MEASUREMENT
/begin MEASUREMENT ZFFSAB._.EEpromZentralHandler.eepromChannel[48].ZFFSAB._.cEEpromChannel._.ret_SetEEpromInitZyklisch "Return value off function" UBYTE SAB_STANDARD_S2_S3 1 100 0 255 DISPLAY_IDENTIFIER ret_SetEEpromInitZyklisch._.cEEpromChannel._.ZFFSAB.eepromChannel[48].EEpromZentralHandler._.ZFFSAB ECU_ADDRESS 0xFFF97E8D /end MEASUREMENT
/begin MEASUREMENT ZFFSAB._.EEpromZentralHandler.eepromChannel[48].ZFFSAB._.cEEpromChannel._.eeprom_info "argument of SetEEpromInitZyklisch" UBYTE SAB_STANDARD_S2_S3 1 100 0 255 DISPLAY_IDENTIFIER eeprom_info._.cEEpromChannel._.ZFFSAB.eepromChannel[48].EEpromZentralHandler._.ZFFSAB ECU_ADDRESS 0xFFF97E8E /end MEASUREMENT
/begin MEASUREMENT ZFFSAB._.EEpromZentralHandler.eepromChannel[48].ZFFSAB._.cEEpromChannel._.cnt_GetSizeofEEpromData "Call counter off function" UBYTE SAB_STANDARD_S2_S3 1 100 0 255 DISPLAY_IDENTIFIER cnt_GetSizeofEEpromData._.cEEpromChannel._.ZFFSAB.eepromChannel[48].EEpromZentralHandler._.ZFFSAB ECU_ADDRESS 0xFFF97E8F /end MEASUREMENT
/begin MEASUREMENT ZFFSAB._.EEpromZentralHandler.eepromChannel[48].ZFFSAB._.cEEpromChannel._.ret_GetSizeofEEpromData "Return value off function" UWORD SAB_STANDARD_S2_S3 1 100 0 65535 DISPLAY_IDENTIFIER ret_GetSizeofEEpromData._.cEEpromChannel._.ZFFSAB.eepromChannel[48].EEpromZentralHandler._.ZFFSAB ECU_ADDRESS 0xFFF97E90 /end MEASUREMENT
/begin MEASUREMENT ZFFSAB._.EEpromZentralHandler.eepromChannel[48].cnt_CallEEpromStoreImmediate "Call counter off function" UBYTE SAB_STANDARD_S2_S3 1 100 0 255 DISPLAY_IDENTIFIER cnt_CallEEpromStoreImmediate.eepromChannel[48].EEpromZentralHandler._.ZFFSAB ECU_ADDRESS 0xFFF97E92 /end MEASUREMENT
/begin MEASUREMENT ZFFSAB._.EEpromZentralHandler.eepromChannel[48].ret_CallEEpromStoreImmediate "Return value off function" UBYTE SAB_STANDARD_S2_S3 1 100 0 255 DISPLAY_IDENTIFIER ret_CallEEpromStoreImmediate.eepromChannel[48].EEpromZentralHandler._.ZFFSAB ECU_ADDRESS 0xFFF97E93 /end MEASUREMENT
/begin MEASUREMENT ZFFSAB._.EEpromZentralHandler.eepromChannel[48].cnt_CallEEpromLoadData "Call counter off function" UBYTE SAB_STANDARD_S2_S3 1 100 0 255 DISPLAY_IDENTIFIER cnt_CallEEpromLoadData.eepromChannel[48].EEpromZentralHandler._.ZFFSAB ECU_ADDRESS 0xFFF97E94 /end MEASUREMENT
/begin MEASUREMENT ZFFSAB._.EEpromZentralHandler.eepromChannel[48].ret_CallEEpromLoadData "Return value off function" UBYTE SAB_STANDARD_S2_S3 1 100 0 255 DISPLAY_IDENTIFIER ret_CallEEpromLoadData.eepromChannel[48].EEpromZentralHandler._.ZFFSAB ECU_ADDRESS 0xFFF97E95 /end MEASUREMENT
/begin MEASUREMENT ZFFSAB._.EEpromZentralHandler.eepromChannel[48].cnt_CallEEpromLoadDataState "Call counter off function" UBYTE SAB_STANDARD_S2_S3 1 100 0 255 DISPLAY_IDENTIFIER cnt_CallEEpromLoadDataState.eepromChannel[48].EEpromZentralHandler._.ZFFSAB ECU_ADDRESS 0xFFF97E96 /end MEASUREMENT
/begin MEASUREMENT ZFFSAB._.EEpromZentralHandler.eepromChannel[48].ret_CallEEpromLoadDataState "Return value off function" UBYTE SAB_STANDARD_S2_S3 1 100 0 255 DISPLAY_IDENTIFIER ret_CallEEpromLoadDataState.eepromChannel[48].EEpromZentralHandler._.ZFFSAB ECU_ADDRESS 0xFFF97E97 /end MEASUREMENT
/begin MEASUREMENT ZFFSAB._.EEpromZentralHandler.eepromChannel[48].mode "argument of SetEEpromInitZyklisch" UBYTE SAB_STANDARD_S2_S3 1 100 0 255 DISPLAY_IDENTIFIER mode.eepromChannel[48].EEpromZentralHandler._.ZFFSAB ECU_ADDRESS 0xFFF97E98 /end MEASUREMENT
/begin MEASUREMENT ZFFSAB._.EEpromZentralHandler.eepromChannel[48].cnt_SetEEpromWriteProtect "Call counter off function" UBYTE SAB_STANDARD_S2_S3 1 100 0 255 DISPLAY_IDENTIFIER cnt_SetEEpromWriteProtect.eepromChannel[48].EEpromZentralHandler._.ZFFSAB ECU_ADDRESS 0xFFF97E99 /end MEASUREMENT
/begin MEASUREMENT ZFFSAB._.EEpromZentralHandler.eepromChannel[49].ZFFSAB._.cEEpromChannel._.cnt_GetEEpromValid "Call counter off function" UBYTE SAB_STANDARD_S2_S3 1 100 0 255 DISPLAY_IDENTIFIER cnt_GetEEpromValid._.cEEpromChannel._.ZFFSAB.eepromChannel[49].EEpromZentralHandler._.ZFFSAB ECU_ADDRESS 0xFFF97E9A /end MEASUREMENT
/begin MEASUREMENT ZFFSAB._.EEpromZentralHandler.eepromChannel[49].ZFFSAB._.cEEpromChannel._.ret_GetEEpromValid "Return value off function" UBYTE SAB_STANDARD_S2_S3 1 100 0 255 DISPLAY_IDENTIFIER ret_GetEEpromValid._.cEEpromChannel._.ZFFSAB.eepromChannel[49].EEpromZentralHandler._.ZFFSAB ECU_ADDRESS 0xFFF97E9B /end MEASUREMENT
/begin MEASUREMENT ZFFSAB._.EEpromZentralHandler.eepromChannel[49].ZFFSAB._.cEEpromChannel._.cnt_GetEEpromUpdate "Call counter off function" UBYTE SAB_STANDARD_S2_S3 1 100 0 255 DISPLAY_IDENTIFIER cnt_GetEEpromUpdate._.cEEpromChannel._.ZFFSAB.eepromChannel[49].EEpromZentralHandler._.ZFFSAB ECU_ADDRESS 0xFFF97E9C /end MEASUREMENT
/begin MEASUREMENT ZFFSAB._.EEpromZentralHandler.eepromChannel[49].ZFFSAB._.cEEpromChannel._.ret_GetEEpromUpdate "Return value off function" UBYTE SAB_STANDARD_S2_S3 1 100 0 255 DISPLAY_IDENTIFIER ret_GetEEpromUpdate._.cEEpromChannel._.ZFFSAB.eepromChannel[49].EEpromZentralHandler._.ZFFSAB ECU_ADDRESS 0xFFF97E9D /end MEASUREMENT
/begin MEASUREMENT ZFFSAB._.EEpromZentralHandler.eepromChannel[49].ZFFSAB._.cEEpromChannel._.cnt_SetEEpromInitZyklisch "Call counter off function" UBYTE SAB_STANDARD_S2_S3 1 100 0 255 DISPLAY_IDENTIFIER cnt_SetEEpromInitZyklisch._.cEEpromChannel._.ZFFSAB.eepromChannel[49].EEpromZentralHandler._.ZFFSAB ECU_ADDRESS 0xFFF97E9E /end MEASUREMENT
/begin MEASUREMENT ZFFSAB._.EEpromZentralHandler.eepromChannel[49].ZFFSAB._.cEEpromChannel._.ret_SetEEpromInitZyklisch "Return value off function" UBYTE SAB_STANDARD_S2_S3 1 100 0 255 DISPLAY_IDENTIFIER ret_SetEEpromInitZyklisch._.cEEpromChannel._.ZFFSAB.eepromChannel[49].EEpromZentralHandler._.ZFFSAB ECU_ADDRESS 0xFFF97E9F /end MEASUREMENT
/begin MEASUREMENT ZFFSAB._.EEpromZentralHandler.eepromChannel[49].ZFFSAB._.cEEpromChannel._.eeprom_info "argument of SetEEpromInitZyklisch" UBYTE SAB_STANDARD_S2_S3 1 100 0 255 DISPLAY_IDENTIFIER eeprom_info._.cEEpromChannel._.ZFFSAB.eepromChannel[49].EEpromZentralHandler._.ZFFSAB ECU_ADDRESS 0xFFF97EA0 /end MEASUREMENT
/begin MEASUREMENT ZFFSAB._.EEpromZentralHandler.eepromChannel[49].ZFFSAB._.cEEpromChannel._.cnt_GetSizeofEEpromData "Call counter off function" UBYTE SAB_STANDARD_S2_S3 1 100 0 255 DISPLAY_IDENTIFIER cnt_GetSizeofEEpromData._.cEEpromChannel._.ZFFSAB.eepromChannel[49].EEpromZentralHandler._.ZFFSAB ECU_ADDRESS 0xFFF97EA1 /end MEASUREMENT
/begin MEASUREMENT ZFFSAB._.EEpromZentralHandler.eepromChannel[49].ZFFSAB._.cEEpromChannel._.ret_GetSizeofEEpromData "Return value off function" UWORD SAB_STANDARD_S2_S3 1 100 0 65535 DISPLAY_IDENTIFIER ret_GetSizeofEEpromData._.cEEpromChannel._.ZFFSAB.eepromChannel[49].EEpromZentralHandler._.ZFFSAB ECU_ADDRESS 0xFFF97EA2 /end MEASUREMENT
/begin MEASUREMENT ZFFSAB._.EEpromZentralHandler.eepromChannel[49].cnt_CallEEpromStoreImmediate "Call counter off function" UBYTE SAB_STANDARD_S2_S3 1 100 0 255 DISPLAY_IDENTIFIER cnt_CallEEpromStoreImmediate.eepromChannel[49].EEpromZentralHandler._.ZFFSAB ECU_ADDRESS 0xFFF97EA4 /end MEASUREMENT
/begin MEASUREMENT ZFFSAB._.EEpromZentralHandler.eepromChannel[49].ret_CallEEpromStoreImmediate "Return value off function" UBYTE SAB_STANDARD_S2_S3 1 100 0 255 DISPLAY_IDENTIFIER ret_CallEEpromStoreImmediate.eepromChannel[49].EEpromZentralHandler._.ZFFSAB ECU_ADDRESS 0xFFF97EA5 /end MEASUREMENT
/begin MEASUREMENT ZFFSAB._.EEpromZentralHandler.eepromChannel[49].cnt_CallEEpromLoadData "Call counter off function" UBYTE SAB_STANDARD_S2_S3 1 100 0 255 DISPLAY_IDENTIFIER cnt_CallEEpromLoadData.eepromChannel[49].EEpromZentralHandler._.ZFFSAB ECU_ADDRESS 0xFFF97EA6 /end MEASUREMENT
/begin MEASUREMENT ZFFSAB._.EEpromZentralHandler.eepromChannel[49].ret_CallEEpromLoadData "Return value off function" UBYTE SAB_STANDARD_S2_S3 1 100 0 255 DISPLAY_IDENTIFIER ret_CallEEpromLoadData.eepromChannel[49].EEpromZentralHandler._.ZFFSAB ECU_ADDRESS 0xFFF97EA7 /end MEASUREMENT
/begin MEASUREMENT ZFFSAB._.EEpromZentralHandler.eepromChannel[49].cnt_CallEEpromLoadDataState "Call counter off function" UBYTE SAB_STANDARD_S2_S3 1 100 0 255 DISPLAY_IDENTIFIER cnt_CallEEpromLoadDataState.eepromChannel[49].EEpromZentralHandler._.ZFFSAB ECU_ADDRESS 0xFFF97EA8 /end MEASUREMENT
/begin MEASUREMENT ZFFSAB._.EEpromZentralHandler.eepromChannel[49].ret_CallEEpromLoadDataState "Return value off function" UBYTE SAB_STANDARD_S2_S3 1 100 0 255 DISPLAY_IDENTIFIER ret_CallEEpromLoadDataState.eepromChannel[49].EEpromZentralHandler._.ZFFSAB ECU_ADDRESS 0xFFF97EA9 /end MEASUREMENT
/begin MEASUREMENT ZFFSAB._.EEpromZentralHandler.eepromChannel[49].mode "argument of SetEEpromInitZyklisch" UBYTE SAB_STANDARD_S2_S3 1 100 0 255 DISPLAY_IDENTIFIER mode.eepromChannel[49].EEpromZentralHandler._.ZFFSAB ECU_ADDRESS 0xFFF97EAA /end MEASUREMENT
/begin MEASUREMENT ZFFSAB._.EEpromZentralHandler.eepromChannel[49].cnt_SetEEpromWriteProtect "Call counter off function" UBYTE SAB_STANDARD_S2_S3 1 100 0 255 DISPLAY_IDENTIFIER cnt_SetEEpromWriteProtect.eepromChannel[49].EEpromZentralHandler._.ZFFSAB ECU_ADDRESS 0xFFF97EAB /end MEASUREMENT
/begin MEASUREMENT ZFFSAB._.EEpromZentralHandler.eepromChannel[50].ZFFSAB._.cEEpromChannel._.cnt_GetEEpromValid "Call counter off function" UBYTE SAB_STANDARD_S2_S3 1 100 0 255 DISPLAY_IDENTIFIER cnt_GetEEpromValid._.cEEpromChannel._.ZFFSAB.eepromChannel[50].EEpromZentralHandler._.ZFFSAB ECU_ADDRESS 0xFFF97EAC /end MEASUREMENT
/begin MEASUREMENT ZFFSAB._.EEpromZentralHandler.eepromChannel[50].ZFFSAB._.cEEpromChannel._.ret_GetEEpromValid "Return value off function" UBYTE SAB_STANDARD_S2_S3 1 100 0 255 DISPLAY_IDENTIFIER ret_GetEEpromValid._.cEEpromChannel._.ZFFSAB.eepromChannel[50].EEpromZentralHandler._.ZFFSAB ECU_ADDRESS 0xFFF97EAD /end MEASUREMENT
/begin MEASUREMENT ZFFSAB._.EEpromZentralHandler.eepromChannel[50].ZFFSAB._.cEEpromChannel._.cnt_GetEEpromUpdate "Call counter off function" UBYTE SAB_STANDARD_S2_S3 1 100 0 255 DISPLAY_IDENTIFIER cnt_GetEEpromUpdate._.cEEpromChannel._.ZFFSAB.eepromChannel[50].EEpromZentralHandler._.ZFFSAB ECU_ADDRESS 0xFFF97EAE /end MEASUREMENT
/begin MEASUREMENT ZFFSAB._.EEpromZentralHandler.eepromChannel[50].ZFFSAB._.cEEpromChannel._.ret_GetEEpromUpdate "Return value off function" UBYTE SAB_STANDARD_S2_S3 1 100 0 255 DISPLAY_IDENTIFIER ret_GetEEpromUpdate._.cEEpromChannel._.ZFFSAB.eepromChannel[50].EEpromZentralHandler._.ZFFSAB ECU_ADDRESS 0xFFF97EAF /end MEASUREMENT
/begin MEASUREMENT ZFFSAB._.EEpromZentralHandler.eepromChannel[50].ZFFSAB._.cEEpromChannel._.cnt_SetEEpromInitZyklisch "Call counter off function" UBYTE SAB_STANDARD_S2_S3 1 100 0 255 DISPLAY_IDENTIFIER cnt_SetEEpromInitZyklisch._.cEEpromChannel._.ZFFSAB.eepromChannel[50].EEpromZentralHandler._.ZFFSAB ECU_ADDRESS 0xFFF97EB0 /end MEASUREMENT
/begin MEASUREMENT ZFFSAB._.EEpromZentralHandler.eepromChannel[50].ZFFSAB._.cEEpromChannel._.ret_SetEEpromInitZyklisch "Return value off function" UBYTE SAB_STANDARD_S2_S3 1 100 0 255 DISPLAY_IDENTIFIER ret_SetEEpromInitZyklisch._.cEEpromChannel._.ZFFSAB.eepromChannel[50].EEpromZentralHandler._.ZFFSAB ECU_ADDRESS 0xFFF97EB1 /end MEASUREMENT
/begin MEASUREMENT ZFFSAB._.EEpromZentralHandler.eepromChannel[50].ZFFSAB._.cEEpromChannel._.eeprom_info "argument of SetEEpromInitZyklisch" UBYTE SAB_STANDARD_S2_S3 1 100 0 255 DISPLAY_IDENTIFIER eeprom_info._.cEEpromChannel._.ZFFSAB.eepromChannel[50].EEpromZentralHandler._.ZFFSAB ECU_ADDRESS 0xFFF97EB2 /end MEASUREMENT
/begin MEASUREMENT ZFFSAB._.EEpromZentralHandler.eepromChannel[50].ZFFSAB._.cEEpromChannel._.cnt_GetSizeofEEpromData "Call counter off function" UBYTE SAB_STANDARD_S2_S3 1 100 0 255 DISPLAY_IDENTIFIER cnt_GetSizeofEEpromData._.cEEpromChannel._.ZFFSAB.eepromChannel[50].EEpromZentralHandler._.ZFFSAB ECU_ADDRESS 0xFFF97EB3 /end MEASUREMENT
/begin MEASUREMENT ZFFSAB._.EEpromZentralHandler.eepromChannel[50].ZFFSAB._.cEEpromChannel._.ret_GetSizeofEEpromData "Return value off function" UWORD SAB_STANDARD_S2_S3 1 100 0 65535 DISPLAY_IDENTIFIER ret_GetSizeofEEpromData._.cEEpromChannel._.ZFFSAB.eepromChannel[50].EEpromZentralHandler._.ZFFSAB ECU_ADDRESS 0xFFF97EB4 /end MEASUREMENT
/begin MEASUREMENT ZFFSAB._.EEpromZentralHandler.eepromChannel[50].cnt_CallEEpromStoreImmediate "Call counter off function" UBYTE SAB_STANDARD_S2_S3 1 100 0 255 DISPLAY_IDENTIFIER cnt_CallEEpromStoreImmediate.eepromChannel[50].EEpromZentralHandler._.ZFFSAB ECU_ADDRESS 0xFFF97EB6 /end MEASUREMENT
/begin MEASUREMENT ZFFSAB._.EEpromZentralHandler.eepromChannel[50].ret_CallEEpromStoreImmediate "Return value off function" UBYTE SAB_STANDARD_S2_S3 1 100 0 255 DISPLAY_IDENTIFIER ret_CallEEpromStoreImmediate.eepromChannel[50].EEpromZentralHandler._.ZFFSAB ECU_ADDRESS 0xFFF97EB7 /end MEASUREMENT
/begin MEASUREMENT ZFFSAB._.EEpromZentralHandler.eepromChannel[50].cnt_CallEEpromLoadData "Call counter off function" UBYTE SAB_STANDARD_S2_S3 1 100 0 255 DISPLAY_IDENTIFIER cnt_CallEEpromLoadData.eepromChannel[50].EEpromZentralHandler._.ZFFSAB ECU_ADDRESS 0xFFF97EB8 /end MEASUREMENT
/begin MEASUREMENT ZFFSAB._.EEpromZentralHandler.eepromChannel[50].ret_CallEEpromLoadData "Return value off function" UBYTE SAB_STANDARD_S2_S3 1 100 0 255 DISPLAY_IDENTIFIER ret_CallEEpromLoadData.eepromChannel[50].EEpromZentralHandler._.ZFFSAB ECU_ADDRESS 0xFFF97EB9 /end MEASUREMENT
/begin MEASUREMENT ZFFSAB._.EEpromZentralHandler.eepromChannel[50].cnt_CallEEpromLoadDataState "Call counter off function" UBYTE SAB_STANDARD_S2_S3 1 100 0 255 DISPLAY_IDENTIFIER cnt_CallEEpromLoadDataState.eepromChannel[50].EEpromZentralHandler._.ZFFSAB ECU_ADDRESS 0xFFF97EBA /end MEASUREMENT
/begin MEASUREMENT ZFFSAB._.EEpromZentralHandler.eepromChannel[50].ret_CallEEpromLoadDataState "Return value off function" UBYTE SAB_STANDARD_S2_S3 1 100 0 255 DISPLAY_IDENTIFIER ret_CallEEpromLoadDataState.eepromChannel[50].EEpromZentralHandler._.ZFFSAB ECU_ADDRESS 0xFFF97EBB /end MEASUREMENT
/begin MEASUREMENT ZFFSAB._.EEpromZentralHandler.eepromChannel[50].mode "argument of SetEEpromInitZyklisch" UBYTE SAB_STANDARD_S2_S3 1 100 0 255 DISPLAY_IDENTIFIER mode.eepromChannel[50].EEpromZentralHandler._.ZFFSAB ECU_ADDRESS 0xFFF97EBC /end MEASUREMENT
/begin MEASUREMENT ZFFSAB._.EEpromZentralHandler.eepromChannel[50].cnt_SetEEpromWriteProtect "Call counter off function" UBYTE SAB_STANDARD_S2_S3 1 100 0 255 DISPLAY_IDENTIFIER cnt_SetEEpromWriteProtect.eepromChannel[50].EEpromZentralHandler._.ZFFSAB ECU_ADDRESS 0xFFF97EBD /end MEASUREMENT
/begin MEASUREMENT ZFFSAB._.EEpromZentralHandler.eepromChannel[51].ZFFSAB._.cEEpromChannel._.cnt_GetEEpromValid "Call counter off function" UBYTE SAB_STANDARD_S2_S3 1 100 0 255 DISPLAY_IDENTIFIER cnt_GetEEpromValid._.cEEpromChannel._.ZFFSAB.eepromChannel[51].EEpromZentralHandler._.ZFFSAB ECU_ADDRESS 0xFFF97EBE /end MEASUREMENT
/begin MEASUREMENT ZFFSAB._.EEpromZentralHandler.eepromChannel[51].ZFFSAB._.cEEpromChannel._.ret_GetEEpromValid "Return value off function" UBYTE SAB_STANDARD_S2_S3 1 100 0 255 DISPLAY_IDENTIFIER ret_GetEEpromValid._.cEEpromChannel._.ZFFSAB.eepromChannel[51].EEpromZentralHandler._.ZFFSAB ECU_ADDRESS 0xFFF97EBF /end MEASUREMENT
/begin MEASUREMENT ZFFSAB._.EEpromZentralHandler.eepromChannel[51].ZFFSAB._.cEEpromChannel._.cnt_GetEEpromUpdate "Call counter off function" UBYTE SAB_STANDARD_S2_S3 1 100 0 255 DISPLAY_IDENTIFIER cnt_GetEEpromUpdate._.cEEpromChannel._.ZFFSAB.eepromChannel[51].EEpromZentralHandler._.ZFFSAB ECU_ADDRESS 0xFFF97EC0 /end MEASUREMENT
/begin MEASUREMENT ZFFSAB._.EEpromZentralHandler.eepromChannel[51].ZFFSAB._.cEEpromChannel._.ret_GetEEpromUpdate "Return value off function" UBYTE SAB_STANDARD_S2_S3 1 100 0 255 DISPLAY_IDENTIFIER ret_GetEEpromUpdate._.cEEpromChannel._.ZFFSAB.eepromChannel[51].EEpromZentralHandler._.ZFFSAB ECU_ADDRESS 0xFFF97EC1 /end MEASUREMENT
/begin MEASUREMENT ZFFSAB._.EEpromZentralHandler.eepromChannel[51].ZFFSAB._.cEEpromChannel._.cnt_SetEEpromInitZyklisch "Call counter off function" UBYTE SAB_STANDARD_S2_S3 1 100 0 255 DISPLAY_IDENTIFIER cnt_SetEEpromInitZyklisch._.cEEpromChannel._.ZFFSAB.eepromChannel[51].EEpromZentralHandler._.ZFFSAB ECU_ADDRESS 0xFFF97EC2 /end MEASUREMENT
/begin MEASUREMENT ZFFSAB._.EEpromZentralHandler.eepromChannel[51].ZFFSAB._.cEEpromChannel._.ret_SetEEpromInitZyklisch "Return value off function" UBYTE SAB_STANDARD_S2_S3 1 100 0 255 DISPLAY_IDENTIFIER ret_SetEEpromInitZyklisch._.cEEpromChannel._.ZFFSAB.eepromChannel[51].EEpromZentralHandler._.ZFFSAB ECU_ADDRESS 0xFFF97EC3 /end MEASUREMENT
/begin MEASUREMENT ZFFSAB._.EEpromZentralHandler.eepromChannel[51].ZFFSAB._.cEEpromChannel._.eeprom_info "argument of SetEEpromInitZyklisch" UBYTE SAB_STANDARD_S2_S3 1 100 0 255 DISPLAY_IDENTIFIER eeprom_info._.cEEpromChannel._.ZFFSAB.eepromChannel[51].EEpromZentralHandler._.ZFFSAB ECU_ADDRESS 0xFFF97EC4 /end MEASUREMENT
/begin MEASUREMENT ZFFSAB._.EEpromZentralHandler.eepromChannel[51].ZFFSAB._.cEEpromChannel._.cnt_GetSizeofEEpromData "Call counter off function" UBYTE SAB_STANDARD_S2_S3 1 100 0 255 DISPLAY_IDENTIFIER cnt_GetSizeofEEpromData._.cEEpromChannel._.ZFFSAB.eepromChannel[51].EEpromZentralHandler._.ZFFSAB ECU_ADDRESS 0xFFF97EC5 /end MEASUREMENT
/begin MEASUREMENT ZFFSAB._.EEpromZentralHandler.eepromChannel[51].ZFFSAB._.cEEpromChannel._.ret_GetSizeofEEpromData "Return value off function" UWORD SAB_STANDARD_S2_S3 1 100 0 65535 DISPLAY_IDENTIFIER ret_GetSizeofEEpromData._.cEEpromChannel._.ZFFSAB.eepromChannel[51].EEpromZentralHandler._.ZFFSAB ECU_ADDRESS 0xFFF97EC6 /end MEASUREMENT
/begin MEASUREMENT ZFFSAB._.EEpromZentralHandler.eepromChannel[51].cnt_CallEEpromStoreImmediate "Call counter off function" UBYTE SAB_STANDARD_S2_S3 1 100 0 255 DISPLAY_IDENTIFIER cnt_CallEEpromStoreImmediate.eepromChannel[51].EEpromZentralHandler._.ZFFSAB ECU_ADDRESS 0xFFF97EC8 /end MEASUREMENT
/begin MEASUREMENT ZFFSAB._.EEpromZentralHandler.eepromChannel[51].ret_CallEEpromStoreImmediate "Return value off function" UBYTE SAB_STANDARD_S2_S3 1 100 0 255 DISPLAY_IDENTIFIER ret_CallEEpromStoreImmediate.eepromChannel[51].EEpromZentralHandler._.ZFFSAB ECU_ADDRESS 0xFFF97EC9 /end MEASUREMENT
/begin MEASUREMENT ZFFSAB._.EEpromZentralHandler.eepromChannel[51].cnt_CallEEpromLoadData "Call counter off function" UBYTE SAB_STANDARD_S2_S3 1 100 0 255 DISPLAY_IDENTIFIER cnt_CallEEpromLoadData.eepromChannel[51].EEpromZentralHandler._.ZFFSAB ECU_ADDRESS 0xFFF97ECA /end MEASUREMENT
/begin MEASUREMENT ZFFSAB._.EEpromZentralHandler.eepromChannel[51].ret_CallEEpromLoadData "Return value off function" UBYTE SAB_STANDARD_S2_S3 1 100 0 255 DISPLAY_IDENTIFIER ret_CallEEpromLoadData.eepromChannel[51].EEpromZentralHandler._.ZFFSAB ECU_ADDRESS 0xFFF97ECB /end MEASUREMENT
/begin MEASUREMENT ZFFSAB._.EEpromZentralHandler.eepromChannel[51].cnt_CallEEpromLoadDataState "Call counter off function" UBYTE SAB_STANDARD_S2_S3 1 100 0 255 DISPLAY_IDENTIFIER cnt_CallEEpromLoadDataState.eepromChannel[51].EEpromZentralHandler._.ZFFSAB ECU_ADDRESS 0xFFF97ECC /end MEASUREMENT
/begin MEASUREMENT ZFFSAB._.EEpromZentralHandler.eepromChannel[51].ret_CallEEpromLoadDataState "Return value off function" UBYTE SAB_STANDARD_S2_S3 1 100 0 255 DISPLAY_IDENTIFIER ret_CallEEpromLoadDataState.eepromChannel[51].EEpromZentralHandler._.ZFFSAB ECU_ADDRESS 0xFFF97ECD /end MEASUREMENT
/begin MEASUREMENT ZFFSAB._.EEpromZentralHandler.eepromChannel[51].mode "argument of SetEEpromInitZyklisch" UBYTE SAB_STANDARD_S2_S3 1 100 0 255 DISPLAY_IDENTIFIER mode.eepromChannel[51].EEpromZentralHandler._.ZFFSAB ECU_ADDRESS 0xFFF97ECE /end MEASUREMENT
/begin MEASUREMENT ZFFSAB._.EEpromZentralHandler.eepromChannel[51].cnt_SetEEpromWriteProtect "Call counter off function" UBYTE SAB_STANDARD_S2_S3 1 100 0 255 DISPLAY_IDENTIFIER cnt_SetEEpromWriteProtect.eepromChannel[51].EEpromZentralHandler._.ZFFSAB ECU_ADDRESS 0xFFF97ECF /end MEASUREMENT
/begin MEASUREMENT ZFFSAB._.EEpromZentralHandler.eepromChannel[52].ZFFSAB._.cEEpromChannel._.cnt_GetEEpromValid "Call counter off function" UBYTE SAB_STANDARD_S2_S3 1 100 0 255 DISPLAY_IDENTIFIER cnt_GetEEpromValid._.cEEpromChannel._.ZFFSAB.eepromChannel[52].EEpromZentralHandler._.ZFFSAB ECU_ADDRESS 0xFFF97ED0 /end MEASUREMENT
/begin MEASUREMENT ZFFSAB._.EEpromZentralHandler.eepromChannel[52].ZFFSAB._.cEEpromChannel._.ret_GetEEpromValid "Return value off function" UBYTE SAB_STANDARD_S2_S3 1 100 0 255 DISPLAY_IDENTIFIER ret_GetEEpromValid._.cEEpromChannel._.ZFFSAB.eepromChannel[52].EEpromZentralHandler._.ZFFSAB ECU_ADDRESS 0xFFF97ED1 /end MEASUREMENT
/begin MEASUREMENT ZFFSAB._.EEpromZentralHandler.eepromChannel[52].ZFFSAB._.cEEpromChannel._.cnt_GetEEpromUpdate "Call counter off function" UBYTE SAB_STANDARD_S2_S3 1 100 0 255 DISPLAY_IDENTIFIER cnt_GetEEpromUpdate._.cEEpromChannel._.ZFFSAB.eepromChannel[52].EEpromZentralHandler._.ZFFSAB ECU_ADDRESS 0xFFF97ED2 /end MEASUREMENT
/begin MEASUREMENT ZFFSAB._.EEpromZentralHandler.eepromChannel[52].ZFFSAB._.cEEpromChannel._.ret_GetEEpromUpdate "Return value off function" UBYTE SAB_STANDARD_S2_S3 1 100 0 255 DISPLAY_IDENTIFIER ret_GetEEpromUpdate._.cEEpromChannel._.ZFFSAB.eepromChannel[52].EEpromZentralHandler._.ZFFSAB ECU_ADDRESS 0xFFF97ED3 /end MEASUREMENT
/begin MEASUREMENT ZFFSAB._.EEpromZentralHandler.eepromChannel[52].ZFFSAB._.cEEpromChannel._.cnt_SetEEpromInitZyklisch "Call counter off function" UBYTE SAB_STANDARD_S2_S3 1 100 0 255 DISPLAY_IDENTIFIER cnt_SetEEpromInitZyklisch._.cEEpromChannel._.ZFFSAB.eepromChannel[52].EEpromZentralHandler._.ZFFSAB ECU_ADDRESS 0xFFF97ED4 /end MEASUREMENT
/begin MEASUREMENT ZFFSAB._.EEpromZentralHandler.eepromChannel[52].ZFFSAB._.cEEpromChannel._.ret_SetEEpromInitZyklisch "Return value off function" UBYTE SAB_STANDARD_S2_S3 1 100 0 255 DISPLAY_IDENTIFIER ret_SetEEpromInitZyklisch._.cEEpromChannel._.ZFFSAB.eepromChannel[52].EEpromZentralHandler._.ZFFSAB ECU_ADDRESS 0xFFF97ED5 /end MEASUREMENT
/begin MEASUREMENT ZFFSAB._.EEpromZentralHandler.eepromChannel[52].ZFFSAB._.cEEpromChannel._.eeprom_info "argument of SetEEpromInitZyklisch" UBYTE SAB_STANDARD_S2_S3 1 100 0 255 DISPLAY_IDENTIFIER eeprom_info._.cEEpromChannel._.ZFFSAB.eepromChannel[52].EEpromZentralHandler._.ZFFSAB ECU_ADDRESS 0xFFF97ED6 /end MEASUREMENT
/begin MEASUREMENT ZFFSAB._.EEpromZentralHandler.eepromChannel[52].ZFFSAB._.cEEpromChannel._.cnt_GetSizeofEEpromData "Call counter off function" UBYTE SAB_STANDARD_S2_S3 1 100 0 255 DISPLAY_IDENTIFIER cnt_GetSizeofEEpromData._.cEEpromChannel._.ZFFSAB.eepromChannel[52].EEpromZentralHandler._.ZFFSAB ECU_ADDRESS 0xFFF97ED7 /end MEASUREMENT
/begin MEASUREMENT ZFFSAB._.EEpromZentralHandler.eepromChannel[52].ZFFSAB._.cEEpromChannel._.ret_GetSizeofEEpromData "Return value off function" UWORD SAB_STANDARD_S2_S3 1 100 0 65535 DISPLAY_IDENTIFIER ret_GetSizeofEEpromData._.cEEpromChannel._.ZFFSAB.eepromChannel[52].EEpromZentralHandler._.ZFFSAB ECU_ADDRESS 0xFFF97ED8 /end MEASUREMENT
/begin MEASUREMENT ZFFSAB._.EEpromZentralHandler.eepromChannel[52].cnt_CallEEpromStoreImmediate "Call counter off function" UBYTE SAB_STANDARD_S2_S3 1 100 0 255 DISPLAY_IDENTIFIER cnt_CallEEpromStoreImmediate.eepromChannel[52].EEpromZentralHandler._.ZFFSAB ECU_ADDRESS 0xFFF97EDA /end MEASUREMENT
/begin MEASUREMENT ZFFSAB._.EEpromZentralHandler.eepromChannel[52].ret_CallEEpromStoreImmediate "Return value off function" UBYTE SAB_STANDARD_S2_S3 1 100 0 255 DISPLAY_IDENTIFIER ret_CallEEpromStoreImmediate.eepromChannel[52].EEpromZentralHandler._.ZFFSAB ECU_ADDRESS 0xFFF97EDB /end MEASUREMENT
/begin MEASUREMENT ZFFSAB._.EEpromZentralHandler.eepromChannel[52].cnt_CallEEpromLoadData "Call counter off function" UBYTE SAB_STANDARD_S2_S3 1 100 0 255 DISPLAY_IDENTIFIER cnt_CallEEpromLoadData.eepromChannel[52].EEpromZentralHandler._.ZFFSAB ECU_ADDRESS 0xFFF97EDC /end MEASUREMENT
/begin MEASUREMENT ZFFSAB._.EEpromZentralHandler.eepromChannel[52].ret_CallEEpromLoadData "Return value off function" UBYTE SAB_STANDARD_S2_S3 1 100 0 255 DISPLAY_IDENTIFIER ret_CallEEpromLoadData.eepromChannel[52].EEpromZentralHandler._.ZFFSAB ECU_ADDRESS 0xFFF97EDD /end MEASUREMENT
/begin MEASUREMENT ZFFSAB._.EEpromZentralHandler.eepromChannel[52].cnt_CallEEpromLoadDataState "Call counter off function" UBYTE SAB_STANDARD_S2_S3 1 100 0 255 DISPLAY_IDENTIFIER cnt_CallEEpromLoadDataState.eepromChannel[52].EEpromZentralHandler._.ZFFSAB ECU_ADDRESS 0xFFF97EDE /end MEASUREMENT
/begin MEASUREMENT ZFFSAB._.EEpromZentralHandler.eepromChannel[52].ret_CallEEpromLoadDataState "Return value off function" UBYTE SAB_STANDARD_S2_S3 1 100 0 255 DISPLAY_IDENTIFIER ret_CallEEpromLoadDataState.eepromChannel[52].EEpromZentralHandler._.ZFFSAB ECU_ADDRESS 0xFFF97EDF /end MEASUREMENT
/begin MEASUREMENT ZFFSAB._.EEpromZentralHandler.eepromChannel[52].mode "argument of SetEEpromInitZyklisch" UBYTE SAB_STANDARD_S2_S3 1 100 0 255 DISPLAY_IDENTIFIER mode.eepromChannel[52].EEpromZentralHandler._.ZFFSAB ECU_ADDRESS 0xFFF97EE0 /end MEASUREMENT
/begin MEASUREMENT ZFFSAB._.EEpromZentralHandler.eepromChannel[52].cnt_SetEEpromWriteProtect "Call counter off function" UBYTE SAB_STANDARD_S2_S3 1 100 0 255 DISPLAY_IDENTIFIER cnt_SetEEpromWriteProtect.eepromChannel[52].EEpromZentralHandler._.ZFFSAB ECU_ADDRESS 0xFFF97EE1 /end MEASUREMENT
/begin MEASUREMENT ZFFSAB._.EEpromZentralHandler.eepromChannel[53].ZFFSAB._.cEEpromChannel._.cnt_GetEEpromValid "Call counter off function" UBYTE SAB_STANDARD_S2_S3 1 100 0 255 DISPLAY_IDENTIFIER cnt_GetEEpromValid._.cEEpromChannel._.ZFFSAB.eepromChannel[53].EEpromZentralHandler._.ZFFSAB ECU_ADDRESS 0xFFF97EE2 /end MEASUREMENT
/begin MEASUREMENT ZFFSAB._.EEpromZentralHandler.eepromChannel[53].ZFFSAB._.cEEpromChannel._.ret_GetEEpromValid "Return value off function" UBYTE SAB_STANDARD_S2_S3 1 100 0 255 DISPLAY_IDENTIFIER ret_GetEEpromValid._.cEEpromChannel._.ZFFSAB.eepromChannel[53].EEpromZentralHandler._.ZFFSAB ECU_ADDRESS 0xFFF97EE3 /end MEASUREMENT
/begin MEASUREMENT ZFFSAB._.EEpromZentralHandler.eepromChannel[53].ZFFSAB._.cEEpromChannel._.cnt_GetEEpromUpdate "Call counter off function" UBYTE SAB_STANDARD_S2_S3 1 100 0 255 DISPLAY_IDENTIFIER cnt_GetEEpromUpdate._.cEEpromChannel._.ZFFSAB.eepromChannel[53].EEpromZentralHandler._.ZFFSAB ECU_ADDRESS 0xFFF97EE4 /end MEASUREMENT
/begin MEASUREMENT ZFFSAB._.EEpromZentralHandler.eepromChannel[53].ZFFSAB._.cEEpromChannel._.ret_GetEEpromUpdate "Return value off function" UBYTE SAB_STANDARD_S2_S3 1 100 0 255 DISPLAY_IDENTIFIER ret_GetEEpromUpdate._.cEEpromChannel._.ZFFSAB.eepromChannel[53].EEpromZentralHandler._.ZFFSAB ECU_ADDRESS 0xFFF97EE5 /end MEASUREMENT
/begin MEASUREMENT ZFFSAB._.EEpromZentralHandler.eepromChannel[53].ZFFSAB._.cEEpromChannel._.cnt_SetEEpromInitZyklisch "Call counter off function" UBYTE SAB_STANDARD_S2_S3 1 100 0 255 DISPLAY_IDENTIFIER cnt_SetEEpromInitZyklisch._.cEEpromChannel._.ZFFSAB.eepromChannel[53].EEpromZentralHandler._.ZFFSAB ECU_ADDRESS 0xFFF97EE6 /end MEASUREMENT
/begin MEASUREMENT ZFFSAB._.EEpromZentralHandler.eepromChannel[53].ZFFSAB._.cEEpromChannel._.ret_SetEEpromInitZyklisch "Return value off function" UBYTE SAB_STANDARD_S2_S3 1 100 0 255 DISPLAY_IDENTIFIER ret_SetEEpromInitZyklisch._.cEEpromChannel._.ZFFSAB.eepromChannel[53].EEpromZentralHandler._.ZFFSAB ECU_ADDRESS 0xFFF97EE7 /end MEASUREMENT
/begin MEASUREMENT ZFFSAB._.EEpromZentralHandler.eepromChannel[53].ZFFSAB._.cEEpromChannel._.eeprom_info "argument of SetEEpromInitZyklisch" UBYTE SAB_STANDARD_S2_S3 1 100 0 255 DISPLAY_IDENTIFIER eeprom_info._.cEEpromChannel._.ZFFSAB.eepromChannel[53].EEpromZentralHandler._.ZFFSAB ECU_ADDRESS 0xFFF97EE8 /end MEASUREMENT
/begin MEASUREMENT ZFFSAB._.EEpromZentralHandler.eepromChannel[53].ZFFSAB._.cEEpromChannel._.cnt_GetSizeofEEpromData "Call counter off function" UBYTE SAB_STANDARD_S2_S3 1 100 0 255 DISPLAY_IDENTIFIER cnt_GetSizeofEEpromData._.cEEpromChannel._.ZFFSAB.eepromChannel[53].EEpromZentralHandler._.ZFFSAB ECU_ADDRESS 0xFFF97EE9 /end MEASUREMENT
/begin MEASUREMENT ZFFSAB._.EEpromZentralHandler.eepromChannel[53].ZFFSAB._.cEEpromChannel._.ret_GetSizeofEEpromData "Return value off function" UWORD SAB_STANDARD_S2_S3 1 100 0 65535 DISPLAY_IDENTIFIER ret_GetSizeofEEpromData._.cEEpromChannel._.ZFFSAB.eepromChannel[53].EEpromZentralHandler._.ZFFSAB ECU_ADDRESS 0xFFF97EEA /end MEASUREMENT
/begin MEASUREMENT ZFFSAB._.EEpromZentralHandler.eepromChannel[53].cnt_CallEEpromStoreImmediate "Call counter off function" UBYTE SAB_STANDARD_S2_S3 1 100 0 255 DISPLAY_IDENTIFIER cnt_CallEEpromStoreImmediate.eepromChannel[53].EEpromZentralHandler._.ZFFSAB ECU_ADDRESS 0xFFF97EEC /end MEASUREMENT
/begin MEASUREMENT ZFFSAB._.EEpromZentralHandler.eepromChannel[53].ret_CallEEpromStoreImmediate "Return value off function" UBYTE SAB_STANDARD_S2_S3 1 100 0 255 DISPLAY_IDENTIFIER ret_CallEEpromStoreImmediate.eepromChannel[53].EEpromZentralHandler._.ZFFSAB ECU_ADDRESS 0xFFF97EED /end MEASUREMENT
/begin MEASUREMENT ZFFSAB._.EEpromZentralHandler.eepromChannel[53].cnt_CallEEpromLoadData "Call counter off function" UBYTE SAB_STANDARD_S2_S3 1 100 0 255 DISPLAY_IDENTIFIER cnt_CallEEpromLoadData.eepromChannel[53].EEpromZentralHandler._.ZFFSAB ECU_ADDRESS 0xFFF97EEE /end MEASUREMENT
/begin MEASUREMENT ZFFSAB._.EEpromZentralHandler.eepromChannel[53].ret_CallEEpromLoadData "Return value off function" UBYTE SAB_STANDARD_S2_S3 1 100 0 255 DISPLAY_IDENTIFIER ret_CallEEpromLoadData.eepromChannel[53].EEpromZentralHandler._.ZFFSAB ECU_ADDRESS 0xFFF97EEF /end MEASUREMENT
/begin MEASUREMENT ZFFSAB._.EEpromZentralHandler.eepromChannel[53].cnt_CallEEpromLoadDataState "Call counter off function" UBYTE SAB_STANDARD_S2_S3 1 100 0 255 DISPLAY_IDENTIFIER cnt_CallEEpromLoadDataState.eepromChannel[53].EEpromZentralHandler._.ZFFSAB ECU_ADDRESS 0xFFF97EF0 /end MEASUREMENT
/begin MEASUREMENT ZFFSAB._.EEpromZentralHandler.eepromChannel[53].ret_CallEEpromLoadDataState "Return value off function" UBYTE SAB_STANDARD_S2_S3 1 100 0 255 DISPLAY_IDENTIFIER ret_CallEEpromLoadDataState.eepromChannel[53].EEpromZentralHandler._.ZFFSAB ECU_ADDRESS 0xFFF97EF1 /end MEASUREMENT
/begin MEASUREMENT ZFFSAB._.EEpromZentralHandler.eepromChannel[53].mode "argument of SetEEpromInitZyklisch" UBYTE SAB_STANDARD_S2_S3 1 100 0 255 DISPLAY_IDENTIFIER mode.eepromChannel[53].EEpromZentralHandler._.ZFFSAB ECU_ADDRESS 0xFFF97EF2 /end MEASUREMENT
/begin MEASUREMENT ZFFSAB._.EEpromZentralHandler.eepromChannel[53].cnt_SetEEpromWriteProtect "Call counter off function" UBYTE SAB_STANDARD_S2_S3 1 100 0 255 DISPLAY_IDENTIFIER cnt_SetEEpromWriteProtect.eepromChannel[53].EEpromZentralHandler._.ZFFSAB ECU_ADDRESS 0xFFF97EF3 /end MEASUREMENT
/begin MEASUREMENT ZFFSAB._.EEpromZentralHandler.eepromChannel[54].ZFFSAB._.cEEpromChannel._.cnt_GetEEpromValid "Call counter off function" UBYTE SAB_STANDARD_S2_S3 1 100 0 255 DISPLAY_IDENTIFIER cnt_GetEEpromValid._.cEEpromChannel._.ZFFSAB.eepromChannel[54].EEpromZentralHandler._.ZFFSAB ECU_ADDRESS 0xFFF97EF4 /end MEASUREMENT
/begin MEASUREMENT ZFFSAB._.EEpromZentralHandler.eepromChannel[54].ZFFSAB._.cEEpromChannel._.ret_GetEEpromValid "Return value off function" UBYTE SAB_STANDARD_S2_S3 1 100 0 255 DISPLAY_IDENTIFIER ret_GetEEpromValid._.cEEpromChannel._.ZFFSAB.eepromChannel[54].EEpromZentralHandler._.ZFFSAB ECU_ADDRESS 0xFFF97EF5 /end MEASUREMENT
/begin MEASUREMENT ZFFSAB._.EEpromZentralHandler.eepromChannel[54].ZFFSAB._.cEEpromChannel._.cnt_GetEEpromUpdate "Call counter off function" UBYTE SAB_STANDARD_S2_S3 1 100 0 255 DISPLAY_IDENTIFIER cnt_GetEEpromUpdate._.cEEpromChannel._.ZFFSAB.eepromChannel[54].EEpromZentralHandler._.ZFFSAB ECU_ADDRESS 0xFFF97EF6 /end MEASUREMENT
/begin MEASUREMENT ZFFSAB._.EEpromZentralHandler.eepromChannel[54].ZFFSAB._.cEEpromChannel._.ret_GetEEpromUpdate "Return value off function" UBYTE SAB_STANDARD_S2_S3 1 100 0 255 DISPLAY_IDENTIFIER ret_GetEEpromUpdate._.cEEpromChannel._.ZFFSAB.eepromChannel[54].EEpromZentralHandler._.ZFFSAB ECU_ADDRESS 0xFFF97EF7 /end MEASUREMENT
/begin MEASUREMENT ZFFSAB._.EEpromZentralHandler.eepromChannel[54].ZFFSAB._.cEEpromChannel._.cnt_SetEEpromInitZyklisch "Call counter off function" UBYTE SAB_STANDARD_S2_S3 1 100 0 255 DISPLAY_IDENTIFIER cnt_SetEEpromInitZyklisch._.cEEpromChannel._.ZFFSAB.eepromChannel[54].EEpromZentralHandler._.ZFFSAB ECU_ADDRESS 0xFFF97EF8 /end MEASUREMENT
/begin MEASUREMENT ZFFSAB._.EEpromZentralHandler.eepromChannel[54].ZFFSAB._.cEEpromChannel._.ret_SetEEpromInitZyklisch "Return value off function" UBYTE SAB_STANDARD_S2_S3 1 100 0 255 DISPLAY_IDENTIFIER ret_SetEEpromInitZyklisch._.cEEpromChannel._.ZFFSAB.eepromChannel[54].EEpromZentralHandler._.ZFFSAB ECU_ADDRESS 0xFFF97EF9 /end MEASUREMENT
/begin MEASUREMENT ZFFSAB._.EEpromZentralHandler.eepromChannel[54].ZFFSAB._.cEEpromChannel._.eeprom_info "argument of SetEEpromInitZyklisch" UBYTE SAB_STANDARD_S2_S3 1 100 0 255 DISPLAY_IDENTIFIER eeprom_info._.cEEpromChannel._.ZFFSAB.eepromChannel[54].EEpromZentralHandler._.ZFFSAB ECU_ADDRESS 0xFFF97EFA /end MEASUREMENT
/begin MEASUREMENT ZFFSAB._.EEpromZentralHandler.eepromChannel[54].ZFFSAB._.cEEpromChannel._.cnt_GetSizeofEEpromData "Call counter off function" UBYTE SAB_STANDARD_S2_S3 1 100 0 255 DISPLAY_IDENTIFIER cnt_GetSizeofEEpromData._.cEEpromChannel._.ZFFSAB.eepromChannel[54].EEpromZentralHandler._.ZFFSAB ECU_ADDRESS 0xFFF97EFB /end MEASUREMENT
/begin MEASUREMENT ZFFSAB._.EEpromZentralHandler.eepromChannel[54].ZFFSAB._.cEEpromChannel._.ret_GetSizeofEEpromData "Return value off function" UWORD SAB_STANDARD_S2_S3 1 100 0 65535 DISPLAY_IDENTIFIER ret_GetSizeofEEpromData._.cEEpromChannel._.ZFFSAB.eepromChannel[54].EEpromZentralHandler._.ZFFSAB ECU_ADDRESS 0xFFF97EFC /end MEASUREMENT
/begin MEASUREMENT ZFFSAB._.EEpromZentralHandler.eepromChannel[54].cnt_CallEEpromStoreImmediate "Call counter off function" UBYTE SAB_STANDARD_S2_S3 1 100 0 255 DISPLAY_IDENTIFIER cnt_CallEEpromStoreImmediate.eepromChannel[54].EEpromZentralHandler._.ZFFSAB ECU_ADDRESS 0xFFF97EFE /end MEASUREMENT
/begin MEASUREMENT ZFFSAB._.EEpromZentralHandler.eepromChannel[54].ret_CallEEpromStoreImmediate "Return value off function" UBYTE SAB_STANDARD_S2_S3 1 100 0 255 DISPLAY_IDENTIFIER ret_CallEEpromStoreImmediate.eepromChannel[54].EEpromZentralHandler._.ZFFSAB ECU_ADDRESS 0xFFF97EFF /end MEASUREMENT
/begin MEASUREMENT ZFFSAB._.EEpromZentralHandler.eepromChannel[54].cnt_CallEEpromLoadData "Call counter off function" UBYTE SAB_STANDARD_S2_S3 1 100 0 255 DISPLAY_IDENTIFIER cnt_CallEEpromLoadData.eepromChannel[54].EEpromZentralHandler._.ZFFSAB ECU_ADDRESS 0xFFF97F00 /end MEASUREMENT
/begin MEASUREMENT ZFFSAB._.EEpromZentralHandler.eepromChannel[54].ret_CallEEpromLoadData "Return value off function" UBYTE SAB_STANDARD_S2_S3 1 100 0 255 DISPLAY_IDENTIFIER ret_CallEEpromLoadData.eepromChannel[54].EEpromZentralHandler._.ZFFSAB ECU_ADDRESS 0xFFF97F01 /end MEASUREMENT
/begin MEASUREMENT ZFFSAB._.EEpromZentralHandler.eepromChannel[54].cnt_CallEEpromLoadDataState "Call counter off function" UBYTE SAB_STANDARD_S2_S3 1 100 0 255 DISPLAY_IDENTIFIER cnt_CallEEpromLoadDataState.eepromChannel[54].EEpromZentralHandler._.ZFFSAB ECU_ADDRESS 0xFFF97F02 /end MEASUREMENT
/begin MEASUREMENT ZFFSAB._.EEpromZentralHandler.eepromChannel[54].ret_CallEEpromLoadDataState "Return value off function" UBYTE SAB_STANDARD_S2_S3 1 100 0 255 DISPLAY_IDENTIFIER ret_CallEEpromLoadDataState.eepromChannel[54].EEpromZentralHandler._.ZFFSAB ECU_ADDRESS 0xFFF97F03 /end MEASUREMENT
/begin MEASUREMENT ZFFSAB._.EEpromZentralHandler.eepromChannel[54].mode "argument of SetEEpromInitZyklisch" UBYTE SAB_STANDARD_S2_S3 1 100 0 255 DISPLAY_IDENTIFIER mode.eepromChannel[54].EEpromZentralHandler._.ZFFSAB ECU_ADDRESS 0xFFF97F04 /end MEASUREMENT
/begin MEASUREMENT ZFFSAB._.EEpromZentralHandler.eepromChannel[54].cnt_SetEEpromWriteProtect "Call counter off function" UBYTE SAB_STANDARD_S2_S3 1 100 0 255 DISPLAY_IDENTIFIER cnt_SetEEpromWriteProtect.eepromChannel[54].EEpromZentralHandler._.ZFFSAB ECU_ADDRESS 0xFFF97F05 /end MEASUREMENT
/begin MEASUREMENT ZFFSAB._.EEpromZentralHandler.eepromChannel[55].ZFFSAB._.cEEpromChannel._.cnt_GetEEpromValid "Call counter off function" UBYTE SAB_STANDARD_S2_S3 1 100 0 255 DISPLAY_IDENTIFIER cnt_GetEEpromValid._.cEEpromChannel._.ZFFSAB.eepromChannel[55].EEpromZentralHandler._.ZFFSAB ECU_ADDRESS 0xFFF97F06 /end MEASUREMENT
/begin MEASUREMENT ZFFSAB._.EEpromZentralHandler.eepromChannel[55].ZFFSAB._.cEEpromChannel._.ret_GetEEpromValid "Return value off function" UBYTE SAB_STANDARD_S2_S3 1 100 0 255 DISPLAY_IDENTIFIER ret_GetEEpromValid._.cEEpromChannel._.ZFFSAB.eepromChannel[55].EEpromZentralHandler._.ZFFSAB ECU_ADDRESS 0xFFF97F07 /end MEASUREMENT
/begin MEASUREMENT ZFFSAB._.EEpromZentralHandler.eepromChannel[55].ZFFSAB._.cEEpromChannel._.cnt_GetEEpromUpdate "Call counter off function" UBYTE SAB_STANDARD_S2_S3 1 100 0 255 DISPLAY_IDENTIFIER cnt_GetEEpromUpdate._.cEEpromChannel._.ZFFSAB.eepromChannel[55].EEpromZentralHandler._.ZFFSAB ECU_ADDRESS 0xFFF97F08 /end MEASUREMENT
/begin MEASUREMENT ZFFSAB._.EEpromZentralHandler.eepromChannel[55].ZFFSAB._.cEEpromChannel._.ret_GetEEpromUpdate "Return value off function" UBYTE SAB_STANDARD_S2_S3 1 100 0 255 DISPLAY_IDENTIFIER ret_GetEEpromUpdate._.cEEpromChannel._.ZFFSAB.eepromChannel[55].EEpromZentralHandler._.ZFFSAB ECU_ADDRESS 0xFFF97F09 /end MEASUREMENT
/begin MEASUREMENT ZFFSAB._.EEpromZentralHandler.eepromChannel[55].ZFFSAB._.cEEpromChannel._.cnt_SetEEpromInitZyklisch "Call counter off function" UBYTE SAB_STANDARD_S2_S3 1 100 0 255 DISPLAY_IDENTIFIER cnt_SetEEpromInitZyklisch._.cEEpromChannel._.ZFFSAB.eepromChannel[55].EEpromZentralHandler._.ZFFSAB ECU_ADDRESS 0xFFF97F0A /end MEASUREMENT
/begin MEASUREMENT ZFFSAB._.EEpromZentralHandler.eepromChannel[55].ZFFSAB._.cEEpromChannel._.ret_SetEEpromInitZyklisch "Return value off function" UBYTE SAB_STANDARD_S2_S3 1 100 0 255 DISPLAY_IDENTIFIER ret_SetEEpromInitZyklisch._.cEEpromChannel._.ZFFSAB.eepromChannel[55].EEpromZentralHandler._.ZFFSAB ECU_ADDRESS 0xFFF97F0B /end MEASUREMENT
/begin MEASUREMENT ZFFSAB._.EEpromZentralHandler.eepromChannel[55].ZFFSAB._.cEEpromChannel._.eeprom_info "argument of SetEEpromInitZyklisch" UBYTE SAB_STANDARD_S2_S3 1 100 0 255 DISPLAY_IDENTIFIER eeprom_info._.cEEpromChannel._.ZFFSAB.eepromChannel[55].EEpromZentralHandler._.ZFFSAB ECU_ADDRESS 0xFFF97F0C /end MEASUREMENT
/begin MEASUREMENT ZFFSAB._.EEpromZentralHandler.eepromChannel[55].ZFFSAB._.cEEpromChannel._.cnt_GetSizeofEEpromData "Call counter off function" UBYTE SAB_STANDARD_S2_S3 1 100 0 255 DISPLAY_IDENTIFIER cnt_GetSizeofEEpromData._.cEEpromChannel._.ZFFSAB.eepromChannel[55].EEpromZentralHandler._.ZFFSAB ECU_ADDRESS 0xFFF97F0D /end MEASUREMENT
/begin MEASUREMENT ZFFSAB._.EEpromZentralHandler.eepromChannel[55].ZFFSAB._.cEEpromChannel._.ret_GetSizeofEEpromData "Return value off function" UWORD SAB_STANDARD_S2_S3 1 100 0 65535 DISPLAY_IDENTIFIER ret_GetSizeofEEpromData._.cEEpromChannel._.ZFFSAB.eepromChannel[55].EEpromZentralHandler._.ZFFSAB ECU_ADDRESS 0xFFF97F0E /end MEASUREMENT
/begin MEASUREMENT ZFFSAB._.EEpromZentralHandler.eepromChannel[55].cnt_CallEEpromStoreImmediate "Call counter off function" UBYTE SAB_STANDARD_S2_S3 1 100 0 255 DISPLAY_IDENTIFIER cnt_CallEEpromStoreImmediate.eepromChannel[55].EEpromZentralHandler._.ZFFSAB ECU_ADDRESS 0xFFF97F10 /end MEASUREMENT
/begin MEASUREMENT ZFFSAB._.EEpromZentralHandler.eepromChannel[55].ret_CallEEpromStoreImmediate "Return value off function" UBYTE SAB_STANDARD_S2_S3 1 100 0 255 DISPLAY_IDENTIFIER ret_CallEEpromStoreImmediate.eepromChannel[55].EEpromZentralHandler._.ZFFSAB ECU_ADDRESS 0xFFF97F11 /end MEASUREMENT
/begin MEASUREMENT ZFFSAB._.EEpromZentralHandler.eepromChannel[55].cnt_CallEEpromLoadData "Call counter off function" UBYTE SAB_STANDARD_S2_S3 1 100 0 255 DISPLAY_IDENTIFIER cnt_CallEEpromLoadData.eepromChannel[55].EEpromZentralHandler._.ZFFSAB ECU_ADDRESS 0xFFF97F12 /end MEASUREMENT
/begin MEASUREMENT ZFFSAB._.EEpromZentralHandler.eepromChannel[55].ret_CallEEpromLoadData "Return value off function" UBYTE SAB_STANDARD_S2_S3 1 100 0 255 DISPLAY_IDENTIFIER ret_CallEEpromLoadData.eepromChannel[55].EEpromZentralHandler._.ZFFSAB ECU_ADDRESS 0xFFF97F13 /end MEASUREMENT
/begin MEASUREMENT ZFFSAB._.EEpromZentralHandler.eepromChannel[55].cnt_CallEEpromLoadDataState "Call counter off function" UBYTE SAB_STANDARD_S2_S3 1 100 0 255 DISPLAY_IDENTIFIER cnt_CallEEpromLoadDataState.eepromChannel[55].EEpromZentralHandler._.ZFFSAB ECU_ADDRESS 0xFFF97F14 /end MEASUREMENT
/begin MEASUREMENT ZFFSAB._.EEpromZentralHandler.eepromChannel[55].ret_CallEEpromLoadDataState "Return value off function" UBYTE SAB_STANDARD_S2_S3 1 100 0 255 DISPLAY_IDENTIFIER ret_CallEEpromLoadDataState.eepromChannel[55].EEpromZentralHandler._.ZFFSAB ECU_ADDRESS 0xFFF97F15 /end MEASUREMENT
/begin MEASUREMENT ZFFSAB._.EEpromZentralHandler.eepromChannel[55].mode "argument of SetEEpromInitZyklisch" UBYTE SAB_STANDARD_S2_S3 1 100 0 255 DISPLAY_IDENTIFIER mode.eepromChannel[55].EEpromZentralHandler._.ZFFSAB ECU_ADDRESS 0xFFF97F16 /end MEASUREMENT
/begin MEASUREMENT ZFFSAB._.EEpromZentralHandler.eepromChannel[55].cnt_SetEEpromWriteProtect "Call counter off function" UBYTE SAB_STANDARD_S2_S3 1 100 0 255 DISPLAY_IDENTIFIER cnt_SetEEpromWriteProtect.eepromChannel[55].EEpromZentralHandler._.ZFFSAB ECU_ADDRESS 0xFFF97F17 /end MEASUREMENT
/begin MEASUREMENT ZFFSAB._.EEpromZentralHandler.eepromChannel[56].ZFFSAB._.cEEpromChannel._.cnt_GetEEpromValid "Call counter off function" UBYTE SAB_STANDARD_S2_S3 1 100 0 255 DISPLAY_IDENTIFIER cnt_GetEEpromValid._.cEEpromChannel._.ZFFSAB.eepromChannel[56].EEpromZentralHandler._.ZFFSAB ECU_ADDRESS 0xFFF97F18 /end MEASUREMENT
/begin MEASUREMENT ZFFSAB._.EEpromZentralHandler.eepromChannel[56].ZFFSAB._.cEEpromChannel._.ret_GetEEpromValid "Return value off function" UBYTE SAB_STANDARD_S2_S3 1 100 0 255 DISPLAY_IDENTIFIER ret_GetEEpromValid._.cEEpromChannel._.ZFFSAB.eepromChannel[56].EEpromZentralHandler._.ZFFSAB ECU_ADDRESS 0xFFF97F19 /end MEASUREMENT
/begin MEASUREMENT ZFFSAB._.EEpromZentralHandler.eepromChannel[56].ZFFSAB._.cEEpromChannel._.cnt_GetEEpromUpdate "Call counter off function" UBYTE SAB_STANDARD_S2_S3 1 100 0 255 DISPLAY_IDENTIFIER cnt_GetEEpromUpdate._.cEEpromChannel._.ZFFSAB.eepromChannel[56].EEpromZentralHandler._.ZFFSAB ECU_ADDRESS 0xFFF97F1A /end MEASUREMENT
/begin MEASUREMENT ZFFSAB._.EEpromZentralHandler.eepromChannel[56].ZFFSAB._.cEEpromChannel._.ret_GetEEpromUpdate "Return value off function" UBYTE SAB_STANDARD_S2_S3 1 100 0 255 DISPLAY_IDENTIFIER ret_GetEEpromUpdate._.cEEpromChannel._.ZFFSAB.eepromChannel[56].EEpromZentralHandler._.ZFFSAB ECU_ADDRESS 0xFFF97F1B /end MEASUREMENT
/begin MEASUREMENT ZFFSAB._.EEpromZentralHandler.eepromChannel[56].ZFFSAB._.cEEpromChannel._.cnt_SetEEpromInitZyklisch "Call counter off function" UBYTE SAB_STANDARD_S2_S3 1 100 0 255 DISPLAY_IDENTIFIER cnt_SetEEpromInitZyklisch._.cEEpromChannel._.ZFFSAB.eepromChannel[56].EEpromZentralHandler._.ZFFSAB ECU_ADDRESS 0xFFF97F1C /end MEASUREMENT
/begin MEASUREMENT ZFFSAB._.EEpromZentralHandler.eepromChannel[56].ZFFSAB._.cEEpromChannel._.ret_SetEEpromInitZyklisch "Return value off function" UBYTE SAB_STANDARD_S2_S3 1 100 0 255 DISPLAY_IDENTIFIER ret_SetEEpromInitZyklisch._.cEEpromChannel._.ZFFSAB.eepromChannel[56].EEpromZentralHandler._.ZFFSAB ECU_ADDRESS 0xFFF97F1D /end MEASUREMENT
/begin MEASUREMENT ZFFSAB._.EEpromZentralHandler.eepromChannel[56].ZFFSAB._.cEEpromChannel._.eeprom_info "argument of SetEEpromInitZyklisch" UBYTE SAB_STANDARD_S2_S3 1 100 0 255 DISPLAY_IDENTIFIER eeprom_info._.cEEpromChannel._.ZFFSAB.eepromChannel[56].EEpromZentralHandler._.ZFFSAB ECU_ADDRESS 0xFFF97F1E /end MEASUREMENT
/begin MEASUREMENT ZFFSAB._.EEpromZentralHandler.eepromChannel[56].ZFFSAB._.cEEpromChannel._.cnt_GetSizeofEEpromData "Call counter off function" UBYTE SAB_STANDARD_S2_S3 1 100 0 255 DISPLAY_IDENTIFIER cnt_GetSizeofEEpromData._.cEEpromChannel._.ZFFSAB.eepromChannel[56].EEpromZentralHandler._.ZFFSAB ECU_ADDRESS 0xFFF97F1F /end MEASUREMENT
/begin MEASUREMENT ZFFSAB._.EEpromZentralHandler.eepromChannel[56].ZFFSAB._.cEEpromChannel._.ret_GetSizeofEEpromData "Return value off function" UWORD SAB_STANDARD_S2_S3 1 100 0 65535 DISPLAY_IDENTIFIER ret_GetSizeofEEpromData._.cEEpromChannel._.ZFFSAB.eepromChannel[56].EEpromZentralHandler._.ZFFSAB ECU_ADDRESS 0xFFF97F20 /end MEASUREMENT
/begin MEASUREMENT ZFFSAB._.EEpromZentralHandler.eepromChannel[56].cnt_CallEEpromStoreImmediate "Call counter off function" UBYTE SAB_STANDARD_S2_S3 1 100 0 255 DISPLAY_IDENTIFIER cnt_CallEEpromStoreImmediate.eepromChannel[56].EEpromZentralHandler._.ZFFSAB ECU_ADDRESS 0xFFF97F22 /end MEASUREMENT
/begin MEASUREMENT ZFFSAB._.EEpromZentralHandler.eepromChannel[56].ret_CallEEpromStoreImmediate "Return value off function" UBYTE SAB_STANDARD_S2_S3 1 100 0 255 DISPLAY_IDENTIFIER ret_CallEEpromStoreImmediate.eepromChannel[56].EEpromZentralHandler._.ZFFSAB ECU_ADDRESS 0xFFF97F23 /end MEASUREMENT
/begin MEASUREMENT ZFFSAB._.EEpromZentralHandler.eepromChannel[56].cnt_CallEEpromLoadData "Call counter off function" UBYTE SAB_STANDARD_S2_S3 1 100 0 255 DISPLAY_IDENTIFIER cnt_CallEEpromLoadData.eepromChannel[56].EEpromZentralHandler._.ZFFSAB ECU_ADDRESS 0xFFF97F24 /end MEASUREMENT
/begin MEASUREMENT ZFFSAB._.EEpromZentralHandler.eepromChannel[56].ret_CallEEpromLoadData "Return value off function" UBYTE SAB_STANDARD_S2_S3 1 100 0 255 DISPLAY_IDENTIFIER ret_CallEEpromLoadData.eepromChannel[56].EEpromZentralHandler._.ZFFSAB ECU_ADDRESS 0xFFF97F25 /end MEASUREMENT
/begin MEASUREMENT ZFFSAB._.EEpromZentralHandler.eepromChannel[56].cnt_CallEEpromLoadDataState "Call counter off function" UBYTE SAB_STANDARD_S2_S3 1 100 0 255 DISPLAY_IDENTIFIER cnt_CallEEpromLoadDataState.eepromChannel[56].EEpromZentralHandler._.ZFFSAB ECU_ADDRESS 0xFFF97F26 /end MEASUREMENT
/begin MEASUREMENT ZFFSAB._.EEpromZentralHandler.eepromChannel[56].ret_CallEEpromLoadDataState "Return value off function" UBYTE SAB_STANDARD_S2_S3 1 100 0 255 DISPLAY_IDENTIFIER ret_CallEEpromLoadDataState.eepromChannel[56].EEpromZentralHandler._.ZFFSAB ECU_ADDRESS 0xFFF97F27 /end MEASUREMENT
/begin MEASUREMENT ZFFSAB._.EEpromZentralHandler.eepromChannel[56].mode "argument of SetEEpromInitZyklisch" UBYTE SAB_STANDARD_S2_S3 1 100 0 255 DISPLAY_IDENTIFIER mode.eepromChannel[56].EEpromZentralHandler._.ZFFSAB ECU_ADDRESS 0xFFF97F28 /end MEASUREMENT
/begin MEASUREMENT ZFFSAB._.EEpromZentralHandler.eepromChannel[56].cnt_SetEEpromWriteProtect "Call counter off function" UBYTE SAB_STANDARD_S2_S3 1 100 0 255 DISPLAY_IDENTIFIER cnt_SetEEpromWriteProtect.eepromChannel[56].EEpromZentralHandler._.ZFFSAB ECU_ADDRESS 0xFFF97F29 /end MEASUREMENT
/begin MEASUREMENT ZFFSAB._.EEpromZentralHandler.eepromChannel[57].ZFFSAB._.cEEpromChannel._.cnt_GetEEpromValid "Call counter off function" UBYTE SAB_STANDARD_S2_S3 1 100 0 255 DISPLAY_IDENTIFIER cnt_GetEEpromValid._.cEEpromChannel._.ZFFSAB.eepromChannel[57].EEpromZentralHandler._.ZFFSAB ECU_ADDRESS 0xFFF97F2A /end MEASUREMENT
/begin MEASUREMENT ZFFSAB._.EEpromZentralHandler.eepromChannel[57].ZFFSAB._.cEEpromChannel._.ret_GetEEpromValid "Return value off function" UBYTE SAB_STANDARD_S2_S3 1 100 0 255 DISPLAY_IDENTIFIER ret_GetEEpromValid._.cEEpromChannel._.ZFFSAB.eepromChannel[57].EEpromZentralHandler._.ZFFSAB ECU_ADDRESS 0xFFF97F2B /end MEASUREMENT
/begin MEASUREMENT ZFFSAB._.EEpromZentralHandler.eepromChannel[57].ZFFSAB._.cEEpromChannel._.cnt_GetEEpromUpdate "Call counter off function" UBYTE SAB_STANDARD_S2_S3 1 100 0 255 DISPLAY_IDENTIFIER cnt_GetEEpromUpdate._.cEEpromChannel._.ZFFSAB.eepromChannel[57].EEpromZentralHandler._.ZFFSAB ECU_ADDRESS 0xFFF97F2C /end MEASUREMENT
/begin MEASUREMENT ZFFSAB._.EEpromZentralHandler.eepromChannel[57].ZFFSAB._.cEEpromChannel._.ret_GetEEpromUpdate "Return value off function" UBYTE SAB_STANDARD_S2_S3 1 100 0 255 DISPLAY_IDENTIFIER ret_GetEEpromUpdate._.cEEpromChannel._.ZFFSAB.eepromChannel[57].EEpromZentralHandler._.ZFFSAB ECU_ADDRESS 0xFFF97F2D /end MEASUREMENT
/begin MEASUREMENT ZFFSAB._.EEpromZentralHandler.eepromChannel[57].ZFFSAB._.cEEpromChannel._.cnt_SetEEpromInitZyklisch "Call counter off function" UBYTE SAB_STANDARD_S2_S3 1 100 0 255 DISPLAY_IDENTIFIER cnt_SetEEpromInitZyklisch._.cEEpromChannel._.ZFFSAB.eepromChannel[57].EEpromZentralHandler._.ZFFSAB ECU_ADDRESS 0xFFF97F2E /end MEASUREMENT
/begin MEASUREMENT ZFFSAB._.EEpromZentralHandler.eepromChannel[57].ZFFSAB._.cEEpromChannel._.ret_SetEEpromInitZyklisch "Return value off function" UBYTE SAB_STANDARD_S2_S3 1 100 0 255 DISPLAY_IDENTIFIER ret_SetEEpromInitZyklisch._.cEEpromChannel._.ZFFSAB.eepromChannel[57].EEpromZentralHandler._.ZFFSAB ECU_ADDRESS 0xFFF97F2F /end MEASUREMENT
/begin MEASUREMENT ZFFSAB._.EEpromZentralHandler.eepromChannel[57].ZFFSAB._.cEEpromChannel._.eeprom_info "argument of SetEEpromInitZyklisch" UBYTE SAB_STANDARD_S2_S3 1 100 0 255 DISPLAY_IDENTIFIER eeprom_info._.cEEpromChannel._.ZFFSAB.eepromChannel[57].EEpromZentralHandler._.ZFFSAB ECU_ADDRESS 0xFFF97F30 /end MEASUREMENT
/begin MEASUREMENT ZFFSAB._.EEpromZentralHandler.eepromChannel[57].ZFFSAB._.cEEpromChannel._.cnt_GetSizeofEEpromData "Call counter off function" UBYTE SAB_STANDARD_S2_S3 1 100 0 255 DISPLAY_IDENTIFIER cnt_GetSizeofEEpromData._.cEEpromChannel._.ZFFSAB.eepromChannel[57].EEpromZentralHandler._.ZFFSAB ECU_ADDRESS 0xFFF97F31 /end MEASUREMENT
/begin MEASUREMENT ZFFSAB._.EEpromZentralHandler.eepromChannel[57].ZFFSAB._.cEEpromChannel._.ret_GetSizeofEEpromData "Return value off function" UWORD SAB_STANDARD_S2_S3 1 100 0 65535 DISPLAY_IDENTIFIER ret_GetSizeofEEpromData._.cEEpromChannel._.ZFFSAB.eepromChannel[57].EEpromZentralHandler._.ZFFSAB ECU_ADDRESS 0xFFF97F32 /end MEASUREMENT
/begin MEASUREMENT ZFFSAB._.EEpromZentralHandler.eepromChannel[57].cnt_CallEEpromStoreImmediate "Call counter off function" UBYTE SAB_STANDARD_S2_S3 1 100 0 255 DISPLAY_IDENTIFIER cnt_CallEEpromStoreImmediate.eepromChannel[57].EEpromZentralHandler._.ZFFSAB ECU_ADDRESS 0xFFF97F34 /end MEASUREMENT
/begin MEASUREMENT ZFFSAB._.EEpromZentralHandler.eepromChannel[57].ret_CallEEpromStoreImmediate "Return value off function" UBYTE SAB_STANDARD_S2_S3 1 100 0 255 DISPLAY_IDENTIFIER ret_CallEEpromStoreImmediate.eepromChannel[57].EEpromZentralHandler._.ZFFSAB ECU_ADDRESS 0xFFF97F35 /end MEASUREMENT
/begin MEASUREMENT ZFFSAB._.EEpromZentralHandler.eepromChannel[57].cnt_CallEEpromLoadData "Call counter off function" UBYTE SAB_STANDARD_S2_S3 1 100 0 255 DISPLAY_IDENTIFIER cnt_CallEEpromLoadData.eepromChannel[57].EEpromZentralHandler._.ZFFSAB ECU_ADDRESS 0xFFF97F36 /end MEASUREMENT
/begin MEASUREMENT ZFFSAB._.EEpromZentralHandler.eepromChannel[57].ret_CallEEpromLoadData "Return value off function" UBYTE SAB_STANDARD_S2_S3 1 100 0 255 DISPLAY_IDENTIFIER ret_CallEEpromLoadData.eepromChannel[57].EEpromZentralHandler._.ZFFSAB ECU_ADDRESS 0xFFF97F37 /end MEASUREMENT
/begin MEASUREMENT ZFFSAB._.EEpromZentralHandler.eepromChannel[57].cnt_CallEEpromLoadDataState "Call counter off function" UBYTE SAB_STANDARD_S2_S3 1 100 0 255 DISPLAY_IDENTIFIER cnt_CallEEpromLoadDataState.eepromChannel[57].EEpromZentralHandler._.ZFFSAB ECU_ADDRESS 0xFFF97F38 /end MEASUREMENT
/begin MEASUREMENT ZFFSAB._.EEpromZentralHandler.eepromChannel[57].ret_CallEEpromLoadDataState "Return value off function" UBYTE SAB_STANDARD_S2_S3 1 100 0 255 DISPLAY_IDENTIFIER ret_CallEEpromLoadDataState.eepromChannel[57].EEpromZentralHandler._.ZFFSAB ECU_ADDRESS 0xFFF97F39 /end MEASUREMENT
/begin MEASUREMENT ZFFSAB._.EEpromZentralHandler.eepromChannel[57].mode "argument of SetEEpromInitZyklisch" UBYTE SAB_STANDARD_S2_S3 1 100 0 255 DISPLAY_IDENTIFIER mode.eepromChannel[57].EEpromZentralHandler._.ZFFSAB ECU_ADDRESS 0xFFF97F3A /end MEASUREMENT
/begin MEASUREMENT ZFFSAB._.EEpromZentralHandler.eepromChannel[57].cnt_SetEEpromWriteProtect "Call counter off function" UBYTE SAB_STANDARD_S2_S3 1 100 0 255 DISPLAY_IDENTIFIER cnt_SetEEpromWriteProtect.eepromChannel[57].EEpromZentralHandler._.ZFFSAB ECU_ADDRESS 0xFFF97F3B /end MEASUREMENT
/begin MEASUREMENT ZFFSAB._.EEpromZentralHandler.eepromChannel[58].ZFFSAB._.cEEpromChannel._.cnt_GetEEpromValid "Call counter off function" UBYTE SAB_STANDARD_S2_S3 1 100 0 255 DISPLAY_IDENTIFIER cnt_GetEEpromValid._.cEEpromChannel._.ZFFSAB.eepromChannel[58].EEpromZentralHandler._.ZFFSAB ECU_ADDRESS 0xFFF97F3C /end MEASUREMENT
/begin MEASUREMENT ZFFSAB._.EEpromZentralHandler.eepromChannel[58].ZFFSAB._.cEEpromChannel._.ret_GetEEpromValid "Return value off function" UBYTE SAB_STANDARD_S2_S3 1 100 0 255 DISPLAY_IDENTIFIER ret_GetEEpromValid._.cEEpromChannel._.ZFFSAB.eepromChannel[58].EEpromZentralHandler._.ZFFSAB ECU_ADDRESS 0xFFF97F3D /end MEASUREMENT
/begin MEASUREMENT ZFFSAB._.EEpromZentralHandler.eepromChannel[58].ZFFSAB._.cEEpromChannel._.cnt_GetEEpromUpdate "Call counter off function" UBYTE SAB_STANDARD_S2_S3 1 100 0 255 DISPLAY_IDENTIFIER cnt_GetEEpromUpdate._.cEEpromChannel._.ZFFSAB.eepromChannel[58].EEpromZentralHandler._.ZFFSAB ECU_ADDRESS 0xFFF97F3E /end MEASUREMENT
/begin MEASUREMENT ZFFSAB._.EEpromZentralHandler.eepromChannel[58].ZFFSAB._.cEEpromChannel._.ret_GetEEpromUpdate "Return value off function" UBYTE SAB_STANDARD_S2_S3 1 100 0 255 DISPLAY_IDENTIFIER ret_GetEEpromUpdate._.cEEpromChannel._.ZFFSAB.eepromChannel[58].EEpromZentralHandler._.ZFFSAB ECU_ADDRESS 0xFFF97F3F /end MEASUREMENT
/begin MEASUREMENT ZFFSAB._.EEpromZentralHandler.eepromChannel[58].ZFFSAB._.cEEpromChannel._.cnt_SetEEpromInitZyklisch "Call counter off function" UBYTE SAB_STANDARD_S2_S3 1 100 0 255 DISPLAY_IDENTIFIER cnt_SetEEpromInitZyklisch._.cEEpromChannel._.ZFFSAB.eepromChannel[58].EEpromZentralHandler._.ZFFSAB ECU_ADDRESS 0xFFF97F40 /end MEASUREMENT
/begin MEASUREMENT ZFFSAB._.EEpromZentralHandler.eepromChannel[58].ZFFSAB._.cEEpromChannel._.ret_SetEEpromInitZyklisch "Return value off function" UBYTE SAB_STANDARD_S2_S3 1 100 0 255 DISPLAY_IDENTIFIER ret_SetEEpromInitZyklisch._.cEEpromChannel._.ZFFSAB.eepromChannel[58].EEpromZentralHandler._.ZFFSAB ECU_ADDRESS 0xFFF97F41 /end MEASUREMENT
/begin MEASUREMENT ZFFSAB._.EEpromZentralHandler.eepromChannel[58].ZFFSAB._.cEEpromChannel._.eeprom_info "argument of SetEEpromInitZyklisch" UBYTE SAB_STANDARD_S2_S3 1 100 0 255 DISPLAY_IDENTIFIER eeprom_info._.cEEpromChannel._.ZFFSAB.eepromChannel[58].EEpromZentralHandler._.ZFFSAB ECU_ADDRESS 0xFFF97F42 /end MEASUREMENT
/begin MEASUREMENT ZFFSAB._.EEpromZentralHandler.eepromChannel[58].ZFFSAB._.cEEpromChannel._.cnt_GetSizeofEEpromData "Call counter off function" UBYTE SAB_STANDARD_S2_S3 1 100 0 255 DISPLAY_IDENTIFIER cnt_GetSizeofEEpromData._.cEEpromChannel._.ZFFSAB.eepromChannel[58].EEpromZentralHandler._.ZFFSAB ECU_ADDRESS 0xFFF97F43 /end MEASUREMENT
/begin MEASUREMENT ZFFSAB._.EEpromZentralHandler.eepromChannel[58].ZFFSAB._.cEEpromChannel._.ret_GetSizeofEEpromData "Return value off function" UWORD SAB_STANDARD_S2_S3 1 100 0 65535 DISPLAY_IDENTIFIER ret_GetSizeofEEpromData._.cEEpromChannel._.ZFFSAB.eepromChannel[58].EEpromZentralHandler._.ZFFSAB ECU_ADDRESS 0xFFF97F44 /end MEASUREMENT
/begin MEASUREMENT ZFFSAB._.EEpromZentralHandler.eepromChannel[58].cnt_CallEEpromStoreImmediate "Call counter off function" UBYTE SAB_STANDARD_S2_S3 1 100 0 255 DISPLAY_IDENTIFIER cnt_CallEEpromStoreImmediate.eepromChannel[58].EEpromZentralHandler._.ZFFSAB ECU_ADDRESS 0xFFF97F46 /end MEASUREMENT
/begin MEASUREMENT ZFFSAB._.EEpromZentralHandler.eepromChannel[58].ret_CallEEpromStoreImmediate "Return value off function" UBYTE SAB_STANDARD_S2_S3 1 100 0 255 DISPLAY_IDENTIFIER ret_CallEEpromStoreImmediate.eepromChannel[58].EEpromZentralHandler._.ZFFSAB ECU_ADDRESS 0xFFF97F47 /end MEASUREMENT
/begin MEASUREMENT ZFFSAB._.EEpromZentralHandler.eepromChannel[58].cnt_CallEEpromLoadData "Call counter off function" UBYTE SAB_STANDARD_S2_S3 1 100 0 255 DISPLAY_IDENTIFIER cnt_CallEEpromLoadData.eepromChannel[58].EEpromZentralHandler._.ZFFSAB ECU_ADDRESS 0xFFF97F48 /end MEASUREMENT
/begin MEASUREMENT ZFFSAB._.EEpromZentralHandler.eepromChannel[58].ret_CallEEpromLoadData "Return value off function" UBYTE SAB_STANDARD_S2_S3 1 100 0 255 DISPLAY_IDENTIFIER ret_CallEEpromLoadData.eepromChannel[58].EEpromZentralHandler._.ZFFSAB ECU_ADDRESS 0xFFF97F49 /end MEASUREMENT
/begin MEASUREMENT ZFFSAB._.EEpromZentralHandler.eepromChannel[58].cnt_CallEEpromLoadDataState "Call counter off function" UBYTE SAB_STANDARD_S2_S3 1 100 0 255 DISPLAY_IDENTIFIER cnt_CallEEpromLoadDataState.eepromChannel[58].EEpromZentralHandler._.ZFFSAB ECU_ADDRESS 0xFFF97F4A /end MEASUREMENT
/begin MEASUREMENT ZFFSAB._.EEpromZentralHandler.eepromChannel[58].ret_CallEEpromLoadDataState "Return value off function" UBYTE SAB_STANDARD_S2_S3 1 100 0 255 DISPLAY_IDENTIFIER ret_CallEEpromLoadDataState.eepromChannel[58].EEpromZentralHandler._.ZFFSAB ECU_ADDRESS 0xFFF97F4B /end MEASUREMENT
/begin MEASUREMENT ZFFSAB._.EEpromZentralHandler.eepromChannel[58].mode "argument of SetEEpromInitZyklisch" UBYTE SAB_STANDARD_S2_S3 1 100 0 255 DISPLAY_IDENTIFIER mode.eepromChannel[58].EEpromZentralHandler._.ZFFSAB ECU_ADDRESS 0xFFF97F4C /end MEASUREMENT
/begin MEASUREMENT ZFFSAB._.EEpromZentralHandler.eepromChannel[58].cnt_SetEEpromWriteProtect "Call counter off function" UBYTE SAB_STANDARD_S2_S3 1 100 0 255 DISPLAY_IDENTIFIER cnt_SetEEpromWriteProtect.eepromChannel[58].EEpromZentralHandler._.ZFFSAB ECU_ADDRESS 0xFFF97F4D /end MEASUREMENT
/begin MEASUREMENT ZFFSAB._.EEpromZentralHandler.eepromChannel[59].ZFFSAB._.cEEpromChannel._.cnt_GetEEpromValid "Call counter off function" UBYTE SAB_STANDARD_S2_S3 1 100 0 255 DISPLAY_IDENTIFIER cnt_GetEEpromValid._.cEEpromChannel._.ZFFSAB.eepromChannel[59].EEpromZentralHandler._.ZFFSAB ECU_ADDRESS 0xFFF97F4E /end MEASUREMENT
/begin MEASUREMENT ZFFSAB._.EEpromZentralHandler.eepromChannel[59].ZFFSAB._.cEEpromChannel._.ret_GetEEpromValid "Return value off function" UBYTE SAB_STANDARD_S2_S3 1 100 0 255 DISPLAY_IDENTIFIER ret_GetEEpromValid._.cEEpromChannel._.ZFFSAB.eepromChannel[59].EEpromZentralHandler._.ZFFSAB ECU_ADDRESS 0xFFF97F4F /end MEASUREMENT
/begin MEASUREMENT ZFFSAB._.EEpromZentralHandler.eepromChannel[59].ZFFSAB._.cEEpromChannel._.cnt_GetEEpromUpdate "Call counter off function" UBYTE SAB_STANDARD_S2_S3 1 100 0 255 DISPLAY_IDENTIFIER cnt_GetEEpromUpdate._.cEEpromChannel._.ZFFSAB.eepromChannel[59].EEpromZentralHandler._.ZFFSAB ECU_ADDRESS 0xFFF97F50 /end MEASUREMENT
/begin MEASUREMENT ZFFSAB._.EEpromZentralHandler.eepromChannel[59].ZFFSAB._.cEEpromChannel._.ret_GetEEpromUpdate "Return value off function" UBYTE SAB_STANDARD_S2_S3 1 100 0 255 DISPLAY_IDENTIFIER ret_GetEEpromUpdate._.cEEpromChannel._.ZFFSAB.eepromChannel[59].EEpromZentralHandler._.ZFFSAB ECU_ADDRESS 0xFFF97F51 /end MEASUREMENT
/begin MEASUREMENT ZFFSAB._.EEpromZentralHandler.eepromChannel[59].ZFFSAB._.cEEpromChannel._.cnt_SetEEpromInitZyklisch "Call counter off function" UBYTE SAB_STANDARD_S2_S3 1 100 0 255 DISPLAY_IDENTIFIER cnt_SetEEpromInitZyklisch._.cEEpromChannel._.ZFFSAB.eepromChannel[59].EEpromZentralHandler._.ZFFSAB ECU_ADDRESS 0xFFF97F52 /end MEASUREMENT
/begin MEASUREMENT ZFFSAB._.EEpromZentralHandler.eepromChannel[59].ZFFSAB._.cEEpromChannel._.ret_SetEEpromInitZyklisch "Return value off function" UBYTE SAB_STANDARD_S2_S3 1 100 0 255 DISPLAY_IDENTIFIER ret_SetEEpromInitZyklisch._.cEEpromChannel._.ZFFSAB.eepromChannel[59].EEpromZentralHandler._.ZFFSAB ECU_ADDRESS 0xFFF97F53 /end MEASUREMENT
/begin MEASUREMENT ZFFSAB._.EEpromZentralHandler.eepromChannel[59].ZFFSAB._.cEEpromChannel._.eeprom_info "argument of SetEEpromInitZyklisch" UBYTE SAB_STANDARD_S2_S3 1 100 0 255 DISPLAY_IDENTIFIER eeprom_info._.cEEpromChannel._.ZFFSAB.eepromChannel[59].EEpromZentralHandler._.ZFFSAB ECU_ADDRESS 0xFFF97F54 /end MEASUREMENT
/begin MEASUREMENT ZFFSAB._.EEpromZentralHandler.eepromChannel[59].ZFFSAB._.cEEpromChannel._.cnt_GetSizeofEEpromData "Call counter off function" UBYTE SAB_STANDARD_S2_S3 1 100 0 255 DISPLAY_IDENTIFIER cnt_GetSizeofEEpromData._.cEEpromChannel._.ZFFSAB.eepromChannel[59].EEpromZentralHandler._.ZFFSAB ECU_ADDRESS 0xFFF97F55 /end MEASUREMENT
/begin MEASUREMENT ZFFSAB._.EEpromZentralHandler.eepromChannel[59].ZFFSAB._.cEEpromChannel._.ret_GetSizeofEEpromData "Return value off function" UWORD SAB_STANDARD_S2_S3 1 100 0 65535 DISPLAY_IDENTIFIER ret_GetSizeofEEpromData._.cEEpromChannel._.ZFFSAB.eepromChannel[59].EEpromZentralHandler._.ZFFSAB ECU_ADDRESS 0xFFF97F56 /end MEASUREMENT
/begin MEASUREMENT ZFFSAB._.EEpromZentralHandler.eepromChannel[59].cnt_CallEEpromStoreImmediate "Call counter off function" UBYTE SAB_STANDARD_S2_S3 1 100 0 255 DISPLAY_IDENTIFIER cnt_CallEEpromStoreImmediate.eepromChannel[59].EEpromZentralHandler._.ZFFSAB ECU_ADDRESS 0xFFF97F58 /end MEASUREMENT
/begin MEASUREMENT ZFFSAB._.EEpromZentralHandler.eepromChannel[59].ret_CallEEpromStoreImmediate "Return value off function" UBYTE SAB_STANDARD_S2_S3 1 100 0 255 DISPLAY_IDENTIFIER ret_CallEEpromStoreImmediate.eepromChannel[59].EEpromZentralHandler._.ZFFSAB ECU_ADDRESS 0xFFF97F59 /end MEASUREMENT
/begin MEASUREMENT ZFFSAB._.EEpromZentralHandler.eepromChannel[59].cnt_CallEEpromLoadData "Call counter off function" UBYTE SAB_STANDARD_S2_S3 1 100 0 255 DISPLAY_IDENTIFIER cnt_CallEEpromLoadData.eepromChannel[59].EEpromZentralHandler._.ZFFSAB ECU_ADDRESS 0xFFF97F5A /end MEASUREMENT
/begin MEASUREMENT ZFFSAB._.EEpromZentralHandler.eepromChannel[59].ret_CallEEpromLoadData "Return value off function" UBYTE SAB_STANDARD_S2_S3 1 100 0 255 DISPLAY_IDENTIFIER ret_CallEEpromLoadData.eepromChannel[59].EEpromZentralHandler._.ZFFSAB ECU_ADDRESS 0xFFF97F5B /end MEASUREMENT
/begin MEASUREMENT ZFFSAB._.EEpromZentralHandler.eepromChannel[59].cnt_CallEEpromLoadDataState "Call counter off function" UBYTE SAB_STANDARD_S2_S3 1 100 0 255 DISPLAY_IDENTIFIER cnt_CallEEpromLoadDataState.eepromChannel[59].EEpromZentralHandler._.ZFFSAB ECU_ADDRESS 0xFFF97F5C /end MEASUREMENT
/begin MEASUREMENT ZFFSAB._.EEpromZentralHandler.eepromChannel[59].ret_CallEEpromLoadDataState "Return value off function" UBYTE SAB_STANDARD_S2_S3 1 100 0 255 DISPLAY_IDENTIFIER ret_CallEEpromLoadDataState.eepromChannel[59].EEpromZentralHandler._.ZFFSAB ECU_ADDRESS 0xFFF97F5D /end MEASUREMENT
/begin MEASUREMENT ZFFSAB._.EEpromZentralHandler.eepromChannel[59].mode "argument of SetEEpromInitZyklisch" UBYTE SAB_STANDARD_S2_S3 1 100 0 255 DISPLAY_IDENTIFIER mode.eepromChannel[59].EEpromZentralHandler._.ZFFSAB ECU_ADDRESS 0xFFF97F5E /end MEASUREMENT
/begin MEASUREMENT ZFFSAB._.EEpromZentralHandler.eepromChannel[59].cnt_SetEEpromWriteProtect "Call counter off function" UBYTE SAB_STANDARD_S2_S3 1 100 0 255 DISPLAY_IDENTIFIER cnt_SetEEpromWriteProtect.eepromChannel[59].EEpromZentralHandler._.ZFFSAB ECU_ADDRESS 0xFFF97F5F /end MEASUREMENT
/begin MEASUREMENT ZFFSAB._.EEpromZentralHandler.eepromChannel[60].ZFFSAB._.cEEpromChannel._.cnt_GetEEpromValid "Call counter off function" UBYTE SAB_STANDARD_S2_S3 1 100 0 255 DISPLAY_IDENTIFIER cnt_GetEEpromValid._.cEEpromChannel._.ZFFSAB.eepromChannel[60].EEpromZentralHandler._.ZFFSAB ECU_ADDRESS 0xFFF97F60 /end MEASUREMENT
/begin MEASUREMENT ZFFSAB._.EEpromZentralHandler.eepromChannel[60].ZFFSAB._.cEEpromChannel._.ret_GetEEpromValid "Return value off function" UBYTE SAB_STANDARD_S2_S3 1 100 0 255 DISPLAY_IDENTIFIER ret_GetEEpromValid._.cEEpromChannel._.ZFFSAB.eepromChannel[60].EEpromZentralHandler._.ZFFSAB ECU_ADDRESS 0xFFF97F61 /end MEASUREMENT
/begin MEASUREMENT ZFFSAB._.EEpromZentralHandler.eepromChannel[60].ZFFSAB._.cEEpromChannel._.cnt_GetEEpromUpdate "Call counter off function" UBYTE SAB_STANDARD_S2_S3 1 100 0 255 DISPLAY_IDENTIFIER cnt_GetEEpromUpdate._.cEEpromChannel._.ZFFSAB.eepromChannel[60].EEpromZentralHandler._.ZFFSAB ECU_ADDRESS 0xFFF97F62 /end MEASUREMENT
/begin MEASUREMENT ZFFSAB._.EEpromZentralHandler.eepromChannel[60].ZFFSAB._.cEEpromChannel._.ret_GetEEpromUpdate "Return value off function" UBYTE SAB_STANDARD_S2_S3 1 100 0 255 DISPLAY_IDENTIFIER ret_GetEEpromUpdate._.cEEpromChannel._.ZFFSAB.eepromChannel[60].EEpromZentralHandler._.ZFFSAB ECU_ADDRESS 0xFFF97F63 /end MEASUREMENT
/begin MEASUREMENT ZFFSAB._.EEpromZentralHandler.eepromChannel[60].ZFFSAB._.cEEpromChannel._.cnt_SetEEpromInitZyklisch "Call counter off function" UBYTE SAB_STANDARD_S2_S3 1 100 0 255 DISPLAY_IDENTIFIER cnt_SetEEpromInitZyklisch._.cEEpromChannel._.ZFFSAB.eepromChannel[60].EEpromZentralHandler._.ZFFSAB ECU_ADDRESS 0xFFF97F64 /end MEASUREMENT
/begin MEASUREMENT ZFFSAB._.EEpromZentralHandler.eepromChannel[60].ZFFSAB._.cEEpromChannel._.ret_SetEEpromInitZyklisch "Return value off function" UBYTE SAB_STANDARD_S2_S3 1 100 0 255 DISPLAY_IDENTIFIER ret_SetEEpromInitZyklisch._.cEEpromChannel._.ZFFSAB.eepromChannel[60].EEpromZentralHandler._.ZFFSAB ECU_ADDRESS 0xFFF97F65 /end MEASUREMENT
/begin MEASUREMENT ZFFSAB._.EEpromZentralHandler.eepromChannel[60].ZFFSAB._.cEEpromChannel._.eeprom_info "argument of SetEEpromInitZyklisch" UBYTE SAB_STANDARD_S2_S3 1 100 0 255 DISPLAY_IDENTIFIER eeprom_info._.cEEpromChannel._.ZFFSAB.eepromChannel[60].EEpromZentralHandler._.ZFFSAB ECU_ADDRESS 0xFFF97F66 /end MEASUREMENT
/begin MEASUREMENT ZFFSAB._.EEpromZentralHandler.eepromChannel[60].ZFFSAB._.cEEpromChannel._.cnt_GetSizeofEEpromData "Call counter off function" UBYTE SAB_STANDARD_S2_S3 1 100 0 255 DISPLAY_IDENTIFIER cnt_GetSizeofEEpromData._.cEEpromChannel._.ZFFSAB.eepromChannel[60].EEpromZentralHandler._.ZFFSAB ECU_ADDRESS 0xFFF97F67 /end MEASUREMENT
/begin MEASUREMENT ZFFSAB._.EEpromZentralHandler.eepromChannel[60].ZFFSAB._.cEEpromChannel._.ret_GetSizeofEEpromData "Return value off function" UWORD SAB_STANDARD_S2_S3 1 100 0 65535 DISPLAY_IDENTIFIER ret_GetSizeofEEpromData._.cEEpromChannel._.ZFFSAB.eepromChannel[60].EEpromZentralHandler._.ZFFSAB ECU_ADDRESS 0xFFF97F68 /end MEASUREMENT
/begin MEASUREMENT ZFFSAB._.EEpromZentralHandler.eepromChannel[60].cnt_CallEEpromStoreImmediate "Call counter off function" UBYTE SAB_STANDARD_S2_S3 1 100 0 255 DISPLAY_IDENTIFIER cnt_CallEEpromStoreImmediate.eepromChannel[60].EEpromZentralHandler._.ZFFSAB ECU_ADDRESS 0xFFF97F6A /end MEASUREMENT
/begin MEASUREMENT ZFFSAB._.EEpromZentralHandler.eepromChannel[60].ret_CallEEpromStoreImmediate "Return value off function" UBYTE SAB_STANDARD_S2_S3 1 100 0 255 DISPLAY_IDENTIFIER ret_CallEEpromStoreImmediate.eepromChannel[60].EEpromZentralHandler._.ZFFSAB ECU_ADDRESS 0xFFF97F6B /end MEASUREMENT
/begin MEASUREMENT ZFFSAB._.EEpromZentralHandler.eepromChannel[60].cnt_CallEEpromLoadData "Call counter off function" UBYTE SAB_STANDARD_S2_S3 1 100 0 255 DISPLAY_IDENTIFIER cnt_CallEEpromLoadData.eepromChannel[60].EEpromZentralHandler._.ZFFSAB ECU_ADDRESS 0xFFF97F6C /end MEASUREMENT
/begin MEASUREMENT ZFFSAB._.EEpromZentralHandler.eepromChannel[60].ret_CallEEpromLoadData "Return value off function" UBYTE SAB_STANDARD_S2_S3 1 100 0 255 DISPLAY_IDENTIFIER ret_CallEEpromLoadData.eepromChannel[60].EEpromZentralHandler._.ZFFSAB ECU_ADDRESS 0xFFF97F6D /end MEASUREMENT
/begin MEASUREMENT ZFFSAB._.EEpromZentralHandler.eepromChannel[60].cnt_CallEEpromLoadDataState "Call counter off function" UBYTE SAB_STANDARD_S2_S3 1 100 0 255 DISPLAY_IDENTIFIER cnt_CallEEpromLoadDataState.eepromChannel[60].EEpromZentralHandler._.ZFFSAB ECU_ADDRESS 0xFFF97F6E /end MEASUREMENT
/begin MEASUREMENT ZFFSAB._.EEpromZentralHandler.eepromChannel[60].ret_CallEEpromLoadDataState "Return value off function" UBYTE SAB_STANDARD_S2_S3 1 100 0 255 DISPLAY_IDENTIFIER ret_CallEEpromLoadDataState.eepromChannel[60].EEpromZentralHandler._.ZFFSAB ECU_ADDRESS 0xFFF97F6F /end MEASUREMENT
/begin MEASUREMENT ZFFSAB._.EEpromZentralHandler.eepromChannel[60].mode "argument of SetEEpromInitZyklisch" UBYTE SAB_STANDARD_S2_S3 1 100 0 255 DISPLAY_IDENTIFIER mode.eepromChannel[60].EEpromZentralHandler._.ZFFSAB ECU_ADDRESS 0xFFF97F70 /end MEASUREMENT
/begin MEASUREMENT ZFFSAB._.EEpromZentralHandler.eepromChannel[60].cnt_SetEEpromWriteProtect "Call counter off function" UBYTE SAB_STANDARD_S2_S3 1 100 0 255 DISPLAY_IDENTIFIER cnt_SetEEpromWriteProtect.eepromChannel[60].EEpromZentralHandler._.ZFFSAB ECU_ADDRESS 0xFFF97F71 /end MEASUREMENT
/begin MEASUREMENT ZFFSAB._.EEpromZentralHandler.eepromChannel[61].ZFFSAB._.cEEpromChannel._.cnt_GetEEpromValid "Call counter off function" UBYTE SAB_STANDARD_S2_S3 1 100 0 255 DISPLAY_IDENTIFIER cnt_GetEEpromValid._.cEEpromChannel._.ZFFSAB.eepromChannel[61].EEpromZentralHandler._.ZFFSAB ECU_ADDRESS 0xFFF97F72 /end MEASUREMENT
/begin MEASUREMENT ZFFSAB._.EEpromZentralHandler.eepromChannel[61].ZFFSAB._.cEEpromChannel._.ret_GetEEpromValid "Return value off function" UBYTE SAB_STANDARD_S2_S3 1 100 0 255 DISPLAY_IDENTIFIER ret_GetEEpromValid._.cEEpromChannel._.ZFFSAB.eepromChannel[61].EEpromZentralHandler._.ZFFSAB ECU_ADDRESS 0xFFF97F73 /end MEASUREMENT
/begin MEASUREMENT ZFFSAB._.EEpromZentralHandler.eepromChannel[61].ZFFSAB._.cEEpromChannel._.cnt_GetEEpromUpdate "Call counter off function" UBYTE SAB_STANDARD_S2_S3 1 100 0 255 DISPLAY_IDENTIFIER cnt_GetEEpromUpdate._.cEEpromChannel._.ZFFSAB.eepromChannel[61].EEpromZentralHandler._.ZFFSAB ECU_ADDRESS 0xFFF97F74 /end MEASUREMENT
/begin MEASUREMENT ZFFSAB._.EEpromZentralHandler.eepromChannel[61].ZFFSAB._.cEEpromChannel._.ret_GetEEpromUpdate "Return value off function" UBYTE SAB_STANDARD_S2_S3 1 100 0 255 DISPLAY_IDENTIFIER ret_GetEEpromUpdate._.cEEpromChannel._.ZFFSAB.eepromChannel[61].EEpromZentralHandler._.ZFFSAB ECU_ADDRESS 0xFFF97F75 /end MEASUREMENT
/begin MEASUREMENT ZFFSAB._.EEpromZentralHandler.eepromChannel[61].ZFFSAB._.cEEpromChannel._.cnt_SetEEpromInitZyklisch "Call counter off function" UBYTE SAB_STANDARD_S2_S3 1 100 0 255 DISPLAY_IDENTIFIER cnt_SetEEpromInitZyklisch._.cEEpromChannel._.ZFFSAB.eepromChannel[61].EEpromZentralHandler._.ZFFSAB ECU_ADDRESS 0xFFF97F76 /end MEASUREMENT
/begin MEASUREMENT ZFFSAB._.EEpromZentralHandler.eepromChannel[61].ZFFSAB._.cEEpromChannel._.ret_SetEEpromInitZyklisch "Return value off function" UBYTE SAB_STANDARD_S2_S3 1 100 0 255 DISPLAY_IDENTIFIER ret_SetEEpromInitZyklisch._.cEEpromChannel._.ZFFSAB.eepromChannel[61].EEpromZentralHandler._.ZFFSAB ECU_ADDRESS 0xFFF97F77 /end MEASUREMENT
/begin MEASUREMENT ZFFSAB._.EEpromZentralHandler.eepromChannel[61].ZFFSAB._.cEEpromChannel._.eeprom_info "argument of SetEEpromInitZyklisch" UBYTE SAB_STANDARD_S2_S3 1 100 0 255 DISPLAY_IDENTIFIER eeprom_info._.cEEpromChannel._.ZFFSAB.eepromChannel[61].EEpromZentralHandler._.ZFFSAB ECU_ADDRESS 0xFFF97F78 /end MEASUREMENT
/begin MEASUREMENT ZFFSAB._.EEpromZentralHandler.eepromChannel[61].ZFFSAB._.cEEpromChannel._.cnt_GetSizeofEEpromData "Call counter off function" UBYTE SAB_STANDARD_S2_S3 1 100 0 255 DISPLAY_IDENTIFIER cnt_GetSizeofEEpromData._.cEEpromChannel._.ZFFSAB.eepromChannel[61].EEpromZentralHandler._.ZFFSAB ECU_ADDRESS 0xFFF97F79 /end MEASUREMENT
/begin MEASUREMENT ZFFSAB._.EEpromZentralHandler.eepromChannel[61].ZFFSAB._.cEEpromChannel._.ret_GetSizeofEEpromData "Return value off function" UWORD SAB_STANDARD_S2_S3 1 100 0 65535 DISPLAY_IDENTIFIER ret_GetSizeofEEpromData._.cEEpromChannel._.ZFFSAB.eepromChannel[61].EEpromZentralHandler._.ZFFSAB ECU_ADDRESS 0xFFF97F7A /end MEASUREMENT
/begin MEASUREMENT ZFFSAB._.EEpromZentralHandler.eepromChannel[61].cnt_CallEEpromStoreImmediate "Call counter off function" UBYTE SAB_STANDARD_S2_S3 1 100 0 255 DISPLAY_IDENTIFIER cnt_CallEEpromStoreImmediate.eepromChannel[61].EEpromZentralHandler._.ZFFSAB ECU_ADDRESS 0xFFF97F7C /end MEASUREMENT
/begin MEASUREMENT ZFFSAB._.EEpromZentralHandler.eepromChannel[61].ret_CallEEpromStoreImmediate "Return value off function" UBYTE SAB_STANDARD_S2_S3 1 100 0 255 DISPLAY_IDENTIFIER ret_CallEEpromStoreImmediate.eepromChannel[61].EEpromZentralHandler._.ZFFSAB ECU_ADDRESS 0xFFF97F7D /end MEASUREMENT
/begin MEASUREMENT ZFFSAB._.EEpromZentralHandler.eepromChannel[61].cnt_CallEEpromLoadData "Call counter off function" UBYTE SAB_STANDARD_S2_S3 1 100 0 255 DISPLAY_IDENTIFIER cnt_CallEEpromLoadData.eepromChannel[61].EEpromZentralHandler._.ZFFSAB ECU_ADDRESS 0xFFF97F7E /end MEASUREMENT
/begin MEASUREMENT ZFFSAB._.EEpromZentralHandler.eepromChannel[61].ret_CallEEpromLoadData "Return value off function" UBYTE SAB_STANDARD_S2_S3 1 100 0 255 DISPLAY_IDENTIFIER ret_CallEEpromLoadData.eepromChannel[61].EEpromZentralHandler._.ZFFSAB ECU_ADDRESS 0xFFF97F7F /end MEASUREMENT
/begin MEASUREMENT ZFFSAB._.EEpromZentralHandler.eepromChannel[61].cnt_CallEEpromLoadDataState "Call counter off function" UBYTE SAB_STANDARD_S2_S3 1 100 0 255 DISPLAY_IDENTIFIER cnt_CallEEpromLoadDataState.eepromChannel[61].EEpromZentralHandler._.ZFFSAB ECU_ADDRESS 0xFFF97F80 /end MEASUREMENT
/begin MEASUREMENT ZFFSAB._.EEpromZentralHandler.eepromChannel[61].ret_CallEEpromLoadDataState "Return value off function" UBYTE SAB_STANDARD_S2_S3 1 100 0 255 DISPLAY_IDENTIFIER ret_CallEEpromLoadDataState.eepromChannel[61].EEpromZentralHandler._.ZFFSAB ECU_ADDRESS 0xFFF97F81 /end MEASUREMENT
/begin MEASUREMENT ZFFSAB._.EEpromZentralHandler.eepromChannel[61].mode "argument of SetEEpromInitZyklisch" UBYTE SAB_STANDARD_S2_S3 1 100 0 255 DISPLAY_IDENTIFIER mode.eepromChannel[61].EEpromZentralHandler._.ZFFSAB ECU_ADDRESS 0xFFF97F82 /end MEASUREMENT
/begin MEASUREMENT ZFFSAB._.EEpromZentralHandler.eepromChannel[61].cnt_SetEEpromWriteProtect "Call counter off function" UBYTE SAB_STANDARD_S2_S3 1 100 0 255 DISPLAY_IDENTIFIER cnt_SetEEpromWriteProtect.eepromChannel[61].EEpromZentralHandler._.ZFFSAB ECU_ADDRESS 0xFFF97F83 /end MEASUREMENT
/begin MEASUREMENT ZFFSAB._.EEpromZentralHandler.eepromChannel[62].ZFFSAB._.cEEpromChannel._.cnt_GetEEpromValid "Call counter off function" UBYTE SAB_STANDARD_S2_S3 1 100 0 255 DISPLAY_IDENTIFIER cnt_GetEEpromValid._.cEEpromChannel._.ZFFSAB.eepromChannel[62].EEpromZentralHandler._.ZFFSAB ECU_ADDRESS 0xFFF97F84 /end MEASUREMENT
/begin MEASUREMENT ZFFSAB._.EEpromZentralHandler.eepromChannel[62].ZFFSAB._.cEEpromChannel._.ret_GetEEpromValid "Return value off function" UBYTE SAB_STANDARD_S2_S3 1 100 0 255 DISPLAY_IDENTIFIER ret_GetEEpromValid._.cEEpromChannel._.ZFFSAB.eepromChannel[62].EEpromZentralHandler._.ZFFSAB ECU_ADDRESS 0xFFF97F85 /end MEASUREMENT
/begin MEASUREMENT ZFFSAB._.EEpromZentralHandler.eepromChannel[62].ZFFSAB._.cEEpromChannel._.cnt_GetEEpromUpdate "Call counter off function" UBYTE SAB_STANDARD_S2_S3 1 100 0 255 DISPLAY_IDENTIFIER cnt_GetEEpromUpdate._.cEEpromChannel._.ZFFSAB.eepromChannel[62].EEpromZentralHandler._.ZFFSAB ECU_ADDRESS 0xFFF97F86 /end MEASUREMENT
/begin MEASUREMENT ZFFSAB._.EEpromZentralHandler.eepromChannel[62].ZFFSAB._.cEEpromChannel._.ret_GetEEpromUpdate "Return value off function" UBYTE SAB_STANDARD_S2_S3 1 100 0 255 DISPLAY_IDENTIFIER ret_GetEEpromUpdate._.cEEpromChannel._.ZFFSAB.eepromChannel[62].EEpromZentralHandler._.ZFFSAB ECU_ADDRESS 0xFFF97F87 /end MEASUREMENT
/begin MEASUREMENT ZFFSAB._.EEpromZentralHandler.eepromChannel[62].ZFFSAB._.cEEpromChannel._.cnt_SetEEpromInitZyklisch "Call counter off function" UBYTE SAB_STANDARD_S2_S3 1 100 0 255 DISPLAY_IDENTIFIER cnt_SetEEpromInitZyklisch._.cEEpromChannel._.ZFFSAB.eepromChannel[62].EEpromZentralHandler._.ZFFSAB ECU_ADDRESS 0xFFF97F88 /end MEASUREMENT
/begin MEASUREMENT ZFFSAB._.EEpromZentralHandler.eepromChannel[62].ZFFSAB._.cEEpromChannel._.ret_SetEEpromInitZyklisch "Return value off function" UBYTE SAB_STANDARD_S2_S3 1 100 0 255 DISPLAY_IDENTIFIER ret_SetEEpromInitZyklisch._.cEEpromChannel._.ZFFSAB.eepromChannel[62].EEpromZentralHandler._.ZFFSAB ECU_ADDRESS 0xFFF97F89 /end MEASUREMENT
/begin MEASUREMENT ZFFSAB._.EEpromZentralHandler.eepromChannel[62].ZFFSAB._.cEEpromChannel._.eeprom_info "argument of SetEEpromInitZyklisch" UBYTE SAB_STANDARD_S2_S3 1 100 0 255 DISPLAY_IDENTIFIER eeprom_info._.cEEpromChannel._.ZFFSAB.eepromChannel[62].EEpromZentralHandler._.ZFFSAB ECU_ADDRESS 0xFFF97F8A /end MEASUREMENT
/begin MEASUREMENT ZFFSAB._.EEpromZentralHandler.eepromChannel[62].ZFFSAB._.cEEpromChannel._.cnt_GetSizeofEEpromData "Call counter off function" UBYTE SAB_STANDARD_S2_S3 1 100 0 255 DISPLAY_IDENTIFIER cnt_GetSizeofEEpromData._.cEEpromChannel._.ZFFSAB.eepromChannel[62].EEpromZentralHandler._.ZFFSAB ECU_ADDRESS 0xFFF97F8B /end MEASUREMENT
/begin MEASUREMENT ZFFSAB._.EEpromZentralHandler.eepromChannel[62].ZFFSAB._.cEEpromChannel._.ret_GetSizeofEEpromData "Return value off function" UWORD SAB_STANDARD_S2_S3 1 100 0 65535 DISPLAY_IDENTIFIER ret_GetSizeofEEpromData._.cEEpromChannel._.ZFFSAB.eepromChannel[62].EEpromZentralHandler._.ZFFSAB ECU_ADDRESS 0xFFF97F8C /end MEASUREMENT
/begin MEASUREMENT ZFFSAB._.EEpromZentralHandler.eepromChannel[62].cnt_CallEEpromStoreImmediate "Call counter off function" UBYTE SAB_STANDARD_S2_S3 1 100 0 255 DISPLAY_IDENTIFIER cnt_CallEEpromStoreImmediate.eepromChannel[62].EEpromZentralHandler._.ZFFSAB ECU_ADDRESS 0xFFF97F8E /end MEASUREMENT
/begin MEASUREMENT ZFFSAB._.EEpromZentralHandler.eepromChannel[62].ret_CallEEpromStoreImmediate "Return value off function" UBYTE SAB_STANDARD_S2_S3 1 100 0 255 DISPLAY_IDENTIFIER ret_CallEEpromStoreImmediate.eepromChannel[62].EEpromZentralHandler._.ZFFSAB ECU_ADDRESS 0xFFF97F8F /end MEASUREMENT
/begin MEASUREMENT ZFFSAB._.EEpromZentralHandler.eepromChannel[62].cnt_CallEEpromLoadData "Call counter off function" UBYTE SAB_STANDARD_S2_S3 1 100 0 255 DISPLAY_IDENTIFIER cnt_CallEEpromLoadData.eepromChannel[62].EEpromZentralHandler._.ZFFSAB ECU_ADDRESS 0xFFF97F90 /end MEASUREMENT
/begin MEASUREMENT ZFFSAB._.EEpromZentralHandler.eepromChannel[62].ret_CallEEpromLoadData "Return value off function" UBYTE SAB_STANDARD_S2_S3 1 100 0 255 DISPLAY_IDENTIFIER ret_CallEEpromLoadData.eepromChannel[62].EEpromZentralHandler._.ZFFSAB ECU_ADDRESS 0xFFF97F91 /end MEASUREMENT
/begin MEASUREMENT ZFFSAB._.EEpromZentralHandler.eepromChannel[62].cnt_CallEEpromLoadDataState "Call counter off function" UBYTE SAB_STANDARD_S2_S3 1 100 0 255 DISPLAY_IDENTIFIER cnt_CallEEpromLoadDataState.eepromChannel[62].EEpromZentralHandler._.ZFFSAB ECU_ADDRESS 0xFFF97F92 /end MEASUREMENT
/begin MEASUREMENT ZFFSAB._.EEpromZentralHandler.eepromChannel[62].ret_CallEEpromLoadDataState "Return value off function" UBYTE SAB_STANDARD_S2_S3 1 100 0 255 DISPLAY_IDENTIFIER ret_CallEEpromLoadDataState.eepromChannel[62].EEpromZentralHandler._.ZFFSAB ECU_ADDRESS 0xFFF97F93 /end MEASUREMENT
/begin MEASUREMENT ZFFSAB._.EEpromZentralHandler.eepromChannel[62].mode "argument of SetEEpromInitZyklisch" UBYTE SAB_STANDARD_S2_S3 1 100 0 255 DISPLAY_IDENTIFIER mode.eepromChannel[62].EEpromZentralHandler._.ZFFSAB ECU_ADDRESS 0xFFF97F94 /end MEASUREMENT
/begin MEASUREMENT ZFFSAB._.EEpromZentralHandler.eepromChannel[62].cnt_SetEEpromWriteProtect "Call counter off function" UBYTE SAB_STANDARD_S2_S3 1 100 0 255 DISPLAY_IDENTIFIER cnt_SetEEpromWriteProtect.eepromChannel[62].EEpromZentralHandler._.ZFFSAB ECU_ADDRESS 0xFFF97F95 /end MEASUREMENT
/begin MEASUREMENT ZFFSAB._.EEpromZentralHandler.eepromChannel[63].ZFFSAB._.cEEpromChannel._.cnt_GetEEpromValid "Call counter off function" UBYTE SAB_STANDARD_S2_S3 1 100 0 255 DISPLAY_IDENTIFIER cnt_GetEEpromValid._.cEEpromChannel._.ZFFSAB.eepromChannel[63].EEpromZentralHandler._.ZFFSAB ECU_ADDRESS 0xFFF97F96 /end MEASUREMENT
/begin MEASUREMENT ZFFSAB._.EEpromZentralHandler.eepromChannel[63].ZFFSAB._.cEEpromChannel._.ret_GetEEpromValid "Return value off function" UBYTE SAB_STANDARD_S2_S3 1 100 0 255 DISPLAY_IDENTIFIER ret_GetEEpromValid._.cEEpromChannel._.ZFFSAB.eepromChannel[63].EEpromZentralHandler._.ZFFSAB ECU_ADDRESS 0xFFF97F97 /end MEASUREMENT
/begin MEASUREMENT ZFFSAB._.EEpromZentralHandler.eepromChannel[63].ZFFSAB._.cEEpromChannel._.cnt_GetEEpromUpdate "Call counter off function" UBYTE SAB_STANDARD_S2_S3 1 100 0 255 DISPLAY_IDENTIFIER cnt_GetEEpromUpdate._.cEEpromChannel._.ZFFSAB.eepromChannel[63].EEpromZentralHandler._.ZFFSAB ECU_ADDRESS 0xFFF97F98 /end MEASUREMENT
/begin MEASUREMENT ZFFSAB._.EEpromZentralHandler.eepromChannel[63].ZFFSAB._.cEEpromChannel._.ret_GetEEpromUpdate "Return value off function" UBYTE SAB_STANDARD_S2_S3 1 100 0 255 DISPLAY_IDENTIFIER ret_GetEEpromUpdate._.cEEpromChannel._.ZFFSAB.eepromChannel[63].EEpromZentralHandler._.ZFFSAB ECU_ADDRESS 0xFFF97F99 /end MEASUREMENT
/begin MEASUREMENT ZFFSAB._.EEpromZentralHandler.eepromChannel[63].ZFFSAB._.cEEpromChannel._.cnt_SetEEpromInitZyklisch "Call counter off function" UBYTE SAB_STANDARD_S2_S3 1 100 0 255 DISPLAY_IDENTIFIER cnt_SetEEpromInitZyklisch._.cEEpromChannel._.ZFFSAB.eepromChannel[63].EEpromZentralHandler._.ZFFSAB ECU_ADDRESS 0xFFF97F9A /end MEASUREMENT
/begin MEASUREMENT ZFFSAB._.EEpromZentralHandler.eepromChannel[63].ZFFSAB._.cEEpromChannel._.ret_SetEEpromInitZyklisch "Return value off function" UBYTE SAB_STANDARD_S2_S3 1 100 0 255 DISPLAY_IDENTIFIER ret_SetEEpromInitZyklisch._.cEEpromChannel._.ZFFSAB.eepromChannel[63].EEpromZentralHandler._.ZFFSAB ECU_ADDRESS 0xFFF97F9B /end MEASUREMENT
/begin MEASUREMENT ZFFSAB._.EEpromZentralHandler.eepromChannel[63].ZFFSAB._.cEEpromChannel._.eeprom_info "argument of SetEEpromInitZyklisch" UBYTE SAB_STANDARD_S2_S3 1 100 0 255 DISPLAY_IDENTIFIER eeprom_info._.cEEpromChannel._.ZFFSAB.eepromChannel[63].EEpromZentralHandler._.ZFFSAB ECU_ADDRESS 0xFFF97F9C /end MEASUREMENT
/begin MEASUREMENT ZFFSAB._.EEpromZentralHandler.eepromChannel[63].ZFFSAB._.cEEpromChannel._.cnt_GetSizeofEEpromData "Call counter off function" UBYTE SAB_STANDARD_S2_S3 1 100 0 255 DISPLAY_IDENTIFIER cnt_GetSizeofEEpromData._.cEEpromChannel._.ZFFSAB.eepromChannel[63].EEpromZentralHandler._.ZFFSAB ECU_ADDRESS 0xFFF97F9D /end MEASUREMENT
/begin MEASUREMENT ZFFSAB._.EEpromZentralHandler.eepromChannel[63].ZFFSAB._.cEEpromChannel._.ret_GetSizeofEEpromData "Return value off function" UWORD SAB_STANDARD_S2_S3 1 100 0 65535 DISPLAY_IDENTIFIER ret_GetSizeofEEpromData._.cEEpromChannel._.ZFFSAB.eepromChannel[63].EEpromZentralHandler._.ZFFSAB ECU_ADDRESS 0xFFF97F9E /end MEASUREMENT
/begin MEASUREMENT ZFFSAB._.EEpromZentralHandler.eepromChannel[63].cnt_CallEEpromStoreImmediate "Call counter off function" UBYTE SAB_STANDARD_S2_S3 1 100 0 255 DISPLAY_IDENTIFIER cnt_CallEEpromStoreImmediate.eepromChannel[63].EEpromZentralHandler._.ZFFSAB ECU_ADDRESS 0xFFF97FA0 /end MEASUREMENT
/begin MEASUREMENT ZFFSAB._.EEpromZentralHandler.eepromChannel[63].ret_CallEEpromStoreImmediate "Return value off function" UBYTE SAB_STANDARD_S2_S3 1 100 0 255 DISPLAY_IDENTIFIER ret_CallEEpromStoreImmediate.eepromChannel[63].EEpromZentralHandler._.ZFFSAB ECU_ADDRESS 0xFFF97FA1 /end MEASUREMENT
/begin MEASUREMENT ZFFSAB._.EEpromZentralHandler.eepromChannel[63].cnt_CallEEpromLoadData "Call counter off function" UBYTE SAB_STANDARD_S2_S3 1 100 0 255 DISPLAY_IDENTIFIER cnt_CallEEpromLoadData.eepromChannel[63].EEpromZentralHandler._.ZFFSAB ECU_ADDRESS 0xFFF97FA2 /end MEASUREMENT
/begin MEASUREMENT ZFFSAB._.EEpromZentralHandler.eepromChannel[63].ret_CallEEpromLoadData "Return value off function" UBYTE SAB_STANDARD_S2_S3 1 100 0 255 DISPLAY_IDENTIFIER ret_CallEEpromLoadData.eepromChannel[63].EEpromZentralHandler._.ZFFSAB ECU_ADDRESS 0xFFF97FA3 /end MEASUREMENT
/begin MEASUREMENT ZFFSAB._.EEpromZentralHandler.eepromChannel[63].cnt_CallEEpromLoadDataState "Call counter off function" UBYTE SAB_STANDARD_S2_S3 1 100 0 255 DISPLAY_IDENTIFIER cnt_CallEEpromLoadDataState.eepromChannel[63].EEpromZentralHandler._.ZFFSAB ECU_ADDRESS 0xFFF97FA4 /end MEASUREMENT
/begin MEASUREMENT ZFFSAB._.EEpromZentralHandler.eepromChannel[63].ret_CallEEpromLoadDataState "Return value off function" UBYTE SAB_STANDARD_S2_S3 1 100 0 255 DISPLAY_IDENTIFIER ret_CallEEpromLoadDataState.eepromChannel[63].EEpromZentralHandler._.ZFFSAB ECU_ADDRESS 0xFFF97FA5 /end MEASUREMENT
/begin MEASUREMENT ZFFSAB._.EEpromZentralHandler.eepromChannel[63].mode "argument of SetEEpromInitZyklisch" UBYTE SAB_STANDARD_S2_S3 1 100 0 255 DISPLAY_IDENTIFIER mode.eepromChannel[63].EEpromZentralHandler._.ZFFSAB ECU_ADDRESS 0xFFF97FA6 /end MEASUREMENT
/begin MEASUREMENT ZFFSAB._.EEpromZentralHandler.eepromChannel[63].cnt_SetEEpromWriteProtect "Call counter off function" UBYTE SAB_STANDARD_S2_S3 1 100 0 255 DISPLAY_IDENTIFIER cnt_SetEEpromWriteProtect.eepromChannel[63].EEpromZentralHandler._.ZFFSAB ECU_ADDRESS 0xFFF97FA7 /end MEASUREMENT
/begin MEASUREMENT ZFFSAB._.EEpromZentralHandler.iv_cnt_EeUpdt "Returns number of successfull saved partitions since start of EEPROM-Emulation" ULONG SAB_STANDARD_S2_S3 1 100 0 4294967295 DISPLAY_IDENTIFIER iv_cnt_EeUpdt.EEpromZentralHandler._.ZFFSAB ECU_ADDRESS 0xFFF97FE0 /end MEASUREMENT
/begin MEASUREMENT ZFFSAB._.EEpromZentralHandler.iv_cnt_ErrMemEntry "Number of Trouble Codes Set due to Diagnostic Test" UWORD SAB_STANDARD_S2_S3 1 100 0 65535 DISPLAY_IDENTIFIER iv_cnt_ErrMemEntry.EEpromZentralHandler._.ZFFSAB ECU_ADDRESS 0xFFF97FE4 /end MEASUREMENT
/begin MEASUREMENT ZFFSAB._.EEpromZentralHandler.f_EeStoreInProgress "1=EEPROM Storage - outside EEZH - is active 0=EEPROM Storage is not active" UBYTE SAB_STANDARD_S2_S3 1 100 0 255 DISPLAY_IDENTIFIER f_EeStoreInProgress.EEpromZentralHandler._.ZFFSAB ECU_ADDRESS 0xFFF97FE6 /end MEASUREMENT
/begin MEASUREMENT ZFFSAB._.EEpromZentralHandler.f_EeStoringActive "True if Storing - within EEZH - into the EEPROM is in progress" UBYTE SAB_STANDARD_S2_S3 1 100 0 255 DISPLAY_IDENTIFIER f_EeStoringActive.EEpromZentralHandler._.ZFFSAB ECU_ADDRESS 0xFFF97FE7 /end MEASUREMENT
/begin MEASUREMENT ZFFSAB._.EEpromZentralHandler.st_EeUpdateAll "Internal current state of the state machine" UBYTE SAB_STANDARD_S2_S3 1 100 0 6 DISPLAY_IDENTIFIER st_EeUpdateAll.EEpromZentralHandler._.ZFFSAB ECU_ADDRESS 0xFFF97FE8 /end MEASUREMENT
/begin MEASUREMENT ZFFSAB._.EEpromZentralHandler.f_EeUpdateAllRequest "True if there is an update request of the EEPROM" UBYTE SAB_STANDARD_S2_S3 1 100 0 1 DISPLAY_IDENTIFIER f_EeUpdateAllRequest.EEpromZentralHandler._.ZFFSAB ECU_ADDRESS 0xFFF97FE9 /end MEASUREMENT
/begin MEASUREMENT ZFFSAB._.EEpromZentralHandler.iv_f_EeUpdateAllState "Gets the state of the eeprom update of all eeprom channels invoked by the macro GET_ZF_EE_UPDATE_ALL. The state of this macro must change at same time the update request gets detected" UBYTE SAB_STANDARD_S2_S3 1 100 0 1 DISPLAY_IDENTIFIER iv_f_EeUpdateAllState.EEpromZentralHandler._.ZFFSAB ECU_ADDRESS 0xFFF97FEA /end MEASUREMENT
/begin COMPU_METHOD SAB_STANDARD_S2_S3 "int = ((phys * 1) / 1) - (0) -" RAT_FUNC "%2.0" "-" COEFFS 0 1 -0 0 0 1 /end COMPU_METHOD
/begin FUNCTION zf_SAB_EEpromZentralHandler "desc_en"
 /begin LOC_MEASUREMENT ZFFSAB._.EEpromZentralHandler.eepromChannel[40].ret_CallEEpromLoadData ZFFSAB._.EEpromZentralHandler.eepromChannel[40].ret_CallEEpromLoadDataState ZFFSAB._.EEpromZentralHandler.eepromChannel[40].ret_CallEEpromStoreImmediate ZFFSAB._.EEpromZentralHandler.eepromChannel[41].ZFFSAB._.cEEpromChannel._.cnt_GetEEpromUpdate ZFFSAB._.EEpromZentralHandler.eepromChannel[41].ZFFSAB._.cEEpromChannel._.cnt_GetEEpromValid ZFFSAB._.EEpromZentralHandler.eepromChannel[41].ZFFSAB._.cEEpromChannel._.cnt_GetSizeofEEpromData ZFFSAB._.EEpromZentralHandler.eepromChannel[41].ZFFSAB._.cEEpromChannel._.cnt_SetEEpromInitZyklisch ZFFSAB._.EEpromZentralHandler.eepromChannel[41].ZFFSAB._.cEEpromChannel._.eeprom_info ZFFSAB._.EEpromZentralHandler.eepromChannel[41].ZFFSAB._.cEEpromChannel._.ret_GetEEpromUpdate ZFFSAB._.EEpromZentralHandler.eepromChannel[41].ZFFSAB._.cEEpromChannel._.ret_GetEEpromValid ZFFSAB._.EEpromZentralHandler.eepromChannel[41].ZFFSAB._.cEEpromChannel._.ret_GetSizeofEEpromData ZFFSAB._.EEpromZentralHandler.eepromChannel[41].ZFFSAB._.cEEpromChannel._.ret_SetEEpromInitZyklisch ZFFSAB._.EEpromZentralHandler.eepromChannel[41].cnt_CallEEpromLoadData ZFFSAB._.EEpromZentralHandler.eepromChannel[41].cnt_CallEEpromLoadDataState ZFFSAB._.EEpromZentralHandler.eepromChannel[41].cnt_CallEEpromStoreImmediate ZFFSAB._.EEpromZentralHandler.eepromChannel[41].cnt_SetEEpromWriteProtect ZFFSAB._.EEpromZentralHandler.eepromChannel[41].mode ZFFSAB._.EEpromZentralHandler.eepromChannel[41].ret_CallEEpromLoadData ZFFSAB._.EEpromZentralHandler.eepromChannel[41].ret_CallEEpromLoadDataState ZFFSAB._.EEpromZentralHandler.eepromChannel[41].ret_CallEEpromStoreImmediate ZFFSAB._.EEpromZentralHandler.eepromChannel[42].ZFFSAB._.cEEpromChannel._.cnt_GetEEpromUpdate ZFFSAB._.EEpromZentralHandler.eepromChannel[42].ZFFSAB._.cEEpromChannel._.cnt_GetEEpromValid ZFFSAB._.EEpromZentralHandler.eepromChannel[42].ZFFSAB._.cEEpromChannel._.cnt_GetSizeofEEpromData ZFFSAB._.EEpromZentralHandler.eepromChannel[42].ZFFSAB._.cEEpromChannel._.cnt_SetEEpromInitZyklisch ZFFSAB._.EEpromZentralHandler.eepromChannel[42].ZFFSAB._.cEEpromChannel._.eeprom_info ZFFSAB._.EEpromZentralHandler.eepromChannel[42].ZFFSAB._.cEEpromChannel._.ret_GetEEpromUpdate ZFFSAB._.EEpromZentralHandler.eepromChannel[42].ZFFSAB._.cEEpromChannel._.ret_GetEEpromValid ZFFSAB._.EEpromZentralHandler.eepromChannel[42].ZFFSAB._.cEEpromChannel._.ret_GetSizeofEEpromData ZFFSAB._.EEpromZentralHandler.eepromChannel[42].ZFFSAB._.cEEpromChannel._.ret_SetEEpromInitZyklisch ZFFSAB._.EEpromZentralHandler.eepromChannel[42].cnt_CallEEpromLoadData ZFFSAB._.EEpromZentralHandler.eepromChannel[42].cnt_CallEEpromLoadDataState ZFFSAB._.EEpromZentralHandler.eepromChannel[42].cnt_CallEEpromStoreImmediate ZFFSAB._.EEpromZentralHandler.eepromChannel[42].cnt_SetEEpromWriteProtect ZFFSAB._.EEpromZentralHandler.eepromChannel[42].mode ZFFSAB._.EEpromZentralHandler.eepromChannel[42].ret_CallEEpromLoadData ZFFSAB._.EEpromZentralHandler.eepromChannel[42].ret_CallEEpromLoadDataState ZFFSAB._.EEpromZentralHandler.eepromChannel[42].ret_CallEEpromStoreImmediate ZFFSAB._.EEpromZentralHandler.eepromChannel[43].ZFFSAB._.cEEpromChannel._.cnt_GetEEpromUpdate ZFFSAB._.EEpromZentralHandler.eepromChannel[43].ZFFSAB._.cEEpromChannel._.cnt_GetEEpromValid ZFFSAB._.EEpromZentralHandler.eepromChannel[43].ZFFSAB._.cEEpromChannel._.cnt_GetSizeofEEpromData ZFFSAB._.EEpromZentralHandler.eepromChannel[43].ZFFSAB._.cEEpromChannel._.cnt_SetEEpromInitZyklisch ZFFSAB._.EEpromZentralHandler.eepromChannel[43].ZFFSAB._.cEEpromChannel._.eeprom_info ZFFSAB._.EEpromZentralHandler.eepromChannel[43].ZFFSAB._.cEEpromChannel._.ret_GetEEpromUpdate ZFFSAB._.EEpromZentralHandler.eepromChannel[43].ZFFSAB._.cEEpromChannel._.ret_GetEEpromValid ZFFSAB._.EEpromZentralHandler.eepromChannel[43].ZFFSAB._.cEEpromChannel._.ret_GetSizeofEEpromData ZFFSAB._.EEpromZentralHandler.eepromChannel[43].ZFFSAB._.cEEpromChannel._.ret_SetEEpromInitZyklisch ZFFSAB._.EEpromZentralHandler.eepromChannel[43].cnt_CallEEpromLoadData ZFFSAB._.EEpromZentralHandler.eepromChannel[43].cnt_CallEEpromLoadDataState ZFFSAB._.EEpromZentralHandler.eepromChannel[43].cnt_CallEEpromStoreImmediate ZFFSAB._.EEpromZentralHandler.eepromChannel[43].cnt_SetEEpromWriteProtect ZFFSAB._.EEpromZentralHandler.eepromChannel[43].mode ZFFSAB._.EEpromZentralHandler.eepromChannel[43].ret_CallEEpromLoadData ZFFSAB._.EEpromZentralHandler.eepromChannel[43].ret_CallEEpromLoadDataState ZFFSAB._.EEpromZentralHandler.eepromChannel[43].ret_CallEEpromStoreImmediate ZFFSAB._.EEpromZentralHandler.eepromChannel[44].ZFFSAB._.cEEpromChannel._.cnt_GetEEpromUpdate ZFFSAB._.EEpromZentralHandler.eepromChannel[44].ZFFSAB._.cEEpromChannel._.cnt_GetEEpromValid ZFFSAB._.EEpromZentralHandler.eepromChannel[44].ZFFSAB._.cEEpromChannel._.cnt_GetSizeofEEpromData ZFFSAB._.EEpromZentralHandler.eepromChannel[44].ZFFSAB._.cEEpromChannel._.cnt_SetEEpromInitZyklisch ZFFSAB._.EEpromZentralHandler.eepromChannel[44].ZFFSAB._.cEEpromChannel._.eeprom_info ZFFSAB._.EEpromZentralHandler.eepromChannel[44].ZFFSAB._.cEEpromChannel._.ret_GetEEpromUpdate ZFFSAB._.EEpromZentralHandler.eepromChannel[44].ZFFSAB._.cEEpromChannel._.ret_GetEEpromValid ZFFSAB._.EEpromZentralHandler.eepromChannel[44].ZFFSAB._.cEEpromChannel._.ret_GetSizeofEEpromData ZFFSAB._.EEpromZentralHandler.eepromChannel[44].ZFFSAB._.cEEpromChannel._.ret_SetEEpromInitZyklisch ZFFSAB._.EEpromZentralHandler.eepromChannel[44].cnt_CallEEpromLoadData ZFFSAB._.EEpromZentralHandler.eepromChannel[44].cnt_CallEEpromLoadDataState ZFFSAB._.EEpromZentralHandler.eepromChannel[44].cnt_CallEEpromStoreImmediate ZFFSAB._.EEpromZentralHandler.eepromChannel[44].cnt_SetEEpromWriteProtect ZFFSAB._.EEpromZentralHandler.eepromChannel[44].mode ZFFSAB._.EEpromZentralHandler.eepromChannel[44].ret_CallEEpromLoadData ZFFSAB._.EEpromZentralHandler.eepromChannel[44].ret_CallEEpromLoadDataState ZFFSAB._.EEpromZentralHandler.eepromChannel[44].ret_CallEEpromStoreImmediate ZFFSAB._.EEpromZentralHandler.eepromChannel[45].ZFFSAB._.cEEpromChannel._.cnt_GetEEpromUpdate ZFFSAB._.EEpromZentralHandler.eepromChannel[45].ZFFSAB._.cEEpromChannel._.cnt_GetEEpromValid ZFFSAB._.EEpromZentralHandler.eepromChannel[45].ZFFSAB._.cEEpromChannel._.cnt_GetSizeofEEpromData ZFFSAB._.EEpromZentralHandler.eepromChannel[45].ZFFSAB._.cEEpromChannel._.cnt_SetEEpromInitZyklisch ZFFSAB._.EEpromZentralHandler.eepromChannel[45].ZFFSAB._.cEEpromChannel._.eeprom_info ZFFSAB._.EEpromZentralHandler.eepromChannel[45].ZFFSAB._.cEEpromChannel._.ret_GetEEpromUpdate ZFFSAB._.EEpromZentralHandler.eepromChannel[45].ZFFSAB._.cEEpromChannel._.ret_GetEEpromValid ZFFSAB._.EEpromZentralHandler.eepromChannel[45].ZFFSAB._.cEEpromChannel._.ret_GetSizeofEEpromData ZFFSAB._.EEpromZentralHandler.eepromChannel[45].ZFFSAB._.cEEpromChannel._.ret_SetEEpromInitZyklisch ZFFSAB._.EEpromZentralHandler.eepromChannel[45].cnt_CallEEpromLoadData ZFFSAB._.EEpromZentralHandler.eepromChannel[45].cnt_CallEEpromLoadDataState ZFFSAB._.EEpromZentralHandler.eepromChannel[45].cnt_CallEEpromStoreImmediate ZFFSAB._.EEpromZentralHandler.eepromChannel[45].cnt_SetEEpromWriteProtect ZFFSAB._.EEpromZentralHandler.eepromChannel[45].mode ZFFSAB._.EEpromZentralHandler.eepromChannel[45].ret_CallEEpromLoadData ZFFSAB._.EEpromZentralHandler.eepromChannel[45].ret_CallEEpromLoadDataState ZFFSAB._.EEpromZentralHandler.eepromChannel[45].ret_CallEEpromStoreImmediate ZFFSAB._.EEpromZentralHandler.eepromChannel[46].ZFFSAB._.cEEpromChannel._.cnt_GetEEpromUpdate ZFFSAB._.EEpromZentralHandler.eepromChannel[46].ZFFSAB._.cEEpromChannel._.cnt_GetEEpromValid ZFFSAB._.EEpromZentralHandler.eepromChannel[46].ZFFSAB._.cEEpromChannel._.cnt_GetSizeofEEpromData ZFFSAB._.EEpromZentralHandler.eepromChannel[46].ZFFSAB._.cEEpromChannel._.cnt_SetEEpromInitZyklisch ZFFSAB._.EEpromZentralHandler.eepromChannel[46].ZFFSAB._.cEEpromChannel._.eeprom_info ZFFSAB._.EEpromZentralHandler.eepromChannel[46].ZFFSAB._.cEEpromChannel._.ret_GetEEpromUpdate ZFFSAB._.EEpromZentralHandler.eepromChannel[46].ZFFSAB._.cEEpromChannel._.ret_GetEEpromValid ZFFSAB._.EEpromZentralHandler.eepromChannel[46].ZFFSAB._.cEEpromChannel._.ret_GetSizeofEEpromData ZFFSAB._.EEpromZentralHandler.eepromChannel[46].ZFFSAB._.cEEpromChannel._.ret_SetEEpromInitZyklisch ZFFSAB._.EEpromZentralHandler.eepromChannel[46].cnt_CallEEpromLoadData ZFFSAB._.EEpromZentralHandler.eepromChannel[46].cnt_CallEEpromLoadDataState ZFFSAB._.EEpromZentralHandler.eepromChannel[46].cnt_CallEEpromStoreImmediate ZFFSAB._.EEpromZentralHandler.eepromChannel[46].cnt_SetEEpromWriteProtect ZFFSAB._.EEpromZentralHandler.eepromChannel[46].mode ZFFSAB._.EEpromZentralHandler.eepromChannel[46].ret_CallEEpromLoadData ZFFSAB._.EEpromZentralHandler.eepromChannel[46].ret_CallEEpromLoadDataState ZFFSAB._.EEpromZentralHandler.eepromChannel[46].ret_CallEEpromStoreImmediate ZFFSAB._.EEpromZentralHandler.eepromChannel[47].ZFFSAB._.cEEpromChannel._.cnt_GetEEpromUpdate ZFFSAB._.EEpromZentralHandler.eepromChannel[47].ZFFSAB._.cEEpromChannel._.cnt_GetEEpromValid ZFFSAB._.EEpromZentralHandler.eepromChannel[47].ZFFSAB._.cEEpromChannel._.cnt_GetSizeofEEpromData ZFFSAB._.EEpromZentralHandler.eepromChannel[47].ZFFSAB._.cEEpromChannel._.cnt_SetEEpromInitZyklisch ZFFSAB._.EEpromZentralHandler.eepromChannel[47].ZFFSAB._.cEEpromChannel._.eeprom_info ZFFSAB._.EEpromZentralHandler.eepromChannel[47].ZFFSAB._.cEEpromChannel._.ret_GetEEpromUpdate ZFFSAB._.EEpromZentralHandler.eepromChannel[47].ZFFSAB._.cEEpromChannel._.ret_GetEEpromValid ZFFSAB._.EEpromZentralHandler.eepromChannel[47].ZFFSAB._.cEEpromChannel._.ret_GetSizeofEEpromData ZFFSAB._.EEpromZentralHandler.eepromChannel[47].ZFFSAB._.cEEpromChannel._.ret_SetEEpromInitZyklisch ZFFSAB._.EEpromZentralHandler.eepromChannel[47].cnt_CallEEpromLoadData ZFFSAB._.EEpromZentralHandler.eepromChannel[47].cnt_CallEEpromLoadDataState ZFFSAB._.EEpromZentralHandler.eepromChannel[47].cnt_CallEEpromStoreImmediate ZFFSAB._.EEpromZentralHandler.eepromChannel[47].cnt_SetEEpromWriteProtect ZFFSAB._.EEpromZentralHandler.eepromChannel[47].mode ZFFSAB._.EEpromZentralHandler.eepromChannel[47].ret_CallEEpromLoadData ZFFSAB._.EEpromZentralHandler.eepromChannel[47].ret_CallEEpromLoadDataState ZFFSAB._.EEpromZentralHandler.eepromChannel[47].ret_CallEEpromStoreImmediate ZFFSAB._.EEpromZentralHandler.eepromChannel[48].ZFFSAB._.cEEpromChannel._.cnt_GetEEpromUpdate ZFFSAB._.EEpromZentralHandler.eepromChannel[48].ZFFSAB._.cEEpromChannel._.cnt_GetEEpromValid ZFFSAB._.EEpromZentralHandler.eepromChannel[48].ZFFSAB._.cEEpromChannel._.cnt_GetSizeofEEpromData ZFFSAB._.EEpromZentralHandler.eepromChannel[48].ZFFSAB._.cEEpromChannel._.cnt_SetEEpromInitZyklisch ZFFSAB._.EEpromZentralHandler.eepromChannel[48].ZFFSAB._.cEEpromChannel._.eeprom_info ZFFSAB._.EEpromZentralHandler.eepromChannel[48].ZFFSAB._.cEEpromChannel._.ret_GetEEpromUpdate ZFFSAB._.EEpromZentralHandler.eepromChannel[48].ZFFSAB._.cEEpromChannel._.ret_GetEEpromValid ZFFSAB._.EEpromZentralHandler.eepromChannel[48].ZFFSAB._.cEEpromChannel._.ret_GetSizeofEEpromData ZFFSAB._.EEpromZentralHandler.eepromChannel[48].ZFFSAB._.cEEpromChannel._.ret_SetEEpromInitZyklisch ZFFSAB._.EEpromZentralHandler.eepromChannel[48].cnt_CallEEpromLoadData ZFFSAB._.EEpromZentralHandler.eepromChannel[48].cnt_CallEEpromLoadDataState ZFFSAB._.EEpromZentralHandler.eepromChannel[48].cnt_CallEEpromStoreImmediate ZFFSAB._.EEpromZentralHandler.eepromChannel[48].cnt_SetEEpromWriteProtect ZFFSAB._.EEpromZentralHandler.eepromChannel[48].mode ZFFSAB._.EEpromZentralHandler.eepromChannel[48].ret_CallEEpromLoadData ZFFSAB._.EEpromZentralHandler.eepromChannel[48].ret_CallEEpromLoadDataState ZFFSAB._.EEpromZentralHandler.eepromChannel[48].ret_CallEEpromStoreImmediate ZFFSAB._.EEpromZentralHandler.eepromChannel[49].ZFFSAB._.cEEpromChannel._.cnt_GetEEpromUpdate ZFFSAB._.EEpromZentralHandler.eepromChannel[49].ZFFSAB._.cEEpromChannel._.cnt_GetEEpromValid ZFFSAB._.EEpromZentralHandler.eepromChannel[49].ZFFSAB._.cEEpromChannel._.cnt_GetSizeofEEpromData ZFFSAB._.EEpromZentralHandler.eepromChannel[49].ZFFSAB._.cEEpromChannel._.cnt_SetEEpromInitZyklisch ZFFSAB._.EEpromZentralHandler.eepromChannel[49].ZFFSAB._.cEEpromChannel._.eeprom_info ZFFSAB._.EEpromZentralHandler.eepromChannel[49].ZFFSAB._.cEEpromChannel._.ret_GetEEpromUpdate ZFFSAB._.EEpromZentralHandler.eepromChannel[49].ZFFSAB._.cEEpromChannel._.ret_GetEEpromValid ZFFSAB._.EEpromZentralHandler.eepromChannel[49].ZFFSAB._.cEEpromChannel._.ret_GetSizeofEEpromData ZFFSAB._.EEpromZentralHandler.eepromChannel[49].ZFFSAB._.cEEpromChannel._.ret_SetEEpromInitZyklisch ZFFSAB._.EEpromZentralHandler.eepromChannel[49].cnt_CallEEpromLoadData ZFFSAB._.EEpromZentralHandler.eepromChannel[49].cnt_CallEEpromLoadDataState ZFFSAB._.EEpromZentralHandler.eepromChannel[49].cnt_CallEEpromStoreImmediate ZFFSAB._.EEpromZentralHandler.eepromChannel[49].cnt_SetEEpromWriteProtect ZFFSAB._.EEpromZentralHandler.eepromChannel[49].mode ZFFSAB._.EEpromZentralHandler.eepromChannel[49].ret_CallEEpromLoadData ZFFSAB._.EEpromZentralHandler.eepromChannel[49].ret_CallEEpromLoadDataState ZFFSAB._.EEpromZentralHandler.eepromChannel[49].ret_CallEEpromStoreImmediate ZFFSAB._.EEpromZentralHandler.eepromChannel[4].ZFFSAB._.cEEpromChannel._.cnt_GetEEpromUpdate ZFFSAB._.EEpromZentralHandler.eepromChannel[4].ZFFSAB._.cEEpromChannel._.cnt_GetEEpromValid ZFFSAB._.EEpromZentralHandler.eepromChannel[4].ZFFSAB._.cEEpromChannel._.cnt_GetSizeofEEpromData ZFFSAB._.EEpromZentralHandler.eepromChannel[4].ZFFSAB._.cEEpromChannel._.cnt_SetEEpromInitZyklisch ZFFSAB._.EEpromZentralHandler.eepromChannel[4].ZFFSAB._.cEEpromChannel._.eeprom_info ZFFSAB._.EEpromZentralHandler.eepromChannel[4].ZFFSAB._.cEEpromChannel._.ret_GetEEpromUpdate ZFFSAB._.EEpromZentralHandler.eepromChannel[4].ZFFSAB._.cEEpromChannel._.ret_GetEEpromValid ZFFSAB._.EEpromZentralHandler.eepromChannel[4].ZFFSAB._.cEEpromChannel._.ret_GetSizeofEEpromData ZFFSAB._.EEpromZentralHandler.eepromChannel[4].ZFFSAB._.cEEpromChannel._.ret_SetEEpromInitZyklisch ZFFSAB._.EEpromZentralHandler.eepromChannel[4].cnt_CallEEpromLoadData ZFFSAB._.EEpromZentralHandler.eepromChannel[4].cnt_CallEEpromLoadDataState ZFFSAB._.EEpromZentralHandler.eepromChannel[4].cnt_CallEEpromStoreImmediate ZFFSAB._.EEpromZentralHandler.eepromChannel[4].cnt_SetEEpromWriteProtect ZFFSAB._.EEpromZentralHandler.eepromChannel[4].mode ZFFSAB._.EEpromZentralHandler.eepromChannel[4].ret_CallEEpromLoadData ZFFSAB._.EEpromZentralHandler.eepromChannel[4].ret_CallEEpromLoadDataState ZFFSAB._.EEpromZentralHandler.eepromChannel[4].ret_CallEEpromStoreImmediate ZFFSAB._.EEpromZentralHandler.eepromChannel[50].ZFFSAB._.cEEpromChannel._.cnt_GetEEpromUpdate ZFFSAB._.EEpromZentralHandler.eepromChannel[50].ZFFSAB._.cEEpromChannel._.cnt_GetEEpromValid ZFFSAB._.EEpromZentralHandler.eepromChannel[50].ZFFSAB._.cEEpromChannel._.cnt_GetSizeofEEpromData ZFFSAB._.EEpromZentralHandler.eepromChannel[50].ZFFSAB._.cEEpromChannel._.cnt_SetEEpromInitZyklisch ZFFSAB._.EEpromZentralHandler.eepromChannel[50].ZFFSAB._.cEEpromChannel._.eeprom_info ZFFSAB._.EEpromZentralHandler.eepromChannel[50].ZFFSAB._.cEEpromChannel._.ret_GetEEpromUpdate ZFFSAB._.EEpromZentralHandler.eepromChannel[50].ZFFSAB._.cEEpromChannel._.ret_GetEEpromValid ZFFSAB._.EEpromZentralHandler.eepromChannel[50].ZFFSAB._.cEEpromChannel._.ret_GetSizeofEEpromData ZFFSAB._.EEpromZentralHandler.eepromChannel[50].ZFFSAB._.cEEpromChannel._.ret_SetEEpromInitZyklisch ZFFSAB._.EEpromZentralHandler.eepromChannel[50].cnt_CallEEpromLoadData ZFFSAB._.EEpromZentralHandler.eepromChannel[50].cnt_CallEEpromLoadDataState ZFFSAB._.EEpromZentralHandler.eepromChannel[50].cnt_CallEEpromStoreImmediate ZFFSAB._.EEpromZentralHandler.eepromChannel[50].cnt_SetEEpromWriteProtect ZFFSAB._.EEpromZentralHandler.eepromChannel[50].mode ZFFSAB._.EEpromZentralHandler.eepromChannel[50].ret_CallEEpromLoadData ZFFSAB._.EEpromZentralHandler.eepromChannel[50].ret_CallEEpromLoadDataState ZFFSAB._.EEpromZentralHandler.eepromChannel[50].ret_CallEEpromStoreImmediate ZFFSAB._.EEpromZentralHandler.eepromChannel[51].ZFFSAB._.cEEpromChannel._.cnt_GetEEpromUpdate ZFFSAB._.EEpromZentralHandler.eepromChannel[51].ZFFSAB._.cEEpromChannel._.cnt_GetEEpromValid ZFFSAB._.EEpromZentralHandler.eepromChannel[51].ZFFSAB._.cEEpromChannel._.cnt_GetSizeofEEpromData ZFFSAB._.EEpromZentralHandler.eepromChannel[51].ZFFSAB._.cEEpromChannel._.cnt_SetEEpromInitZyklisch ZFFSAB._.EEpromZentralHandler.eepromChannel[51].ZFFSAB._.cEEpromChannel._.eeprom_info ZFFSAB._.EEpromZentralHandler.eepromChannel[51].ZFFSAB._.cEEpromChannel._.ret_GetEEpromUpdate ZFFSAB._.EEpromZentralHandler.eepromChannel[51].ZFFSAB._.cEEpromChannel._.ret_GetEEpromValid ZFFSAB._.EEpromZentralHandler.eepromChannel[51].ZFFSAB._.cEEpromChannel._.ret_GetSizeofEEpromData ZFFSAB._.EEpromZentralHandler.eepromChannel[51].ZFFSAB._.cEEpromChannel._.ret_SetEEpromInitZyklisch ZFFSAB._.EEpromZentralHandler.eepromChannel[51].cnt_CallEEpromLoadData ZFFSAB._.EEpromZentralHandler.eepromChannel[51].cnt_CallEEpromLoadDataState ZFFSAB._.EEpromZentralHandler.eepromChannel[51].cnt_CallEEpromStoreImmediate ZFFSAB._.EEpromZentralHandler.eepromChannel[51].cnt_SetEEpromWriteProtect ZFFSAB._.EEpromZentralHandler.eepromChannel[51].mode ZFFSAB._.EEpromZentralHandler.eepromChannel[51].ret_CallEEpromLoadData ZFFSAB._.EEpromZentralHandler.eepromChannel[51].ret_CallEEpromLoadDataState ZFFSAB._.EEpromZentralHandler.eepromChannel[51].ret_CallEEpromStoreImmediate ZFFSAB._.EEpromZentralHandler.eepromChannel[52].ZFFSAB._.cEEpromChannel._.cnt_GetEEpromUpdate ZFFSAB._.EEpromZentralHandler.eepromChannel[52].ZFFSAB._.cEEpromChannel._.cnt_GetEEpromValid ZFFSAB._.EEpromZentralHandler.eepromChannel[52].ZFFSAB._.cEEpromChannel._.cnt_GetSizeofEEpromData ZFFSAB._.EEpromZentralHandler.eepromChannel[52].ZFFSAB._.cEEpromChannel._.cnt_SetEEpromInitZyklisch ZFFSAB._.EEpromZentralHandler.eepromChannel[52].ZFFSAB._.cEEpromChannel._.eeprom_info ZFFSAB._.EEpromZentralHandler.eepromChannel[52].ZFFSAB._.cEEpromChannel._.ret_GetEEpromUpdate ZFFSAB._.EEpromZentralHandler.eepromChannel[52].ZFFSAB._.cEEpromChannel._.ret_GetEEpromValid ZFFSAB._.EEpromZentralHandler.eepromChannel[52].ZFFSAB._.cEEpromChannel._.ret_GetSizeofEEpromData ZFFSAB._.EEpromZentralHandler.eepromChannel[52].ZFFSAB._.cEEpromChannel._.ret_SetEEpromInitZyklisch ZFFSAB._.EEpromZentralHandler.eepromChannel[52].cnt_CallEEpromLoadData ZFFSAB._.EEpromZentralHandler.eepromChannel[52].cnt_CallEEpromLoadDataState ZFFSAB._.EEpromZentralHandler.eepromChannel[52].cnt_CallEEpromStoreImmediate ZFFSAB._.EEpromZentralHandler.eepromChannel[52].cnt_SetEEpromWriteProtect ZFFSAB._.EEpromZentralHandler.eepromChannel[52].mode ZFFSAB._.EEpromZentralHandler.eepromChannel[52].ret_CallEEpromLoadData ZFFSAB._.EEpromZentralHandler.eepromChannel[52].ret_CallEEpromLoadDataState ZFFSAB._.EEpromZentralHandler.eepromChannel[52].ret_CallEEpromStoreImmediate ZFFSAB._.EEpromZentralHandler.eepromChannel[53].ZFFSAB._.cEEpromChannel._.cnt_GetEEpromUpdate ZFFSAB._.EEpromZentralHandler.eepromChannel[53].ZFFSAB._.cEEpromChannel._.cnt_GetEEpromValid ZFFSAB._.EEpromZentralHandler.eepromChannel[53].ZFFSAB._.cEEpromChannel._.cnt_GetSizeofEEpromData ZFFSAB._.EEpromZentralHandler.eepromChannel[53].ZFFSAB._.cEEpromChannel._.cnt_SetEEpromInitZyklisch ZFFSAB._.EEpromZentralHandler.eepromChannel[53].ZFFSAB._.cEEpromChannel._.eeprom_info ZFFSAB._.EEpromZentralHandler.eepromChannel[53].ZFFSAB._.cEEpromChannel._.ret_GetEEpromUpdate ZFFSAB._.EEpromZentralHandler.eepromChannel[53].ZFFSAB._.cEEpromChannel._.ret_GetEEpromValid ZFFSAB._.EEpromZentralHandler.eepromChannel[53].ZFFSAB._.cEEpromChannel._.ret_GetSizeofEEpromData ZFFSAB._.EEpromZentralHandler.eepromChannel[53].ZFFSAB._.cEEpromChannel._.ret_SetEEpromInitZyklisch ZFFSAB._.EEpromZentralHandler.eepromChannel[53].cnt_CallEEpromLoadData ZFFSAB._.EEpromZentralHandler.eepromChannel[53].cnt_CallEEpromLoadDataState ZFFSAB._.EEpromZentralHandler.eepromChannel[53].cnt_CallEEpromStoreImmediate ZFFSAB._.EEpromZentralHandler.eepromChannel[53].cnt_SetEEpromWriteProtect ZFFSAB._.EEpromZentralHandler.eepromChannel[53].mode ZFFSAB._.EEpromZentralHandler.eepromChannel[53].ret_CallEEpromLoadData ZFFSAB._.EEpromZentralHandler.eepromChannel[53].ret_CallEEpromLoadDataState ZFFSAB._.EEpromZentralHandler.eepromChannel[53].ret_CallEEpromStoreImmediate ZFFSAB._.EEpromZentralHandler.eepromChannel[54].ZFFSAB._.cEEpromChannel._.cnt_GetEEpromUpdate ZFFSAB._.EEpromZentralHandler.eepromChannel[54].ZFFSAB._.cEEpromChannel._.cnt_GetEEpromValid ZFFSAB._.EEpromZentralHandler.eepromChannel[54].ZFFSAB._.cEEpromChannel._.cnt_GetSizeofEEpromData ZFFSAB._.EEpromZentralHandler.eepromChannel[54].ZFFSAB._.cEEpromChannel._.cnt_SetEEpromInitZyklisch ZFFSAB._.EEpromZentralHandler.eepromChannel[54].ZFFSAB._.cEEpromChannel._.eeprom_info ZFFSAB._.EEpromZentralHandler.eepromChannel[54].ZFFSAB._.cEEpromChannel._.ret_GetEEpromUpdate ZFFSAB._.EEpromZentralHandler.eepromChannel[54].ZFFSAB._.cEEpromChannel._.ret_GetEEpromValid ZFFSAB._.EEpromZentralHandler.eepromChannel[54].ZFFSAB._.cEEpromChannel._.ret_GetSizeofEEpromData ZFFSAB._.EEpromZentralHandler.eepromChannel[54].ZFFSAB._.cEEpromChannel._.ret_SetEEpromInitZyklisch ZFFSAB._.EEpromZentralHandler.eepromChannel[54].cnt_CallEEpromLoadData ZFFSAB._.EEpromZentralHandler.eepromChannel[54].cnt_CallEEpromLoadDataState ZFFSAB._.EEpromZentralHandler.eepromChannel[54].cnt_CallEEpromStoreImmediate ZFFSAB._.EEpromZentralHandler.eepromChannel[54].cnt_SetEEpromWriteProtect ZFFSAB._.EEpromZentralHandler.eepromChannel[54].mode ZFFSAB._.EEpromZentralHandler.eepromChannel[54].ret_CallEEpromLoadData ZFFSAB._.EEpromZentralHandler.eepromChannel[54].ret_CallEEpromLoadDataState ZFFSAB._.EEpromZentralHandler.eepromChannel[54].ret_CallEEpromStoreImmediate ZFFSAB._.EEpromZentralHandler.eepromChannel[55].ZFFSAB._.cEEpromChannel._.cnt_GetEEpromUpdate ZFFSAB._.EEpromZentralHandler.eepromChannel[55].ZFFSAB._.cEEpromChannel._.cnt_GetEEpromValid ZFFSAB._.EEpromZentralHandler.eepromChannel[55].ZFFSAB._.cEEpromChannel._.cnt_GetSizeofEEpromData ZFFSAB._.EEpromZentralHandler.eepromChannel[55].ZFFSAB._.cEEpromChannel._.cnt_SetEEpromInitZyklisch ZFFSAB._.EEpromZentralHandler.eepromChannel[55].ZFFSAB._.cEEpromChannel._.eeprom_info ZFFSAB._.EEpromZentralHandler.eepromChannel[55].ZFFSAB._.cEEpromChannel._.ret_GetEEpromUpdate ZFFSAB._.EEpromZentralHandler.eepromChannel[55].ZFFSAB._.cEEpromChannel._.ret_GetEEpromValid ZFFSAB._.EEpromZentralHandler.eepromChannel[55].ZFFSAB._.cEEpromChannel._.ret_GetSizeofEEpromData ZFFSAB._.EEpromZentralHandler.eepromChannel[55].ZFFSAB._.cEEpromChannel._.ret_SetEEpromInitZyklisch ZFFSAB._.EEpromZentralHandler.eepromChannel[55].cnt_CallEEpromLoadData ZFFSAB._.EEpromZentralHandler.eepromChannel[55].cnt_CallEEpromLoadDataState ZFFSAB._.EEpromZentralHandler.eepromChannel[55].cnt_CallEEpromStoreImmediate ZFFSAB._.EEpromZentralHandler.eepromChannel[55].cnt_SetEEpromWriteProtect ZFFSAB._.EEpromZentralHandler.eepromChannel[55].mode ZFFSAB._.EEpromZentralHandler.eepromChannel[55].ret_CallEEpromLoadData ZFFSAB._.EEpromZentralHandler.eepromChannel[55].ret_CallEEpromLoadDataState ZFFSAB._.EEpromZentralHandler.eepromChannel[55].ret_CallEEpromStoreImmediate ZFFSAB._.EEpromZentralHandler.eepromChannel[56].ZFFSAB._.cEEpromChannel._.cnt_GetEEpromUpdate ZFFSAB._.EEpromZentralHandler.eepromChannel[56].ZFFSAB._.cEEpromChannel._.cnt_GetEEpromValid ZFFSAB._.EEpromZentralHandler.eepromChannel[56].ZFFSAB._.cEEpromChannel._.cnt_GetSizeofEEpromData ZFFSAB._.EEpromZentralHandler.eepromChannel[56].ZFFSAB._.cEEpromChannel._.cnt_SetEEpromInitZyklisch ZFFSAB._.EEpromZentralHandler.eepromChannel[56].ZFFSAB._.cEEpromChannel._.eeprom_info ZFFSAB._.EEpromZentralHandler.eepromChannel[56].ZFFSAB._.cEEpromChannel._.ret_GetEEpromUpdate ZFFSAB._.EEpromZentralHandler.eepromChannel[56].ZFFSAB._.cEEpromChannel._.ret_GetEEpromValid ZFFSAB._.EEpromZentralHandler.eepromChannel[56].ZFFSAB._.cEEpromChannel._.ret_GetSizeofEEpromData ZFFSAB._.EEpromZentralHandler.eepromChannel[56].ZFFSAB._.cEEpromChannel._.ret_SetEEpromInitZyklisch ZFFSAB._.EEpromZentralHandler.eepromChannel[56].cnt_CallEEpromLoadData ZFFSAB._.EEpromZentralHandler.eepromChannel[56].cnt_CallEEpromLoadDataState ZFFSAB._.EEpromZentralHandler.eepromChannel[56].cnt_CallEEpromStoreImmediate ZFFSAB._.EEpromZentralHandler.eepromChannel[56].cnt_SetEEpromWriteProtect ZFFSAB._.EEpromZentralHandler.eepromChannel[56].mode ZFFSAB._.EEpromZentralHandler.eepromChannel[56].ret_CallEEpromLoadData ZFFSAB._.EEpromZentralHandler.eepromChannel[56].ret_CallEEpromLoadDataState ZFFSAB._.EEpromZentralHandler.eepromChannel[56].ret_CallEEpromStoreImmediate ZFFSAB._.EEpromZentralHandler.eepromChannel[57].ZFFSAB._.cEEpromChannel._.cnt_GetEEpromUpdate ZFFSAB._.EEpromZentralHandler.eepromChannel[57].ZFFSAB._.cEEpromChannel._.cnt_GetEEpromValid ZFFSAB._.EEpromZentralHandler.eepromChannel[57].ZFFSAB._.cEEpromChannel._.cnt_GetSizeofEEpromData ZFFSAB._.EEpromZentralHandler.eepromChannel[57].ZFFSAB._.cEEpromChannel._.cnt_SetEEpromInitZyklisch ZFFSAB._.EEpromZentralHandler.eepromChannel[57].ZFFSAB._.cEEpromChannel._.eeprom_info ZFFSAB._.EEpromZentralHandler.eepromChannel[57].ZFFSAB._.cEEpromChannel._.ret_GetEEpromUpdate ZFFSAB._.EEpromZentralHandler.eepromChannel[57].ZFFSAB._.cEEpromChannel._.ret_GetEEpromValid ZFFSAB._.EEpromZentralHandler.eepromChannel[57].ZFFSAB._.cEEpromChannel._.ret_GetSizeofEEpromData ZFFSAB._.EEpromZentralHandler.eepromChannel[57].ZFFSAB._.cEEpromChannel._.ret_SetEEpromInitZyklisch ZFFSAB._.EEpromZentralHandler.eepromChannel[57].cnt_CallEEpromLoadData ZFFSAB._.EEpromZentralHandler.eepromChannel[57].cnt_CallEEpromLoadDataState ZFFSAB._.EEpromZentralHandler.eepromChannel[57].cnt_CallEEpromStoreImmediate ZFFSAB._.EEpromZentralHandler.eepromChannel[57].cnt_SetEEpromWriteProtect ZFFSAB._.EEpromZentralHandler.eepromChannel[57].mode ZFFSAB._.EEpromZentralHandler.eepromChannel[57].ret_CallEEpromLoadData ZFFSAB._.EEpromZentralHandler.eepromChannel[57].ret_CallEEpromLoadDataState ZFFSAB._.EEpromZentralHandler.eepromChannel[57].ret_CallEEpromStoreImmediate ZFFSAB._.EEpromZentralHandler.eepromChannel[58].ZFFSAB._.cEEpromChannel._.cnt_GetEEpromUpdate ZFFSAB._.EEpromZentralHandler.eepromChannel[58].ZFFSAB._.cEEpromChannel._.cnt_GetEEpromValid ZFFSAB._.EEpromZentralHandler.eepromChannel[58].ZFFSAB._.cEEpromChannel._.cnt_GetSizeofEEpromData ZFFSAB._.EEpromZentralHandler.eepromChannel[58].ZFFSAB._.cEEpromChannel._.cnt_SetEEpromInitZyklisch ZFFSAB._.EEpromZentralHandler.eepromChannel[58].ZFFSAB._.cEEpromChannel._.eeprom_info ZFFSAB._.EEpromZentralHandler.eepromChannel[58].ZFFSAB._.cEEpromChannel._.ret_GetEEpromUpdate ZFFSAB._.EEpromZentralHandler.eepromChannel[58].ZFFSAB._.cEEpromChannel._.ret_GetEEpromValid ZFFSAB._.EEpromZentralHandler.eepromChannel[58].ZFFSAB._.cEEpromChannel._.ret_GetSizeofEEpromData ZFFSAB._.EEpromZentralHandler.eepromChannel[58].ZFFSAB._.cEEpromChannel._.ret_SetEEpromInitZyklisch ZFFSAB._.EEpromZentralHandler.eepromChannel[58].cnt_CallEEpromLoadData ZFFSAB._.EEpromZentralHandler.eepromChannel[58].cnt_CallEEpromLoadDataState ZFFSAB._.EEpromZentralHandler.eepromChannel[58].cnt_CallEEpromStoreImmediate ZFFSAB._.EEpromZentralHandler.eepromChannel[58].cnt_SetEEpromWriteProtect ZFFSAB._.EEpromZentralHandler.eepromChannel[58].mode ZFFSAB._.EEpromZentralHandler.eepromChannel[58].ret_CallEEpromLoadData ZFFSAB._.EEpromZentralHandler.eepromChannel[58].ret_CallEEpromLoadDataState ZFFSAB._.EEpromZentralHandler.eepromChannel[58].ret_CallEEpromStoreImmediate ZFFSAB._.EEpromZentralHandler.eepromChannel[59].ZFFSAB._.cEEpromChannel._.cnt_GetEEpromUpdate ZFFSAB._.EEpromZentralHandler.eepromChannel[59].ZFFSAB._.cEEpromChannel._.cnt_GetEEpromValid ZFFSAB._.EEpromZentralHandler.eepromChannel[59].ZFFSAB._.cEEpromChannel._.cnt_GetSizeofEEpromData ZFFSAB._.EEpromZentralHandler.eepromChannel[59].ZFFSAB._.cEEpromChannel._.cnt_SetEEpromInitZyklisch ZFFSAB._.EEpromZentralHandler.eepromChannel[59].ZFFSAB._.cEEpromChannel._.eeprom_info ZFFSAB._.EEpromZentralHandler.eepromChannel[59].ZFFSAB._.cEEpromChannel._.ret_GetEEpromUpdate ZFFSAB._.EEpromZentralHandler.eepromChannel[59].ZFFSAB._.cEEpromChannel._.ret_GetEEpromValid ZFFSAB._.EEpromZentralHandler.eepromChannel[59].ZFFSAB._.cEEpromChannel._.ret_GetSizeofEEpromData ZFFSAB._.EEpromZentralHandler.eepromChannel[59].ZFFSAB._.cEEpromChannel._.ret_SetEEpromInitZyklisch ZFFSAB._.EEpromZentralHandler.eepromChannel[59].cnt_CallEEpromLoadData ZFFSAB._.EEpromZentralHandler.eepromChannel[59].cnt_CallEEpromLoadDataState ZFFSAB._.EEpromZentralHandler.eepromChannel[59].cnt_CallEEpromStoreImmediate ZFFSAB._.EEpromZentralHandler.eepromChannel[59].cnt_SetEEpromWriteProtect ZFFSAB._.EEpromZentralHandler.eepromChannel[59].mode ZFFSAB._.EEpromZentralHandler.eepromChannel[59].ret_CallEEpromLoadData ZFFSAB._.EEpromZentralHandler.eepromChannel[59].ret_CallEEpromLoadDataState ZFFSAB._.EEpromZentralHandler.eepromChannel[59].ret_CallEEpromStoreImmediate ZFFSAB._.EEpromZentralHandler.eepromChannel[5].ZFFSAB._.cEEpromChannel._.cnt_GetEEpromUpdate ZFFSAB._.EEpromZentralHandler.eepromChannel[5].ZFFSAB._.cEEpromChannel._.cnt_GetEEpromValid ZFFSAB._.EEpromZentralHandler.eepromChannel[5].ZFFSAB._.cEEpromChannel._.cnt_GetSizeofEEpromData ZFFSAB._.EEpromZentralHandler.eepromChannel[5].ZFFSAB._.cEEpromChannel._.cnt_SetEEpromInitZyklisch ZFFSAB._.EEpromZentralHandler.eepromChannel[5].ZFFSAB._.cEEpromChannel._.eeprom_info ZFFSAB._.EEpromZentralHandler.eepromChannel[5].ZFFSAB._.cEEpromChannel._.ret_GetEEpromUpdate ZFFSAB._.EEpromZentralHandler.eepromChannel[5].ZFFSAB._.cEEpromChannel._.ret_GetEEpromValid ZFFSAB._.EEpromZentralHandler.eepromChannel[5].ZFFSAB._.cEEpromChannel._.ret_GetSizeofEEpromData ZFFSAB._.EEpromZentralHandler.eepromChannel[5].ZFFSAB._.cEEpromChannel._.ret_SetEEpromInitZyklisch ZFFSAB._.EEpromZentralHandler.eepromChannel[5].cnt_CallEEpromLoadData ZFFSAB._.EEpromZentralHandler.eepromChannel[5].cnt_CallEEpromLoadDataState ZFFSAB._.EEpromZentralHandler.eepromChannel[5].cnt_CallEEpromStoreImmediate ZFFSAB._.EEpromZentralHandler.eepromChannel[5].cnt_SetEEpromWriteProtect ZFFSAB._.EEpromZentralHandler.eepromChannel[5].mode ZFFSAB._.EEpromZentralHandler.eepromChannel[5].ret_CallEEpromLoadData ZFFSAB._.EEpromZentralHandler.eepromChannel[5].ret_CallEEpromLoadDataState ZFFSAB._.EEpromZentralHandler.eepromChannel[5].ret_CallEEpromStoreImmediate ZFFSAB._.EEpromZentralHandler.eepromChannel[60].ZFFSAB._.cEEpromChannel._.cnt_GetEEpromUpdate ZFFSAB._.EEpromZentralHandler.eepromChannel[60].ZFFSAB._.cEEpromChannel._.cnt_GetEEpromValid ZFFSAB._.EEpromZentralHandler.eepromChannel[60].ZFFSAB._.cEEpromChannel._.cnt_GetSizeofEEpromData ZFFSAB._.EEpromZentralHandler.eepromChannel[60].ZFFSAB._.cEEpromChannel._.cnt_SetEEpromInitZyklisch ZFFSAB._.EEpromZentralHandler.eepromChannel[60].ZFFSAB._.cEEpromChannel._.eeprom_info ZFFSAB._.EEpromZentralHandler.eepromChannel[60].ZFFSAB._.cEEpromChannel._.ret_GetEEpromUpdate ZFFSAB._.EEpromZentralHandler.eepromChannel[60].ZFFSAB._.cEEpromChannel._.ret_GetEEpromValid ZFFSAB._.EEpromZentralHandler.eepromChannel[60].ZFFSAB._.cEEpromChannel._.ret_GetSizeofEEpromData ZFFSAB._.EEpromZentralHandler.eepromChannel[60].ZFFSAB._.cEEpromChannel._.ret_SetEEpromInitZyklisch ZFFSAB._.EEpromZentralHandler.eepromChannel[60].cnt_CallEEpromLoadData ZFFSAB._.EEpromZentralHandler.eepromChannel[60].cnt_CallEEpromLoadDataState ZFFSAB._.EEpromZentralHandler.eepromChannel[60].cnt_CallEEpromStoreImmediate ZFFSAB._.EEpromZentralHandler.eepromChannel[60].cnt_SetEEpromWriteProtect ZFFSAB._.EEpromZentralHandler.eepromChannel[60].mode ZFFSAB._.EEpromZentralHandler.eepromChannel[60].ret_CallEEpromLoadData ZFFSAB._.EEpromZentralHandler.eepromChannel[60].ret_CallEEpromLoadDataState ZFFSAB._.EEpromZentralHandler.eepromChannel[60].ret_CallEEpromStoreImmediate ZFFSAB._.EEpromZentralHandler.eepromChannel[61].ZFFSAB._.cEEpromChannel._.cnt_GetEEpromUpdate ZFFSAB._.EEpromZentralHandler.eepromChannel[61].ZFFSAB._.cEEpromChannel._.cnt_GetEEpromValid ZFFSAB._.EEpromZentralHandler.eepromChannel[61].ZFFSAB._.cEEpromChannel._.cnt_GetSizeofEEpromData ZFFSAB._.EEpromZentralHandler.eepromChannel[61].ZFFSAB._.cEEpromChannel._.cnt_SetEEpromInitZyklisch ZFFSAB._.EEpromZentralHandler.eepromChannel[61].ZFFSAB._.cEEpromChannel._.eeprom_info ZFFSAB._.EEpromZentralHandler.eepromChannel[61].ZFFSAB._.cEEpromChannel._.ret_GetEEpromUpdate ZFFSAB._.EEpromZentralHandler.eepromChannel[61].ZFFSAB._.cEEpromChannel._.ret_GetEEpromValid ZFFSAB._.EEpromZentralHandler.eepromChannel[61].ZFFSAB._.cEEpromChannel._.ret_GetSizeofEEpromData ZFFSAB._.EEpromZentralHandler.eepromChannel[61].ZFFSAB._.cEEpromChannel._.ret_SetEEpromInitZyklisch ZFFSAB._.EEpromZentralHandler.eepromChannel[61].cnt_CallEEpromLoadData ZFFSAB._.EEpromZentralHandler.eepromChannel[61].cnt_CallEEpromLoadDataState ZFFSAB._.EEpromZentralHandler.eepromChannel[61].cnt_CallEEpromStoreImmediate ZFFSAB._.EEpromZentralHandler.eepromChannel[61].cnt_SetEEpromWriteProtect ZFFSAB._.EEpromZentralHandler.eepromChannel[61].mode ZFFSAB._.EEpromZentralHandler.eepromChannel[61].ret_CallEEpromLoadData ZFFSAB._.EEpromZentralHandler.eepromChannel[61].ret_CallEEpromLoadDataState ZFFSAB._.EEpromZentralHandler.eepromChannel[61].ret_CallEEpromStoreImmediate ZFFSAB._.EEpromZentralHandler.eepromChannel[62].ZFFSAB._.cEEpromChannel._.cnt_GetEEpromUpdate ZFFSAB._.EEpromZentralHandler.eepromChannel[62].ZFFSAB._.cEEpromChannel._.cnt_GetEEpromValid ZFFSAB._.EEpromZentralHandler.eepromChannel[62].ZFFSAB._.cEEpromChannel._.cnt_GetSizeofEEpromData ZFFSAB._.EEpromZentralHandler.eepromChannel[62].ZFFSAB._.cEEpromChannel._.cnt_SetEEpromInitZyklisch ZFFSAB._.EEpromZentralHandler.eepromChannel[62].ZFFSAB._.cEEpromChannel._.eeprom_info ZFFSAB._.EEpromZentralHandler.eepromChannel[62].ZFFSAB._.cEEpromChannel._.ret_GetEEpromUpdate ZFFSAB._.EEpromZentralHandler.eepromChannel[62].ZFFSAB._.cEEpromChannel._.ret_GetEEpromValid ZFFSAB._.EEpromZentralHandler.eepromChannel[62].ZFFSAB._.cEEpromChannel._.ret_GetSizeofEEpromData ZFFSAB._.EEpromZentralHandler.eepromChannel[62].ZFFSAB._.cEEpromChannel._.ret_SetEEpromInitZyklisch ZFFSAB._.EEpromZentralHandler.eepromChannel[62].cnt_CallEEpromLoadData ZFFSAB._.EEpromZentralHandler.eepromChannel[62].cnt_CallEEpromLoadDataState ZFFSAB._.EEpromZentralHandler.eepromChannel[62].cnt_CallEEpromStoreImmediate ZFFSAB._.EEpromZentralHandler.eepromChannel[62].cnt_SetEEpromWriteProtect ZFFSAB._.EEpromZentralHandler.eepromChannel[62].mode ZFFSAB._.EEpromZentralHandler.eepromChannel[62].ret_CallEEpromLoadData ZFFSAB._.EEpromZentralHandler.eepromChannel[62].ret_CallEEpromLoadDataState ZFFSAB._.EEpromZentralHandler.eepromChannel[62].ret_CallEEpromStoreImmediate ZFFSAB._.EEpromZentralHandler.eepromChannel[63].ZFFSAB._.cEEpromChannel._.cnt_GetEEpromUpdate ZFFSAB._.EEpromZentralHandler.eepromChannel[63].ZFFSAB._.cEEpromChannel._.cnt_GetEEpromValid ZFFSAB._.EEpromZentralHandler.eepromChannel[63].ZFFSAB._.cEEpromChannel._.cnt_GetSizeofEEpromData ZFFSAB._.EEpromZentralHandler.eepromChannel[63].ZFFSAB._.cEEpromChannel._.cnt_SetEEpromInitZyklisch ZFFSAB._.EEpromZentralHandler.eepromChannel[63].ZFFSAB._.cEEpromChannel._.eeprom_info ZFFSAB._.EEpromZentralHandler.eepromChannel[63].ZFFSAB._.cEEpromChannel._.ret_GetEEpromUpdate ZFFSAB._.EEpromZentralHandler.eepromChannel[63].ZFFSAB._.cEEpromChannel._.ret_GetEEpromValid ZFFSAB._.EEpromZentralHandler.eepromChannel[63].ZFFSAB._.cEEpromChannel._.ret_GetSizeofEEpromData ZFFSAB._.EEpromZentralHandler.eepromChannel[63].ZFFSAB._.cEEpromChannel._.ret_SetEEpromInitZyklisch ZFFSAB._.EEpromZentralHandler.eepromChannel[63].cnt_CallEEpromLoadData ZFFSAB._.EEpromZentralHandler.eepromChannel[63].cnt_CallEEpromLoadDataState ZFFSAB._.EEpromZentralHandler.eepromChannel[63].cnt_CallEEpromStoreImmediate ZFFSAB._.EEpromZentralHandler.eepromChannel[63].cnt_SetEEpromWriteProtect ZFFSAB._.EEpromZentralHandler.eepromChannel[63].mode ZFFSAB._.EEpromZentralHandler.eepromChannel[63].ret_CallEEpromLoadData ZFFSAB._.EEpromZentralHandler.eepromChannel[63].ret_CallEEpromLoadDataState ZFFSAB._.EEpromZentralHandler.eepromChannel[63].ret_CallEEpromStoreImmediate ZFFSAB._.EEpromZentralHandler.eepromChannel[6].ZFFSAB._.cEEpromChannel._.cnt_GetEEpromUpdate ZFFSAB._.EEpromZentralHandler.eepromChannel[6].ZFFSAB._.cEEpromChannel._.cnt_GetEEpromValid ZFFSAB._.EEpromZentralHandler.eepromChannel[6].ZFFSAB._.cEEpromChannel._.cnt_GetSizeofEEpromData ZFFSAB._.EEpromZentralHandler.eepromChannel[6].ZFFSAB._.cEEpromChannel._.cnt_SetEEpromInitZyklisch ZFFSAB._.EEpromZentralHandler.eepromChannel[6].ZFFSAB._.cEEpromChannel._.eeprom_info ZFFSAB._.EEpromZentralHandler.eepromChannel[6].ZFFSAB._.cEEpromChannel._.ret_GetEEpromUpdate ZFFSAB._.EEpromZentralHandler.eepromChannel[6].ZFFSAB._.cEEpromChannel._.ret_GetEEpromValid ZFFSAB._.EEpromZentralHandler.eepromChannel[6].ZFFSAB._.cEEpromChannel._.ret_GetSizeofEEpromData ZFFSAB._.EEpromZentralHandler.eepromChannel[6].ZFFSAB._.cEEpromChannel._.ret_SetEEpromInitZyklisch ZFFSAB._.EEpromZentralHandler.eepromChannel[6].cnt_CallEEpromLoadData ZFFSAB._.EEpromZentralHandler.eepromChannel[6].cnt_CallEEpromLoadDataState ZFFSAB._.EEpromZentralHandler.eepromChannel[6].cnt_CallEEpromStoreImmediate ZFFSAB._.EEpromZentralHandler.eepromChannel[6].cnt_SetEEpromWriteProtect ZFFSAB._.EEpromZentralHandler.eepromChannel[6].mode ZFFSAB._.EEpromZentralHandler.eepromChannel[6].ret_CallEEpromLoadData ZFFSAB._.EEpromZentralHandler.eepromChannel[6].ret_CallEEpromLoadDataState ZFFSAB._.EEpromZentralHandler.eepromChannel[6].ret_CallEEpromStoreImmediate ZFFSAB._.EEpromZentralHandler.eepromChannel[7].ZFFSAB._.cEEpromChannel._.cnt_GetEEpromUpdate ZFFSAB._.EEpromZentralHandler.eepromChannel[7].ZFFSAB._.cEEpromChannel._.cnt_GetEEpromValid ZFFSAB._.EEpromZentralHandler.eepromChannel[7].ZFFSAB._.cEEpromChannel._.cnt_GetSizeofEEpromData ZFFSAB._.EEpromZentralHandler.eepromChannel[7].ZFFSAB._.cEEpromChannel._.cnt_SetEEpromInitZyklisch ZFFSAB._.EEpromZentralHandler.eepromChannel[7].ZFFSAB._.cEEpromChannel._.eeprom_info ZFFSAB._.EEpromZentralHandler.eepromChannel[7].ZFFSAB._.cEEpromChannel._.ret_GetEEpromUpdate ZFFSAB._.EEpromZentralHandler.eepromChannel[7].ZFFSAB._.cEEpromChannel._.ret_GetEEpromValid ZFFSAB._.EEpromZentralHandler.eepromChannel[7].ZFFSAB._.cEEpromChannel._.ret_GetSizeofEEpromData ZFFSAB._.EEpromZentralHandler.eepromChannel[7].ZFFSAB._.cEEpromChannel._.ret_SetEEpromInitZyklisch ZFFSAB._.EEpromZentralHandler.eepromChannel[7].cnt_CallEEpromLoadData ZFFSAB._.EEpromZentralHandler.eepromChannel[7].cnt_CallEEpromLoadDataState ZFFSAB._.EEpromZentralHandler.eepromChannel[7].cnt_CallEEpromStoreImmediate ZFFSAB._.EEpromZentralHandler.eepromChannel[7].cnt_SetEEpromWriteProtect ZFFSAB._.EEpromZentralHandler.eepromChannel[7].mode ZFFSAB._.EEpromZentralHandler.eepromChannel[7].ret_CallEEpromLoadData ZFFSAB._.EEpromZentralHandler.eepromChannel[7].ret_CallEEpromLoadDataState ZFFSAB._.EEpromZentralHandler.eepromChannel[7].ret_CallEEpromStoreImmediate ZFFSAB._.EEpromZentralHandler.eepromChannel[8].ZFFSAB._.cEEpromChannel._.cnt_GetEEpromUpdate ZFFSAB._.EEpromZentralHandler.eepromChannel[8].ZFFSAB._.cEEpromChannel._.cnt_GetEEpromValid ZFFSAB._.EEpromZentralHandler.eepromChannel[8].ZFFSAB._.cEEpromChannel._.cnt_GetSizeofEEpromData ZFFSAB._.EEpromZentralHandler.eepromChannel[8].ZFFSAB._.cEEpromChannel._.cnt_SetEEpromInitZyklisch ZFFSAB._.EEpromZentralHandler.eepromChannel[8].ZFFSAB._.cEEpromChannel._.eeprom_info ZFFSAB._.EEpromZentralHandler.eepromChannel[8].ZFFSAB._.cEEpromChannel._.ret_GetEEpromUpdate ZFFSAB._.EEpromZentralHandler.eepromChannel[8].ZFFSAB._.cEEpromChannel._.ret_GetEEpromValid ZFFSAB._.EEpromZentralHandler.eepromChannel[8].ZFFSAB._.cEEpromChannel._.ret_GetSizeofEEpromData ZFFSAB._.EEpromZentralHandler.eepromChannel[8].ZFFSAB._.cEEpromChannel._.ret_SetEEpromInitZyklisch ZFFSAB._.EEpromZentralHandler.eepromChannel[8].cnt_CallEEpromLoadData ZFFSAB._.EEpromZentralHandler.eepromChannel[8].cnt_CallEEpromLoadDataState ZFFSAB._.EEpromZentralHandler.eepromChannel[8].cnt_CallEEpromStoreImmediate ZFFSAB._.EEpromZentralHandler.eepromChannel[8].cnt_SetEEpromWriteProtect ZFFSAB._.EEpromZentralHandler.eepromChannel[8].mode ZFFSAB._.EEpromZentralHandler.eepromChannel[8].ret_CallEEpromLoadData ZFFSAB._.EEpromZentralHandler.eepromChannel[8].ret_CallEEpromLoadDataState ZFFSAB._.EEpromZentralHandler.eepromChannel[8].ret_CallEEpromStoreImmediate ZFFSAB._.EEpromZentralHandler.eepromChannel[9].ZFFSAB._.cEEpromChannel._.cnt_GetEEpromUpdate ZFFSAB._.EEpromZentralHandler.eepromChannel[9].ZFFSAB._.cEEpromChannel._.cnt_GetEEpromValid ZFFSAB._.EEpromZentralHandler.eepromChannel[9].ZFFSAB._.cEEpromChannel._.cnt_GetSizeofEEpromData ZFFSAB._.EEpromZentralHandler.eepromChannel[9].ZFFSAB._.cEEpromChannel._.cnt_SetEEpromInitZyklisch ZFFSAB._.EEpromZentralHandler.eepromChannel[9].ZFFSAB._.cEEpromChannel._.eeprom_info ZFFSAB._.EEpromZentralHandler.eepromChannel[9].ZFFSAB._.cEEpromChannel._.ret_GetEEpromUpdate ZFFSAB._.EEpromZentralHandler.eepromChannel[9].ZFFSAB._.cEEpromChannel._.ret_GetEEpromValid ZFFSAB._.EEpromZentralHandler.eepromChannel[9].ZFFSAB._.cEEpromChannel._.ret_GetSizeofEEpromData ZFFSAB._.EEpromZentralHandler.eepromChannel[9].ZFFSAB._.cEEpromChannel._.ret_SetEEpromInitZyklisch ZFFSAB._.EEpromZentralHandler.eepromChannel[9].cnt_CallEEpromLoadData ZFFSAB._.EEpromZentralHandler.eepromChannel[9].cnt_CallEEpromLoadDataState ZFFSAB._.EEpromZentralHandler.eepromChannel[9].cnt_CallEEpromStoreImmediate ZFFSAB._.EEpromZentralHandler.eepromChannel[9].cnt_SetEEpromWriteProtect ZFFSAB._.EEpromZentralHandler.eepromChannel[9].mode ZFFSAB._.EEpromZentralHandler.eepromChannel[9].ret_CallEEpromLoadData ZFFSAB._.EEpromZentralHandler.eepromChannel[9].ret_CallEEpromLoadDataState ZFFSAB._.EEpromZentralHandler.eepromChannel[9].ret_CallEEpromStoreImmediate ZFFSAB._.EEpromZentralHandler.f_EeStoreInProgress ZFFSAB._.EEpromZentralHandler.f_EeStoringActive ZFFSAB._.EEpromZentralHandler.f_EeUpdateAllRequest ZFFSAB._.EEpromZentralHandler.iv_cnt_EeUpdt ZFFSAB._.EEpromZentralHandler.iv_cnt_ErrMemEntry ZFFSAB._.EEpromZentralHandler.iv_f_EeUpdateAllState ZFFSAB._.EEpromZentralHandler.st_EeUpdateAll /end LOC_MEASUREMENT
/end FUNCTION
/end MODULE
/end PROJECT
