ASAP2_VERSION 1 51
/begin PROJECT _929_929 "Gen2_BMW_System_Supplier_Lib"
/begin HEADER "" VERSION "C_03_03" PROJECT_NO _929_929 /end HEADER
/begin MODULE DIM ""
/begin MOD_COMMON "" BYTE_ORDER MSB_FIRST ALIGNMENT_BYTE 1 ALIGNMENT_WORD 2 ALIGNMENT_LONG 4 ALIGNMENT_FLOAT32_IEEE 4 /end MOD_COMMON
/begin CHARACTERISTIC KF_F_RAMPEOEFFNEN_ENTKOPPL "Faktor auf Anfahrvorsteuermoment in Abhängigkeit des Motordrückens unter die Sollleerlaufdrehzahl der Entkopplungfunktion" MAP 0x222C94 kf_si16_S6_S3 20 UMR___1_100_0_S6_S3 -10 10
 /begin AXIS_DESCR STD_AXIS NO_INPUT_QUANTITY UMR_GRADC__1_1_M40_S6_S3 6 -10040 9960 DEPOSIT ABSOLUTE MONOTONY MON_INCREASE /end AXIS_DESCR
 /begin AXIS_DESCR STD_AXIS NO_INPUT_QUANTITY UMR___1_1_0_S6_S3 6 -1 8 DEPOSIT ABSOLUTE MONOTONY MON_INCREASE /end AXIS_DESCR
/end CHARACTERISTIC
/begin CHARACTERISTIC KF_MO_RAMPEOEFFNEN_ENTKOPPL "Momentenoffset auf Oeffnenrampe im Entkoppeln" MAP 0x222CFC kf_si16_S6_S3 2000 UMR_NM__1_1_0_S6_S3 -1000 1000
 /begin AXIS_DESCR STD_AXIS NO_INPUT_QUANTITY UMR_NM__1_1_0_S6_S3 6 -400 1640 DEPOSIT ABSOLUTE MONOTONY MON_INCREASE /end AXIS_DESCR
 /begin AXIS_DESCR STD_AXIS NO_INPUT_QUANTITY UMR___1_1_0_S6_S3 6 -1 8 DEPOSIT ABSOLUTE MONOTONY MON_INCREASE /end AXIS_DESCR
/end CHARACTERISTIC
/begin CHARACTERISTIC KF_MOSOLLLASTNMOT_ENTKOPPL "Momentenoffset bei Laständerung in Synchronisieren der Entkopplungfunktion" MAP 0x222D64 kf_si16_S6_S3 2000 UMR_NM__1_1_0_S6_S3 -1000 1000
 /begin AXIS_DESCR STD_AXIS NO_INPUT_QUANTITY UMR_NM__1_1_0_S6_S3 6 -400 1640 DEPOSIT ABSOLUTE MONOTONY MON_INCREASE /end AXIS_DESCR
 /begin AXIS_DESCR STD_AXIS iIaeSigna.n_mot_iae UMR_U_MIN_1_1_0_S6_S3 6 0 10000 DEPOSIT ABSOLUTE MONOTONY MON_INCREASE /end AXIS_DESCR
/end CHARACTERISTIC
/begin CHARACTERISTIC KF_MGSOLL_MDIF_ENTKOPPL "Schließrampe im Entkoppeln, gesteuerter Anteil der Entkopplungfunktion" MAP 0x222DCC kf_si16_S6_S3 4000 UMR_NM_SEC_1_1_0_S6_S3 -2000 2000
 /begin AXIS_DESCR STD_AXIS NO_INPUT_QUANTITY UMR_PROZENT__20_51_0_S6_S3 4 0 100 DEPOSIT ABSOLUTE MONOTONY MON_INCREASE /end AXIS_DESCR
 /begin AXIS_DESCR STD_AXIS NO_INPUT_QUANTITY UMR_NM__1_1_0_S6_S3 6 -2000 2000 DEPOSIT ABSOLUTE MONOTONY MON_INCREASE /end AXIS_DESCR
/end CHARACTERISTIC
/begin CHARACTERISTIC KF_MGSOLL_NDG_ENTKOPPL "Schließrampe im Entkoppeln, geregelter Anteil der Entkopplungfunktion" MAP 0x222E18 kf_si16_S6_S3 2000 UMR_NM_SEC_1_1_0_S6_S3 -1000 1000
 /begin AXIS_DESCR STD_AXIS NO_INPUT_QUANTITY UMR_PROZENT__20_51_0_S6_S3 4 0 100 DEPOSIT ABSOLUTE MONOTONY MON_INCREASE /end AXIS_DESCR
 /begin AXIS_DESCR STD_AXIS NO_INPUT_QUANTITY UMR_U_MINSEC_1_1_0_S6_S3 4 -30000 30000 DEPOSIT ABSOLUTE MONOTONY MON_INCREASE /end AXIS_DESCR
/end CHARACTERISTIC
/begin CHARACTERISTIC TAB_NDS_ZU_ENTKOPPL "Differenzdrehzahlschwelle für Geschlossen-Erkennung in der Entkopplungsfunktion" CURVE 0x222E50 tab_si16_S6_S3 100 UMR_NM__1_1_0_S6_S3 0 100
 /begin AXIS_DESCR FIX_AXIS iAzsIstgang.istgang UMR___1_1_0_S6_S3 10 -1 8 FIX_AXIS_PAR_DIST -1 1 10 /end AXIS_DESCR
/end CHARACTERISTIC
/begin CHARACTERISTIC TAB_HYS_NDS_ENTKOPPL "Hystereseschwelle auf Differenzdrehzahlschwelle für Schlupferkennung in der Entkopplungsfunktion" CURVE 0x222E68 tab_si16_S6_S3 100 UMR_NM__1_1_0_S6_S3 0 100
 /begin AXIS_DESCR FIX_AXIS iAzsIstgang.istgang UMR___1_1_0_S6_S3 10 -1 8 FIX_AXIS_PAR_DIST -1 1 10 /end AXIS_DESCR
/end CHARACTERISTIC
/begin CHARACTERISTIC TAB_MSLASTFREI_ENTKOPPL "Momentenschwellwert, innerhalb welchem der lastfreie Bereich der Entkopplungsfunktion erkannt wird" CURVE 0x222E80 tab_si16_S6_S3 255 UMR_NM__1_1_0_S6_S3 0 255
 /begin AXIS_DESCR FIX_AXIS NO_INPUT_QUANTITY UMR___1_1_0_S6_S3 10 -1 8 FIX_AXIS_PAR_DIST -1 1 10 /end AXIS_DESCR
/end CHARACTERISTIC
/begin CHARACTERISTIC TAB_TSLASTFREI_ENTKOPPL "Rampenzeit, innerhalb des lastfreien Bereichs der Entkopplungsfunktion" CURVE 0x222E98 tab_ui16_S6_S3 2550 UMR_MSEC__10_1_0_S6_S3 0 2550
 /begin AXIS_DESCR FIX_AXIS NO_INPUT_QUANTITY UMR___1_1_0_S6_S3 10 -1 8 FIX_AXIS_PAR_DIST -1 1 10 /end AXIS_DESCR
/end CHARACTERISTIC
/begin CHARACTERISTIC T_NDS_ZU_ENTKOPPL "Dauer für Schlupferkennung in der Entkopplungsfunktion" VALUE 0x26D60C kw_ui16_S6_S3 2550 UMR_MSEC__10_1_0_S6_S3 0 2550 /end CHARACTERISTIC
/begin CHARACTERISTIC KF_F_SCHLIESSEN_ENTKOPPL "Faktor auf Schliessmomentenaufbau aus Schliessen_Entkoppeln" MAP 0x222EB0 kf_si16_S6_S3 10 UMR___1_100_0_S6_S3 0 10
 /begin AXIS_DESCR STD_AXIS iAzsIstgang.istgang UMR___1_1_0_S6_S3 6 -1 8 DEPOSIT ABSOLUTE MONOTONY MON_INCREASE /end AXIS_DESCR
 /begin AXIS_DESCR STD_AXIS NO_INPUT_QUANTITY UMR_GRADC__1_1_M40_S6_S3 6 -80 500 DEPOSIT ABSOLUTE MONOTONY MON_INCREASE /end AXIS_DESCR
/end CHARACTERISTIC
/begin CHARACTERISTIC KF_MS_MOSTART_ENTKOPPL "Momentenschwelle zur Aktivierung des Momentenoffsets im Entkoppeln" MAP 0x222F18 kf_si16_S6_S3 2000 UMR_NM__1_1_0_S6_S3 -1000 1000
 /begin AXIS_DESCR STD_AXIS NO_INPUT_QUANTITY UMR_GRADC__1_1_M40_S6_S3 6 -40 215 DEPOSIT ABSOLUTE MONOTONY MON_INCREASE /end AXIS_DESCR
 /begin AXIS_DESCR STD_AXIS iAzsIstgang.istgang UMR___1_1_0_S6_S3 6 -1 8 DEPOSIT ABSOLUTE MONOTONY MON_INCREASE /end AXIS_DESCR
/end CHARACTERISTIC
/begin CHARACTERISTIC KF_MOZIEL_ENTKOPPL "Min-Begrenzung von m_soll_iae im Entkoppeln" MAP 0x222F80 kf_si16_S6_S3 2000 UMR_NM__1_1_0_S6_S3 -1000 1000
 /begin AXIS_DESCR STD_AXIS NO_INPUT_QUANTITY UMR_GRADC__1_1_M40_S6_S3 6 -40 215 DEPOSIT ABSOLUTE MONOTONY MON_INCREASE /end AXIS_DESCR
 /begin AXIS_DESCR STD_AXIS iAzsIstgang.istgang UMR___1_1_0_S6_S3 6 -1 8 DEPOSIT ABSOLUTE MONOTONY MON_INCREASE /end AXIS_DESCR
/end CHARACTERISTIC
/begin CHARACTERISTIC KF_MPT_MO_ENTKOPPL "Filterwert des Momentenoffsets im Entkoppeln" MAP 0x222FE8 kf_ui8_S6_S3 1 UMR___1_100_0_S6_S3 0 1
 /begin AXIS_DESCR STD_AXIS NO_INPUT_QUANTITY UMR_GRADC__1_1_M40_S6_S3 6 -40 215 DEPOSIT ABSOLUTE MONOTONY MON_INCREASE /end AXIS_DESCR
 /begin AXIS_DESCR STD_AXIS NO_INPUT_QUANTITY UMR___1_1_M1_S6_S3 6 -1 10 DEPOSIT ABSOLUTE MONOTONY MON_INCREASE /end AXIS_DESCR
/end CHARACTERISTIC
/begin CHARACTERISTIC SWI_MO_ENTKOPPL "Schalter zur Aktivierung des Momentenoffsets im Entkoppeln" VALUE 0x26E552 kw_bool8_S6_S3 1 UMR___1_1_0_S6_S3 0 1 /end CHARACTERISTIC
/begin CHARACTERISTIC KF_M_SOLL_MIN_ENTKOPPL "Min-Begrenzung von m_soll_iae im Entkoppeln" MAP 0x223020 kf_si16_S6_S3 1000 UMR_NM__1_1_0_S6_S3 -1000 0
 /begin AXIS_DESCR STD_AXIS NO_INPUT_QUANTITY UMR_GRADC__1_1_M40_S6_S3 6 -40 215 DEPOSIT ABSOLUTE MONOTONY MON_INCREASE /end AXIS_DESCR
 /begin AXIS_DESCR STD_AXIS iAzsIstgang.istgang UMR___1_1_0_S6_S3 6 -1 8 DEPOSIT ABSOLUTE MONOTONY MON_INCREASE /end AXIS_DESCR
/end CHARACTERISTIC
/begin CHARACTERISTIC KF_MOSOLLNDIAETIMER_ENTKOPPL "Momentenoffset bei zunehmendem nd_iae_kf und Timerwert im Schliessen_Entkoppeln" MAP 0x223088 kf_si16_S6_S3 1000 UMR_NM__1_1_0_S6_S3 0 1000
 /begin AXIS_DESCR STD_AXIS NO_INPUT_QUANTITY UMR_MSEC__10_1_0_S6_S3 6 0 300000 DEPOSIT ABSOLUTE MONOTONY MON_INCREASE /end AXIS_DESCR
 /begin AXIS_DESCR STD_AXIS iIaeSigna.nd_iae UMR_U_MIN_1_1_0_S6_S3 6 0 10000 DEPOSIT ABSOLUTE MONOTONY MON_INCREASE /end AXIS_DESCR
/end CHARACTERISTIC
/begin CHARACTERISTIC KF_RAMPEOEFFNEN_ENTKOPPL_R "Momentenrampe zum Kupplungsöffnen in der Entkopplungsfunktion" MAP 0x2230F0 kf_si16_S6_S3 2000 UMR_NM__1_1_0_S6_S3 -1000 1000
 /begin AXIS_DESCR STD_AXIS NO_INPUT_QUANTITY UMR_MSEC__10_1_0_S6_S3 6 0 5000 DEPOSIT ABSOLUTE MONOTONY MON_INCREASE /end AXIS_DESCR
 /begin AXIS_DESCR STD_AXIS NO_INPUT_QUANTITY UMR_NM__1_1_0_S6_S3 6 -400 1640 DEPOSIT ABSOLUTE MONOTONY MON_INCREASE /end AXIS_DESCR
/end CHARACTERISTIC
/begin CHARACTERISTIC KF_RAMPEOEFFNEN_ENTKOPPL_1 "Momentenrampe zum Kupplungsöffnen in der Entkopplungsfunktion" MAP 0x223158 kf_si16_S6_S3 2000 UMR_NM__1_1_0_S6_S3 -1000 1000
 /begin AXIS_DESCR STD_AXIS NO_INPUT_QUANTITY UMR_MSEC__10_1_0_S6_S3 6 0 5000 DEPOSIT ABSOLUTE MONOTONY MON_INCREASE /end AXIS_DESCR
 /begin AXIS_DESCR STD_AXIS NO_INPUT_QUANTITY UMR_NM__1_1_0_S6_S3 6 -400 1640 DEPOSIT ABSOLUTE MONOTONY MON_INCREASE /end AXIS_DESCR
/end CHARACTERISTIC
/begin CHARACTERISTIC KF_RAMPEOEFFNEN_ENTKOPPL_2 "Momentenrampe zum Kupplungsöffnen in der Entkopplungsfunktion" MAP 0x2231C0 kf_si16_S6_S3 2000 UMR_NM__1_1_0_S6_S3 -1000 1000
 /begin AXIS_DESCR STD_AXIS NO_INPUT_QUANTITY UMR_MSEC__10_1_0_S6_S3 6 0 5000 DEPOSIT ABSOLUTE MONOTONY MON_INCREASE /end AXIS_DESCR
 /begin AXIS_DESCR STD_AXIS NO_INPUT_QUANTITY UMR_NM__1_1_0_S6_S3 6 -400 1640 DEPOSIT ABSOLUTE MONOTONY MON_INCREASE /end AXIS_DESCR
/end CHARACTERISTIC
/begin CHARACTERISTIC KF_RAMPEOEFFNEN_ENTKOPPL_3 "Momentenrampe zum Kupplungsöffnen in der Entkopplungsfunktion" MAP 0x223228 kf_si16_S6_S3 2000 UMR_NM__1_1_0_S6_S3 -1000 1000
 /begin AXIS_DESCR STD_AXIS NO_INPUT_QUANTITY UMR_MSEC__10_1_0_S6_S3 6 0 5000 DEPOSIT ABSOLUTE MONOTONY MON_INCREASE /end AXIS_DESCR
 /begin AXIS_DESCR STD_AXIS NO_INPUT_QUANTITY UMR_NM__1_1_0_S6_S3 6 -400 1640 DEPOSIT ABSOLUTE MONOTONY MON_INCREASE /end AXIS_DESCR
/end CHARACTERISTIC
/begin CHARACTERISTIC KF_RAMPEOEFFNEN_ENTKOPPL_4 "Momentenrampe zum Kupplungsöffnen in der Entkopplungsfunktion" MAP 0x223290 kf_si16_S6_S3 2000 UMR_NM__1_1_0_S6_S3 -1000 1000
 /begin AXIS_DESCR STD_AXIS NO_INPUT_QUANTITY UMR_MSEC__10_1_0_S6_S3 6 0 5000 DEPOSIT ABSOLUTE MONOTONY MON_INCREASE /end AXIS_DESCR
 /begin AXIS_DESCR STD_AXIS NO_INPUT_QUANTITY UMR_NM__1_1_0_S6_S3 6 -400 1640 DEPOSIT ABSOLUTE MONOTONY MON_INCREASE /end AXIS_DESCR
/end CHARACTERISTIC
/begin CHARACTERISTIC KF_RAMPEOEFFNEN_ENTKOPPL_5 "Momentenrampe zum Kupplungsöffnen in der Entkopplungsfunktion" MAP 0x2232F8 kf_si16_S6_S3 2000 UMR_NM__1_1_0_S6_S3 -1000 1000
 /begin AXIS_DESCR STD_AXIS NO_INPUT_QUANTITY UMR_MSEC__10_1_0_S6_S3 6 0 5000 DEPOSIT ABSOLUTE MONOTONY MON_INCREASE /end AXIS_DESCR
 /begin AXIS_DESCR STD_AXIS NO_INPUT_QUANTITY UMR_NM__1_1_0_S6_S3 6 -400 1640 DEPOSIT ABSOLUTE MONOTONY MON_INCREASE /end AXIS_DESCR
/end CHARACTERISTIC
/begin CHARACTERISTIC CS_START_MAX_UEFIAE "Max-Temperatur für Adaption" VALUE 0x26E4EB kw_ui8_S6_S3 200 UMR_GRADC__1_1_0_S6_S3 0 200 /end CHARACTERISTIC
/begin CHARACTERISTIC CS_START_MIN_UEFIAE "Min-Temperatur für Adaption" VALUE 0x26E4EC kw_ui8_S6_S3 200 UMR_GRADC__1_1_0_S6_S3 0 200 /end CHARACTERISTIC
/begin CHARACTERISTIC DO_MUEMAX_UEFIAE "Betrag Adaptionshubbegrenzung (positiv und negativ)" VALUE 0x26E4ED kw_ui8_S6_S3 100 UMR_NM_BAR_1_1_0_S6_S3 0 100 /end CHARACTERISTIC
/begin CHARACTERISTIC KL_J_KOR_UEFIAE "Berechnungskorrektur Massenträgheit" CURVE 0x21FD00 kl_si16_S6_S3 200 UMR_NM_BAR_1_1_0_S6_S3 -100 100
 /begin AXIS_DESCR STD_AXIS NO_INPUT_QUANTITY UMR_U_MINSEC_1_1_0_S6_S3 4 -10000 10000 DEPOSIT ABSOLUTE MONOTONY MON_INCREASE /end AXIS_DESCR
/end CHARACTERISTIC
/begin CHARACTERISTIC MS_MOTIST_ABBR_UEFIAE "Abbruchschwelle Aenderung Motormoment" VALUE 0x26D522 kw_si16_S6_S3 1000 UMR_NM__1_1_0_S6_S3 0 1000 /end CHARACTERISTIC
/begin CHARACTERISTIC M_MOTIST_START_MAX_UEFIAE "Max-Motormoment fuer Adaption" VALUE 0x26D524 kw_si16_S6_S3 1000 UMR_NM__1_1_0_S6_S3 0 1000 /end CHARACTERISTIC
/begin CHARACTERISTIC M_MOTIST_START_MIN_UEFIAE "Min-Motormoment fuer Adaption" VALUE 0x26D526 kw_si16_S6_S3 1000 UMR_NM__1_1_0_S6_S3 0 1000 /end CHARACTERISTIC
/begin CHARACTERISTIC MS_START_MAX_UEFIAE "Max-Kupplungsmoment für Adaption" VALUE 0x26D528 kw_si16_S6_S3 1000 UMR_NM__1_1_0_S6_S3 0 1000 /end CHARACTERISTIC
/begin CHARACTERISTIC MS_START_MIN_UEFIAE "Min-Kupplungsmoment für Adaption" VALUE 0x26D52A kw_si16_S6_S3 2000 UMR_NM__1_1_0_S6_S3 -1000 1000 /end CHARACTERISTIC
/begin CHARACTERISTIC MSTELL_ABBR_UEFIAE "Abbruchschwelle Änderung Kupplungsmoment" VALUE 0x26D52C kw_si16_S6_S3 1000 UMR_NM__1_1_0_S6_S3 0 1000 /end CHARACTERISTIC
/begin CHARACTERISTIC NDGS_START_MAX_UEFIAE "Max-Schlupfgradient für Adaption U/min/sek" VALUE 0x26D52E kw_si16_S6_S3 1000 UMR_U_MINSEC_1_1_0_S6_S3 0 1000 /end CHARACTERISTIC
/begin CHARACTERISTIC NDGS_START_MIN_UEFIAE "Min-Schlupfgradient für Adaption U/min/sek" VALUE 0x26D530 kw_si16_S6_S3 2000 UMR_U_MINSEC_1_1_0_S6_S3 -1000 1000 /end CHARACTERISTIC
/begin CHARACTERISTIC NDS_ABBR_UEFIAE "Abbruchschwelle Änderung IAE-Schlupf" VALUE 0x26D532 kw_si16_S6_S3 1000 UMR_U_MIN_1_1_0_S6_S3 0 1000 /end CHARACTERISTIC
/begin CHARACTERISTIC NDS_START_MAX_UEFIAE "Max-Grenze IAE-Schlupf für Adaption U/min" VALUE 0x26D534 kw_si16_S6_S3 1000 UMR_U_MIN_1_1_0_S6_S3 0 1000 /end CHARACTERISTIC
/begin CHARACTERISTIC NDS_START_MIN_UEFIAE "Min-Grenze IAE-Schlupf für Adaption U/min" VALUE 0x26D536 kw_si16_S6_S3 2000 UMR_U_MIN_1_1_0_S6_S3 -1000 1000 /end CHARACTERISTIC
/begin CHARACTERISTIC NGS_ABBR_UEFIAE "Abbruchschwelle Änderung Motordrehzahlgradient U/min/sek" VALUE 0x26D538 kw_si16_S6_S3 1000 UMR_U_MINSEC_1_1_0_S6_S3 0 1000 /end CHARACTERISTIC
/begin CHARACTERISTIC NGS_MOT_START_MAX_UEFIAE "Max-Grenze Motordrehzahlgradient für Adaption" VALUE 0x26D53A kw_si16_S6_S3 1000 UMR_U_MINSEC_1_1_0_S6_S3 0 1000 /end CHARACTERISTIC
/begin CHARACTERISTIC NGS_MOT_START_MIN_UEFIAE "Min-Grenze Motordrehzahlgradient für Adaption" VALUE 0x26D53C kw_si16_S6_S3 2000 UMR_U_MINSEC_1_1_0_S6_S3 -1000 1000 /end CHARACTERISTIC
/begin CHARACTERISTIC PSTELL_ABBR_UEFIAE "Abbruchschwelle Anderung Stelldruck B" VALUE 0x26D53E kw_si16_S6_S3 1 UMR_BAR__1_1000_0_S6_S3 0 1 /end CHARACTERISTIC
/begin CHARACTERISTIC T_LAUF_UEFIAE "Adaptionsdauer" VALUE 0x26E4EE kw_ui8_S6_S3 1000 UMR_MSEC__10_1_0_S6_S3 0 1000 /end CHARACTERISTIC
/begin CHARACTERISTIC TAB_MTM_MOT_UEFIAE "Summe Massenträgheitsmoment vor Getriebe" CURVE 0x21FD14 tab_ui8_S6_S3 1 UMR_KGM2__1_100_0_S6_S3 0 1
 /begin AXIS_DESCR FIX_AXIS iItfInput.z_modus_iae UMR___1_1_0_S6_S3 3 0 2 FIX_AXIS_PAR_DIST 0 1 3 /end AXIS_DESCR
/end CHARACTERISTIC
/begin CHARACTERISTIC MUE_IST_MIN_UEFIAE "physiklische Untergrenze von Mue" VALUE 0x26D540 kw_si16_S6_S3 190 UMR_NM_BAR_1_1_0_S6_S3 10 200 /end CHARACTERISTIC
/begin CHARACTERISTIC MUE_IST_MAX_UEFIAE "physiklische Obergrenze von Mue" VALUE 0x26D542 kw_si16_S6_S3 300 UMR_NM_BAR_1_1_0_S6_S3 200 500 /end CHARACTERISTIC
/begin CHARACTERISTIC KF_F_M_ANFAHRT_E_IAE "Faktor auf Vorsteueranteil im Zustand H- oder E-Anfahren" MAP 0x21FD1C kf_si16_S6_S3 2 UMR___1_1000_0_S6_S3 0 2
 /begin AXIS_DESCR STD_AXIS iIaeMomen.ng_motanfahr_gef_iae UMR_U_MINSEC_1_1_0_S6_S3 6 -8160 8160 DEPOSIT ABSOLUTE MONOTONY MON_INCREASE /end AXIS_DESCR
 /begin AXIS_DESCR STD_AXIS NO_INPUT_QUANTITY UMR___1_1_0_S6_S3 6 0 1000 DEPOSIT ABSOLUTE MONOTONY MON_INCREASE /end AXIS_DESCR
/end CHARACTERISTIC
/begin CHARACTERISTIC KL_NGMOTANFAHRINIT_E_IAE "Initialisierungsgradient für den Sollanfahrdrehzahlfilter" CURVE 0x21FD84 kl_si16_S6_S3 10000 UMR_U_MINSEC_1_1_0_S6_S3 0 10000
 /begin AXIS_DESCR STD_AXIS NO_INPUT_QUANTITY UMR_PROZENT__20_51_0_S6_S3 6 0 100 DEPOSIT ABSOLUTE MONOTONY MON_INCREASE /end AXIS_DESCR
/end CHARACTERISTIC
/begin CHARACTERISTIC KF_NMOTANFAHR_SOLL_E_IAE "" MAP 0x21FDA0 kf_si16_S6_S3 7000 UMR_U_MIN_1_1_0_S6_S3 0 7000
 /begin AXIS_DESCR STD_AXIS NO_INPUT_QUANTITY UMR___1_1_0_S6_S3 6 -1 8 DEPOSIT ABSOLUTE MONOTONY MON_INCREASE /end AXIS_DESCR
 /begin AXIS_DESCR STD_AXIS NO_INPUT_QUANTITY UMR_PROZENT__20_51_0_S6_S3 6 0 100 DEPOSIT ABSOLUTE MONOTONY MON_INCREASE /end AXIS_DESCR
/end CHARACTERISTIC
/begin CHARACTERISTIC KF_NMOTANFAHR_SOLL_STALL_E_IAE "Drehzahloffset auf LL für Anfahrsolldrehzahl (Stallbetrieb)" MAP 0x21FE08 kf_si16_S6_S3 7000 UMR_U_MIN_1_1_0_S6_S3 0 7000
 /begin AXIS_DESCR STD_AXIS NO_INPUT_QUANTITY UMR_GRAD__1_3_M128_S6_S3 6 -42.6666666667 42.3333333333 DEPOSIT ABSOLUTE MONOTONY MON_INCREASE /end AXIS_DESCR
 /begin AXIS_DESCR STD_AXIS NO_INPUT_QUANTITY UMR_PROZENT__20_51_0_S6_S3 6 0 100 DEPOSIT ABSOLUTE MONOTONY MON_INCREASE /end AXIS_DESCR
/end CHARACTERISTIC
/begin CHARACTERISTIC KF_F_M_ANFAHRT_H_IAE "Faktor auf Vorsteueranteil im Zustand H- oder E-Anfahren" MAP 0x21FE70 kf_si16_S6_S3 2 UMR___1_1000_0_S6_S3 0 2
 /begin AXIS_DESCR STD_AXIS iIaeMomen.ng_motanfahr_gef_iae UMR_U_MINSEC_1_1_0_S6_S3 6 -8160 8160 DEPOSIT ABSOLUTE MONOTONY MON_INCREASE /end AXIS_DESCR
 /begin AXIS_DESCR STD_AXIS NO_INPUT_QUANTITY UMR___1_1_0_S6_S3 6 0 1000 DEPOSIT ABSOLUTE MONOTONY MON_INCREASE /end AXIS_DESCR
/end CHARACTERISTIC
/begin CHARACTERISTIC KL_NGMOTANFAHRINIT_H_IAE "Initialisierungsgradient für den Sollanfahrdrehzahlfilter" CURVE 0x21FED8 kl_si16_S6_S3 10000 UMR_U_MINSEC_1_1_0_S6_S3 0 10000
 /begin AXIS_DESCR STD_AXIS NO_INPUT_QUANTITY UMR_PROZENT__20_51_0_S6_S3 6 0 100 DEPOSIT ABSOLUTE MONOTONY MON_INCREASE /end AXIS_DESCR
/end CHARACTERISTIC
/begin CHARACTERISTIC KF_NMOTANFAHR_SOLL_H_IAE "" MAP 0x21FEF4 kf_si16_S6_S3 7000 UMR_U_MIN_1_1_0_S6_S3 0 7000
 /begin AXIS_DESCR STD_AXIS NO_INPUT_QUANTITY UMR___1_1_0_S6_S3 6 -1 8 DEPOSIT ABSOLUTE MONOTONY MON_INCREASE /end AXIS_DESCR
 /begin AXIS_DESCR STD_AXIS NO_INPUT_QUANTITY UMR_PROZENT__20_51_0_S6_S3 6 0 100 DEPOSIT ABSOLUTE MONOTONY MON_INCREASE /end AXIS_DESCR
/end CHARACTERISTIC
/begin CHARACTERISTIC KF_NMOTANFAHR_SOLL_STALL_H_IAE "Drehzahloffset auf LL für Anfahrsolldrehzahl (Stallbetrieb)" MAP 0x21FF5C kf_si16_S6_S3 7000 UMR_U_MIN_1_1_0_S6_S3 0 7000
 /begin AXIS_DESCR STD_AXIS NO_INPUT_QUANTITY UMR_GRAD__1_3_M128_S6_S3 6 -42.6666666667 42.3333333333 DEPOSIT ABSOLUTE MONOTONY MON_INCREASE /end AXIS_DESCR
 /begin AXIS_DESCR STD_AXIS NO_INPUT_QUANTITY UMR_PROZENT__20_51_0_S6_S3 6 0 100 DEPOSIT ABSOLUTE MONOTONY MON_INCREASE /end AXIS_DESCR
/end CHARACTERISTIC
/begin CHARACTERISTIC KF_F_M_ANFAHRT_E_ECO_IAE "Faktor auf Vorsteueranteil im Zustand H- oder E-Anfahren" MAP 0x21FFC4 kf_si16_S6_S3 2 UMR___1_1000_0_S6_S3 0 2
 /begin AXIS_DESCR STD_AXIS iIaeMomen.ng_motanfahr_gef_iae UMR_U_MINSEC_1_1_0_S6_S3 6 -8160 8160 DEPOSIT ABSOLUTE MONOTONY MON_INCREASE /end AXIS_DESCR
 /begin AXIS_DESCR STD_AXIS NO_INPUT_QUANTITY UMR___1_1_0_S6_S3 6 0 1000 DEPOSIT ABSOLUTE MONOTONY MON_INCREASE /end AXIS_DESCR
/end CHARACTERISTIC
/begin CHARACTERISTIC KL_NGMOTANFAHRINIT_E_ECO_IAE "Initialisierungsgradient für den Sollanfahrdrehzahlfilter" CURVE 0x22002C kl_si16_S6_S3 10000 UMR_U_MINSEC_1_1_0_S6_S3 0 10000
 /begin AXIS_DESCR STD_AXIS NO_INPUT_QUANTITY UMR_PROZENT__20_51_0_S6_S3 6 0 100 DEPOSIT ABSOLUTE MONOTONY MON_INCREASE /end AXIS_DESCR
/end CHARACTERISTIC
/begin CHARACTERISTIC KF_NMOTANFAHR_SOLL_E_ECO_IAE "" MAP 0x220048 kf_si16_S6_S3 7000 UMR_U_MIN_1_1_0_S6_S3 0 7000
 /begin AXIS_DESCR STD_AXIS NO_INPUT_QUANTITY UMR___1_1_0_S6_S3 6 -1 8 DEPOSIT ABSOLUTE MONOTONY MON_INCREASE /end AXIS_DESCR
 /begin AXIS_DESCR STD_AXIS NO_INPUT_QUANTITY UMR_PROZENT__20_51_0_S6_S3 6 0 100 DEPOSIT ABSOLUTE MONOTONY MON_INCREASE /end AXIS_DESCR
/end CHARACTERISTIC
/begin CHARACTERISTIC KF_NMOTANFAHR_SOLL_STALL_E_ECO_IAE "Drehzahloffset auf LL für Anfahrsolldrehzahl (Stallbetrieb)" MAP 0x2200B0 kf_si16_S6_S3 7000 UMR_U_MIN_1_1_0_S6_S3 0 7000
 /begin AXIS_DESCR STD_AXIS NO_INPUT_QUANTITY UMR_GRAD__1_3_M128_S6_S3 6 -42.6666666667 42.3333333333 DEPOSIT ABSOLUTE MONOTONY MON_INCREASE /end AXIS_DESCR
 /begin AXIS_DESCR STD_AXIS NO_INPUT_QUANTITY UMR_PROZENT__20_51_0_S6_S3 6 0 100 DEPOSIT ABSOLUTE MONOTONY MON_INCREASE /end AXIS_DESCR
/end CHARACTERISTIC
/begin CHARACTERISTIC KF_F_M_ANFAHRT_H_ECO_IAE "Faktor auf Vorsteueranteil im Zustand H- oder E-Anfahren" MAP 0x220118 kf_si16_S6_S3 2 UMR___1_1000_0_S6_S3 0 2
 /begin AXIS_DESCR STD_AXIS iIaeMomen.ng_motanfahr_gef_iae UMR_U_MINSEC_1_1_0_S6_S3 6 -8160 8160 DEPOSIT ABSOLUTE MONOTONY MON_INCREASE /end AXIS_DESCR
 /begin AXIS_DESCR STD_AXIS NO_INPUT_QUANTITY UMR___1_1_0_S6_S3 6 0 1000 DEPOSIT ABSOLUTE MONOTONY MON_INCREASE /end AXIS_DESCR
/end CHARACTERISTIC
/begin CHARACTERISTIC KL_NGMOTANFAHRINIT_H_ECO_IAE "Initialisierungsgradient für den Sollanfahrdrehzahlfilter" CURVE 0x220180 kl_si16_S6_S3 10000 UMR_U_MINSEC_1_1_0_S6_S3 0 10000
 /begin AXIS_DESCR STD_AXIS NO_INPUT_QUANTITY UMR_PROZENT__20_51_0_S6_S3 6 0 100 DEPOSIT ABSOLUTE MONOTONY MON_INCREASE /end AXIS_DESCR
/end CHARACTERISTIC
/begin CHARACTERISTIC KF_NMOTANFAHR_SOLL_H_ECO_IAE "" MAP 0x22019C kf_si16_S6_S3 7000 UMR_U_MIN_1_1_0_S6_S3 0 7000
 /begin AXIS_DESCR STD_AXIS NO_INPUT_QUANTITY UMR___1_1_0_S6_S3 6 -1 8 DEPOSIT ABSOLUTE MONOTONY MON_INCREASE /end AXIS_DESCR
 /begin AXIS_DESCR STD_AXIS NO_INPUT_QUANTITY UMR_PROZENT__20_51_0_S6_S3 6 0 100 DEPOSIT ABSOLUTE MONOTONY MON_INCREASE /end AXIS_DESCR
/end CHARACTERISTIC
/begin CHARACTERISTIC KF_NMOTANFAHR_SOLL_STALL_H_ECO_IAE "Drehzahloffset auf LL für Anfahrsolldrehzahl (Stallbetrieb)" MAP 0x220204 kf_si16_S6_S3 7000 UMR_U_MIN_1_1_0_S6_S3 0 7000
 /begin AXIS_DESCR STD_AXIS NO_INPUT_QUANTITY UMR_GRAD__1_3_M128_S6_S3 6 -42.6666666667 42.3333333333 DEPOSIT ABSOLUTE MONOTONY MON_INCREASE /end AXIS_DESCR
 /begin AXIS_DESCR STD_AXIS NO_INPUT_QUANTITY UMR_PROZENT__20_51_0_S6_S3 6 0 100 DEPOSIT ABSOLUTE MONOTONY MON_INCREASE /end AXIS_DESCR
/end CHARACTERISTIC
/begin CHARACTERISTIC MO_ANGELEGT_KRIECH_IAE "Momentenoffset auf Motoristmoment beim Übergang Zu nach Angelegt/Kriechen" VALUE 0x26D5AA kw_si16_S6_S3 1000 UMR_NM__1_1_0_S6_S3 0 1000 /end CHARACTERISTIC
/begin CHARACTERISTIC M_ANGELEGT_AUTOHOLD_IAE "Vorsteuermoment im Zustand Angelegt bei aktiver Rollverhinderung" VALUE 0x26D5AC kw_si16_S6_S3 50 UMR_NM__1_1_0_S6_S3 0 50 /end CHARACTERISTIC
/begin CHARACTERISTIC KL_M_ANGELEGT_ND_IAE "Momentenvorgabe in ANGELEGT in Abh. von nd_nmot_iae" CURVE 0x2212B0 kl_si16_S6_S3 100 UMR_NM__1_1_0_S6_S3 -50 50
 /begin AXIS_DESCR STD_AXIS NO_INPUT_QUANTITY UMR_U_MIN_1_1_0_S6_S3 6 -8160 8160 DEPOSIT ABSOLUTE MONOTONY MON_INCREASE /end AXIS_DESCR
/end CHARACTERISTIC
/begin CHARACTERISTIC KF_M_ANGELEGT_PBREMSDKI_IAE "Momentenvorgabe in Zustand Angelegt" MAP 0x2212CC kf_si16_S6_S3 100 UMR_NM__1_1_0_S6_S3 0 100
 /begin AXIS_DESCR STD_AXIS iIaeSigna.p_brems_iae UMR_BAR__1_100_0_S6_S3 6 -10 300 DEPOSIT ABSOLUTE MONOTONY MON_INCREASE /end AXIS_DESCR
 /begin AXIS_DESCR STD_AXIS NO_INPUT_QUANTITY UMR_PROZENT__20_51_0_S6_S3 4 0 100 DEPOSIT ABSOLUTE MONOTONY MON_INCREASE /end AXIS_DESCR
/end CHARACTERISTIC
/begin CHARACTERISTIC KL_F_M_ANGELEGT_IAE "Faktor auf Ansteuermoment in Angelegt abhängig von Motordrehzahl" CURVE 0x221318 kl_si16_S6_S3 6 UMR___1_100_0_S6_S3 -5 1
 /begin AXIS_DESCR STD_AXIS iIaeSigna.n_mot_iae UMR_U_MIN_1_1_0_S6_S3 3 0 10000 DEPOSIT ABSOLUTE MONOTONY MON_INCREASE /end AXIS_DESCR
/end CHARACTERISTIC
/begin CHARACTERISTIC TS_MAXANKRIECHEN_IAE "Zeitschwelle zum Erreichen einer Abtriebsdrehzahlschwelle Im Zustand Kriechen" VALUE 0x26D5AE kw_ui16_S6_S3 10000 UMR_MSEC__10_1_0_S6_S3 0 10000 /end CHARACTERISTIC
/begin CHARACTERISTIC NS_ABMINANKRIECHEN_IAE "Abtriebsdrehzahlschwelle im Zustand Kriechen zum Start einer Kriechmomentenoffsetrampe" VALUE 0x26D5B0 kw_si16_S6_S3 2000 UMR_U_MIN_1_1_0_S6_S3 0 2000 /end CHARACTERISTIC
/begin CHARACTERISTIC MG_ANKRIECHEN_IAE "Gradient der Kriechmomentenoffsetrampe" VALUE 0x26D5B2 kw_si16_S6_S3 10000 UMR_NM_SEC_1_1_0_S6_S3 0 10000 /end CHARACTERISTIC
/begin CHARACTERISTIC MG_ANKRIECHNEG_IAE "Negativer Gradient zum Rausrampen des Kriechmomentenoffsetrampe" VALUE 0x26D5B4 kw_si16_S6_S3 10000 UMR_NM_SEC_1_1_0_S6_S3 -10000 0 /end CHARACTERISTIC
/begin CHARACTERISTIC KF_ND_IAESOLLKRIECH_IAE "maximales Kriechmoment" MAP 0x221328 kf_si16_S6_S3 4000 UMR_U_MIN_1_1_0_S6_S3 -2000 2000
 /begin AXIS_DESCR STD_AXIS iIaeSigna.nd_getrein_basis_ll_iae UMR_U_MIN_1_1_0_S6_S3 6 0 10000 DEPOSIT ABSOLUTE MONOTONY MON_INCREASE /end AXIS_DESCR
 /begin AXIS_DESCR STD_AXIS NO_INPUT_QUANTITY UMR___1_1_0_S6_S3 6 -1 8 DEPOSIT ABSOLUTE MONOTONY MON_INCREASE /end AXIS_DESCR
/end CHARACTERISTIC
/begin CHARACTERISTIC KL_F_NDIAESOLLKRIECH_IAE "Faktor auf Solldrehzahl im Kriechen" CURVE 0x221390 kl_si16_S6_S3 2 UMR___1_100_0_S6_S3 0 2
 /begin AXIS_DESCR STD_AXIS iIaeSigna.nd_getrein_iae UMR_U_MIN_1_1_0_S6_S3 6 -10000 10000 DEPOSIT ABSOLUTE MONOTONY MON_INCREASE /end AXIS_DESCR
/end CHARACTERISTIC
/begin CHARACTERISTIC NS_ABREGINITKRIECH_HYS_IAE "Abtriebsdrehzahlhysteresewert zur Initialisierung des Kriechdifferenzdrehzahlreglers" VALUE 0x26D5B6 kw_si16_S6_S3 2000 UMR_U_MIN_1_1_0_S6_S3 0 2000 /end CHARACTERISTIC
/begin CHARACTERISTIC NS_ABREGINITKRIECH_IAE "Abtriebsdrehzahlwert zur Initialisierung des Kriechdifferenzdrehzahlreglers" VALUE 0x26D5B8 kw_si16_S6_S3 2100 UMR_U_MIN_1_1_0_S6_S3 -100 2000 /end CHARACTERISTIC
/begin CHARACTERISTIC KL_M_KRIECHMAX_MOTSTRESS_IAE "Max. Kriechmoment, abhängig vom motorstress_iae" CURVE 0x2213AC kl_si16_S6_S3 250 UMR_NM__1_1_0_S6_S3 -50 200
 /begin AXIS_DESCR STD_AXIS iIaeSigna.mot_stress_iae UMR_PROZENT__16_10_0_S6_S3 4 0 204.8 DEPOSIT ABSOLUTE MONOTONY MON_INCREASE /end AXIS_DESCR
/end CHARACTERISTIC
/begin CHARACTERISTIC KL_M_KRIECHMAX_CGETR_IAE "Max. Kriechmoment, abhängig von c_getr" CURVE 0x2213C0 kl_si16_S6_S3 250 UMR_NM__1_1_0_S6_S3 -50 200
 /begin AXIS_DESCR STD_AXIS NO_INPUT_QUANTITY UMR_GRADC__1_1_M40_S6_S3 4 -40 500 DEPOSIT ABSOLUTE MONOTONY MON_INCREASE /end AXIS_DESCR
/end CHARACTERISTIC
/begin CHARACTERISTIC KF_M_KRIECH_MAX_IAE "maximales Kriechmoment" MAP 0x2213D4 kf_si16_S6_S3 400 UMR_NM__1_1_0_S6_S3 -200 200
 /begin AXIS_DESCR STD_AXIS iIaeSigna.nd_getrein_iae UMR_U_MIN_1_1_0_S6_S3 6 -10000 10000 DEPOSIT ABSOLUTE MONOTONY MON_INCREASE /end AXIS_DESCR
 /begin AXIS_DESCR STD_AXIS iIaeSigna.p_brems_iae UMR_BAR__1_100_0_S6_S3 6 -10 300 DEPOSIT ABSOLUTE MONOTONY MON_INCREASE /end AXIS_DESCR
/end CHARACTERISTIC
/begin CHARACTERISTIC KL_F_M_KRIECH_MAX_NEIGUNG_IAE "Faktor auf maximales Kriechmoment in Abhängigkeit der Neigung" CURVE 0x22143C kl_si16_S6_S3 2 UMR___1_100_0_S6_S3 0 2
 /begin AXIS_DESCR STD_AXIS iIaeSigna.neigung_iae UMR_GRAD__1_3_M128_S6_S3 4 -3376 3290.66666667 DEPOSIT ABSOLUTE MONOTONY MON_INCREASE /end AXIS_DESCR
/end CHARACTERISTIC
/begin CHARACTERISTIC KF_F_M_KRIECH_MAX_IAE "Faktor auf maximales Kriechmoment" MAP 0x221450 kf_si16_S6_S3 2 UMR___1_100_0_S6_S3 0 2
 /begin AXIS_DESCR STD_AXIS iIaeSigna.nd_mot_iae UMR_U_MIN_1_1_0_S6_S3 6 -10000 10000 DEPOSIT ABSOLUTE MONOTONY MON_INCREASE /end AXIS_DESCR
 /begin AXIS_DESCR STD_AXIS iIaeSigna.m_motist_iae UMR_NM__1_1_0_S6_S3 6 -400 1640 DEPOSIT ABSOLUTE MONOTONY MON_INCREASE /end AXIS_DESCR
/end CHARACTERISTIC
/begin CHARACTERISTIC KF_M_KRIECH_MIN_IAE "minimales Kriechmoment" MAP 0x2214B8 kf_si16_S6_S3 400 UMR_NM__1_1_0_S6_S3 -200 200
 /begin AXIS_DESCR STD_AXIS iIaeSigna.nd_getrein_iae UMR_U_MIN_1_1_0_S6_S3 6 -10000 10000 DEPOSIT ABSOLUTE MONOTONY MON_INCREASE /end AXIS_DESCR
 /begin AXIS_DESCR STD_AXIS iIaeSigna.p_brems_iae UMR_BAR__1_100_0_S6_S3 6 -10 300 DEPOSIT ABSOLUTE MONOTONY MON_INCREASE /end AXIS_DESCR
/end CHARACTERISTIC
/begin CHARACTERISTIC KF_M_KRIECH_IAE "gest. Kriechmoment" MAP 0x221520 kf_si16_S6_S3 2000 UMR_NM__1_1_0_S6_S3 0 2000
 /begin AXIS_DESCR STD_AXIS iIaeSigna.nd_getrein_iae UMR_U_MIN_1_1_0_S6_S3 6 -10000 10000 DEPOSIT ABSOLUTE MONOTONY MON_INCREASE /end AXIS_DESCR
 /begin AXIS_DESCR STD_AXIS NO_INPUT_QUANTITY UMR_GRADC__1_1_M40_S6_S3 6 -40 500 DEPOSIT ABSOLUTE MONOTONY MON_INCREASE /end AXIS_DESCR
/end CHARACTERISTIC
/begin CHARACTERISTIC TAB_F_MMAX_KRIECH_IAE "Gangfaktor Max-Kriechmoment" CURVE 0x221588 tab_ui8_S6_S3 2 UMR___1_100_0_S6_S3 0 2
 /begin AXIS_DESCR FIX_AXIS NO_INPUT_QUANTITY UMR___1_1_0_S6_S3 10 -1 8 FIX_AXIS_PAR_DIST -1 1 10 /end AXIS_DESCR
/end CHARACTERISTIC
/begin CHARACTERISTIC TAB_F_MMIN_KRIECH_IAE "Gangfaktor Min-Kriechmoment" CURVE 0x221598 tab_ui8_S6_S3 2 UMR___1_100_0_S6_S3 0 2
 /begin AXIS_DESCR FIX_AXIS NO_INPUT_QUANTITY UMR___1_1_0_S6_S3 10 -1 8 FIX_AXIS_PAR_DIST -1 1 10 /end AXIS_DESCR
/end CHARACTERISTIC
/begin CHARACTERISTIC TAB_F_MVST_KRIECH_IAE "Gangfaktor Kriechmoment Vorsteuerung" CURVE 0x2215A8 tab_ui8_S6_S3 2 UMR___1_100_0_S6_S3 0 2
 /begin AXIS_DESCR FIX_AXIS NO_INPUT_QUANTITY UMR___1_1_0_S6_S3 10 -1 8 FIX_AXIS_PAR_DIST -1 1 10 /end AXIS_DESCR
/end CHARACTERISTIC
/begin CHARACTERISTIC KF_MOSOLLLASTNMOT_IAE "Momentengradient im Synchronisieren" MAP 0x2215B8 kf_si16_S6_S3 2000 UMR_NM__1_1_0_S6_S3 -1000 1000
 /begin AXIS_DESCR STD_AXIS NO_INPUT_QUANTITY UMR_NM__1_1_0_S6_S3 6 -3000 3000 DEPOSIT ABSOLUTE MONOTONY MON_INCREASE /end AXIS_DESCR
 /begin AXIS_DESCR STD_AXIS iIaeSigna.n_mot_iae UMR_U_MIN_1_1_0_S6_S3 6 0 10000 DEPOSIT ABSOLUTE MONOTONY MON_INCREASE /end AXIS_DESCR
/end CHARACTERISTIC
/begin CHARACTERISTIC KF_MOSOLLNDIAETIMER_IAE "Momentenoffset bei zunehmendem nd_iae_kf und Timerwert im Synchronisieren" MAP 0x221620 kf_si16_S6_S3 1000 UMR_NM__1_1_0_S6_S3 0 1000
 /begin AXIS_DESCR STD_AXIS NO_INPUT_QUANTITY UMR_MSEC__10_1_0_S6_S3 6 0 300000 DEPOSIT ABSOLUTE MONOTONY MON_INCREASE /end AXIS_DESCR
 /begin AXIS_DESCR STD_AXIS iIaeSigna.nd_iae_kf UMR_U_MIN_1_1_0_S6_S3 6 0 10000 DEPOSIT ABSOLUTE MONOTONY MON_INCREASE /end AXIS_DESCR
/end CHARACTERISTIC
/begin CHARACTERISTIC KF_MGSOLLSYNC_IAE "Momentengradient im Synchronisieren" MAP 0x221688 kf_si16_S6_S3 5000 UMR_NM_SEC_1_1_0_S6_S3 0 5000
 /begin AXIS_DESCR STD_AXIS iIaeSigna.m_motistoe_iae UMR_NM__1_1_0_S6_S3 6 -1000 10000 DEPOSIT ABSOLUTE MONOTONY MON_INCREASE /end AXIS_DESCR
 /begin AXIS_DESCR STD_AXIS iIaeSigna.ng_ab_iae UMR_U_MINSEC_1_1_0_S6_S3 4 -30000 30000 DEPOSIT ABSOLUTE MONOTONY MON_INCREASE /end AXIS_DESCR
/end CHARACTERISTIC
/begin CHARACTERISTIC MG_SOLL_ENPGFIX_IAE "Momentengradient zum Schließen der IAE während aktiver Ersatzmaßnahme KMN_ENPG1FIX oder KMN_ENPG3FIX" VALUE 0x26D5BA kw_si16_S6_S3 10000 UMR_NM_SEC_1_1_0_S6_S3 0 10000 /end CHARACTERISTIC
/begin CHARACTERISTIC KL_F_MOSCHALT_ZU_IAE "Faktor auf Überanpressung in Zustand Zu während Schaltungen" CURVE 0x2216D4 kl_si16_S6_S3 5 UMR___1_100_0_S6_S3 0 5
 /begin AXIS_DESCR STD_AXIS iIaeSigna.m_motistoe_iae UMR_NM__1_1_0_S6_S3 4 -400 1640 DEPOSIT ABSOLUTE MONOTONY MON_INCREASE /end AXIS_DESCR
/end CHARACTERISTIC
/begin CHARACTERISTIC KF_MO_ZU_IAE "Momentenoffset zur Einstellung der Überanpressung in ZU" MAP 0x2216E8 kf_si16_S6_S3 1000 UMR_NM__1_1_0_S6_S3 0 1000
 /begin AXIS_DESCR STD_AXIS iIaeSigna.m_motistoe_iae UMR_NM__1_1_0_S6_S3 6 -400 1640 DEPOSIT ABSOLUTE MONOTONY MON_INCREASE /end AXIS_DESCR
 /begin AXIS_DESCR STD_AXIS iIaeMomen.i_stuetz_iae UMR___1_1000_0_S6_S3 6 0 6 DEPOSIT ABSOLUTE MONOTONY MON_INCREASE /end AXIS_DESCR
/end CHARACTERISTIC
/begin CHARACTERISTIC KL_MO_ASRREGELT_ZU_IAE "Momentenoffset zur Einstellung der Überanpressung in ZU wenn elektronische Differenzialsperre aktiv ist" CURVE 0x221750 kl_si16_S6_S3 900 UMR_NM__1_1_0_S6_S3 0 900
 /begin AXIS_DESCR STD_AXIS iIaeSigna.m_motistoe_iae UMR_NM__1_1_0_S6_S3 6 -400 1640 DEPOSIT ABSOLUTE MONOTONY MON_INCREASE /end AXIS_DESCR
/end CHARACTERISTIC
/begin CHARACTERISTIC KL_MG_ZU_IAE "Momentengradient zum Schließen der IAE" CURVE 0x22176C kl_si16_S6_S3 5000 UMR_NM_SEC_1_1_0_S6_S3 0 5000
 /begin AXIS_DESCR STD_AXIS iIaeSigna.m_motistoe_iae UMR_NM__1_1_0_S6_S3 6 -400 1640 DEPOSIT ABSOLUTE MONOTONY MON_INCREASE /end AXIS_DESCR
/end CHARACTERISTIC
/begin CHARACTERISTIC KL_MAXIREGZU_IAE "Momentengradient zum Schließen der IAE" CURVE 0x221788 kl_si16_S6_S3 2000 UMR_NM__1_1_0_S6_S3 -1000 1000
 /begin AXIS_DESCR STD_AXIS iIaeSigna.m_motistoe_iae UMR_NM__1_1_0_S6_S3 6 -400 1640 DEPOSIT ABSOLUTE MONOTONY MON_INCREASE /end AXIS_DESCR
/end CHARACTERISTIC
/begin CHARACTERISTIC XDS_ZU_IAE "Schwelle für Regelabweichung in ZU, ab der der I-Regler startet" VALUE 0x2217A4 kw_fl32_S6_S3 100 UMR_U_MIN_1_1_0_S6_S3 0 100 /end CHARACTERISTIC
/begin CHARACTERISTIC MO_ZU_ANFAHR_IAE "Momentenoffset auf Motoristmoment beim Übergang Zu nach Angelegt/Kriechen" VALUE 0x26D5BC kw_si16_S6_S3 2000 UMR_NM__1_1_0_S6_S3 -1000 1000 /end CHARACTERISTIC
/begin CHARACTERISTIC NDS_ANFAHRINIT_IAE "Momentenoffset auf Betrag von m_motist_iae zur Initialisierung des Sollmoments im Anfahren" VALUE 0x26D5BE kw_si16_S6_S3 100 UMR_U_MIN_1_1_0_S6_S3 0 100 /end CHARACTERISTIC
/begin CHARACTERISTIC SWI_PT2INIT_ANFAHRT_IAE "Schalter zur Wahl der Initialisierung der Sollanfahrdrehzahl" VALUE 0x26E50F kw_bool8_S6_S3 1 UMR___1_1_0_S6_S3 0 1 /end CHARACTERISTIC
/begin CHARACTERISTIC KL_M_MAX_BASIS_ANF_KORR_IAE "Begrenzung von m_basis_anfahrt_korr_iae" CURVE 0x2217A8 kl_si16_S6_S3 50 UMR_NM__1_1_0_S6_S3 0 50
 /begin AXIS_DESCR STD_AXIS NO_INPUT_QUANTITY UMR_U_MIN_1_1_0_S6_S3 4 -8160 8160 DEPOSIT ABSOLUTE MONOTONY MON_INCREASE /end AXIS_DESCR
/end CHARACTERISTIC
/begin CHARACTERISTIC KL_CSMOT_ANFMODUS_IAE "Motortemperaturschwelle zum Einstieg in Kaltanfahrmodus" CURVE 0x2217BC kl_si16_S6_S3 80 UMR_GRADC__1_1_M48_S6_S3 -40 40
 /begin AXIS_DESCR STD_AXIS iIaeSigna.mot_stress_iae UMR_PROZENT__16_10_0_S6_S3 4 0 200 DEPOSIT ABSOLUTE MONOTONY MON_INCREASE /end AXIS_DESCR
/end CHARACTERISTIC
/begin CHARACTERISTIC CS_GETR_ANFMODUS_IAE "Getriebetemperaturschwelle zum Einstieg in Kaltanfahrmodus" VALUE 0x26D5C0 kw_ui16_S6_S3 80 UMR_GRADC__1_1_M40_S6_S3 -40 40 /end CHARACTERISTIC
/begin CHARACTERISTIC KF_F_NDMOTANFAHR_IAE "Faktor auf Anfahrvorsteuermoment in Abhängigkeit des Motordrückens unter die Sollleerlaufdrehzahl" MAP 0x2217D0 kf_si16_S6_S3 2 UMR___1_1000_0_S6_S3 0 2
 /begin AXIS_DESCR STD_AXIS iIaeSigna.nd_mot_iae UMR_U_MIN_1_1_0_S6_S3 4 -8160 8160 DEPOSIT ABSOLUTE MONOTONY MON_INCREASE /end AXIS_DESCR
 /begin AXIS_DESCR STD_AXIS iIaeSigna.ng_mot_iae UMR_U_MINSEC_1_1_0_S6_S3 4 -30000 30000 DEPOSIT ABSOLUTE MONOTONY MON_INCREASE /end AXIS_DESCR
/end CHARACTERISTIC
/begin CHARACTERISTIC KF_MSOLL_KALTANFAHR_IAE "IAE Sollmoment während Kaltanfahrt" MAP 0x221808 kf_si16_S6_S3 1000 UMR_NM__1_1_0_S6_S3 0 1000
 /begin AXIS_DESCR STD_AXIS iIaeSigna.nd_mot_iae UMR_U_MIN_1_1_0_S6_S3 8 -8160 8160 DEPOSIT ABSOLUTE MONOTONY MON_INCREASE /end AXIS_DESCR
 /begin AXIS_DESCR STD_AXIS iIaeSigna.mot_stress_iae UMR_PROZENT__16_10_0_S6_S3 4 0 200 DEPOSIT ABSOLUTE MONOTONY MON_INCREASE /end AXIS_DESCR
/end CHARACTERISTIC
/begin CHARACTERISTIC F_MKRIECH_ANF_IAE "Faktor, mit welchem das letzte Kriechmoment als Min-Anfahrmoment berücksichtigt wird" VALUE 0x26E510 kw_ui8_S6_S3 1 UMR___1_100_0_S6_S3 0 1 /end CHARACTERISTIC
/begin CHARACTERISTIC KL_START_UEBTEMPPULS_IAE "Faktor zur Verzögerung der Pulsausgabe" CURVE 0x221868 kl_ui16_S6_S3 1 UMR___1_100_0_S6_S3 0 1
 /begin AXIS_DESCR STD_AXIS NO_INPUT_QUANTITY UMR_SEC__1_100_0_S6_S3 4 0 300 DEPOSIT ABSOLUTE MONOTONY MON_INCREASE /end AXIS_DESCR
/end CHARACTERISTIC
/begin CHARACTERISTIC KL_F_AMPUEBTEMPPULS_NEIG_IAE "Faktor zur Verzögerung der Pulsausgabe" CURVE 0x22187C kl_si16_S6_S3 1 UMR___1_100_0_S6_S3 0 1
 /begin AXIS_DESCR STD_AXIS NO_INPUT_QUANTITY UMR_GRAD__1_3_M128_S6_S3 5 -42.6666666667 42.3333333333 DEPOSIT ABSOLUTE MONOTONY MON_INCREASE /end AXIS_DESCR
/end CHARACTERISTIC
/begin CHARACTERISTIC KF_AMPUEBTEMPPULS_IAE "Amplitude des Rechteckimpuls bei Übertemperaturpulsen der IAE im Anfahren" MAP 0x221894 kf_si16_S6_S3 1000 UMR_NM__1_1_0_S6_S3 0 1000
 /begin AXIS_DESCR STD_AXIS NO_INPUT_QUANTITY UMR_GRADC__1_1_M40_S6_S3 4 -40 500 DEPOSIT ABSOLUTE MONOTONY MON_INCREASE /end AXIS_DESCR
 /begin AXIS_DESCR STD_AXIS NO_INPUT_QUANTITY UMR_GRADC__1_1_M40_S6_S3 4 -40 215 DEPOSIT ABSOLUTE MONOTONY MON_INCREASE /end AXIS_DESCR
/end CHARACTERISTIC
/begin CHARACTERISTIC KF_F_AMPUEBTEMPPULS_IAE "Faktor auf Amplitude des Rechteckimpuls bei Übertemperaturpulsen der IAE im Anfahren" MAP 0x2218CC kf_si16_S6_S3 10 UMR___1_100_0_S6_S3 0 10
 /begin AXIS_DESCR STD_AXIS NO_INPUT_QUANTITY UMR_PROZENT__20_51_0_S6_S3 4 0 100 DEPOSIT ABSOLUTE MONOTONY MON_INCREASE /end AXIS_DESCR
 /begin AXIS_DESCR STD_AXIS iIaeSigna.nd_iae UMR_U_MIN_1_1_0_S6_S3 4 -10000 10000 DEPOSIT ABSOLUTE MONOTONY MON_INCREASE /end AXIS_DESCR
/end CHARACTERISTIC
/begin CHARACTERISTIC T_UEBTEMPPULS_IAE "Rechteckimpulsdauer bei Übertemperaturpulsen der IAE im Anfahren" VALUE 0x26E511 kw_ui8_S6_S3 2550 UMR_MSEC__10_1_0_S6_S3 0 2550 /end CHARACTERISTIC
/begin CHARACTERISTIC KF_NMOTANFAHR_SOLL_NEIGUNG_IAE "Drehzahloffset auf Anfahrsolldrehzahl in Abhängigkeit der Neigung und des Pedalwerts" MAP 0x221904 kf_si16_S6_S3 7000 UMR_U_MIN_1_1_0_S6_S3 0 7000
 /begin AXIS_DESCR STD_AXIS NO_INPUT_QUANTITY UMR_GRAD__1_3_M128_S6_S3 6 -42.6666666667 42.3333333333 DEPOSIT ABSOLUTE MONOTONY MON_INCREASE /end AXIS_DESCR
 /begin AXIS_DESCR STD_AXIS NO_INPUT_QUANTITY UMR_PROZENT__20_51_0_S6_S3 6 0 100 DEPOSIT ABSOLUTE MONOTONY MON_INCREASE /end AXIS_DESCR
/end CHARACTERISTIC
/begin CHARACTERISTIC KL_F_NGMOTANFAHRINITGE_IAE "Faktor auf Initialisierungsgradient für den Sollanfahrdrehzahlfilter während des Gangeinlegevorgangs" CURVE 0x22196C kl_si16_S6_S3 2 UMR___1_100_0_S6_S3 0 2
 /begin AXIS_DESCR STD_AXIS NO_INPUT_QUANTITY UMR_PROZENT__20_51_0_S6_S3 6 0 100 DEPOSIT ABSOLUTE MONOTONY MON_INCREASE /end AXIS_DESCR
/end CHARACTERISTIC
/begin CHARACTERISTIC KL_MAXOGNMOTANFAHR_SOLL_IAE "Begrenzung Offsetgradient KF_OGNMOTANFAHR_SOLL_x_IAE nach Stallanfahrt" CURVE 0x221988 kl_si16_S6_S3 10000 UMR_U_MINSEC_1_1_0_S6_S3 0 10000
 /begin AXIS_DESCR STD_AXIS NO_INPUT_QUANTITY UMR_PROZENT__20_51_0_S6_S3 6 0 100 DEPOSIT ABSOLUTE MONOTONY MON_INCREASE /end AXIS_DESCR
/end CHARACTERISTIC
/begin CHARACTERISTIC N_EMKNICK_ERSATZ_IAE "Ersatzwert für EM-Knickdrehzahl" VALUE 0x26D5C2 kw_si16_S6_S3 10000 UMR_U_MIN_1_1_0_S6_S3 0 10000 /end CHARACTERISTIC
/begin CHARACTERISTIC SWI_PT2INITEH_ANFAHRT_IAE "Init PT2-Filter im Anfahren bei z_modus_iae-Wechsel" VALUE 0x26E512 kw_bool8_S6_S3 1 UMR___1_1_0_S6_S3 0 1 /end CHARACTERISTIC
/begin CHARACTERISTIC KL_FNMOTANFAHRLL_IAE "Faktor zur Korrektur der Anfahrdrehzahl bei LL-Drehzahlanhebung" CURVE 0x2219A4 kl_si16_S6_S3 2 UMR___1_100_0_S6_S3 0 2
 /begin AXIS_DESCR STD_AXIS iIaeSigna.n_motanfahr_basis_iae UMR_U_MIN_1_1_0_S6_S3 4 0 5000 DEPOSIT ABSOLUTE MONOTONY MON_INCREASE /end AXIS_DESCR
/end CHARACTERISTIC
/begin CHARACTERISTIC KL_ONMOTANFAHR_IAE "Faktor zur Korrektur der Anfahrdrehzahl bei LL-Drehzahlanhebung" CURVE 0x2219B8 kl_si16_S6_S3 5000 UMR_U_MIN_1_1_0_S6_S3 0 5000
 /begin AXIS_DESCR STD_AXIS iIaeSigna.n_getrein_iae UMR_U_MIN_1_1_0_S6_S3 4 0 8000 DEPOSIT ABSOLUTE MONOTONY MON_INCREASE /end AXIS_DESCR
/end CHARACTERISTIC
/begin CHARACTERISTIC KL_F_ONMOTANFAHR_IAE "Faktor auf Anfahrdrehzahloffset zur Erkennung auf entkoppelt_anfahren" CURVE 0x2219CC kl_si16_S6_S3 1 UMR___1_100_0_S6_S3 0 1
 /begin AXIS_DESCR STD_AXIS iIaeSigna.n_mot_iae UMR_U_MIN_1_1_0_S6_S3 6 0 8160 DEPOSIT ABSOLUTE MONOTONY MON_INCREASE /end AXIS_DESCR
/end CHARACTERISTIC
/begin CHARACTERISTIC KF_NMOTANFAHRMAXC_IAE "Max. Anfahrdrehzahlbegrenzung bei Übertemperatur" MAP 0x2219E8 kf_si16_S6_S3 5000 UMR_U_MIN_1_1_0_S6_S3 0 5000
 /begin AXIS_DESCR STD_AXIS NO_INPUT_QUANTITY UMR_GRADC__1_1_M40_S6_S3 6 -40 500 DEPOSIT ABSOLUTE MONOTONY MON_INCREASE /end AXIS_DESCR
 /begin AXIS_DESCR STD_AXIS NO_INPUT_QUANTITY UMR_GRADC__1_1_M40_S6_S3 6 -40 215 DEPOSIT ABSOLUTE MONOTONY MON_INCREASE /end AXIS_DESCR
/end CHARACTERISTIC
/begin CHARACTERISTIC KL_NMOTANFAHRMMOTMAX_IAE "Max. Anfahrdrehzahlbegrenzung bei IAE-Motormomentenbegrenzung" CURVE 0x221A50 kl_si16_S6_S3 5000 UMR_U_MIN_1_1_0_S6_S3 0 5000
 /begin AXIS_DESCR STD_AXIS NO_INPUT_QUANTITY UMR_NM__1_1_0_S6_S3 6 0 1500 DEPOSIT ABSOLUTE MONOTONY MON_INCREASE /end AXIS_DESCR
/end CHARACTERISTIC
/begin CHARACTERISTIC KL_FNMOTANFAHRMOTSTRESS_IAE "Dauer der Überführungsfunktion des Kriechsollwerts" CURVE 0x221A6C kl_si16_S6_S3 2 UMR___1_100_0_S6_S3 0 2
 /begin AXIS_DESCR STD_AXIS iIaeSigna.mot_stress_iae UMR_PROZENT__16_10_0_S6_S3 4 0 200 DEPOSIT ABSOLUTE MONOTONY MON_INCREASE /end AXIS_DESCR
/end CHARACTERISTIC
/begin CHARACTERISTIC NS_MOTANFAHRMAXC_IAE "Motordrehzahlschwellwert im Anfahren ab welcher Anfahrdrehzahlbegrenzung aktiv wird" VALUE 0x26D5C4 kw_si16_S6_S3 5000 UMR_U_MIN_1_1_0_S6_S3 0 5000 /end CHARACTERISTIC
/begin CHARACTERISTIC MPT_NMOTSOLLANFAHR_ENTK_IAE "Filterkonstante für PT1-Filter für Sollanfahrdrehzahl während Entkopplung" VALUE 0x26E513 kw_ui8_S6_S3 1 UMR___1_100_0_S6_S3 0 1 /end CHARACTERISTIC
/begin CHARACTERISTIC KL_T_PT2_NMOTANFENTKOPPL_IAE "Filterzeitkonstante PT2-Filter für Sollanfahrdrehzahl E-Anfahren-entkoppelt" CURVE 0x221A80 kl_si16_S6_S3 4000 UMR_MSEC__1_1_0_S6_S3 0 4000
 /begin AXIS_DESCR STD_AXIS iIaeSigna.ng_getrein_iae UMR_U_MINSEC_1_1_0_S6_S3 4 -10000 10000 DEPOSIT ABSOLUTE MONOTONY MON_INCREASE /end AXIS_DESCR
/end CHARACTERISTIC
/begin CHARACTERISTIC T_XDG_REGLER_IAE "Zeitkonstante D-Anteil Regler IAE" VALUE 0x221A94 kw_fl32_S6_S3 2000 UMR_MSEC__1_1_0_S6_S3 0 2000 /end CHARACTERISTIC
/begin CHARACTERISTIC KI_ZU_IAE "I-Anteil für Absicherungsregler in ZU" VALUE 0x221A98 kw_fl32_S6_S3 10 UMR___1_1_0_S6_S3 0 10 FORMAT "%4.2" /end CHARACTERISTIC
/begin CHARACTERISTIC KF_KI_KRIECH_IAE "I-Anteil für Differenzdrehzahlregler im Kriechen" MAP 0x221A9C kf_fl32_S6_S3 9.999 UMR___1_1_0_3_S6_S3 0.001 10 FORMAT "%5.3"
 /begin AXIS_DESCR STD_AXIS NO_INPUT_QUANTITY UMR_GRADC__1_1_0_S6_S3 6 -40 215 DEPOSIT ABSOLUTE MONOTONY MON_INCREASE /end AXIS_DESCR
 /begin AXIS_DESCR STD_AXIS zff_atsys._.iSignale._.obj.sig_istgang UMR___1_1_0_S6_S3 7 -1 7 DEPOSIT ABSOLUTE MONOTONY MON_INCREASE /end AXIS_DESCR
/end CHARACTERISTIC
/begin CHARACTERISTIC KF_KP_KRIECH_IAE "P-Anteil für Differenzdrehzahlregler im Kriechen" MAP 0x221B80 kf_fl32_S6_S3 9.999 UMR___1_1_0_3_S6_S3 0.001 10 FORMAT "%5.3"
 /begin AXIS_DESCR STD_AXIS NO_INPUT_QUANTITY UMR_GRADC__1_1_0_S6_S3 6 -40 215 DEPOSIT ABSOLUTE MONOTONY MON_INCREASE /end AXIS_DESCR
 /begin AXIS_DESCR STD_AXIS zff_atsys._.iSignale._.obj.sig_istgang UMR___1_1_0_S6_S3 7 -1 7 DEPOSIT ABSOLUTE MONOTONY MON_INCREASE /end AXIS_DESCR
/end CHARACTERISTIC
/begin CHARACTERISTIC KL_TYP_UEF_1_IAE "Verlauf der Überführungsfunktion Typ 1" CURVE 0x221C64 kl_si16_S6_S3 100 UMR_PROZENT__1_100_0_S6_S3 0 100
 /begin AXIS_DESCR STD_AXIS NO_INPUT_QUANTITY UMR_PROZENT__1_100_0_S6_S3 10 0 100 DEPOSIT ABSOLUTE MONOTONY MON_INCREASE /end AXIS_DESCR
/end CHARACTERISTIC
/begin CHARACTERISTIC KL_TYP_UEF_2_IAE "Verlauf der Überführungsfunktion Typ 2" CURVE 0x221C90 kl_si16_S6_S3 100 UMR_PROZENT__1_100_0_S6_S3 0 100
 /begin AXIS_DESCR STD_AXIS NO_INPUT_QUANTITY UMR_PROZENT__1_100_0_S6_S3 10 0 100 DEPOSIT ABSOLUTE MONOTONY MON_INCREASE /end AXIS_DESCR
/end CHARACTERISTIC
/begin CHARACTERISTIC KL_TYP_UEF_3_IAE "Verlauf der Überführungsfunktion Typ 3" CURVE 0x221CBC kl_si16_S6_S3 100 UMR_PROZENT__1_100_0_S6_S3 0 100
 /begin AXIS_DESCR STD_AXIS NO_INPUT_QUANTITY UMR_PROZENT__1_100_0_S6_S3 10 0 100 DEPOSIT ABSOLUTE MONOTONY MON_INCREASE /end AXIS_DESCR
/end CHARACTERISTIC
/begin CHARACTERISTIC KL_TYP_UEF_4_IAE "Verlauf der Überführungsfunktion Typ 4" CURVE 0x221CE8 kl_si16_S6_S3 100 UMR_PROZENT__1_100_0_S6_S3 0 100
 /begin AXIS_DESCR STD_AXIS NO_INPUT_QUANTITY UMR_PROZENT__1_100_0_S6_S3 10 0 100 DEPOSIT ABSOLUTE MONOTONY MON_INCREASE /end AXIS_DESCR
/end CHARACTERISTIC
/begin CHARACTERISTIC TYP_UEF_MSOLLEHANF_IAE "Typ der Überführungsfunktion des Sollanfahrmoments beim Wechsel aus E-Anfahren/E-Anfahren_entkoppelt nach H-Anfahren" VALUE 0x26E514 kw_ui8_S6_S3 3 UMR___1_1_0_S6_S3 1 4 /end CHARACTERISTIC
/begin CHARACTERISTIC TYP_UEF_MSOLLANFAHR_IAE "Typ der Überführungsfunktion beim Übergang von Kriechen nach H-Anfahren" VALUE 0x26E515 kw_ui8_S6_S3 3 UMR___1_1_0_S6_S3 1 4 /end CHARACTERISTIC
/begin CHARACTERISTIC TYP_UEF_MSOLLEENTK_IAE "Typ der Überführungsfunktion des Sollanfahrmoments beim Wechsel aus E-Anfahren nach E-Anfahren_entkoppelt" VALUE 0x26E516 kw_ui8_S6_S3 3 UMR___1_1_0_S6_S3 1 4 /end CHARACTERISTIC
/begin CHARACTERISTIC TYP_UEF_M_KRIECH_ANGELEGT_IAE "Typ der Überführungsfunktion beim Übergang von Kriechen nach Stillstand für m_soll_iae" VALUE 0x26E517 kw_ui8_S6_S3 3 UMR___1_1_0_S6_S3 1 4 /end CHARACTERISTIC
/begin CHARACTERISTIC TYP_UEF_ZU_KRIECH_ANGL_IAE "Typ der Überführungsfunktion für m_soll_iae beim Übergang aus ZU nach Kriechen oder Angelegt" VALUE 0x26E518 kw_ui8_S6_S3 3 UMR___1_1_0_S6_S3 1 4 /end CHARACTERISTIC
/begin CHARACTERISTIC TYP_UEF_ZU_ANF_IAE "Typ der Überführungsfunktion beim Übergang aus ZU nach Anfahren" VALUE 0x26E519 kw_ui8_S6_S3 3 UMR___1_1_0_S6_S3 1 4 /end CHARACTERISTIC
/begin CHARACTERISTIC TYP_UEF_MANF_ANGL_IAE "Typ der Überführungsfunktion für m_soll_iae beim Übergang von Anfahren nach Angelegt" VALUE 0x26E51A kw_ui8_S6_S3 3 UMR___1_1_0_S6_S3 1 4 /end CHARACTERISTIC
/begin CHARACTERISTIC TYP_UEF_MANF_KRIECH_IAE "Typ der Überführungsfunktion für m_soll_iae beim Übergang von Anfahren nach Kriechen" VALUE 0x26E51B kw_ui8_S6_S3 3 UMR___1_1_0_S6_S3 1 4 /end CHARACTERISTIC
/begin CHARACTERISTIC TYP_UEF_M_ANGELEGT_KRIECH_IAE "Typ der Überführungsfunktion beim Übergang von Stillstand nach Kriechen für das gesteuerte Moment" VALUE 0x26E51C kw_ui8_S6_S3 3 UMR___1_1_0_S6_S3 1 4 /end CHARACTERISTIC
/begin CHARACTERISTIC TYP_UEF_KRIECH_IAE "Typ der Überführungsfunktion zum Führen des Kriechsollwerts" VALUE 0x26E51D kw_ui8_S6_S3 3 UMR___1_1_0_S6_S3 1 4 /end CHARACTERISTIC
/begin CHARACTERISTIC TYP_UEF_KALTANFAHR_IAE "Typ der Überführung Kriechen >> Kaltanfahren" VALUE 0x26E51E kw_ui8_S6_S3 3 UMR___1_1_0_S6_S3 1 4 /end CHARACTERISTIC
/begin CHARACTERISTIC T_UEF_KALTANFAHR_IAE "Dauer der Überführung Kriechen >> Kaltanfahren" VALUE 0x26D5C6 kw_si16_S6_S3 10000 UMR_MSEC__10_1_0_S6_S3 0 10000 /end CHARACTERISTIC
/begin CHARACTERISTIC KF_T_UEF_M_KRIECH_ANGELEGT_IAE "Dauer der Überführungsfunktion beim Übergang von Kriechen nach Angelegt für m_soll_iae" MAP 0x221D14 kf_si16_S6_S3 5000 UMR_MSEC__10_1_0_S6_S3 0 5000
 /begin AXIS_DESCR STD_AXIS iIaeMomen.m_soll_iae UMR_NM__1_1_0_S6_S3 4 -400 1640 DEPOSIT ABSOLUTE MONOTONY MON_INCREASE /end AXIS_DESCR
 /begin AXIS_DESCR STD_AXIS iIaeSigna.ng_getrein_iae UMR_U_MINSEC_1_1_0_S6_S3 4 -10000 10000 DEPOSIT ABSOLUTE MONOTONY MON_INCREASE /end AXIS_DESCR
/end CHARACTERISTIC
/begin CHARACTERISTIC KF_T_UEF_ZU_ANF_IAE "Dauer der Überführungsfunktion beim Übergang von Kriechen nach Angelegt für m_soll_iae" MAP 0x221D4C kf_si16_S6_S3 5000 UMR_MSEC__10_1_0_S6_S3 0 5000
 /begin AXIS_DESCR STD_AXIS NO_INPUT_QUANTITY UMR_PROZENT__20_51_0_S6_S3 4 0 100 DEPOSIT ABSOLUTE MONOTONY MON_INCREASE /end AXIS_DESCR
 /begin AXIS_DESCR STD_AXIS iIaeSigna.ng_getrein_iae UMR_U_MINSEC_1_1_0_S6_S3 4 -10000 10000 DEPOSIT ABSOLUTE MONOTONY MON_INCREASE /end AXIS_DESCR
/end CHARACTERISTIC
/begin CHARACTERISTIC KL_F_T_UEF_ZU_ANF_IAE "Faktor auf Dauer der Überführungsfunktion beim Übergang Zu nach Angelegt/Kriechen" CURVE 0x221D84 kl_si16_S6_S3 1 UMR___1_100_0_S6_S3 0 1
 /begin AXIS_DESCR STD_AXIS NO_INPUT_QUANTITY UMR_GRADC__1_1_M40_S6_S3 6 -40 215 DEPOSIT ABSOLUTE MONOTONY MON_INCREASE /end AXIS_DESCR
/end CHARACTERISTIC
/begin CHARACTERISTIC KF_T_UEF_ZU_KRIECH_ANGL_IAE "Zeit der Überführungsfunktion für m_soll_iae beim Übergang von ZU nach Kriechen oder Angelegt" MAP 0x221DA0 kf_si16_S6_S3 5000 UMR_MSEC__10_1_0_S6_S3 0 5000
 /begin AXIS_DESCR STD_AXIS NO_INPUT_QUANTITY UMR___1_1_0_S6_S3 6 -1 9 DEPOSIT ABSOLUTE MONOTONY MON_INCREASE /end AXIS_DESCR
 /begin AXIS_DESCR STD_AXIS NO_INPUT_QUANTITY UMR_U_MINSEC_1_1_0_S6_S3 6 -10000 10000 DEPOSIT ABSOLUTE MONOTONY MON_INCREASE /end AXIS_DESCR
/end CHARACTERISTIC
/begin CHARACTERISTIC KL_F_T_UEF_ZU_KRIECH_ANGL_IAE "Faktor auf Dauer der Überführungsfunktion beim Übergang Zu nach Angelegt/Kriechen" CURVE 0x221E08 kl_si16_S6_S3 1 UMR___1_100_0_S6_S3 0 1
 /begin AXIS_DESCR STD_AXIS NO_INPUT_QUANTITY UMR_GRADC__1_1_M40_S6_S3 6 -40 215 DEPOSIT ABSOLUTE MONOTONY MON_INCREASE /end AXIS_DESCR
/end CHARACTERISTIC
/begin CHARACTERISTIC KF_T_UEF_KRIECH_IAE "Dauer der Überführungsfunktion für die Kriechdifferenzdrehzahl" MAP 0x221E24 kf_si16_S6_S3 10000 UMR_MSEC__10_1_0_S6_S3 0 10000
 /begin AXIS_DESCR STD_AXIS NO_INPUT_QUANTITY UMR_U_MIN_1_1_0_S6_S3 4 -10000 10000 DEPOSIT ABSOLUTE MONOTONY MON_INCREASE /end AXIS_DESCR
 /begin AXIS_DESCR STD_AXIS NO_INPUT_QUANTITY UMR___1_1_0_S6_S3 4 -1 8 DEPOSIT ABSOLUTE MONOTONY MON_INCREASE /end AXIS_DESCR
/end CHARACTERISTIC
/begin CHARACTERISTIC KL_T_UEF_MSOLLEHANF_IAE "Dauer der Überführungsfunktion beim Wechsel aus E-Anfahren/E-Anfahren_entkoppl nach H-Anfahren" CURVE 0x221E5C kl_si16_S6_S3 5000 UMR_MSEC__10_1_0_S6_S3 0 5000
 /begin AXIS_DESCR STD_AXIS iIaeSigna.ng_getrein_iae UMR_U_MINSEC_1_1_0_S6_S3 4 -30000 30000 DEPOSIT ABSOLUTE MONOTONY MON_INCREASE /end AXIS_DESCR
/end CHARACTERISTIC
/begin CHARACTERISTIC KL_T_UEF_MSOLLEENTK_IAE "Dauer der Überführungsfunktion beim Wechsel aus E-Anfahren nach E-Anfahren_entkoppl" CURVE 0x221E70 kl_si16_S6_S3 5000 UMR_MSEC__10_1_0_S6_S3 0 5000
 /begin AXIS_DESCR STD_AXIS iIaeSigna.ng_getrein_iae UMR_U_MINSEC_1_1_0_S6_S3 4 -30000 30000 DEPOSIT ABSOLUTE MONOTONY MON_INCREASE /end AXIS_DESCR
/end CHARACTERISTIC
/begin CHARACTERISTIC KL_T_UEF_MSOLLANFAHR_IAE "Dauer der Überführungsfunktion bei Einstieg in Anfahren" CURVE 0x221E84 kl_si16_S6_S3 5000 UMR_MSEC__10_1_0_S6_S3 0 5000
 /begin AXIS_DESCR STD_AXIS NO_INPUT_QUANTITY UMR_PROZENT__20_51_0_S6_S3 6 0 100 DEPOSIT ABSOLUTE MONOTONY MON_INCREASE /end AXIS_DESCR
/end CHARACTERISTIC
/begin CHARACTERISTIC KF_T_UEF_M_ANGELEGT_KRIECH_IAE "Zeit der Überführungsfunktion für m_soll_iae beim Übergang von Angelegt nach Kriechen" MAP 0x221EA0 kf_si16_S6_S3 50000 UMR_MSEC__10_1_0_S6_S3 0 50000
 /begin AXIS_DESCR STD_AXIS NO_INPUT_QUANTITY UMR_U_MIN_1_1_0_S6_S3 6 0 10000 DEPOSIT ABSOLUTE MONOTONY MON_INCREASE /end AXIS_DESCR
 /begin AXIS_DESCR STD_AXIS NO_INPUT_QUANTITY UMR_GRADC__1_1_M40_S6_S3 6 -10040 9960 DEPOSIT ABSOLUTE MONOTONY MON_INCREASE /end AXIS_DESCR
/end CHARACTERISTIC
/begin CHARACTERISTIC KF_T_UEF_MANF_KRIECH_IAE "Zeit der Überführungsfunktion für m_soll_iae beim Übergang von Anfahren nach Kriechen" MAP 0x221F08 kf_si16_S6_S3 5000 UMR_MSEC__10_1_0_S6_S3 0 5000
 /begin AXIS_DESCR STD_AXIS iIaeMomen.m_soll_iae UMR_NM__1_1_0_S6_S3 4 -200 2000 DEPOSIT ABSOLUTE MONOTONY MON_INCREASE /end AXIS_DESCR
 /begin AXIS_DESCR STD_AXIS iIaeSigna.nd_mot_iae UMR_U_MIN_1_1_0_S6_S3 4 -10000 10000 DEPOSIT ABSOLUTE MONOTONY MON_INCREASE /end AXIS_DESCR
/end CHARACTERISTIC
/begin CHARACTERISTIC KF_T_UEF_MANF_ANGL_IAE "Zeit der Überführungsfunktion für m_soll_iae beim Übergang von Anfahren nach Angelegt" MAP 0x221F40 kf_si16_S6_S3 5000 UMR_MSEC__10_1_0_S6_S3 0 5000
 /begin AXIS_DESCR STD_AXIS iIaeMomen.m_soll_iae UMR_NM__1_1_0_S6_S3 4 -200 2000 DEPOSIT ABSOLUTE MONOTONY MON_INCREASE /end AXIS_DESCR
 /begin AXIS_DESCR STD_AXIS iIaeSigna.nd_mot_iae UMR_U_MIN_1_1_0_S6_S3 4 -10000 10000 DEPOSIT ABSOLUTE MONOTONY MON_INCREASE /end AXIS_DESCR
/end CHARACTERISTIC
/begin CHARACTERISTIC KF_T_PT2_M_IST_IAE "Filterkonstante für PT2-Filter für m_ist_iae" MAP 0x221F78 kf_si16_S6_S3 1.98 UMR_SEC__1_1000_0_S6_S3 0.02 2
 /begin AXIS_DESCR STD_AXIS iIaeDraus.p_ist_basis_iae UMR_BAR__1_1000_0_S6_S3 6 -1 20 DEPOSIT ABSOLUTE MONOTONY MON_INCREASE /end AXIS_DESCR
 /begin AXIS_DESCR STD_AXIS NO_INPUT_QUANTITY UMR_GRADC__1_1_M40_S6_S3 6 -40 215 DEPOSIT ABSOLUTE MONOTONY MON_INCREASE /end AXIS_DESCR
/end CHARACTERISTIC
/begin CHARACTERISTIC KL_F_M_SCHLEPP_CGETR_IAE "Faktor auf Schleppmoment des Getriebes" CURVE 0x221FE0 kl_si16_S6_S3 5 UMR___1_100_0_S6_S3 0 5
 /begin AXIS_DESCR STD_AXIS NO_INPUT_QUANTITY UMR_GRADC__1_1_M40_S6_S3 4 -10040 9960 DEPOSIT ABSOLUTE MONOTONY MON_INCREASE /end AXIS_DESCR
/end CHARACTERISTIC
/begin CHARACTERISTIC KF_M_SCHLEPP_GETR_IAE "Schleppmoment des Getriebes" MAP 0x221FF4 kf_si16_S6_S3 50 UMR_NM__1_1_0_S6_S3 0 50
 /begin AXIS_DESCR STD_AXIS NO_INPUT_QUANTITY UMR___1_1_0_S6_S3 4 -1 8 DEPOSIT ABSOLUTE MONOTONY MON_INCREASE /end AXIS_DESCR
 /begin AXIS_DESCR STD_AXIS iIaeSigna.n_mot_iae UMR_U_MIN_1_1_0_S6_S3 4 0 10000 DEPOSIT ABSOLUTE MONOTONY MON_INCREASE /end AXIS_DESCR
/end CHARACTERISTIC
/begin CHARACTERISTIC KL_M_SCHLEPP_GETRPN_IAE "Schleppmoment des Getriebes in P/N" CURVE 0x22202C kl_si16_S6_S3 50 UMR_NM__1_1_0_S6_S3 0 50
 /begin AXIS_DESCR STD_AXIS iIaeSigna.n_mot_iae UMR_U_MIN_1_1_0_S6_S3 4 0 10000 DEPOSIT ABSOLUTE MONOTONY MON_INCREASE /end AXIS_DESCR
/end CHARACTERISTIC
/begin CHARACTERISTIC SWI_MIAEAUF_ANFAHREN_IAE "Schalter für Berechnung m_iaeauf im Anfahren" VALUE 0x26E51F kw_bool8_S6_S3 1 UMR___1_1_0_S6_S3 0 1 /end CHARACTERISTIC
/begin CHARACTERISTIC TYP_UEF_M_VOR_ANF_IAE "Berechnung von m_ist_vorst_iae im Zustand Anfahren" VALUE 0x26E520 kw_ui8_S6_S3 3 UMR___1_1_0_S6_S3 1 4 /end CHARACTERISTIC
/begin CHARACTERISTIC KF_T_UEF_M_VOR_ANF_IAE "Dauer Überführung von m_ist_vorst_iae im Zustand Anfahren" MAP 0x222040 kf_si16_S6_S3 5000 UMR_MSEC__10_1_0_S6_S3 0 5000
 /begin AXIS_DESCR STD_AXIS NO_INPUT_QUANTITY UMR_U_MIN_1_1_0_S6_S3 6 0 10000 DEPOSIT ABSOLUTE MONOTONY MON_INCREASE /end AXIS_DESCR
 /begin AXIS_DESCR STD_AXIS NO_INPUT_QUANTITY UMR_GRADC__1_1_M40_S6_S3 6 -10040 9960 DEPOSIT ABSOLUTE MONOTONY MON_INCREASE /end AXIS_DESCR
/end CHARACTERISTIC
/begin CHARACTERISTIC TYP_UEF_M_VOR_ANF_KRIANG_IAE "Berechnung von m_ist_vorst_iae beim Zustandsübergang von Anfahren nach Kriechen oder Angelegt" VALUE 0x26E521 kw_ui8_S6_S3 3 UMR___1_1_0_S6_S3 1 4 /end CHARACTERISTIC
/begin CHARACTERISTIC KF_T_UEF_M_VOR_ANF_KRIANG_IAE "Dauer Überführung von m_ist_vorst_iae im Zustand Angelegt/Kriechen von Anfahren" MAP 0x2220A8 kf_si16_S6_S3 5000 UMR_MSEC__10_1_0_S6_S3 0 5000
 /begin AXIS_DESCR STD_AXIS NO_INPUT_QUANTITY UMR_U_MIN_1_1_0_S6_S3 6 0 10000 DEPOSIT ABSOLUTE MONOTONY MON_INCREASE /end AXIS_DESCR
 /begin AXIS_DESCR STD_AXIS NO_INPUT_QUANTITY UMR_GRADC__1_1_M40_S6_S3 6 -10040 9960 DEPOSIT ABSOLUTE MONOTONY MON_INCREASE /end AXIS_DESCR
/end CHARACTERISTIC
/begin CHARACTERISTIC TYP_UEF_M_AUF_IAE "Typ der Überführungsfunktion fuer das IAE-Aufnahmemoment bei GE/GA" VALUE 0x26E522 kw_ui8_S6_S3 3 UMR___1_1_0_S6_S3 1 4 /end CHARACTERISTIC
/begin CHARACTERISTIC OG_M_AUF_REST_IAE "Reduzierungsgradient für nicht abgebaute Anteile von m_aufiae. Betragswert, wird in beide Richtungen verwendet" VALUE 0x26D5C8 kw_si16_S6_S3 1000 UMR_NM_SEC_1_1_0_S6_S3 0 1000 /end CHARACTERISTIC
/begin CHARACTERISTIC SWI_M_IAEAUF_SCHLEPP_IAE "Schalter für Rausrampen IAE-Schleppmoment" VALUE 0x26E523 kw_bool8_S6_S3 1 UMR___1_1_0_S6_S3 0 1 /end CHARACTERISTIC
/begin CHARACTERISTIC KF_OG_M_AUF_FAKTOR_IAE "Mindeständerung des Faktors zum Rausrampen des eingefrorenen IAE-Aufnahmemomentenwerts" MAP 0x222110 kf_fl32_S6_S3 10000 UMR__SEC_1_1_0_S6_S3 -10000 0 FORMAT "%4.2"
 /begin AXIS_DESCR STD_AXIS NO_INPUT_QUANTITY UMR_PROZENT__20_51_0_S6_S3 4 0 100 DEPOSIT ABSOLUTE MONOTONY MON_INCREASE /end AXIS_DESCR
 /begin AXIS_DESCR STD_AXIS NO_INPUT_QUANTITY UMR_U_MIN_1_1_0_S6_S3 2 0 8160 DEPOSIT ABSOLUTE MONOTONY MON_INCREASE /end AXIS_DESCR
/end CHARACTERISTIC
/begin CHARACTERISTIC KL_T_UEF_M_AUF_GA_IAE "Dauer der Überführungsfunktion zum Abbau des IAE-Aufnahmemoments beim Gangauslegen" CURVE 0x222150 kl_si16_S6_S3 3000 UMR_MSEC__10_1_0_S6_S3 0 3000
 /begin AXIS_DESCR STD_AXIS NO_INPUT_QUANTITY UMR_GRADC__1_1_M40_S6_S3 4 -40 215 DEPOSIT ABSOLUTE MONOTONY MON_INCREASE /end AXIS_DESCR
/end CHARACTERISTIC
/begin CHARACTERISTIC KL_T_UEF_M_AUF_GA_IAE_EL "Dauer der Überführungsfunktion zum Abbau des IAE-Aufnahmemoments beim Gangauslegen" CURVE 0x222164 kl_si16_S6_S3 3000 UMR_MSEC__10_1_0_S6_S3 0 3000
 /begin AXIS_DESCR STD_AXIS NO_INPUT_QUANTITY UMR_GRADC__1_1_M40_S6_S3 4 -40 215 DEPOSIT ABSOLUTE MONOTONY MON_INCREASE /end AXIS_DESCR
/end CHARACTERISTIC
/begin CHARACTERISTIC KL_T_UEF_M_AUF_GE_IAE "Dauer der Überführungsfunktion zum Abbau des IAE-Aufnahmemoments beim Gangeinlegen" CURVE 0x222178 kl_si16_S6_S3 3000 UMR_MSEC__10_1_0_S6_S3 0 3000
 /begin AXIS_DESCR STD_AXIS NO_INPUT_QUANTITY UMR_GRADC__1_1_M40_S6_S3 4 -40 215 DEPOSIT ABSOLUTE MONOTONY MON_INCREASE /end AXIS_DESCR
/end CHARACTERISTIC
/begin CHARACTERISTIC KL_T_UEF_M_AUF_GE_IAE_EL "Dauer der Überführungsfunktion zum Abbau des IAE-Aufnahmemoments beim Gangeinlegen" CURVE 0x22218C kl_si16_S6_S3 3000 UMR_MSEC__10_1_0_S6_S3 0 3000
 /begin AXIS_DESCR STD_AXIS NO_INPUT_QUANTITY UMR_GRADC__1_1_M40_S6_S3 4 -40 215 DEPOSIT ABSOLUTE MONOTONY MON_INCREASE /end AXIS_DESCR
/end CHARACTERISTIC
/begin CHARACTERISTIC KF_F_M_AUF_IAE "Faktor auf IAE-Aufnahmemoment" MAP 0x2221A0 kf_si16_S6_S3 1 UMR___1_100_0_S6_S3 0 1
 /begin AXIS_DESCR STD_AXIS iIaeSigna.nue_iae UMR___1_1000_0_S6_S3 4 0 30 DEPOSIT ABSOLUTE MONOTONY MON_INCREASE /end AXIS_DESCR
 /begin AXIS_DESCR STD_AXIS iIaeSigna.nd_mot_iae UMR_U_MIN_1_1_0_S6_S3 4 -8000 8000 DEPOSIT ABSOLUTE MONOTONY MON_INCREASE /end AXIS_DESCR
/end CHARACTERISTIC
/begin CHARACTERISTIC KF_F_MAUFNMOTPBREMS_IAE "Faktor auf m_iaeauf - Wert zur Überführung auf den Wert 0" MAP 0x2221D8 kf_si16_S6_S3 1 UMR___1_100_0_S6_S3 0 1
 /begin AXIS_DESCR STD_AXIS iIaeSigna.n_mot_iae UMR_U_MIN_1_1_0_S6_S3 4 0 10000 DEPOSIT ABSOLUTE MONOTONY MON_INCREASE /end AXIS_DESCR
 /begin AXIS_DESCR STD_AXIS iIaeSigna.p_brems_iae UMR_BAR__1_100_0_S6_S3 4 -10 300 DEPOSIT ABSOLUTE MONOTONY MON_INCREASE /end AXIS_DESCR
/end CHARACTERISTIC
/begin CHARACTERISTIC KL_F_M_SCHLEPP_IAE "Faktor auf Schleppmoment der IAE" CURVE 0x222210 kl_si16_S6_S3 5 UMR___1_100_0_S6_S3 0 5
 /begin AXIS_DESCR STD_AXIS iIaeMomen.i_stuetz_iae UMR___1_1000_0_S6_S3 4 0 6 DEPOSIT ABSOLUTE MONOTONY MON_INCREASE /end AXIS_DESCR
/end CHARACTERISTIC
/begin CHARACTERISTIC KF_M_SCHLEPP_IAE "Schleppmoment IAE" MAP 0x222224 kf_si16_S6_S3 200 UMR_NM__1_1_0_S6_S3 0 200
 /begin AXIS_DESCR STD_AXIS NO_INPUT_QUANTITY UMR_GRADC__1_1_M40_S6_S3 4 -40 215 DEPOSIT ABSOLUTE MONOTONY MON_INCREASE /end AXIS_DESCR
 /begin AXIS_DESCR STD_AXIS NO_INPUT_QUANTITY UMR_GRADC__1_1_M40_S6_S3 4 -40 415 DEPOSIT ABSOLUTE MONOTONY MON_INCREASE /end AXIS_DESCR
/end CHARACTERISTIC
/begin CHARACTERISTIC KF_F_M_SCHLEPP_IAE "Faktor auf Schleppmoment der IAE" MAP 0x22225C kf_si16_S6_S3 2 UMR___1_100_0_S6_S3 0 2
 /begin AXIS_DESCR STD_AXIS iIaeDraus.p_stell_iae UMR_BAR__1_1000_0_S6_S3 4 -1 12.75 DEPOSIT ABSOLUTE MONOTONY MON_INCREASE /end AXIS_DESCR
 /begin AXIS_DESCR STD_AXIS iIaeSigna.nd_iae UMR_U_MIN_1_1_0_S6_S3 4 -8160 8160 DEPOSIT ABSOLUTE MONOTONY MON_INCREASE /end AXIS_DESCR
/end CHARACTERISTIC
/begin CHARACTERISTIC M_AUF_MIN_IAE "minimales IAE-Aufnahmemoment" VALUE 0x26D5CA kw_si16_S6_S3 100 UMR_NM__1_1_0_S6_S3 0 100 /end CHARACTERISTIC
/begin CHARACTERISTIC MO_IAEAUF_IAE "Offset auf maximales IAE-Aufnahmemoment" VALUE 0x26D5CC kw_si16_S6_S3 10 UMR_NM__1_1_0_S6_S3 0 10 /end CHARACTERISTIC
/begin CHARACTERISTIC TAB_STUETZFAKTOR_IAE "Stützfaktor" CURVE 0x222294 tab_si16_S6_S3 5 UMR___1_1000_0_S6_S3 0 5
 /begin AXIS_DESCR FIX_AXIS NO_INPUT_QUANTITY UMR___1_1_0_S6_S3 10 -1 8 FIX_AXIS_PAR_DIST -1 1 10 /end AXIS_DESCR
/end CHARACTERISTIC
/begin CHARACTERISTIC TAB_UEF_I_STUETZ_IAE "Tabelle zur Auswahl, wie der Stützfaktor überführt werden soll" CURVE 0x2222AC tab_bool8_S6_S3 1 UMR___1_1_0_S6_S3 0 1
 /begin AXIS_DESCR FIX_AXIS iIaeKordi.z_iae UMR___1_1_0_S6_S3 10 0 9 FIX_AXIS_PAR_DIST 0 1 10 /end AXIS_DESCR
/end CHARACTERISTIC
/begin CHARACTERISTIC KF_T_UEF_I_STUETZ_IAE "Dauer der Überführungsfunktion für Umschaltung des Momentenstützfaktors bei Schaltungen" MAP 0x2222BC kf_si16_S6_S3 5000 UMR_MSEC__10_1_0_S6_S3 0 5000
 /begin AXIS_DESCR STD_AXIS iIaeSigna.n_ab_iae UMR_U_MIN_1_1_0_S6_S3 6 0 10000 DEPOSIT ABSOLUTE MONOTONY MON_INCREASE /end AXIS_DESCR
 /begin AXIS_DESCR STD_AXIS NO_INPUT_QUANTITY UMR___1_1_0_S6_S3 4 -1 9 DEPOSIT ABSOLUTE MONOTONY MON_INCREASE /end AXIS_DESCR
/end CHARACTERISTIC
/begin CHARACTERISTIC KF_MPT_ISTUETZSCHALT_IAE "Mindestüberführungszeit für i_stütz_iae bei Schaltungen" MAP 0x222308 kf_si16_S6_S3 5 UMR___1_100_0_S6_S3 0 5
 /begin AXIS_DESCR STD_AXIS iIaeSigna.n_mot_iae UMR_U_MIN_1_1_0_S6_S3 4 0 8160 DEPOSIT ABSOLUTE MONOTONY MON_INCREASE /end AXIS_DESCR
 /begin AXIS_DESCR STD_AXIS iIaeSigna.m_motistoe_iae UMR_NM__1_1_0_S6_S3 4 -400 1640 DEPOSIT ABSOLUTE MONOTONY MON_INCREASE /end AXIS_DESCR
/end CHARACTERISTIC
/begin CHARACTERISTIC TYP_UEF_I_STUETZ_IAE "Typ der Überführungsfunktion für Umschaltung des Momentenstützfaktors bei Schaltungen" VALUE 0x26E524 kw_ui8_S6_S3 3 UMR___1_1_0_S6_S3 1 4 /end CHARACTERISTIC
/begin CHARACTERISTIC SWI_KRIECHAKTIVNDS_IAE "Schalter für Differenzdrehzahlkriterium zur Deaktivierung des Kriechreglers" VALUE 0x26E525 kw_bool8_S6_S3 1 UMR___1_1_0_S6_S3 0 1 /end CHARACTERISTIC
/begin CHARACTERISTIC SWI_NSOLLH_SLST_IAE "Schalter zur Aktivierung H-Anfahrdrehzahl bei z_modus_iae = E-Anfahren" VALUE 0x26E526 kw_bool8_S6_S3 1 UMR___1_1_0_S6_S3 0 1 /end CHARACTERISTIC
/begin CHARACTERISTIC KF_J_ANFAHRT_IAE "Massenträgheit des Antriebsstrangs (VM, EM, Getriebe) bis zur IAE" MAP 0x222340 kf_si16_S6_S3 1 UMR_KGM2__1_1000_0_S6_S3 0 1
 /begin AXIS_DESCR STD_AXIS NO_INPUT_QUANTITY UMR___1_1000_0_S6_S3 6 0 6 DEPOSIT ABSOLUTE MONOTONY MON_INCREASE /end AXIS_DESCR
 /begin AXIS_DESCR STD_AXIS iItfInput.z_modus_iae UMR___1_1_0_S6_S3 2 0 2 DEPOSIT ABSOLUTE MONOTONY MON_INCREASE /end AXIS_DESCR
/end CHARACTERISTIC
/begin CHARACTERISTIC SWI_F_M_BASIS_IAE "Schalter zur Wahl der Berechnung des Anfahrtgewichtungsfaktors f_m_basis_anfahrt_iae" VALUE 0x26E527 kw_bool8_S6_S3 1 UMR___1_1_0_S6_S3 0 1 /end CHARACTERISTIC
/begin CHARACTERISTIC MPT_F_M_BASIS_ANFAHRT_IAE "Filterkonstante PT1-Filter für f_m_basis_anfahrt_iae" VALUE 0x26E528 kw_ui8_S6_S3 0.99 UMR___1_100_0_S6_S3 0.01 1 /end CHARACTERISTIC
/begin CHARACTERISTIC MPT_J_ANFAHRT_IAE "Filterkonstante PT1-Filter für j_anfahrt_iae" VALUE 0x26E529 kw_ui8_S6_S3 0.99 UMR___1_100_0_S6_S3 0.01 1 /end CHARACTERISTIC
/begin CHARACTERISTIC M_KRIECHMAX_FSTBR_IAE "Maximales Kriechmoment bei betätigter Feststellbremse" VALUE 0x26E52A kw_ui8_S6_S3 200 UMR___1_1_0_S6_S3 0 200 /end CHARACTERISTIC
/begin CHARACTERISTIC KL_M_KRIECHMAX_FAS_IAE "Maximales Kriechmoment bei Betrieb mit aktivem Fahrerassistenzsystem" CURVE 0x222370 kl_si16_S6_S3 200 UMR_NM__1_1_0_S6_S3 0 200
 /begin AXIS_DESCR STD_AXIS NO_INPUT_QUANTITY UMR_GRAD__1_3_M128_S6_S3 4 -42.6666666667 42.3333333333 DEPOSIT ABSOLUTE MONOTONY MON_INCREASE /end AXIS_DESCR
/end CHARACTERISTIC
/begin CHARACTERISTIC MG_KRIECHMAXNEG_IAE "Negativer Gradient für das Rausrampen des maximalen Kriechmoments" VALUE 0x26D5CE kw_si16_S6_S3 10000 UMR_NM_SEC_1_1_0_S6_S3 -10000 0 /end CHARACTERISTIC
/begin CHARACTERISTIC MG_KRIECHMAXPOS_IAE "Positiver Gradient für das Reinrampen des maximalen Kriechmoments" VALUE 0x26D5D0 kw_si16_S6_S3 10000 UMR_NM_SEC_1_1_0_S6_S3 0 10000 /end CHARACTERISTIC
/begin CHARACTERISTIC KL_MSOLLMINANFAHR_MAX_IAE "Maximalwertbegrenzung des minimalen Anfahrmoments aus Zustand Kriechen" CURVE 0x222384 kl_si16_S6_S3 300 UMR_NM__1_1_0_S6_S3 -100 200
 /begin AXIS_DESCR STD_AXIS NO_INPUT_QUANTITY UMR_NM__1_1_0_S6_S3 6 -400 1640 DEPOSIT ABSOLUTE MONOTONY MON_INCREASE /end AXIS_DESCR
/end CHARACTERISTIC
/begin CHARACTERISTIC WAERMEKAP_IAE "[J/K] Waermekapazität des Reibelements" VALUE 0x222B28 kw_fl32_S6_S3 7600 UMR_J_K_1_1_0_S6_S3 400 8000 FORMAT "%3.1" /end CHARACTERISTIC
/begin CHARACTERISTIC KL_ALPHA_AUF_IAE "Kennfeld ALPHA_IAE bei kup_status_iae = nicht definiert oder offen" CURVE 0x222B2C kl_fl32_S6_S3 999.9 UMR_W_K_1_1_0_S6_S3 0.1 1000
 /begin AXIS_DESCR STD_AXIS NO_INPUT_QUANTITY UMR_U_MIN_1_1_0_S6_S3 4 -8160 8160 DEPOSIT ABSOLUTE MONOTONY MON_INCREASE /end AXIS_DESCR
/end CHARACTERISTIC
/begin CHARACTERISTIC KL_ALPHA_ZU_IAE "Kennfeld ALPHA_IAE bei kup_status_iae = zu" CURVE 0x222B50 kl_fl32_S6_S3 999.9 UMR_W_K_1_1_0_S6_S3 0.1 1000
 /begin AXIS_DESCR STD_AXIS NO_INPUT_QUANTITY UMR_LITER_MIN_1_10_0_S6_S3 4 0 50 DEPOSIT ABSOLUTE MONOTONY MON_INCREASE /end AXIS_DESCR
/end CHARACTERISTIC
/begin CHARACTERISTIC KF_ALPHA_SCHLUPF_IAE "Kennfeld ALPHA_IAE bei kup_status_iae = schlupfend, angelegt oder entkoppelt" MAP 0x222B74 kf_fl32_S6_S3 999.9 UMR_W_K_1_1_0_S6_S3 0.1 1000
 /begin AXIS_DESCR STD_AXIS NO_INPUT_QUANTITY UMR_U_MIN_1_1_0_S6_S3 6 -8160 8160 DEPOSIT ABSOLUTE MONOTONY MON_INCREASE /end AXIS_DESCR
 /begin AXIS_DESCR STD_AXIS NO_INPUT_QUANTITY UMR_LITER_MIN_1_10_0_S6_S3 4 0 50 DEPOSIT ABSOLUTE MONOTONY MON_INCREASE /end AXIS_DESCR
/end CHARACTERISTIC
/begin CHARACTERISTIC TAB_MVG_C_IAE "Klassengrenzen fuer IAE Temperatur MvG" CURVE 0x222C04 tab_ui16_S6_S3 540 UMR_GRADC__1_1_M40_S6_S3 -40 500
 /begin AXIS_DESCR FIX_AXIS NO_INPUT_QUANTITY UMR___1_1_0_S6_S3 7 0 6 FIX_AXIS_PAR_DIST 0 1 7 /end AXIS_DESCR
/end CHARACTERISTIC
/begin CHARACTERISTIC KL_F_CIAEINI_IAE "Faktor zur IAE-Temperatur-Initialisierung" CURVE 0x222C18 kl_fl32_S6_S3 1 UMR___1_1_0_S6_S3 0 1 FORMAT "%4.2"
 /begin AXIS_DESCR STD_AXIS NO_INPUT_QUANTITY UMR_SEC__1_1_0_S6_S3 6 0 4294967295 DEPOSIT ABSOLUTE MONOTONY MON_INCREASE FORMAT "%5.3" /end AXIS_DESCR
/end CHARACTERISTIC
/begin CHARACTERISTIC T_WARTEN_CIAEINI_IAE "Zeit in der auf ein gültiges Signal timeegsoff gewartet wird" VALUE 0x26D60A kw_ui16_S6_S3 1000 UMR_MSEC__10_1_0_S6_S3 0 1000 /end CHARACTERISTIC
/begin CHARACTERISTIC KL_CG_KUEHL_IAE "Temperaturgradient zur Berechnung der IAE-Kühlöltemperatur c_kuehl_iae" CURVE 0x222C4C kl_fl32_S6_S3 20 UMR_K_SEC_1_1_0_S6_S3 -10 10 FORMAT "%4.2"
 /begin AXIS_DESCR STD_AXIS NO_INPUT_QUANTITY UMR_W__1_1_0_S6_S3 4 -1000000 1000000 DEPOSIT ABSOLUTE MONOTONY MON_INCREASE /end AXIS_DESCR
/end CHARACTERISTIC
/begin CHARACTERISTIC KL_CO_KUEHL_IAE "Offset auf Getriebeöltemperatur c_getr zur Berechnung des Maximalwerts der IAE-Kühlöltemperatur c_kuehl_iae" CURVE 0x222C70 kl_fl32_S6_S3 100 UMR_GRADC__1_1_0_S6_S3 0 100
 /begin AXIS_DESCR STD_AXIS NO_INPUT_QUANTITY UMR_W__1_1_0_S6_S3 4 -1000000 1000000 DEPOSIT ABSOLUTE MONOTONY MON_INCREASE /end AXIS_DESCR
/end CHARACTERISTIC
/begin CHARACTERISTIC MPT_MMOTMAX_IAE "PT1-Filterwert für Motormomentenbegrenzung" VALUE 0x26E52B kw_ui8_S6_S3 0.99 UMR___1_100_0_S6_S3 0.01 1 /end CHARACTERISTIC
/begin CHARACTERISTIC MG_M_MOTMAX_IAE "Momentengradient zum Abbau des reduzierenden Eingriffs" VALUE 0x26D5D2 kw_si16_S6_S3 10000 UMR_NM_SEC_1_1_0_S6_S3 0 10000 /end CHARACTERISTIC
/begin CHARACTERISTIC KL_M_STELLMAX_IAE "max. Momentenbegrenzung IAE im aktiven schlupfenden Zustand" CURVE 0x2223A0 kl_si16_S6_S3 2550 UMR_NM__1_1_0_S6_S3 0 2550
 /begin AXIS_DESCR STD_AXIS NO_INPUT_QUANTITY UMR_GRADC__1_1_M40_S6_S3 4 -40 500 DEPOSIT ABSOLUTE MONOTONY MON_INCREASE /end AXIS_DESCR
/end CHARACTERISTIC
/begin CHARACTERISTIC KF_MMOTMAXC_IAE "Momentenbegrenzung bei hoher IAE-Kupplungstemperatur" MAP 0x2223B4 kf_si16_S6_S3 2000 UMR_NM__1_1_0_S6_S3 -1000 1000
 /begin AXIS_DESCR STD_AXIS NO_INPUT_QUANTITY UMR_GRADC__1_1_M40_S6_S3 6 -40 500 DEPOSIT ABSOLUTE MONOTONY MON_INCREASE /end AXIS_DESCR
 /begin AXIS_DESCR STD_AXIS iIaeSigna.ng_getrein_iae UMR_U_MINSEC_1_1_0_S6_S3 6 -10000 10000 DEPOSIT ABSOLUTE MONOTONY MON_INCREASE /end AXIS_DESCR
/end CHARACTERISTIC
/begin CHARACTERISTIC KL_F_MMOTMAXC_IAE "Faktor auf Momentenbegrenzung von der Getriebetemperatur abhängig" CURVE 0x22241C kl_si16_S6_S3 2 UMR___1_100_0_S6_S3 0 2
 /begin AXIS_DESCR STD_AXIS NO_INPUT_QUANTITY UMR_GRADC__1_1_M40_S6_S3 4 -40 500 DEPOSIT ABSOLUTE MONOTONY MON_INCREASE /end AXIS_DESCR
/end CHARACTERISTIC
/begin CHARACTERISTIC KF_MMOTMAXND_IAE "Momentenbegrenzung bei Differenzdrehzahl im Zustand ZU" MAP 0x222430 kf_si16_S6_S3 2000 UMR_NM__1_1_0_S6_S3 -1000 1000
 /begin AXIS_DESCR STD_AXIS iIaeSigna.nd_iae UMR_U_MIN_1_1_0_S6_S3 6 -10000 10000 DEPOSIT ABSOLUTE MONOTONY MON_INCREASE /end AXIS_DESCR
 /begin AXIS_DESCR STD_AXIS NO_INPUT_QUANTITY UMR_NM__1_1_0_S6_S3 6 -1000 1000 DEPOSIT ABSOLUTE MONOTONY MON_INCREASE /end AXIS_DESCR
/end CHARACTERISTIC
/begin CHARACTERISTIC KL_MMOTMAXXD_IAE "Momentenbegrenzung bei Anfahrdrehzahlabweichung (xd_iae) im Zustand Anfahren/Synchronisieren" CURVE 0x222498 kl_si16_S6_S3 2000 UMR_NM__1_1_0_S6_S3 -1000 1000
 /begin AXIS_DESCR STD_AXIS NO_INPUT_QUANTITY UMR_U_MIN_1_1_0_S6_S3 6 -10000 10000 DEPOSIT ABSOLUTE MONOTONY MON_INCREASE /end AXIS_DESCR
/end CHARACTERISTIC
/begin CHARACTERISTIC KF_M_MOTMAXSTALL_IAE "Motormomentenbegrenzung Endwert im Stallspeed" MAP 0x2224B4 kf_si16_S6_S3 1000 UMR_NM__1_1_0_S6_S3 0 1000
 /begin AXIS_DESCR STD_AXIS NO_INPUT_QUANTITY UMR_SEC__1_100_0_S6_S3 4 0 300 DEPOSIT ABSOLUTE MONOTONY MON_INCREASE /end AXIS_DESCR
 /begin AXIS_DESCR STD_AXIS NO_INPUT_QUANTITY UMR_GRADC__1_1_M40_S6_S3 2 -40 460 DEPOSIT ABSOLUTE MONOTONY MON_INCREASE /end AXIS_DESCR
/end CHARACTERISTIC
/begin CHARACTERISTIC SWI_BLS_STALL_IAE "Schalter zur Auswahl, ob der Bremslichtschalter für den Ein- und Ausstieg des Stallbetriebs beachtet wird" VALUE 0x26E52C kw_bool8_S6_S3 1 UMR___1_1_0_S6_S3 0 1 /end CHARACTERISTIC
/begin CHARACTERISTIC DKIS_STALL_IAE "dki-Schwelle zur Erkennung Stallspeed" VALUE 0x26E52D kw_ui8_S6_S3 100 UMR_PROZENT__20_51_0_S6_S3 0 100 /end CHARACTERISTIC
/begin CHARACTERISTIC PS_BREMS_STALL_IAE "Bremsdruckschwelle für Stallspeederkennung" VALUE 0x26D5D4 kw_si16_S6_S3 100 UMR_BAR__1_100_0_S6_S3 0 100 /end CHARACTERISTIC
/begin CHARACTERISTIC MG_MOTAUFREGELSTALL_IAE "Momentengradient zum Abbau des reduzierenden Eingriffs nach Stallspeed" VALUE 0x26D5D6 kw_si16_S6_S3 10000 UMR_NM_SEC_1_1_0_S6_S3 0 10000 /end CHARACTERISTIC
/begin CHARACTERISTIC NS_NDMOTSTALL_IAE "Differenzdrehzahlschwelle für die Umschaltung der Motormomentengradientenbegrenzung im Anfahren" VALUE 0x26D5D8 kw_si16_S6_S3 5500 UMR_U_MIN_1_1_0_S6_S3 -500 5000 /end CHARACTERISTIC
/begin CHARACTERISTIC KL_M_MOT_MAX_TEMP_TIMER_IAE "Begrenzung Motormoment während aktiver IAE-Übertemperatur-Diagnose" CURVE 0x2224D8 kl_ui16_S6_S3 1000 UMR_NM__1_1_0_S6_S3 0 1000
 /begin AXIS_DESCR STD_AXIS NO_INPUT_QUANTITY UMR_SEC__1_100_0_S6_S3 4 0 300 DEPOSIT ABSOLUTE MONOTONY MON_INCREASE /end AXIS_DESCR
/end CHARACTERISTIC
/begin CHARACTERISTIC NEIGUNG_STALL_IAE "Neigungsschwelle für den Einstieg in die Stallschutzfunktion" VALUE 0x26D5DA kw_si16_S6_S3 84 UMR_GRAD__1_3_M128_S6_S3 -42 42 /end CHARACTERISTIC
/begin CHARACTERISTIC SWI_FESTSTELLBREMSE_STALL_IAE "Schalter zur Auswahl ob die Bedingung Feststellbremse_aktiv für den Einstieg in die Stallschutzfunktion abgefragt wird" VALUE 0x26E52E kw_bool8_S6_S3 1 UMR___1_1_0_S6_S3 0 1 /end CHARACTERISTIC
/begin CHARACTERISTIC NGS_ASRREGELT_IAE "Getriebeeingangsdrehzahlgradientenschwelle für Übergang aus Anfahren nach ZU (Sonderfunktion elektr. Diff.-Sperre, VAG)" VALUE 0x26D576 kw_si16_S6_S3 20000 UMR_U_MINSEC_1_1_0_S6_S3 -10000 10000 /end CHARACTERISTIC
/begin CHARACTERISTIC MS_MOTSOLLREKUEND_IAE "Motorsollmomentenschwelle für Erkennung Schubreku-Ende" VALUE 0x26D578 kw_si16_S6_S3 200 UMR_NM__1_1_0_S6_S3 -100 100 /end CHARACTERISTIC
/begin CHARACTERISTIC NDS_ZU_IAE "Drehzahlschwelle" VALUE 0x26D57A kw_si16_S6_S3 200 UMR_U_MIN_1_1_0_S6_S3 0 200 /end CHARACTERISTIC
/begin CHARACTERISTIC KL_NDS_ANGELEGT_KRIECH_IAE "Betrag Schlupfschwelle Übergang ANGELEGT KRIECHEN" CURVE 0x2210A0 kl_si16_S6_S3 1000 UMR_U_MIN_1_1_0_S6_S3 0 1000
 /begin AXIS_DESCR STD_AXIS iIaeSigna.n_ab_iae UMR_U_MIN_1_1_0_S6_S3 4 0 8000 DEPOSIT ABSOLUTE MONOTONY MON_INCREASE /end AXIS_DESCR
/end CHARACTERISTIC
/begin CHARACTERISTIC NDS_ZU_HYS_IAE "Hysterese für Drehzahlschwelle" VALUE 0x26D57C kw_si16_S6_S3 200 UMR_U_MIN_1_1_0_S6_S3 0 200 /end CHARACTERISTIC
/begin CHARACTERISTIC KF_PS_BREMS_ANFAHRT_IAE "Bremsdruckschwelle für Anfahren" MAP 0x2210B4 kf_si16_S6_S3 50 UMR_BAR__1_100_0_S6_S3 0 50
 /begin AXIS_DESCR STD_AXIS zff_atsys._.iSignale._.obj.sig_neigung_iae UMR_GRAD__1_3_M128_S6_S3 6 -42.6666666667 42.3333333333 DEPOSIT ABSOLUTE MONOTONY MON_INCREASE /end AXIS_DESCR
 /begin AXIS_DESCR STD_AXIS zff_atsys._.iSignale._.obj.sig_istgang UMR___1_1_0_S6_S3 4 -1 10 DEPOSIT ABSOLUTE MONOTONY MON_INCREASE /end AXIS_DESCR
/end CHARACTERISTIC
/begin CHARACTERISTIC PS_HYS_BREMS_IAE "Bremsdruckhysterese" VALUE 0x26D57E kw_si16_S6_S3 20 UMR_BAR__1_100_0_S6_S3 0 20 /end CHARACTERISTIC
/begin CHARACTERISTIC DKIS_ANFAHRT_IAE "DKI-Schwelle" VALUE 0x26E503 kw_ui8_S6_S3 100 UMR_PROZENT__20_51_0_S6_S3 0 100 /end CHARACTERISTIC
/begin CHARACTERISTIC DKIS_ANFAHRT_HYS_IAE "Hysterese für DKI-Schwelle" VALUE 0x26E504 kw_ui8_S6_S3 39.2157 UMR_PROZENT__20_51_0_S6_S3 0 39.2156862745 /end CHARACTERISTIC
/begin CHARACTERISTIC NO_VM_EHANF_IAE "Verbrennungsmotordrehzahlschwelle für Ubergang E- nach H-Anfahren" VALUE 0x26D580 kw_si16_S6_S3 2000 UMR_U_MIN_1_1_0_S6_S3 -1000 1000 /end CHARACTERISTIC
/begin CHARACTERISTIC NO_EM_HEANF_IAE "Drehzahloffset n_vm zu n_mot_iae beim Übergang von H-nach E-Anfahren" VALUE 0x26D582 kw_si16_S6_S3 1000 UMR_U_MIN_1_1_0_S6_S3 -1000 0 /end CHARACTERISTIC
/begin CHARACTERISTIC NS_AB_ANFAHRT_IAE "Abtriebsdrehzahlschwelle" VALUE 0x26D584 kw_si16_S6_S3 1000 UMR_U_MIN_1_1_0_S6_S3 0 1000 /end CHARACTERISTIC
/begin CHARACTERISTIC NS_MOTKRIECH_IAE "Motordrehzahlschwellwert für Übergang aus Angelegt nach Kriechen" VALUE 0x26D586 kw_si16_S6_S3 5000 UMR_U_MIN_1_1_0_S6_S3 0 5000 /end CHARACTERISTIC
/begin CHARACTERISTIC NS_HYS_MOTKRIECH_IAE "Hysteresewert Motordrehzahlschwellwert für Übergang aus Angelegt nach Kriechen" VALUE 0x26D588 kw_si16_S6_S3 1000 UMR_U_MIN_1_1_0_S6_S3 0 1000 /end CHARACTERISTIC
/begin CHARACTERISTIC TAB_SWI_SCHALTVERHIAE_ZZS "Schaltverhinderung von IAE fuer HS und RS" CURVE 0x221100 tab_bool8_S6_S3 1 UMR___1_1_0_S6_S3 0 1
 /begin AXIS_DESCR FIX_AXIS iIaeKordi.z_iae UMR___1_1_0_S6_S3 10 0 9 FIX_AXIS_PAR_DIST 0 1 10 /end AXIS_DESCR
/end CHARACTERISTIC
/begin CHARACTERISTIC TAB_SWI_HSCHALTVERHIAE_ZZS "Schaltverhinderung von IAE fuer HS" CURVE 0x221110 tab_bool8_S6_S3 1 UMR___1_1_0_S6_S3 0 1
 /begin AXIS_DESCR FIX_AXIS iIaeKordi.z_iae UMR___1_1_0_S6_S3 10 0 9 FIX_AXIS_PAR_DIST 0 1 10 /end AXIS_DESCR
/end CHARACTERISTIC
/begin CHARACTERISTIC SWI_ANGELEGT_SCHALT_IAE "Schalter, damit bei einer 2-1 ARS immer nach ANGELEGT gewechselt wird" VALUE 0x26E505 kw_ui8_S6_S3 1 UMR___1_1_0_S6_S3 0 1 /end CHARACTERISTIC
/begin CHARACTERISTIC NDS_SYNC_IAE "Differenzdrehzahlschwelle" VALUE 0x26D58A kw_si16_S6_S3 1000 UMR_U_MIN_1_1_0_S6_S3 0 1000 /end CHARACTERISTIC
/begin CHARACTERISTIC NDS_SYNC_EKS_IAE "Differenzdrehzahlschwelle für Übergang ins Synchronisieren während E-Fahren mit Kraftschluss" VALUE 0x26D58C kw_si16_S6_S3 1000 UMR_U_MIN_1_1_0_S6_S3 0 1000 /end CHARACTERISTIC
/begin CHARACTERISTIC NDO_TORQUEFUSE_IAE "Differenzdrehzahloffset auf Synchrondrehzahl für den Übergang nach Kriechen" VALUE 0x26D58E kw_si16_S6_S3 1000 UMR_U_MIN_1_1_0_S6_S3 0 1000 /end CHARACTERISTIC
/begin CHARACTERISTIC GS_ANGELEGT_SCHALT_IAE "max. Gang, bei dem bei ARS ins ANGELEGT gewechselt wird" VALUE 0x26E506 kw_ui8_S6_S3 8 UMR___1_1_0_S6_S3 0 8 /end CHARACTERISTIC
/begin CHARACTERISTIC SWI_ANFAHRVERB_RS_IAE "Schalter zum Sperren des Übergangs SYNC/ZU nach ANFAHREN" VALUE 0x26E507 kw_bool8_S6_S3 1 UMR___1_1_0_S6_S3 0 1 /end CHARACTERISTIC
/begin CHARACTERISTIC GS_ANFAHRT_IAE "max. Gang, bei dem von ZU nach Schließen/Kriechen gewechselt werden kann" VALUE 0x26E508 kw_ui8_S6_S3 8 UMR___1_1_0_S6_S3 0 8 /end CHARACTERISTIC
/begin CHARACTERISTIC T_NDS_ZU_IAE "Zeit wie lange die Schwelle NDS_ZU unterschritten sein muss für UE_SCHLIESSEN_ZU" VALUE 0x26E509 kw_ui8_S6_S3 2550 UMR_MSEC__10_1_0_S6_S3 0 2550 /end CHARACTERISTIC
/begin CHARACTERISTIC T_RAMAXSNYC_IAE "Zeit wie lange die Schwelle NDS_ZU unterschritten sein muss für UE_SCHLIESSEN_ZU" VALUE 0x26D590 kw_ui16_S6_S3 5000 UMR_MSEC__10_1_0_S6_S3 0 5000 /end CHARACTERISTIC
/begin CHARACTERISTIC NDS_MOTINITREG_IAE "Differenzdrehzahlschwelle für Reglerwiederinitialisierung im Entkoppeln während Anfahren." VALUE 0x26D592 kw_si16_S6_S3 500 UMR_U_MIN_1_1_0_S6_S3 0 500 /end CHARACTERISTIC
/begin CHARACTERISTIC KL_NDMOTVMSTARTBEGINN_IAE "Sollanfahrdrehzahlabweichungsänderung um Beginn Motorschleppstart zu erkennen" CURVE 0x221120 kl_si16_S6_S3 20000 UMR_U_MIN_1_1_0_S6_S3 -10000 10000
 /begin AXIS_DESCR STD_AXIS iIaeSigna.dki_iae UMR_PROZENT__20_51_0_S6_S3 6 0 100 DEPOSIT ABSOLUTE MONOTONY MON_INCREASE /end AXIS_DESCR
/end CHARACTERISTIC
/begin CHARACTERISTIC MS_K0VMSTARTBEGINN_IAE "K0 Momentenschwelle beim VM-Starten für Übergang nach Anfahren_entkoppeln" VALUE 0x26D594 kw_si16_S6_S3 1000 UMR_NM__1_1_0_S6_S3 0 1000 /end CHARACTERISTIC
/begin CHARACTERISTIC KL_ONSENTKOPPL_ANGELEGT_IAE "Offsetdrehzahl auf Öffnendrehzahlschwelle aus Entkoppeln nach Angelegt" CURVE 0x22113C kl_si16_S6_S3 2000 UMR_U_MIN_1_1_0_S6_S3 -1000 1000
 /begin AXIS_DESCR STD_AXIS iIaeSigna.n_motsoll_ll_iae UMR_U_MIN_1_1_0_S6_S3 3 0 10000 DEPOSIT ABSOLUTE MONOTONY MON_INCREASE /end AXIS_DESCR
/end CHARACTERISTIC
/begin CHARACTERISTIC MS_SOLL_ENPGFIX_IAE "Momentenschwelle für den Übergang nach ZU bei Ersatzmaßnahme KMN_ENPG1FIX oder KMN_ENPG3FIX" VALUE 0x26D596 kw_si16_S6_S3 1000 UMR_NM__1_1_0_S6_S3 0 1000 /end CHARACTERISTIC
/begin CHARACTERISTIC TAB_MVG_ND_IAE "Grenzen der Teilintervalle für die Differenzdrehzahl der IAE" CURVE 0x22114C tab_si16_S6_S3 4000 UMR_U_MIN_1_1_0_S6_S3 -2000 2000
 /begin AXIS_DESCR FIX_AXIS NO_INPUT_QUANTITY UMR___1_1_0_S6_S3 7 0 6 FIX_AXIS_PAR_DIST 0 1 7 /end AXIS_DESCR
/end CHARACTERISTIC
/begin CHARACTERISTIC TAB_MVG_MSTELL_IAE "Grenzen der Teilintervalle für das Stellmoment der IAE" CURVE 0x221160 tab_si16_S6_S3 2500 UMR_NM__1_1_0_S6_S3 -500 2000
 /begin AXIS_DESCR FIX_AXIS NO_INPUT_QUANTITY UMR___1_1_0_S6_S3 7 0 6 FIX_AXIS_PAR_DIST 0 1 7 /end AXIS_DESCR
/end CHARACTERISTIC
/begin CHARACTERISTIC KF_VP_KUEHL_SOLL_IAE "erforderliche Kühlölmenger für die IAE" MAP 0x221174 kf_si16_S6_S3 50 UMR_LITER_MIN_1_10_0_S6_S3 0 50
 /begin AXIS_DESCR STD_AXIS NO_INPUT_QUANTITY UMR_KW__1_1000_0_S6_S3 6 0 32 DEPOSIT ABSOLUTE MONOTONY MON_INCREASE /end AXIS_DESCR
 /begin AXIS_DESCR STD_AXIS NO_INPUT_QUANTITY UMR_GRADC__1_1_0_S6_S3 6 -500 500 DEPOSIT ABSOLUTE MONOTONY MON_INCREASE /end AXIS_DESCR
/end CHARACTERISTIC
/begin CHARACTERISTIC MPT_KUEHL_IAE "PT1- Filterzeitkonstante für Sollkühlölmenge vp_kuehl_soll_iae" VALUE 0x26E50A kw_ui8_S6_S3 0.99 UMR___1_100_0_S6_S3 0.01 1 /end CHARACTERISTIC
/begin CHARACTERISTIC MPT_KUEHL_KORR_IAE "Filterkonstante für PT1-Filter für vp_kuehl_korr_iae" VALUE 0x26E50B kw_ui8_S6_S3 0.99 UMR___1_100_0_S6_S3 0.01 1 /end CHARACTERISTIC
/begin CHARACTERISTIC KL_P_KUEHL_IAE "Umrechnung vp_kuehl_iae in Kühldruck" CURVE 0x2211DC kl_si16_S6_S3 20 UMR_BAR__1_1000_0_S6_S3 0 20
 /begin AXIS_DESCR STD_AXIS NO_INPUT_QUANTITY UMR_LITER_MIN_1_10_0_S6_S3 6 0 50 DEPOSIT ABSOLUTE MONOTONY MON_INCREASE /end AXIS_DESCR
/end CHARACTERISTIC
/begin CHARACTERISTIC KL_PO_KUEHL_IAE "Offset auf Soll-Kühlöldruck in R" CURVE 0x2211F8 kl_si16_S6_S3 2 UMR_BAR__1_1000_0_S6_S3 0 2
 /begin AXIS_DESCR STD_AXIS NO_INPUT_QUANTITY UMR_GRADC__1_1_M40_S6_S3 4 -40 215 DEPOSIT ABSOLUTE MONOTONY MON_INCREASE /end AXIS_DESCR
/end CHARACTERISTIC
/begin CHARACTERISTIC KL_F_VP_KUEHL_IAE "Faktor zur Korrektur des Temperatureinflusses" CURVE 0x22120C kl_si16_S6_S3 5 UMR___1_100_0_S6_S3 0 5
 /begin AXIS_DESCR STD_AXIS NO_INPUT_QUANTITY UMR_GRADC__1_1_M40_S6_S3 4 -40 215 DEPOSIT ABSOLUTE MONOTONY MON_INCREASE /end AXIS_DESCR
/end CHARACTERISTIC
/begin CHARACTERISTIC F_KUEHLOELV_IAE "Faktor für die Verteilung der Ölmenge von IAE-Kühlung & K0-Getriebekühlung, Getriebeschmierung" VALUE 0x26D598 kw_si16_S6_S3 1 UMR___1_100_0_S6_S3 0 1 /end CHARACTERISTIC
/begin CHARACTERISTIC CS_GETR_VPKUEHLMIN_IAE "Getriebetemperaturschwelle für minimalen Kühlölvolumenstrom" VALUE 0x26E50C kw_ui8_S6_S3 240 UMR_GRADC__1_1_M40_S6_S3 -40 200 /end CHARACTERISTIC
/begin CHARACTERISTIC VP_KUEHL_MIN_IAE "Minimale Kühlölmenge bei aktivier Kühlung außerhalb ZU" VALUE 0x26D59A kw_si16_S6_S3 50 UMR_LITER_MIN_1_10_0_S6_S3 0 50 /end CHARACTERISTIC
/begin CHARACTERISTIC VP_KUEHL_MAX_IAE "Maximale Kühlölmenge bei aktivier Kühlung" VALUE 0x26D59C kw_si16_S6_S3 50 UMR_LITER_MIN_1_10_0_S6_S3 0 50 /end CHARACTERISTIC
/begin CHARACTERISTIC ZIELGANG_NACHKUEHL_IAE "Zielgang, bis zu welchem die Nachkühlung aktiv sein kann" VALUE 0x26E50D kw_ui8_S6_S3 4 UMR___1_1_0_S6_S3 1 5 /end CHARACTERISTIC
/begin CHARACTERISTIC KL_CS_NACHKUEHL_IAE "IAE-Temperaturschwelle zur Anforderung einer Nachkühlung" CURVE 0x221220 kl_si16_S6_S3 500 UMR_GRADC__1_1_M40_S6_S3 0 500
 /begin AXIS_DESCR STD_AXIS NO_INPUT_QUANTITY UMR_GRADC__1_1_M40_S6_S3 4 -40 215 DEPOSIT ABSOLUTE MONOTONY MON_INCREASE /end AXIS_DESCR
/end CHARACTERISTIC
/begin CHARACTERISTIC KL_CS_NMOTLLSOLL_IAE "IAE-Temperaturschwelle zur Anforderung einer minimalen EM-Drehzahl zur Nachkühlung" CURVE 0x221234 kl_si16_S6_S3 500 UMR_GRADC__1_1_M40_S6_S3 0 500
 /begin AXIS_DESCR STD_AXIS NO_INPUT_QUANTITY UMR_GRADC__1_1_M40_S6_S3 4 -40 215 DEPOSIT ABSOLUTE MONOTONY MON_INCREASE /end AXIS_DESCR
/end CHARACTERISTIC
/begin CHARACTERISTIC CS_SLGRENZ_IAE "IAE-Stahllamellentemperaturschwelle zur Deaktivierung der IAE-Kühlung bei Tieftemperatur" VALUE 0x26D59E kw_ui16_S6_S3 300 UMR_GRADC__1_1_M40_S6_S3 -40 260 /end CHARACTERISTIC
/begin CHARACTERISTIC PWS_KUEHL_INAKTIV_IAE "Schwelle für Reibleistung zur Deaktivierung der Kühlung" VALUE 0x26D5A0 kw_ui16_S6_S3 100 UMR_KW__1_10_0_S6_S3 0 100 /end CHARACTERISTIC
/begin CHARACTERISTIC T_KUEHL_INAKTIV_IAE "Dauer der Nachkühlung im Zustand zu" VALUE 0x26D5A2 kw_ui16_S6_S3 300 UMR_SEC__1_100_0_S6_S3 0 300 /end CHARACTERISTIC
/begin CHARACTERISTIC KF_VP_LECKAGE_IAE "Kennfeld aus dem die Leckagemengen der Hydraulik ausgelesen werden können" MAP 0x221248 kf_ui16_S6_S3 99.99 UMR_LITER_MIN_1_10_0_S6_S3 0.01 100
 /begin AXIS_DESCR STD_AXIS iSasPsyst.p_sys UMR_BAR__1_1000_0_S6_S3 6 0 20 DEPOSIT ABSOLUTE MONOTONY MON_INCREASE /end AXIS_DESCR
 /begin AXIS_DESCR STD_AXIS NO_INPUT_QUANTITY UMR_GRADC__1_1_M40_S6_S3 6 -40 215 DEPOSIT ABSOLUTE MONOTONY MON_INCREASE /end AXIS_DESCR
/end CHARACTERISTIC
/begin CHARACTERISTIC NDS_KUEHLOFFEN_IAE "Differenzdrehzahlschwelle um Kuehlung bei offener IAE einzuschalten" VALUE 0x26D5A4 kw_si16_S6_S3 64000 UMR_U_MIN_1_1_0_S6_S3 -32000 32000 /end CHARACTERISTIC
/begin CHARACTERISTIC ND_HYS_KUEHLOFFEN_IAE "Hysterese auf Differenzdrehzahlschwelle um Kuehlung bei offener IAE einzuschalten" VALUE 0x26D5A6 kw_si16_S6_S3 64000 UMR_U_MIN_1_1_0_S6_S3 -32000 32000 /end CHARACTERISTIC
/begin CHARACTERISTIC VP_KUEHLOFFEN_IAE "Kuehloelmenge bei offener IAE, wenn diese aktiviert wird" VALUE 0x26D5A8 kw_si16_S6_S3 50 UMR_LITER_MIN_1_10_0_S6_S3 0 50 /end CHARACTERISTIC
/begin CHARACTERISTIC TS_EFAHREN_IAE "Zeitschwelle für z_modus_iae im E-Fahren (Schlupf) für Anforderung einer minimalen EM-Drehzahl" VALUE 0x26E50E kw_ui8_S6_S3 2550 UMR_MSEC__10_1_0_S6_S3 0 2550 /end CHARACTERISTIC
/begin CHARACTERISTIC SWI_NDMOT_DIAGIAE "Schalter zur Auswahl der x-Eingangsgröße für KF_MDI_DIAGIAE" VALUE 0x26E4F3 kw_bool8_S6_S3 1 UMR___1_1_0_S6_S3 0 1 /end CHARACTERISTIC
/begin CHARACTERISTIC SWI_CLOSE_AKTIV_DIAG_IAE "Aktivierung der Schließen-Diagnose" VALUE 0x26E4F4 kw_bool8_S6_S3 1 UMR___1_1_0_S6_S3 0 1 /end CHARACTERISTIC
/begin CHARACTERISTIC SWI_NOOPEN_AKTIV_DIAG_IAE "Aktivierung der Nicht-Oeffnen-Diagnose" VALUE 0x26E4F5 kw_bool8_S6_S3 1 UMR___1_1_0_S6_S3 0 1 /end CHARACTERISTIC
/begin CHARACTERISTIC SWI_NOCLOSE_AKTIV_DIAG_IAE "Aktivierung der Nicht-Schließen-Diagnose" VALUE 0x26E4F6 kw_bool8_S6_S3 1 UMR___1_1_0_S6_S3 0 1 /end CHARACTERISTIC
/begin CHARACTERISTIC MPT_MDI_DIAGIAE "PT1 Filterung Motordrückindex" VALUE 0x26E4F7 kw_ui8_S6_S3 0.99 UMR___1_100_0_S6_S3 0.01 1 /end CHARACTERISTIC
/begin CHARACTERISTIC KF_MDI_DIAGIAE "Definition Motordrücken" MAP 0x220D84 kf_si16_S6_S3 100 UMR___1_1_0_S6_S3 0 100
 /begin AXIS_DESCR STD_AXIS NO_INPUT_QUANTITY UMR___1_1_0_S6_S3 6 -10000 10000 DEPOSIT ABSOLUTE MONOTONY MON_INCREASE /end AXIS_DESCR
 /begin AXIS_DESCR STD_AXIS NO_INPUT_QUANTITY UMR_NM__1_1_0_S6_S3 6 -3500 3500 DEPOSIT ABSOLUTE MONOTONY MON_INCREASE /end AXIS_DESCR
/end CHARACTERISTIC
/begin CHARACTERISTIC CS_CGETR_NOCLOSE_DIAGIAE "Aktivierungstemperatur IAE_NOCLOSE" VALUE 0x26E4F8 kw_ui8_S6_S3 240 UMR_GRADC__1_1_M40_S6_S3 -40 200 /end CHARACTERISTIC
/begin CHARACTERISTIC CTR_HOT_MAX_DIAGIAE "Maximalwert für integrierte Differenz c_iae - CS_MAX_DIAGIAE" VALUE 0x26D544 kw_ui16_S6_S3 1000 UMR_KSEC__1_1_0_S6_S3 0 1000 /end CHARACTERISTIC
/begin CHARACTERISTIC CS_MAX_DIAGIAE "Auslöseschwelle KFC_IAEHOT" VALUE 0x26D546 kw_ui16_S6_S3 1000 UMR_GRADC__1_1_M40_S6_S3 0 1000 /end CHARACTERISTIC
/begin CHARACTERISTIC CS_MAX_HYS_DIAGIAE "Hysterese auf Auslöseschwelle KFC_IAEHOT" VALUE 0x26D548 kw_ui16_S6_S3 150 UMR_GRADC__1_1_0_S6_S3 0 150 /end CHARACTERISTIC
/begin CHARACTERISTIC F_NSOLL_NOCLOSE_DIAGIAE "Faktor auf Anfahrdrehzahl zur Erkennung übermäßig Schlupf" VALUE 0x26D54A kw_si16_S6_S3 10 UMR___1_100_0_S6_S3 0 10 /end CHARACTERISTIC
/begin CHARACTERISTIC KF_ND_NOOPEN_DIAGIAE "Zustandsabhängige Schlupfschwelle" MAP 0x220DEC kf_si16_S6_S3 1000 UMR_U_MIN_1_1_0_S6_S3 0 1000
 /begin AXIS_DESCR STD_AXIS NO_INPUT_QUANTITY UMR___1_1_0_S6_S3 3 0 2 DEPOSIT ABSOLUTE MONOTONY MON_INCREASE /end AXIS_DESCR
 /begin AXIS_DESCR STD_AXIS iIaeSigna.n_motsoll_ll_iae UMR_U_MIN_1_1_0_S6_S3 3 0 8160 DEPOSIT ABSOLUTE MONOTONY MON_INCREASE /end AXIS_DESCR
/end CHARACTERISTIC
/begin CHARACTERISTIC KL_MDI_NOOPEN_DIAGIAE "Schwelle Motordrücken 'IAE öffnet nicht'" CURVE 0x220E14 kl_ui8_S6_S3 100 UMR___1_1_0_S6_S3 0 100
 /begin AXIS_DESCR STD_AXIS NO_INPUT_QUANTITY UMR_GRADC__1_1_M40_S6_S3 4 -40 215 DEPOSIT ABSOLUTE MONOTONY MON_INCREASE /end AXIS_DESCR
/end CHARACTERISTIC
/begin CHARACTERISTIC KL_MDI_CLOSE_DIAGIAE "Schwelle Motordrücken 'IAE schließt ungewollt" CURVE 0x220E20 kl_ui8_S6_S3 100 UMR___1_1_0_S6_S3 0 100
 /begin AXIS_DESCR STD_AXIS NO_INPUT_QUANTITY UMR_GRADC__1_1_M40_S6_S3 4 -40 215 DEPOSIT ABSOLUTE MONOTONY MON_INCREASE /end AXIS_DESCR
/end CHARACTERISTIC
/begin CHARACTERISTIC F_MMOT_NOCLOSE_DIAGIAE "Schwellenfaktor Momentenkriterium Erkennung IAE_NOCLOSE" VALUE 0x26D54C kw_si16_S6_S3 10 UMR___1_100_0_S6_S3 0 10 /end CHARACTERISTIC
/begin CHARACTERISTIC M_SOLLMAX_CLOSE_DIAGIAE "Abschaltschwelle IAE Sollmoment zur 'IAE schließt' Erkennung" VALUE 0x26E4F9 kw_ui8_S6_S3 100 UMR_NM__1_1_0_S6_S3 0 100 /end CHARACTERISTIC
/begin CHARACTERISTIC MO_MMOT_NOCLOSE_DIAGIAE "Differenz Soll-Ist Motorbelastung zur Erkennung 'IAE schließt nicht'" VALUE 0x26D54E kw_si16_S6_S3 2000 UMR_NM__1_1_0_S6_S3 -1000 1000 /end CHARACTERISTIC
/begin CHARACTERISTIC NDS_NDIAE_NOCLOSE_DIAGIAE "unzulässiger IAE Schlupf zur Erkennung 'IAE schließt nicht'" VALUE 0x26D550 kw_si16_S6_S3 2000 UMR_U_MIN_1_1_0_S6_S3 -1000 1000 /end CHARACTERISTIC
/begin CHARACTERISTIC KL_NGS_NAB_CLOSE_DIAGIAE "Erkennung unzulässige Beschleunigung" CURVE 0x220E2C kl_si16_S6_S3 20000 UMR_U_MINSEC_1_1_0_S6_S3 -10000 10000
 /begin AXIS_DESCR STD_AXIS NO_INPUT_QUANTITY UMR_GRADC__1_1_M40_S6_S3 4 -40 215 DEPOSIT ABSOLUTE MONOTONY MON_INCREASE /end AXIS_DESCR
/end CHARACTERISTIC
/begin CHARACTERISTIC NGS_NMOT_NOCLOSE_DIAGIAE "Motordrehzahlgradient zur Erkennung 'IAE schließt nicht'" VALUE 0x26D552 kw_si16_S6_S3 20000 UMR_U_MINSEC_1_1_0_S6_S3 -10000 10000 /end CHARACTERISTIC
/begin CHARACTERISTIC NO_NSOLL_NOCLOSE_DIAGIAE "Drehzahloffset auf Anfahrdrehzahl zur Erkennung übermäßig Schlupf" VALUE 0x26D554 kw_si16_S6_S3 2000 UMR_U_MIN_1_1_0_S6_S3 -1000 1000 /end CHARACTERISTIC
/begin CHARACTERISTIC NS_NAB_CLOSE_DIAGIAE "Geschwindigkeitsschwelle Aktivierung Diagnose 'IAE öffnet nicht'" VALUE 0x26D556 kw_si16_S6_S3 2000 UMR_U_MIN_1_1_0_S6_S3 -1000 1000 /end CHARACTERISTIC
/begin CHARACTERISTIC PS_BREMS_NOOPEN_DIAGIAE "Bremsdruckschwelle Aktivierung Diagnose 'IAE öffnet nicht'" VALUE 0x26D558 kw_si16_S6_S3 100 UMR_BAR__1_100_0_S6_S3 0 100 /end CHARACTERISTIC
/begin CHARACTERISTIC T_NOCLOSE_DIAGIAE "Mindestdauer Erkennung 'IAE schließt nicht'" VALUE 0x26D55A kw_ui16_S6_S3 10000 UMR_MSEC__10_1_0_S6_S3 0 10000 /end CHARACTERISTIC
/begin CHARACTERISTIC T_NOOPEN_DIAGIAE "Mindestdauer Erkennung 'IAE oeffnet nicht'" VALUE 0x26D55C kw_ui16_S6_S3 10000 UMR_MSEC__10_1_0_S6_S3 0 10000 /end CHARACTERISTIC
/begin CHARACTERISTIC T_LWREAKT_DIAGIAE "Aktivierungsverzögerung der Diagnose um Lastwechselreaktionen auszublenden" VALUE 0x26D55E kw_ui16_S6_S3 10000 UMR_MSEC__10_1_0_S6_S3 0 10000 /end CHARACTERISTIC
/begin CHARACTERISTIC T_ND_RESET_DIAGIAE "Erkennungsdauer Gutprüfung zur Fehlerrückfilterung" VALUE 0x26D560 kw_ui16_S6_S3 10000 UMR_MSEC__10_1_0_S6_S3 0 10000 /end CHARACTERISTIC
/begin CHARACTERISTIC KL_F_ND_RESET_DIAGIAE "Schlupfschwelle zur Erkennung IAE schlupft für Fehlerrückfilterung" CURVE 0x220E40 kl_ui16_S6_S3 10 UMR___1_100_0_S6_S3 0 10
 /begin AXIS_DESCR STD_AXIS NO_INPUT_QUANTITY UMR_U_MIN_1_1_0_S6_S3 4 0 8000 DEPOSIT ABSOLUTE MONOTONY MON_INCREASE /end AXIS_DESCR
/end CHARACTERISTIC
/begin CHARACTERISTIC TAB_ZMODUS_CLOSE_DIAGIAE "Auswahl der IAE Betriebszustände in denen IAE_CLOSE überwacht wird" CURVE 0x220E54 tab_bool8_S6_S3 1 UMR___1_1_0_S6_S3 0 1
 /begin AXIS_DESCR FIX_AXIS NO_INPUT_QUANTITY UMR___1_1_0_S6_S3 3 0 2 FIX_AXIS_PAR_DIST 0 1 3 /end AXIS_DESCR
/end CHARACTERISTIC
/begin CHARACTERISTIC TAB_ZMODUS_NOOPEN_DIAGIAE "Auswahl der IAE Betriebszustände in denen IAE_NOOPEN überwacht wird" CURVE 0x220E5C tab_bool8_S6_S3 1 UMR___1_1_0_S6_S3 0 1
 /begin AXIS_DESCR FIX_AXIS NO_INPUT_QUANTITY UMR___1_1_0_S6_S3 3 0 2 FIX_AXIS_PAR_DIST 0 1 3 /end AXIS_DESCR
/end CHARACTERISTIC
/begin CHARACTERISTIC N_STOER_KFC_NOCLOSE_DIAGIAE "Auslöseschwelle Störzahler für Eintrag IAE_NOCLOSE" VALUE 0x26E4FA kw_ui8_S6_S3 10 UMR___1_1_0_S6_S3 0 10 /end CHARACTERISTIC
/begin CHARACTERISTIC VDS_WHEEL_CLOSE_DIAGIAE "max-zul. Raddifferenzdrehzahl zur Aktivierung der Diagnosen" VALUE 0x26D562 kw_ui16_S6_S3 10 UMR_KM_H_1_16_0_S6_S3 0 10 /end CHARACTERISTIC
/begin CHARACTERISTIC AX_MAX_CLOSE_DIAGIAE "maximale Neigung zur Aktivierung der Diagnosen" VALUE 0x26D564 kw_si16_S6_S3 10 UMR_M_SEC2_1_32_0_S6_S3 0 10 /end CHARACTERISTIC
/begin CHARACTERISTIC AXS_CLOSE_DIAGIAE "mindest-Beschleunigungsintegral zur ng-ab-Schwelle IAE_CLOSE" VALUE 0x26D566 kw_si16_S6_S3 10 UMR_M_SEC2_1_32_0_S6_S3 0 10 /end CHARACTERISTIC
/begin CHARACTERISTIC TS_AX_CLOSE_DIAGIAE "Integrationzeit zu AXS_CLOSE_DIAGIAE" VALUE 0x26D568 kw_ui16_S6_S3 1000 UMR_MSEC__10_1_0_S6_S3 0 1000 /end CHARACTERISTIC
/begin CHARACTERISTIC SWI_MOT_LAST_IAE "Schalter zur Wahl der Berechnung des Lastzustands des Motors" VALUE 0x26E52F kw_bool8_S6_S3 1 UMR___1_1_0_S6_S3 0 1 /end CHARACTERISTIC
/begin CHARACTERISTIC KF_MOT_LAST_IAE "Gibt den aktuellen Lastzustand des Motors an" MAP 0x2226FC kf_si16_S6_S3 1000 UMR___1_1_0_S6_S3 0 1000
 /begin AXIS_DESCR STD_AXIS iIaeSigna.n_mot_iae UMR_U_MIN_1_1_0_S6_S3 6 0 10000 DEPOSIT ABSOLUTE MONOTONY MON_INCREASE /end AXIS_DESCR
 /begin AXIS_DESCR STD_AXIS NO_INPUT_QUANTITY UMR_PROZENT__20_51_0_S6_S3 6 0 100 DEPOSIT ABSOLUTE MONOTONY MON_INCREASE /end AXIS_DESCR
/end CHARACTERISTIC
/begin CHARACTERISTIC MPT_NUE_IAE "PT1-Filterzeitkonstante für nue_iae" VALUE 0x26E530 kw_ui8_S6_S3 0.99 UMR___1_100_0_S6_S3 0.01 1 /end CHARACTERISTIC
/begin CHARACTERISTIC MPT_ND_MOT_IAE "Filterzeitkonstante für Differenzdrehzahl zwischen Motor und -Leerlaufdrehzahl" VALUE 0x26E531 kw_ui8_S6_S3 0.99 UMR___1_100_0_S6_S3 0.01 1 /end CHARACTERISTIC
/begin CHARACTERISTIC MPT_ND_IAE "Filterzeitkonstante für Differenzdrehzahl am Anfahrelement" VALUE 0x26E532 kw_ui8_S6_S3 0.99 UMR___1_100_0_S6_S3 0.01 1 /end CHARACTERISTIC
/begin CHARACTERISTIC MDT_NDG_IAE "Filterzeitkonstante für Gradinetenbildung fuer Differenzdrehzahl am Anfahrelement" VALUE 0x26E533 kw_ui8_S6_S3 0.99 UMR___1_100_0_S6_S3 0.01 1 /end CHARACTERISTIC
/begin CHARACTERISTIC MPT_NMOT_IAE "Filterzeitkonstante für Motordrehzahl" VALUE 0x26E534 kw_ui8_S6_S3 0.99 UMR___1_100_0_S6_S3 0.01 1 /end CHARACTERISTIC
/begin CHARACTERISTIC MPT_NAB_IAE "Filterzeitkonstante für Abtriebsdrehzahl" VALUE 0x26E535 kw_ui8_S6_S3 0.99 UMR___1_100_0_S6_S3 0.01 1 /end CHARACTERISTIC
/begin CHARACTERISTIC MPT_NT_IAE "Filterzeitkonstante für Abtriebsdrehzahl" VALUE 0x26E536 kw_ui8_S6_S3 0.99 UMR___1_100_0_S6_S3 0.01 1 /end CHARACTERISTIC
/begin CHARACTERISTIC MPT_ND_GETREIN_IAE "Filterkonstante für PT1-Filter Differenzdrehzahl nd_getrein_iae" VALUE 0x26E537 kw_ui8_S6_S3 0.99 UMR___1_100_0_S6_S3 0.01 1 /end CHARACTERISTIC
/begin CHARACTERISTIC MPT_MMOTIST_IAE "Filterzeitkonstante für Motoristmoment" VALUE 0x26E538 kw_ui8_S6_S3 0.99 UMR___1_100_0_S6_S3 0.01 1 /end CHARACTERISTIC
/begin CHARACTERISTIC MPT_MMOTISTOE_IAE "Filterzeitkonstante für PT1-Filter für Motoristmoment ohne Getriebeeingriff" VALUE 0x26E539 kw_ui8_S6_S3 0.99 UMR___1_100_0_S6_S3 0.01 1 /end CHARACTERISTIC
/begin CHARACTERISTIC MPT_MMOTSOLLOE_IAE "Filterzeitkonstante für PT1-Filter für Motorsollmoment ohne Getriebeeingriff" VALUE 0x26E53A kw_ui8_S6_S3 0.99 UMR___1_100_0_S6_S3 0.01 1 /end CHARACTERISTIC
/begin CHARACTERISTIC MPT_MMOTGEM_IAE "Filterzeitkonstante für PT1-Filter für gemischtes Motormoment" VALUE 0x26E53B kw_ui8_S6_S3 0.99 UMR___1_100_0_S6_S3 0.01 1 /end CHARACTERISTIC
/begin CHARACTERISTIC MPT_PBREMS_IAE "Filterzeitkonstante für Bremsdruck" VALUE 0x26E53C kw_ui8_S6_S3 0.99 UMR___1_100_0_S6_S3 0.01 1 /end CHARACTERISTIC
/begin CHARACTERISTIC MPT_DKI_IAE "Filterfaktor für PT-1 Filter des Fahrpedal" VALUE 0x26E53D kw_ui8_S6_S3 0.99 UMR___1_100_0_S6_S3 0.01 1 /end CHARACTERISTIC
/begin CHARACTERISTIC MPT_AX_REF_DIAGIAE "PT1 Filter zur Neigungsermittlung aus der Beschleunigung" VALUE 0x26E53E kw_ui8_S6_S3 0.99 UMR___1_100_0_S6_S3 0.01 1 /end CHARACTERISTIC
/begin CHARACTERISTIC MDT_DKIG_IAE "Filterfaktor für DT-1 Filter des Fahrpedal" VALUE 0x26E53F kw_ui8_S6_S3 0.99 UMR___1_100_0_S6_S3 0.01 1 /end CHARACTERISTIC
/begin CHARACTERISTIC MDT_MG_MOTIST_IAE "Filterzeitkonstante für DT1-Filter für Motoristmoment mit Getriebeeingriff" VALUE 0x26E540 kw_ui8_S6_S3 0.99 UMR___1_100_0_S6_S3 0.01 1 /end CHARACTERISTIC
/begin CHARACTERISTIC MDT_NG_AB_IAE "Filterfaktor für DT-1 Filter für Abtriebsdrehzahl" VALUE 0x26E541 kw_ui8_S6_S3 0.99 UMR___1_100_0_S6_S3 0.01 1 /end CHARACTERISTIC
/begin CHARACTERISTIC MDT_NG_GETREIN_IAE "Filterfaktor für DT-1 Filter für Getriebeeingangsdrehzahl" VALUE 0x26E542 kw_ui8_S6_S3 0.99 UMR___1_100_0_S6_S3 0.01 1 /end CHARACTERISTIC
/begin CHARACTERISTIC MDT_NG_MOT_IAE "Filterfaktor für DT-1 Filter für Motordrehzahl" VALUE 0x26E543 kw_ui8_S6_S3 0.99 UMR___1_100_0_S6_S3 0.01 1 /end CHARACTERISTIC
/begin CHARACTERISTIC MDT_PG_BREMS_IAE "Filterfaktor für DT-1 Filter für Bremsdruck" VALUE 0x26E544 kw_ui8_S6_S3 0.99 UMR___1_100_0_S6_S3 0.01 1 /end CHARACTERISTIC
/begin CHARACTERISTIC MO_MOTIST_IAE "Momentenoffset zur Nullpunktanpassung Motoristmoment" VALUE 0x26E545 kw_si8_S6_S3 255 UMR_NM__1_1_0_S6_S3 -128 127 /end CHARACTERISTIC
/begin CHARACTERISTIC MO_MOTISTOE_IAE "Momentenoffset zur Nullpunktanpassung Motoristmoment ohne Eingriff" VALUE 0x26E546 kw_si8_S6_S3 255 UMR_NM__1_1_0_S6_S3 -128 127 /end CHARACTERISTIC
/begin CHARACTERISTIC MO_MOTSOLLOE_IAE "Momentenoffset zur Nullpunktanpassung Motorsollmoment ohne Eingriff" VALUE 0x26D5DC kw_si16_S6_S3 200 UMR_NM__1_1_0_S6_S3 -100 100 /end CHARACTERISTIC
/begin CHARACTERISTIC KL_MOTSTRESSPAIR_IAE "Bestimmung Motorstress aus Luftdruck" CURVE 0x222764 kl_si16_S6_S3 204.8 UMR_PROZENT__16_10_0_S6_S3 0 204.8
 /begin AXIS_DESCR STD_AXIS NO_INPUT_QUANTITY UMR_MBAR__1_1_0_S6_S3 3 0 2026 DEPOSIT ABSOLUTE MONOTONY MON_INCREASE /end AXIS_DESCR
/end CHARACTERISTIC
/begin CHARACTERISTIC KL_F_FDYNANFAHR_IAE "Faktor zur Berücksichtigung der Getriebeöltemperatur in der Berechnung der IAE-Öffnen und Schliessdrehzahl" CURVE 0x222774 kl_si16_S6_S3 1 UMR___1_100_0_S6_S3 0 1
 /begin AXIS_DESCR STD_AXIS iIaeMomen.i_stuetz_iae UMR___1_1000_0_S6_S3 6 0 6 DEPOSIT ABSOLUTE MONOTONY MON_INCREASE /end AXIS_DESCR
/end CHARACTERISTIC
/begin CHARACTERISTIC KL_FNSSYNC_IAE "Faktor zur Berücksichtigung der Getriebeöltemperatur in der Berechnung der IAE-Öffnen und Schliessdrehzahl" CURVE 0x222790 kl_si16_S6_S3 4 UMR___1_100_0_S6_S3 -2 2
 /begin AXIS_DESCR STD_AXIS NO_INPUT_QUANTITY UMR_GRADC__1_1_M40_S6_S3 6 -40 500 DEPOSIT ABSOLUTE MONOTONY MON_INCREASE /end AXIS_DESCR
/end CHARACTERISTIC
/begin CHARACTERISTIC KL_ONS_SYNC_IAE "Offsetdrehzahl auf Öffnen-/Schliessdrehzahlschwelle" CURVE 0x2227AC kl_si16_S6_S3 2000 UMR_U_MIN_1_1_0_S6_S3 -1000 1000
 /begin AXIS_DESCR STD_AXIS iIaeSigna.m_motist_iae UMR_NM__1_1_0_S6_S3 6 -400 1640 DEPOSIT ABSOLUTE MONOTONY MON_INCREASE /end AXIS_DESCR
/end CHARACTERISTIC
/begin CHARACTERISTIC KL_NS_GETREIN_OEFFNEN_MIN_IAE "Minimale Oeffnen-Drehzahlschwelle" CURVE 0x2227C8 kl_si16_S6_S3 6000 UMR_U_MIN_1_1_0_S6_S3 -1000 5000
 /begin AXIS_DESCR STD_AXIS NO_INPUT_QUANTITY UMR_GRADC__1_1_M40_S6_S3 6 -40 500 DEPOSIT ABSOLUTE MONOTONY MON_INCREASE /end AXIS_DESCR
/end CHARACTERISTIC
/begin CHARACTERISTIC KL_NS_ENPG3_SYNC_IAE "Drehzahlschwelle zur Schließ- und Öffnendrehzahlberechnung bei aktivem Ersatzprogramm ENPG3" CURVE 0x2227E4 kl_si16_S6_S3 6000 UMR_U_MIN_1_1_0_S6_S3 -1000 5000
 /begin AXIS_DESCR STD_AXIS iIaeSigna.ng_ab_iae UMR_U_MINSEC_1_1_0_S6_S3 4 -10000 10000 DEPOSIT ABSOLUTE MONOTONY MON_INCREASE /end AXIS_DESCR
/end CHARACTERISTIC
/begin CHARACTERISTIC SWI_NS_SYNC_IAE "Schalter zur Auswahl, welche Eingangsgröße für die Berechnung der Öffnen- Schließendrehzahl verwendet wird" VALUE 0x26E547 kw_ui8_S6_S3 3 UMR___1_1_0_S6_S3 1 4 /end CHARACTERISTIC
/begin CHARACTERISTIC KF_NS_SYNC_E_IAE "Drehzahlschwelle über Leerlaufdrehzahl, ab der das Anfahrelement geschlossen werden kann" MAP 0x2227F8 kf_si16_S6_S3 3000 UMR_U_MIN_1_1_0_S6_S3 -1000 2000
 /begin AXIS_DESCR STD_AXIS iIaeSigna.x_kf_ns_sync_iae UMR___1_1000_0_S6_S3 9 -30 30 DEPOSIT ABSOLUTE MONOTONY MON_INCREASE /end AXIS_DESCR
 /begin AXIS_DESCR STD_AXIS iIaeSigna.ng_ab_iae UMR_U_MINSEC_1_1_0_S6_S3 6 -10000 10000 DEPOSIT ABSOLUTE MONOTONY MON_INCREASE /end AXIS_DESCR
/end CHARACTERISTIC
/begin CHARACTERISTIC KF_NS_SYNC_H_IAE "Drehzahlschwelle über Leerlaufdrehzahl, ab der das Anfahrelement geschlossen werden kann" MAP 0x22288C kf_si16_S6_S3 3000 UMR_U_MIN_1_1_0_S6_S3 -1000 2000
 /begin AXIS_DESCR STD_AXIS iIaeSigna.x_kf_ns_sync_iae UMR___1_1000_0_S6_S3 9 -30 30 DEPOSIT ABSOLUTE MONOTONY MON_INCREASE /end AXIS_DESCR
 /begin AXIS_DESCR STD_AXIS iIaeSigna.ng_ab_iae UMR_U_MINSEC_1_1_0_S6_S3 6 -10000 10000 DEPOSIT ABSOLUTE MONOTONY MON_INCREASE /end AXIS_DESCR
/end CHARACTERISTIC
/begin CHARACTERISTIC KF_NS_SYNC_HYS_H_IAE "Hysterese für KF_NS_SYNC_IAE im H-Fahrmodus" MAP 0x222920 kf_si16_S6_S3 5000 UMR_U_MIN_1_1_0_S6_S3 0 5000
 /begin AXIS_DESCR STD_AXIS NO_INPUT_QUANTITY UMR_PROZENT__20_51_0_S6_S3 4 0 100 DEPOSIT ABSOLUTE MONOTONY MON_INCREASE /end AXIS_DESCR
 /begin AXIS_DESCR STD_AXIS iIaeSigna.ng_ab_iae UMR_U_MINSEC_1_1_0_S6_S3 4 -10000 10000 DEPOSIT ABSOLUTE MONOTONY MON_INCREASE /end AXIS_DESCR
/end CHARACTERISTIC
/begin CHARACTERISTIC KF_NS_SYNC_HYS_E_IAE "Hysterese für KF_NS_SYNC_IAE im E-Fahrmodus" MAP 0x222958 kf_si16_S6_S3 5000 UMR_U_MIN_1_1_0_S6_S3 0 5000
 /begin AXIS_DESCR STD_AXIS NO_INPUT_QUANTITY UMR_PROZENT__20_51_0_S6_S3 4 0 100 DEPOSIT ABSOLUTE MONOTONY MON_INCREASE /end AXIS_DESCR
 /begin AXIS_DESCR STD_AXIS iIaeSigna.ng_ab_iae UMR_U_MINSEC_1_1_0_S6_S3 4 -10000 10000 DEPOSIT ABSOLUTE MONOTONY MON_INCREASE /end AXIS_DESCR
/end CHARACTERISTIC
/begin CHARACTERISTIC KF_NS_SYNC_HYS_H_ECO_IAE "Hysterese für KF_NS_SYNC_IAE im H-Fahrmodusund ECO" MAP 0x222990 kf_si16_S6_S3 5000 UMR_U_MIN_1_1_0_S6_S3 0 5000
 /begin AXIS_DESCR STD_AXIS NO_INPUT_QUANTITY UMR_PROZENT__20_51_0_S6_S3 4 0 100 DEPOSIT ABSOLUTE MONOTONY MON_INCREASE /end AXIS_DESCR
 /begin AXIS_DESCR STD_AXIS iIaeSigna.ng_ab_iae UMR_U_MINSEC_1_1_0_S6_S3 4 -10000 10000 DEPOSIT ABSOLUTE MONOTONY MON_INCREASE /end AXIS_DESCR
/end CHARACTERISTIC
/begin CHARACTERISTIC KF_NS_SYNC_HYS_E_ECO_IAE "Hysterese für KF_NS_SYNC_IAE im E-Fahrmodus und ECO" MAP 0x2229C8 kf_si16_S6_S3 5000 UMR_U_MIN_1_1_0_S6_S3 0 5000
 /begin AXIS_DESCR STD_AXIS NO_INPUT_QUANTITY UMR_PROZENT__20_51_0_S6_S3 4 0 100 DEPOSIT ABSOLUTE MONOTONY MON_INCREASE /end AXIS_DESCR
 /begin AXIS_DESCR STD_AXIS iIaeSigna.ng_ab_iae UMR_U_MINSEC_1_1_0_S6_S3 4 -10000 10000 DEPOSIT ABSOLUTE MONOTONY MON_INCREASE /end AXIS_DESCR
/end CHARACTERISTIC
/begin CHARACTERISTIC KL_F_NUE_IAE "Faktor auf nue-Wert zur Überführung auf den Wert 0" CURVE 0x222A00 kl_si16_S6_S3 1 UMR___1_100_0_S6_S3 0 1
 /begin AXIS_DESCR STD_AXIS iIaeSigna.n_mot_iae UMR_U_MIN_1_1_0_S6_S3 4 0 8160 DEPOSIT ABSOLUTE MONOTONY MON_INCREASE /end AXIS_DESCR
/end CHARACTERISTIC
/begin CHARACTERISTIC KL_NS_ASRREGELT_SYNC_IAE "Drehzahlschwelle zur Schliess- und Öffnendrehzahlberechnung bei aktiver elektr. Differenzialsperre" CURVE 0x222A14 kl_si16_S6_S3 6000 UMR_U_MIN_1_1_0_S6_S3 -1000 5000
 /begin AXIS_DESCR STD_AXIS iIaeSigna.n_motsoll_ll_iae UMR_U_MIN_1_1_0_S6_S3 4 0 8000 DEPOSIT ABSOLUTE MONOTONY MON_INCREASE /end AXIS_DESCR
/end CHARACTERISTIC
/begin CHARACTERISTIC NS_ASRREGELT_SYNC_HYS_H_IAE "Hysterese auf Drehzahlschwelle zur Oeffnendrehzahlberechnung bei aktivem Anfahrregler-Eingriff" VALUE 0x26D5DE kw_si16_S6_S3 5000 UMR_U_MIN_1_1_0_S6_S3 0 5000 /end CHARACTERISTIC
/begin CHARACTERISTIC NS_ASRREGELT_SYNC_HYS_E_IAE "Hysterese auf Drehzahlschwelle zur Oeffnendrehzahlberechnung bei aktivem Anfahrregler-Eingriff" VALUE 0x26D5E0 kw_si16_S6_S3 5000 UMR_U_MIN_1_1_0_S6_S3 0 5000 /end CHARACTERISTIC
/begin CHARACTERISTIC SWI_NMOTSOLL_LL_E_IAE "Schalter zur Auswahl der Solllleerlaufdrehzahlberechnung beim elektrischen Fahren mit Schlupf" VALUE 0x26E548 kw_ui8_S6_S3 2 UMR___1_1_0_S6_S3 0 2 /end CHARACTERISTIC
/begin CHARACTERISTIC NS_EMLL_MIN_IAE "Minimale EM-Leerlaufdrehzahl" VALUE 0x26D5E2 kw_si16_S6_S3 1000 UMR_U_MIN_1_1_0_S6_S3 0 1000 /end CHARACTERISTIC
/begin CHARACTERISTIC VZ_NAB_IAE "Verzögerungszeit Abtriebsdrehzahl" VALUE 0x26E549 kw_ui8_S6_S3 90 UMR_MSEC__1_1_0_S6_S3 0 90 /end CHARACTERISTIC
/begin CHARACTERISTIC VZ_NT_IAE "Verzögerungszeit Turbinendrehzahl" VALUE 0x26E54A kw_ui8_S6_S3 90 UMR_MSEC__1_1_0_S6_S3 0 90 /end CHARACTERISTIC
/begin CHARACTERISTIC KL_VZ_MMOTIST_IAE "Verzögerungszeit Motoristmoment incl.aller Eingriffe" CURVE 0x222A28 kl_si16_S6_S3 90 UMR_MSEC__1_1_0_S6_S3 0 90
 /begin AXIS_DESCR STD_AXIS iIaeSigna.n_mot_iae UMR_U_MIN_1_1_0_S6_S3 4 0 8160 DEPOSIT ABSOLUTE MONOTONY MON_INCREASE /end AXIS_DESCR
/end CHARACTERISTIC
/begin CHARACTERISTIC KL_VZ_MMOTISTOE_IAE "Verzögerungszeit Motoristmoment ohne Eingriffe" CURVE 0x222A3C kl_si16_S6_S3 90 UMR_MSEC__1_1_0_S6_S3 0 90
 /begin AXIS_DESCR STD_AXIS iIaeSigna.n_mot_iae UMR_U_MIN_1_1_0_S6_S3 4 0 8160 DEPOSIT ABSOLUTE MONOTONY MON_INCREASE /end AXIS_DESCR
/end CHARACTERISTIC
/begin CHARACTERISTIC KL_VZ_MMOTSOLLOE_IAE "Verzögerungszeit Motorsollmoment ohne Eingriffe" CURVE 0x222A50 kl_si16_S6_S3 90 UMR_MSEC__1_1_0_S6_S3 0 90
 /begin AXIS_DESCR STD_AXIS iIaeSigna.n_mot_iae UMR_U_MIN_1_1_0_S6_S3 4 0 8160 DEPOSIT ABSOLUTE MONOTONY MON_INCREASE /end AXIS_DESCR
/end CHARACTERISTIC
/begin CHARACTERISTIC KL_VZ_MMOTGEM_IAE "Verzögerungszeit des gemittelten Motormoment" CURVE 0x222A64 kl_si16_S6_S3 90 UMR_MSEC__1_1_0_S6_S3 0 90
 /begin AXIS_DESCR STD_AXIS iIaeSigna.n_mot_iae UMR_U_MIN_1_1_0_S6_S3 4 0 8160 DEPOSIT ABSOLUTE MONOTONY MON_INCREASE /end AXIS_DESCR
/end CHARACTERISTIC
/begin CHARACTERISTIC F_MMOT_GEM_IAE "Faktor zur Berechnung von m_motgem_iae" VALUE 0x26D5E4 kw_si16_S6_S3 1 UMR___1_100_0_S6_S3 0 1 /end CHARACTERISTIC
/begin CHARACTERISTIC F_MMOTIST_GEM_IAE "Faktor zur Berechnung von m_motgem_iae" VALUE 0x26D5E6 kw_si16_S6_S3 1 UMR___1_100_0_S6_S3 0 1 /end CHARACTERISTIC
/begin CHARACTERISTIC F_MMOTSOLL_GEM_IAE "Faktor zur Berechnung von m_motgem_iae" VALUE 0x26D5E8 kw_si16_S6_S3 1 UMR___1_100_0_S6_S3 0 1 /end CHARACTERISTIC
/begin CHARACTERISTIC NS_NDGETREINLLBASIS_IAE "Drehzahlwert zur Bildung von nd_getrein_iae, wenn Schalter SWI_NDGETREINLLBASIS_IAE auf true" VALUE 0x26D5EA kw_si16_S6_S3 5000 UMR_U_MIN_1_1_0_S6_S3 0 5000 /end CHARACTERISTIC
/begin CHARACTERISTIC SWI_NDGETREINLLBASIS_IAE "Schalter um Ersatzwert NS_NDGETREINLLBASIS_IAE zur Bildung von nd_getrein_iae zu aktivieren." VALUE 0x26E54B kw_bool8_S6_S3 1 UMR___1_1_0_S6_S3 0 1 /end CHARACTERISTIC
/begin CHARACTERISTIC PS_BREMS_POSN_IAE "Bremsdruckschwelle zur Aktivierung der Abwürgschutzfkt." VALUE 0x26D5EC kw_si16_S6_S3 100 UMR_BAR__1_100_0_S6_S3 0 100 /end CHARACTERISTIC
/begin CHARACTERISTIC NDS_POSN_IAE "Differenzdrehzahlschwelle zur LL-Drehzahl zur Aktivierung der Abwürgschutzfkt" VALUE 0x26D5EE kw_si16_S6_S3 2000 UMR_U_MIN_1_1_0_S6_S3 -1000 1000 /end CHARACTERISTIC
/begin CHARACTERISTIC NDS_NDIAE_POSN_IAE "IAE-Differenzdrehzahlschwelle, ab der auf Differenzdrehzahl in der Abwürgeschutzfkt erkannt wird" VALUE 0x26D5F0 kw_si16_S6_S3 5000 UMR_U_MIN_1_1_0_S6_S3 0 5000 /end CHARACTERISTIC
/begin CHARACTERISTIC NS_ABPOSN_RSETZ_IAE "Abtriebsdrehzahlschwelle zum Rücksetzen der kfl_sollneutral Anforderung" VALUE 0x26D5F2 kw_si16_S6_S3 1000 UMR_U_MIN_1_1_0_S6_S3 0 1000 /end CHARACTERISTIC
/begin CHARACTERISTIC ND_MOTPOSN_RSETZ_IAE "Drehzahlschwelle zur LL-Drehzahl um Abwürgeschutzfkt aufzuheben" VALUE 0x26D5F4 kw_si16_S6_S3 2000 UMR_U_MIN_1_1_0_S6_S3 -1000 1000 /end CHARACTERISTIC
/begin CHARACTERISTIC NGS_GETREIN_POSN_IAE "Getriebeeingangsdrehzahlgradientenschwelle zur Aktivierung der Abwürgschutzfkt" VALUE 0x26D5F6 kw_si16_S6_S3 10000 UMR_U_MINSEC_1_1_0_S6_S3 -10000 0 /end CHARACTERISTIC
/begin CHARACTERISTIC NGS_HYSGETREIN_POSN_IAE "Hysterese zur Deaktivierung der Abwürgschutzfkt" VALUE 0x26D5F8 kw_si16_S6_S3 20000 UMR_U_MINSEC_1_1_0_S6_S3 -10000 10000 /end CHARACTERISTIC
/begin CHARACTERISTIC NGS_MOT_POSN_IAE "Motordrehzahlgradientenschwelle zur Aktivierung der Abwürgschutzfkt" VALUE 0x26D5FA kw_si16_S6_S3 10000 UMR_U_MINSEC_1_1_0_S6_S3 -10000 0 /end CHARACTERISTIC
/begin CHARACTERISTIC NGS_AB_POSN_IAE "Abtriebsdrehzahlgradientenschwelle zur Aktivierung der Abwürgschutzfkt" VALUE 0x26D5FC kw_si16_S6_S3 10000 UMR_U_MINSEC_1_1_0_S6_S3 -10000 0 /end CHARACTERISTIC
/begin CHARACTERISTIC NGS_HYSAB_POSN_IAE "Hysterese auf Abtriebsdrehzahlgradientenschwelle zur Deaktivierung der Abwürgschutzfkt" VALUE 0x26D5FE kw_si16_S6_S3 20000 UMR_U_MINSEC_1_1_0_S6_S3 -10000 10000 /end CHARACTERISTIC
/begin CHARACTERISTIC KF_NDMOT_POSN_IAE "Drehzahlschwelle zur Erkennung Motordrücken um kfl_sollneutral_iae zu setzen" MAP 0x222A78 kf_si16_S6_S3 2000 UMR_U_MIN_1_1_0_S6_S3 -1000 1000
 /begin AXIS_DESCR STD_AXIS iIaeSigna.n_motsoll_ll_iae UMR_U_MIN_1_1_0_S6_S3 6 -10000 10000 DEPOSIT ABSOLUTE MONOTONY MON_INCREASE /end AXIS_DESCR
 /begin AXIS_DESCR STD_AXIS iIaeSigna.m_motist_iae UMR_NM__1_1_0_S6_S3 6 -300 1500 DEPOSIT ABSOLUTE MONOTONY MON_INCREASE /end AXIS_DESCR
/end CHARACTERISTIC
/begin CHARACTERISTIC TAB_ZIELGANGPOSN_IAE "Tab-Wert 1 = Freigabe des Zielgangs zur Aktivierung des Abwürgeschutzes" CURVE 0x222AE0 tab_bool8_S6_S3 1 UMR___1_1_0_S6_S3 0 1
 /begin AXIS_DESCR FIX_AXIS NO_INPUT_QUANTITY UMR___1_1_0_S6_S3 10 -1 8 FIX_AXIS_PAR_DIST -1 1 10 /end AXIS_DESCR
/end CHARACTERISTIC
/begin CHARACTERISTIC NDS_MREIBZU_IAE "Drehzahlschwelle für Reibmomentberechnung im Zustand ZU" VALUE 0x26D600 kw_si16_S6_S3 1000 UMR_U_MIN_1_1_0_S6_S3 0 1000 /end CHARACTERISTIC
/begin CHARACTERISTIC NDS_HYSMREIBZU_IAE "Hysterese für Drehzahlschwelle für Reibmomentberechnung im Zustand ZU" VALUE 0x26D602 kw_si16_S6_S3 1000 UMR_U_MIN_1_1_0_S6_S3 0 1000 /end CHARACTERISTIC
/begin CHARACTERISTIC KL_MSCHLEPPOFFEN_IAE "Schleppmoment der IAE im offenem Zustand" CURVE 0x222AF0 kl_si16_S6_S3 100 UMR_NM__1_1_0_S6_S3 0 100
 /begin AXIS_DESCR STD_AXIS NO_INPUT_QUANTITY UMR_GRADC__1_1_M40_S6_S3 4 -40 215 DEPOSIT ABSOLUTE MONOTONY MON_INCREASE /end AXIS_DESCR
/end CHARACTERISTIC
/begin CHARACTERISTIC SWI_NMOTLLREG_AKTIV_IAE "Schalter zur Berücksichtigung ob der Motorleerlaufregler aktiv ist in den Übergangsbedingungen" VALUE 0x26E54C kw_bool8_S6_S3 1 UMR___1_1_0_S6_S3 0 1 /end CHARACTERISTIC
/begin CHARACTERISTIC KL_T_PT2_NEIGUNG_IAE "Filterzeitkonstante für Filterung des Abtriebdrehzahlgradienten zur Neigungsberechnung" CURVE 0x222B04 kl_si16_S6_S3 9970 UMR_MSEC__1_1_0_S6_S3 30 10000
 /begin AXIS_DESCR STD_AXIS NO_INPUT_QUANTITY UMR_U_MINMSEC_1_1_0_S6_S3 4 -30000 30000 DEPOSIT ABSOLUTE MONOTONY MON_INCREASE /end AXIS_DESCR
/end CHARACTERISTIC
/begin CHARACTERISTIC F_NG_AB_NEIGUNG_IAE "Faktor auf Abtriebsdrehzahlgradient zur Korrekturrechnung der Neigung" VALUE 0x26D604 kw_si16_S6_S3 1 UMR___1_1000_0_S6_S3 0 1 /end CHARACTERISTIC
/begin CHARACTERISTIC TAB_SWI_ASRREGELT_IAE "Schalter zur Auswahl, ob ein ASR-Regeleingriff Einfluss auf die Öffnen-/Schließendrehzahlschwellen und Zustandübergänge Synchronisieren/Zu hat" CURVE 0x222B18 tab_bool8_S6_S3 1 UMR___1_1_0_S6_S3 0 1
 /begin AXIS_DESCR FIX_AXIS NO_INPUT_QUANTITY UMR___1_1_0_S6_S3 10 0 9 FIX_AXIS_PAR_DIST 0 1 10 /end AXIS_DESCR
/end CHARACTERISTIC
/begin CHARACTERISTIC NEIG_D_IAE "Neigungsschwelle in Position D oberhalb welcher eine Ausgabe einer min. EM-Drehzahl erfolgt" VALUE 0x26E54D kw_ui8_S6_S3 84.6667 UMR_GRAD__1_3_M128_S6_S3 -42.6666666667 42 /end CHARACTERISTIC
/begin CHARACTERISTIC NEIG_R_IAE "Neigungsschwelle in Position R oberhalb welcher eine Ausgabe einer min. EM-Drehzahl erfolgt" VALUE 0x26E54E kw_ui8_S6_S3 84.6667 UMR_GRAD__1_3_M128_S6_S3 -42.6666666667 42 /end CHARACTERISTIC
/begin CHARACTERISTIC NEIG_HYS_IAE "Hysterese auf Neigungsschwelle" VALUE 0x26E54F kw_ui8_S6_S3 84.6667 UMR_GRAD__1_3_M128_S6_S3 -42.6666666667 42 /end CHARACTERISTIC
/begin CHARACTERISTIC NS_ABNEIG_IAE "Abtriebsdrehzahlschwelle unterhalb welcher eine Ausgabe einer min. EM-Drehzahl möglich ist" VALUE 0x26D606 kw_ui16_S6_S3 2000 UMR_U_MIN_1_1_0_S6_S3 0 2000 /end CHARACTERISTIC
/begin CHARACTERISTIC NS_HYS_ABNEIG_IAE "Hysterese auf Abtriebsdrehzahlschwelle unterhalb welcher eine Ausgabe einer min. EM-Drehzahl möglich ist." VALUE 0x26D608 kw_ui16_S6_S3 2000 UMR_U_MIN_1_1_0_S6_S3 0 2000 /end CHARACTERISTIC
/begin CHARACTERISTIC SWI_NEIGUNGGEF_IAE "Schalter zur Auswahl welches Neigungssignal zur Ausgabe der minimalen E-Maschinendrehzahl verwendet werden soll" VALUE 0x26E550 kw_ui8_S6_S3 2 UMR___1_1_0_S6_S3 1 3 /end CHARACTERISTIC
/begin CHARACTERISTIC SWI_BREMS_SOLLNEUTRAL_IAE "Schalter zur Auswahl, ob die Bremsbedingung bei der Aktivierung der Sollneutralfunktionalität als erfüllt gilt" VALUE 0x26E551 kw_bool8_S6_S3 1 UMR___1_1_0_S6_S3 0 1 /end CHARACTERISTIC
/begin CHARACTERISTIC KF_MUE_IAE "Reibwert" MAP 0x220E64 kf_si16_S6_S3 300 UMR_NM_BAR_1_1_0_S6_S3 0 300
 /begin AXIS_DESCR STD_AXIS NO_INPUT_QUANTITY UMR_U_MIN_1_1_0_S6_S3 6 -8000 8000 DEPOSIT ABSOLUTE MONOTONY MON_INCREASE /end AXIS_DESCR
 /begin AXIS_DESCR STD_AXIS NO_INPUT_QUANTITY UMR_NM__1_1_0_S6_S3 6 -400 1640 DEPOSIT ABSOLUTE MONOTONY MON_INCREASE /end AXIS_DESCR
/end CHARACTERISTIC
/begin CHARACTERISTIC KF_MUE_OFFSET_IAE "Offset auf Reibwert" MAP 0x220ECC kf_si16_S6_S3 300 UMR_NM_BAR_1_1_0_S6_S3 0 300
 /begin AXIS_DESCR STD_AXIS NO_INPUT_QUANTITY UMR_GRADC__1_1_M40_S6_S3 6 -40 215 DEPOSIT ABSOLUTE MONOTONY MON_INCREASE /end AXIS_DESCR
 /begin AXIS_DESCR STD_AXIS NO_INPUT_QUANTITY UMR_NM__1_1_0_S6_S3 6 -400 1640 DEPOSIT ABSOLUTE MONOTONY MON_INCREASE /end AXIS_DESCR
/end CHARACTERISTIC
/begin CHARACTERISTIC KL_F_MUE_IAE "Korrektur für Übertragungsfähigkeit" CURVE 0x220F34 kl_si16_S6_S3 1.7 UMR___1_100_0_S6_S3 0.3 2
 /begin AXIS_DESCR STD_AXIS NO_INPUT_QUANTITY UMR_GRADC__1_1_M40_S6_S3 4 -40 500 DEPOSIT ABSOLUTE MONOTONY MON_INCREASE /end AXIS_DESCR
/end CHARACTERISTIC
/begin CHARACTERISTIC MPT_MUE_IAE "Filterkonstante für PT1-Filter für mue_iae" VALUE 0x26E4FB kw_ui8_S6_S3 1 UMR___1_100_0_S6_S3 0 1 /end CHARACTERISTIC
/begin CHARACTERISTIC MPT_PSTELLBASIS_IAE "Filterkonstante für PT1-Filter für p_stellbasis" VALUE 0x26E4FC kw_ui8_S6_S3 1 UMR___1_100_0_S6_S3 0 1 /end CHARACTERISTIC
/begin CHARACTERISTIC TAB_T_P_HYS_SCHLEIFE_IAE "Zeit für die Dauer der Hystereseschleife" CURVE 0x220F48 tab_ui8_S6_S3 500 UMR_MSEC__10_1_0_S6_S3 0 500
 /begin AXIS_DESCR FIX_AXIS NO_INPUT_QUANTITY UMR___1_1_0_S6_S3 10 0 9 FIX_AXIS_PAR_DIST 0 1 10 /end AXIS_DESCR
/end CHARACTERISTIC
/begin CHARACTERISTIC TAB_MPT_P_HYS_SCHLEIFE_IAE "Filterkonstante für PT1-Filter für Druck am Ende der Hystereseschleife" CURVE 0x220F58 tab_ui8_S6_S3 1 UMR___1_100_0_S6_S3 0 1
 /begin AXIS_DESCR FIX_AXIS NO_INPUT_QUANTITY UMR___1_1_0_S6_S3 10 0 9 FIX_AXIS_PAR_DIST 0 1 10 /end AXIS_DESCR
/end CHARACTERISTIC
/begin CHARACTERISTIC TAB_P_HYS_SCHLEIFE_IAE "Fußpunktdruck der Hysterseschleife" CURVE 0x220F68 tab_si16_S6_S3 20 UMR_BAR__1_1000_0_S6_S3 -10 10
 /begin AXIS_DESCR FIX_AXIS NO_INPUT_QUANTITY UMR___1_1_0_S6_S3 10 0 9 FIX_AXIS_PAR_DIST 0 1 10 /end AXIS_DESCR
/end CHARACTERISTIC
/begin CHARACTERISTIC TAB_SWI_HYS_SCHLEIFE_IAE "Schalter zur Aktivierung der Hysterseschleife" CURVE 0x220F80 tab_bool8_S6_S3 1 UMR___1_1_0_S6_S3 0 1
 /begin AXIS_DESCR FIX_AXIS iIaeKordi.z_iae UMR___1_1_0_S6_S3 10 0 9 FIX_AXIS_PAR_DIST 0 1 10 /end AXIS_DESCR
/end CHARACTERISTIC
/begin CHARACTERISTIC TAB_SWI_P_STELL_MAX_IAE "Tabelle zur Auswahl, in welchem Gang die IAE mit Maximaldruck angesteuert werden kann" CURVE 0x220F90 tab_bool8_S6_S3 1 UMR___1_1_0_S6_S3 0 1
 /begin AXIS_DESCR FIX_AXIS NO_INPUT_QUANTITY UMR___1_1_0_S6_S3 10 -1 8 FIX_AXIS_PAR_DIST -1 1 10 /end AXIS_DESCR
/end CHARACTERISTIC
/begin CHARACTERISTIC TS_INITHYS_SCHLEIFE_IAE "Zeitschwelle zur Auslösung der Hystereseschleife bei Zustandsübergängen" VALUE 0x26D56A kw_ui16_S6_S3 2550 UMR_MSEC__10_1_0_S6_S3 0 2550 /end CHARACTERISTIC
/begin CHARACTERISTIC PDS_HYS_SCHLEIFE_IAE "Druckschwelle der Hysterseschleife" VALUE 0x26D56C kw_si16_S6_S3 10 UMR_BAR__1_1000_0_S6_S3 -10 0 /end CHARACTERISTIC
/begin CHARACTERISTIC SWI_HYSKOMP_KRIECH_IAE "Schalter zum Erlauben der Hysteresekompensation im Kriechen" VALUE 0x26E4FD kw_bool8_S6_S3 1 UMR___1_1_0_S6_S3 0 1 /end CHARACTERISTIC
/begin CHARACTERISTIC MS_HYSKOMP_KRIECHEN_IAE "Vorsteuermoment im Zustand Angelegt bei betätigter Feststellbremse" VALUE 0x26D56E kw_si16_S6_S3 100 UMR_NM__1_1_0_S6_S3 0 100 /end CHARACTERISTIC
/begin CHARACTERISTIC PS_BREMS_HYSKOMP_KRIECH_IAE "Vorsteuermoment im Zustand Angelegt bei betätigter Feststellbremse" VALUE 0x26D570 kw_si16_S6_S3 50 UMR_BAR__1_100_0_S6_S3 0 50 /end CHARACTERISTIC
/begin CHARACTERISTIC MPT_PO_HYSKOMP_IAE "Filterkonstante für PT1-Filter für Hysteresekompensation" VALUE 0x26E4FE kw_ui8_S6_S3 0.99 UMR___1_100_0_S6_S3 0.01 1 /end CHARACTERISTIC
/begin CHARACTERISTIC PG_HYSKOMP_IAE "min. Druckgradient für Hysteresekompensation" VALUE 0x26D572 kw_si16_S6_S3 10 UMR_BAR_SEC_1_10_0_S6_S3 -10 0 /end CHARACTERISTIC
/begin CHARACTERISTIC KL_PO_HYSKOMP_IAE "Druck für Hysteresekompensation(neg.)" CURVE 0x220FA0 kl_si16_S6_S3 2 UMR_BAR__1_1000_0_S6_S3 -2 0
 /begin AXIS_DESCR STD_AXIS NO_INPUT_QUANTITY UMR_GRADC__1_1_M40_S6_S3 4 -40 215 DEPOSIT ABSOLUTE MONOTONY MON_INCREASE /end AXIS_DESCR
/end CHARACTERISTIC
/begin CHARACTERISTIC TAB_F_PO_DYN_ANFAHR_IAE "Gangfaktor Druckoffset po_dyn_iae" CURVE 0x220FB4 tab_si16_S6_S3 1 UMR___1_100_0_S6_S3 0 1
 /begin AXIS_DESCR FIX_AXIS NO_INPUT_QUANTITY UMR___1_1_0_S6_S3 10 0 9 FIX_AXIS_PAR_DIST 0 1 10 /end AXIS_DESCR
/end CHARACTERISTIC
/begin CHARACTERISTIC PO_HYSKOMP_ZIEL_IAE "Zielwert für PT1-Filter für Hysteresekompensation" VALUE 0x26D574 kw_si16_S6_S3 2 UMR_BAR__1_1000_0_S6_S3 -2 0 /end CHARACTERISTIC
/begin CHARACTERISTIC KL_T_HALTE_HYSKOMP_IAE "Haltezeit für Hysteresekompensatin" CURVE 0x220FCC kl_ui16_S6_S3 2000 UMR_MSEC__10_1_0_S6_S3 0 2000
 /begin AXIS_DESCR STD_AXIS NO_INPUT_QUANTITY UMR_GRADC__1_1_M40_S6_S3 4 -40 215 DEPOSIT ABSOLUTE MONOTONY MON_INCREASE /end AXIS_DESCR
/end CHARACTERISTIC
/begin CHARACTERISTIC KL_PO_DYN_ANFAHR_IAE "Faktor auf dynamischen Offset in Anfahren" CURVE 0x220FE0 kl_si16_S6_S3 10 UMR_BAR__1_1000_0_S6_S3 0 10
 /begin AXIS_DESCR STD_AXIS NO_INPUT_QUANTITY UMR_GRADC__1_1_M40_S6_S3 4 -40 215 DEPOSIT ABSOLUTE MONOTONY MON_INCREASE /end AXIS_DESCR
/end CHARACTERISTIC
/begin CHARACTERISTIC KF_PO_DYN_ANFAHR_IAE "Druckoffset beim Übergang Kriechen -> Schliessen" MAP 0x220FF4 kf_si16_S6_S3 10 UMR_BAR__1_1000_0_S6_S3 0 10
 /begin AXIS_DESCR STD_AXIS NO_INPUT_QUANTITY UMR_BAR__1_1000_0_S6_S3 4 -30 30 DEPOSIT ABSOLUTE MONOTONY MON_INCREASE /end AXIS_DESCR
 /begin AXIS_DESCR STD_AXIS NO_INPUT_QUANTITY UMR_PROZENT__20_51_0_S6_S3 4 0 100 DEPOSIT ABSOLUTE MONOTONY MON_INCREASE /end AXIS_DESCR
/end CHARACTERISTIC
/begin CHARACTERISTIC KL_F_PO_DYN_KRIECH_IAE "Faktor auf Druckoffset beim Übergang ANGELEGT -> Kriechen" CURVE 0x22102C kl_si16_S6_S3 5 UMR___1_100_0_S6_S3 0 5
 /begin AXIS_DESCR STD_AXIS NO_INPUT_QUANTITY UMR_MSEC__10_1_0_S6_S3 4 0 2550 DEPOSIT ABSOLUTE MONOTONY MON_INCREASE /end AXIS_DESCR
/end CHARACTERISTIC
/begin CHARACTERISTIC KL_PO_DYN_KRIECH_IAE "Druckoffset beim Übergang ANGELEGT -> Kriechen" CURVE 0x221040 kl_si16_S6_S3 10 UMR_BAR__1_1000_0_S6_S3 0 10
 /begin AXIS_DESCR STD_AXIS NO_INPUT_QUANTITY UMR_GRADC__1_1_M40_S6_S3 4 -40 215 DEPOSIT ABSOLUTE MONOTONY MON_INCREASE /end AXIS_DESCR
/end CHARACTERISTIC
/begin CHARACTERISTIC KL_T_PO_DYN_KRIECH_IAE "Dauer des Druckoffsets beim Übergang ANGELEGT -> Kriechen" CURVE 0x221054 kl_ui16_S6_S3 20000 UMR_MSEC__10_1_0_S6_S3 0 20000
 /begin AXIS_DESCR STD_AXIS NO_INPUT_QUANTITY UMR_GRADC__1_1_M40_S6_S3 4 -40 215 DEPOSIT ABSOLUTE MONOTONY MON_INCREASE /end AXIS_DESCR
/end CHARACTERISTIC
/begin CHARACTERISTIC KL_T_PO_DYN_ANFAHR_IAE "Dauer des Druckoffsets beim Übergang Kriechen -> Schliessen" CURVE 0x221068 kl_ui16_S6_S3 20000 UMR_MSEC__10_1_0_S6_S3 0 20000
 /begin AXIS_DESCR STD_AXIS NO_INPUT_QUANTITY UMR_GRADC__1_1_M40_S6_S3 4 -40 215 DEPOSIT ABSOLUTE MONOTONY MON_INCREASE /end AXIS_DESCR
/end CHARACTERISTIC
/begin CHARACTERISTIC MPT_PO_DYN_KRIECH_IAE "Filterkonstante für PT1-Filter zum Abfiltern des Druckoffsets" VALUE 0x26E4FF kw_ui8_S6_S3 0.99 UMR___1_100_0_S6_S3 0.01 1 /end CHARACTERISTIC
/begin CHARACTERISTIC MPT_PO_DYN_ANFAHR_IAE "Filterkonstante für PT1-Filter zum Abfiltern des Druckoffsets" VALUE 0x26E500 kw_ui8_S6_S3 0.99 UMR___1_100_0_S6_S3 0.01 1 /end CHARACTERISTIC
/begin CHARACTERISTIC SWI_PO_DYN_KRIECH_IAE "Schalter zum Erlauben des dynamischen Druckoffsets" VALUE 0x26E501 kw_bool8_S6_S3 1 UMR___1_1_0_S6_S3 0 1 /end CHARACTERISTIC
/begin CHARACTERISTIC SWI_PO_DYN_ANFAHR_IAE "Schalter zum Erlauben des dynamischen Druckoffsets" VALUE 0x26E502 kw_bool8_S6_S3 1 UMR___1_1_0_S6_S3 0 1 /end CHARACTERISTIC
/begin CHARACTERISTIC TAB_MIN_ND_IAEKFMUE_IAE "Zustandsabhängige Mindestdifferenzdrehzahl für Kennfeldzugriff KF_MUE_IAE" CURVE 0x22107C tab_si16_S6_S3 2000 UMR_U_MIN_1_1_0_S6_S3 0 2000
 /begin AXIS_DESCR FIX_AXIS iIaeKordi.z_iae UMR___1_1_0_S6_S3 10 0 9 FIX_AXIS_PAR_DIST 0 1 10 /end AXIS_DESCR
/end CHARACTERISTIC
/begin CHARACTERISTIC TAB_MIN_ND_IAEKFMUE_ENTKOPPL "Zustandsabhängige Mindestdifferenzdrehzahl für Kennfeldzugriff KF_MUE_IAE" CURVE 0x221094 tab_si16_S6_S3 2000 UMR_U_MIN_1_1_0_S6_S3 0 2000
 /begin AXIS_DESCR FIX_AXIS iKasEkopl.z_entkoppeln UMR___1_1_0_S6_S3 4 0 3 FIX_AXIS_PAR_DIST 0 1 4 /end AXIS_DESCR
/end CHARACTERISTIC
/begin CHARACTERISTIC SWI_M_BASIS_ANFAHRT_E_IAE "Schalter zur Wahl des Basismoments im Anfahren" VALUE 0x26E4EF kw_ui8_S6_S3 3 UMR___1_1_0_S6_S3 1 4 /end CHARACTERISTIC
/begin CHARACTERISTIC SWI_M_BASIS_ANFAHRT_MIN_E_IAE "Schalter zur Auswahl des minimalen Basismoments beim Anfahren" VALUE 0x26E4F0 kw_ui8_S6_S3 3 UMR___1_1_0_S6_S3 1 4 /end CHARACTERISTIC
/begin CHARACTERISTIC KF_KD_ANFAHRT_E_IAE "D-Anteil für PID-Regler im E- oder H-Anfahren" MAP 0x22026C kf_fl32_S6_S3 9.999 UMR___1_1_0_3_S6_S3 0.001 10 FORMAT "%5.3"
 /begin AXIS_DESCR STD_AXIS NO_INPUT_QUANTITY UMR_U_MINSEC_1_1_0_S6_S3 6 -10000 10000 DEPOSIT ABSOLUTE MONOTONY MON_INCREASE /end AXIS_DESCR
 /begin AXIS_DESCR STD_AXIS iIaeMomen.xd_iae UMR___1_1_0_S6_S3 6 -10000 10000 DEPOSIT ABSOLUTE MONOTONY MON_INCREASE FORMAT "%4.2" /end AXIS_DESCR
/end CHARACTERISTIC
/begin CHARACTERISTIC KF_KI_ANFAHRT_E_IAE "I-Anteil für PID-Regler im E- oder H-Anfahren" MAP 0x220334 kf_fl32_S6_S3 9.999 UMR___1_1_0_3_S6_S3 0.001 10 FORMAT "%5.3"
 /begin AXIS_DESCR STD_AXIS NO_INPUT_QUANTITY UMR_U_MINSEC_1_1_0_S6_S3 6 -10000 10000 DEPOSIT ABSOLUTE MONOTONY MON_INCREASE /end AXIS_DESCR
 /begin AXIS_DESCR STD_AXIS iIaeMomen.xd_iae UMR___1_1_0_S6_S3 6 -10000 10000 DEPOSIT ABSOLUTE MONOTONY MON_INCREASE FORMAT "%4.2" /end AXIS_DESCR
/end CHARACTERISTIC
/begin CHARACTERISTIC KF_KP_ANFAHRT_E_IAE "P-Anteil für PID-Regler im E- oder H-Anfahren" MAP 0x2203FC kf_fl32_S6_S3 9.999 UMR___1_1_0_3_S6_S3 0.001 10 FORMAT "%5.3"
 /begin AXIS_DESCR STD_AXIS NO_INPUT_QUANTITY UMR_U_MINSEC_1_1_0_S6_S3 6 -10000 10000 DEPOSIT ABSOLUTE MONOTONY MON_INCREASE /end AXIS_DESCR
 /begin AXIS_DESCR STD_AXIS iIaeMomen.xd_iae UMR___1_1_0_S6_S3 6 -10000 10000 DEPOSIT ABSOLUTE MONOTONY MON_INCREASE FORMAT "%4.2" /end AXIS_DESCR
/end CHARACTERISTIC
/begin CHARACTERISTIC KF_F_KD_ANFAHRT_E_IAE "Faktor für D-Anteil für PID-Regler im E- oder H-Anfahren" MAP 0x2204C4 kf_fl32_S6_S3 1.999 UMR___1_1_0_3_S6_S3 0.001 2 FORMAT "%5.3"
 /begin AXIS_DESCR STD_AXIS NO_INPUT_QUANTITY UMR___1_1_0_S6_S3 6 -1 8 DEPOSIT ABSOLUTE MONOTONY MON_INCREASE FORMAT "%4.2" /end AXIS_DESCR
 /begin AXIS_DESCR STD_AXIS NO_INPUT_QUANTITY UMR_GRADC__1_1_0_S6_S3 6 -40 215 DEPOSIT ABSOLUTE MONOTONY MON_INCREASE /end AXIS_DESCR
/end CHARACTERISTIC
/begin CHARACTERISTIC KF_F_KI_ANFAHRT_E_IAE "Faktor für I-Anteil für PID-Regler im E- oder H-Anfahren" MAP 0x22058C kf_fl32_S6_S3 1.999 UMR___1_1_0_3_S6_S3 0.001 2 FORMAT "%5.3"
 /begin AXIS_DESCR STD_AXIS NO_INPUT_QUANTITY UMR___1_1_0_S6_S3 6 -1 8 DEPOSIT ABSOLUTE MONOTONY MON_INCREASE FORMAT "%4.2" /end AXIS_DESCR
 /begin AXIS_DESCR STD_AXIS NO_INPUT_QUANTITY UMR_GRADC__1_1_0_S6_S3 6 -40 215 DEPOSIT ABSOLUTE MONOTONY MON_INCREASE /end AXIS_DESCR
/end CHARACTERISTIC
/begin CHARACTERISTIC KF_F_KP_ANFAHRT_E_IAE "Faktor für P-Anteil für PID-Regler im E- oder H-Anfahren" MAP 0x220654 kf_fl32_S6_S3 1.999 UMR___1_1_0_3_S6_S3 0.001 2 FORMAT "%5.3"
 /begin AXIS_DESCR STD_AXIS NO_INPUT_QUANTITY UMR___1_1_0_S6_S3 6 -1 8 DEPOSIT ABSOLUTE MONOTONY MON_INCREASE FORMAT "%4.2" /end AXIS_DESCR
 /begin AXIS_DESCR STD_AXIS NO_INPUT_QUANTITY UMR_GRADC__1_1_0_S6_S3 6 -40 215 DEPOSIT ABSOLUTE MONOTONY MON_INCREASE /end AXIS_DESCR
/end CHARACTERISTIC
/begin CHARACTERISTIC KL_MPT_NMOTSOLLANFAHR_ROH_E_IAE "Filterparameter auf Zieldrehzahl" CURVE 0x22071C kl_si16_S6_S3 0.99 UMR___1_100_0_S6_S3 0.01 1
 /begin AXIS_DESCR STD_AXIS NO_INPUT_QUANTITY UMR_PROZENT_SEC_20_51_0_S6_S3 4 -11764.7058824 11764.7058824 DEPOSIT ABSOLUTE MONOTONY MON_INCREASE /end AXIS_DESCR
/end CHARACTERISTIC
/begin CHARACTERISTIC KF_T_PT2_NMOTANFAHR_E_IAE "Filterkonstante für PT2-Filter für Solldrehzahl im Anfahren" MAP 0x220730 kf_si16_S6_S3 4000 UMR_MSEC__1_1_0_S6_S3 0 4000
 /begin AXIS_DESCR STD_AXIS NO_INPUT_QUANTITY UMR_PROZENT__20_51_0_S6_S3 4 -3921.56862745 3921.56862745 DEPOSIT ABSOLUTE MONOTONY MON_INCREASE /end AXIS_DESCR
 /begin AXIS_DESCR STD_AXIS iIaeSigna.dkig_iae UMR_PROZENT_SEC_20_51_0_S6_S3 4 -3921.56862745 3921.56862745 DEPOSIT ABSOLUTE MONOTONY MON_INCREASE /end AXIS_DESCR
/end CHARACTERISTIC
/begin CHARACTERISTIC KL_F_M_PUAUF_ANFAHRT_E_IAE "Faktor, mit welchem das Pumpenaufnahmemoment m_puauf zur Bildung des Basisanfahrmoments m_basis_anfahrt_iae abgezogen wird" CURVE 0x220768 kl_si16_S6_S3 1 UMR___1_100_0_S6_S3 0 1
 /begin AXIS_DESCR STD_AXIS NO_INPUT_QUANTITY UMR_GRADC__1_1_M40_S6_S3 4 -40 215 DEPOSIT ABSOLUTE MONOTONY MON_INCREASE /end AXIS_DESCR
/end CHARACTERISTIC
/begin CHARACTERISTIC KL_F_M_SCHLEPP_ANFAHRT_E_IAE "Faktor, mit welchem das IAE-Schleppmoment m_schlepp_iae zur Bildung des Basisanfahrmoments m_basis_anfahrt_iae abgezogen wird" CURVE 0x22077C kl_si16_S6_S3 1 UMR___1_100_0_S6_S3 0 1
 /begin AXIS_DESCR STD_AXIS NO_INPUT_QUANTITY UMR_GRADC__1_1_M40_S6_S3 4 -40 215 DEPOSIT ABSOLUTE MONOTONY MON_INCREASE /end AXIS_DESCR
/end CHARACTERISTIC
/begin CHARACTERISTIC KF_OGNMOTANFAHR_SOLL_E_IAE "Offsetgradient der Sollanfahrdrehzahl beim E- oder H-Anfahren" MAP 0x220790 kf_si16_S6_S3 20000 UMR_U_MINSEC_1_1_0_S6_S3 -10000 10000
 /begin AXIS_DESCR STD_AXIS NO_INPUT_QUANTITY UMR_U_MIN_1_1_0_S6_S3 6 -10000 10000 DEPOSIT ABSOLUTE MONOTONY MON_INCREASE /end AXIS_DESCR
 /begin AXIS_DESCR STD_AXIS iIaeSigna.ng_getrein_iae UMR_U_MINSEC_1_1_0_S6_S3 6 -10000 10000 DEPOSIT ABSOLUTE MONOTONY MON_INCREASE /end AXIS_DESCR
/end CHARACTERISTIC
/begin CHARACTERISTIC SWI_M_BASIS_ANFAHRT_H_IAE "Schalter zur Wahl des Basismoments im Anfahren" VALUE 0x26E4F1 kw_ui8_S6_S3 3 UMR___1_1_0_S6_S3 1 4 /end CHARACTERISTIC
/begin CHARACTERISTIC SWI_M_BASIS_ANFAHRT_MIN_H_IAE "Schalter zur Auswahl des minimalen Basismoments beim Anfahren" VALUE 0x26E4F2 kw_ui8_S6_S3 3 UMR___1_1_0_S6_S3 1 4 /end CHARACTERISTIC
/begin CHARACTERISTIC KF_KD_ANFAHRT_H_IAE "D-Anteil für PID-Regler im E- oder H-Anfahren" MAP 0x2207F8 kf_fl32_S6_S3 9.999 UMR___1_1_0_3_S6_S3 0.001 10 FORMAT "%5.3"
 /begin AXIS_DESCR STD_AXIS NO_INPUT_QUANTITY UMR_U_MINSEC_1_1_0_S6_S3 6 -10000 10000 DEPOSIT ABSOLUTE MONOTONY MON_INCREASE /end AXIS_DESCR
 /begin AXIS_DESCR STD_AXIS iIaeMomen.xd_iae UMR___1_1_0_S6_S3 6 -10000 10000 DEPOSIT ABSOLUTE MONOTONY MON_INCREASE FORMAT "%4.2" /end AXIS_DESCR
/end CHARACTERISTIC
/begin CHARACTERISTIC KF_KI_ANFAHRT_H_IAE "I-Anteil für PID-Regler im E- oder H-Anfahren" MAP 0x2208C0 kf_fl32_S6_S3 9.999 UMR___1_1_0_3_S6_S3 0.001 10 FORMAT "%5.3"
 /begin AXIS_DESCR STD_AXIS NO_INPUT_QUANTITY UMR_U_MINSEC_1_1_0_S6_S3 6 -10000 10000 DEPOSIT ABSOLUTE MONOTONY MON_INCREASE /end AXIS_DESCR
 /begin AXIS_DESCR STD_AXIS iIaeMomen.xd_iae UMR___1_1_0_S6_S3 6 -10000 10000 DEPOSIT ABSOLUTE MONOTONY MON_INCREASE FORMAT "%4.2" /end AXIS_DESCR
/end CHARACTERISTIC
/begin CHARACTERISTIC KF_KP_ANFAHRT_H_IAE "P-Anteil für PID-Regler im E- oder H-Anfahren" MAP 0x220988 kf_fl32_S6_S3 9.999 UMR___1_1_0_3_S6_S3 0.001 10 FORMAT "%5.3"
 /begin AXIS_DESCR STD_AXIS NO_INPUT_QUANTITY UMR_U_MINSEC_1_1_0_S6_S3 6 -10000 10000 DEPOSIT ABSOLUTE MONOTONY MON_INCREASE /end AXIS_DESCR
 /begin AXIS_DESCR STD_AXIS iIaeMomen.xd_iae UMR___1_1_0_S6_S3 6 -10000 10000 DEPOSIT ABSOLUTE MONOTONY MON_INCREASE FORMAT "%4.2" /end AXIS_DESCR
/end CHARACTERISTIC
/begin CHARACTERISTIC KF_F_KD_ANFAHRT_H_IAE "Faktor für D-Anteil für PID-Regler im E- oder H-Anfahren" MAP 0x220A50 kf_fl32_S6_S3 1.999 UMR___1_1_0_3_S6_S3 0.001 2 FORMAT "%5.3"
 /begin AXIS_DESCR STD_AXIS NO_INPUT_QUANTITY UMR___1_1_0_S6_S3 6 -1 8 DEPOSIT ABSOLUTE MONOTONY MON_INCREASE FORMAT "%4.2" /end AXIS_DESCR
 /begin AXIS_DESCR STD_AXIS NO_INPUT_QUANTITY UMR_GRADC__1_1_0_S6_S3 6 -40 215 DEPOSIT ABSOLUTE MONOTONY MON_INCREASE /end AXIS_DESCR
/end CHARACTERISTIC
/begin CHARACTERISTIC KF_F_KI_ANFAHRT_H_IAE "Faktor für I-Anteil für PID-Regler im E- oder H-Anfahren" MAP 0x220B18 kf_fl32_S6_S3 1.999 UMR___1_1_0_3_S6_S3 0.001 2 FORMAT "%5.3"
 /begin AXIS_DESCR STD_AXIS NO_INPUT_QUANTITY UMR___1_1_0_S6_S3 6 -1 8 DEPOSIT ABSOLUTE MONOTONY MON_INCREASE FORMAT "%4.2" /end AXIS_DESCR
 /begin AXIS_DESCR STD_AXIS NO_INPUT_QUANTITY UMR_GRADC__1_1_0_S6_S3 6 -40 215 DEPOSIT ABSOLUTE MONOTONY MON_INCREASE /end AXIS_DESCR
/end CHARACTERISTIC
/begin CHARACTERISTIC KF_F_KP_ANFAHRT_H_IAE "Faktor für P-Anteil für PID-Regler im E- oder H-Anfahren" MAP 0x220BE0 kf_fl32_S6_S3 1.999 UMR___1_1_0_3_S6_S3 0.001 2 FORMAT "%5.3"
 /begin AXIS_DESCR STD_AXIS NO_INPUT_QUANTITY UMR___1_1_0_S6_S3 6 -1 8 DEPOSIT ABSOLUTE MONOTONY MON_INCREASE FORMAT "%4.2" /end AXIS_DESCR
 /begin AXIS_DESCR STD_AXIS NO_INPUT_QUANTITY UMR_GRADC__1_1_0_S6_S3 6 -40 215 DEPOSIT ABSOLUTE MONOTONY MON_INCREASE /end AXIS_DESCR
/end CHARACTERISTIC
/begin CHARACTERISTIC KL_MPT_NMOTSOLLANFAHR_ROH_H_IAE "Filterparameter auf Zieldrehzahl" CURVE 0x220CA8 kl_si16_S6_S3 0.99 UMR___1_100_0_S6_S3 0.01 1
 /begin AXIS_DESCR STD_AXIS NO_INPUT_QUANTITY UMR_PROZENT_SEC_20_51_0_S6_S3 4 -11764.7058824 11764.7058824 DEPOSIT ABSOLUTE MONOTONY MON_INCREASE /end AXIS_DESCR
/end CHARACTERISTIC
/begin CHARACTERISTIC KF_T_PT2_NMOTANFAHR_H_IAE "Filterkonstante für PT2-Filter für Solldrehzahl im Anfahren" MAP 0x220CBC kf_si16_S6_S3 4000 UMR_MSEC__1_1_0_S6_S3 0 4000
 /begin AXIS_DESCR STD_AXIS NO_INPUT_QUANTITY UMR_PROZENT__20_51_0_S6_S3 4 -3921.56862745 3921.56862745 DEPOSIT ABSOLUTE MONOTONY MON_INCREASE /end AXIS_DESCR
 /begin AXIS_DESCR STD_AXIS iIaeSigna.dkig_iae UMR_PROZENT_SEC_20_51_0_S6_S3 4 -3921.56862745 3921.56862745 DEPOSIT ABSOLUTE MONOTONY MON_INCREASE /end AXIS_DESCR
/end CHARACTERISTIC
/begin CHARACTERISTIC KL_F_M_PUAUF_ANFAHRT_H_IAE "Faktor, mit welchem das Pumpenaufnahmemoment m_puauf zur Bildung des Basisanfahrmoments m_basis_anfahrt_iae abgezogen wird" CURVE 0x220CF4 kl_si16_S6_S3 1 UMR___1_100_0_S6_S3 0 1
 /begin AXIS_DESCR STD_AXIS NO_INPUT_QUANTITY UMR_GRADC__1_1_M40_S6_S3 4 -40 215 DEPOSIT ABSOLUTE MONOTONY MON_INCREASE /end AXIS_DESCR
/end CHARACTERISTIC
/begin CHARACTERISTIC KL_F_M_SCHLEPP_ANFAHRT_H_IAE "Faktor, mit welchem das IAE-Schleppmoment m_schlepp_iae zur Bildung des Basisanfahrmoments m_basis_anfahrt_iae abgezogen wird" CURVE 0x220D08 kl_si16_S6_S3 1 UMR___1_100_0_S6_S3 0 1
 /begin AXIS_DESCR STD_AXIS NO_INPUT_QUANTITY UMR_GRADC__1_1_M40_S6_S3 4 -40 215 DEPOSIT ABSOLUTE MONOTONY MON_INCREASE /end AXIS_DESCR
/end CHARACTERISTIC
/begin CHARACTERISTIC KF_OGNMOTANFAHR_SOLL_H_IAE "Offsetgradient der Sollanfahrdrehzahl beim E- oder H-Anfahren" MAP 0x220D1C kf_si16_S6_S3 20000 UMR_U_MINSEC_1_1_0_S6_S3 -10000 10000
 /begin AXIS_DESCR STD_AXIS NO_INPUT_QUANTITY UMR_U_MIN_1_1_0_S6_S3 6 -10000 10000 DEPOSIT ABSOLUTE MONOTONY MON_INCREASE /end AXIS_DESCR
 /begin AXIS_DESCR STD_AXIS iIaeSigna.ng_getrein_iae UMR_U_MINSEC_1_1_0_S6_S3 6 -10000 10000 DEPOSIT ABSOLUTE MONOTONY MON_INCREASE /end AXIS_DESCR
/end CHARACTERISTIC
/begin CHARACTERISTIC KF_MSOLLMAXANFAHR_ECO_IAE "Maximales Soll-Moment im Anfahren" MAP 0x2224EC kf_si16_S6_S3 1100 UMR_NM__1_1_0_S6_S3 -100 1000
 /begin AXIS_DESCR STD_AXIS iIaeSigna.nd_mot_iae UMR_U_MIN_1_1_0_S6_S3 6 -8160 8160 DEPOSIT ABSOLUTE MONOTONY MON_INCREASE /end AXIS_DESCR
 /begin AXIS_DESCR STD_AXIS NO_INPUT_QUANTITY UMR_PROZENT__20_51_0_S6_S3 4 0 100 DEPOSIT ABSOLUTE MONOTONY MON_INCREASE /end AXIS_DESCR
/end CHARACTERISTIC
/begin CHARACTERISTIC KL_MSOLLMINANFAHR_ECO_IAE "Min. Anfahrmomentengrenze" CURVE 0x222538 kl_si16_S6_S3 200 UMR_NM__1_1_0_S6_S3 0 200
 /begin AXIS_DESCR STD_AXIS NO_INPUT_QUANTITY UMR_NM__1_1_0_S6_S3 6 -200 1000 DEPOSIT ABSOLUTE MONOTONY MON_INCREASE /end AXIS_DESCR
/end CHARACTERISTIC
/begin CHARACTERISTIC KL_MSMOTINIT_PT2_ECO_IAE "Motormomentenschwelle zur Initialisierung des Sollanfahrdrehzahlfilter" CURVE 0x222554 kl_si16_S6_S3 300 UMR_NM__1_1_0_S6_S3 -100 200
 /begin AXIS_DESCR STD_AXIS NO_INPUT_QUANTITY UMR_PROZENT__20_51_0_S6_S3 6 0 100 DEPOSIT ABSOLUTE MONOTONY MON_INCREASE /end AXIS_DESCR
/end CHARACTERISTIC
/begin CHARACTERISTIC KL_NSMOTINIT_PT2_ECO_IAE "Motordrehzahlschwelle zur Initialisierung des Sollanfahrdrehzahlfilter" CURVE 0x222570 kl_si16_S6_S3 300 UMR_U_MIN_1_1_0_S6_S3 -100 200
 /begin AXIS_DESCR STD_AXIS NO_INPUT_QUANTITY UMR_PROZENT__20_51_0_S6_S3 6 0 100 DEPOSIT ABSOLUTE MONOTONY MON_INCREASE /end AXIS_DESCR
/end CHARACTERISTIC
/begin CHARACTERISTIC KF_FDYNANFAHR_ECO_IAE "Fahrdynamikoffset für Anfahren IAE" MAP 0x22258C kf_si16_S6_S3 8000 UMR_NM__1_1_0_S6_S3 -2000 6000
 /begin AXIS_DESCR STD_AXIS NO_INPUT_QUANTITY UMR_PROZENT__20_51_0_S6_S3 6 0 100 DEPOSIT ABSOLUTE MONOTONY MON_INCREASE /end AXIS_DESCR
 /begin AXIS_DESCR STD_AXIS NO_INPUT_QUANTITY UMR_PROZENT_SEC_20_51_0_S6_S3 6 -11764.7058824 11764.7058824 DEPOSIT ABSOLUTE MONOTONY MON_INCREASE /end AXIS_DESCR
/end CHARACTERISTIC
/begin CHARACTERISTIC KF_MSOLLMAXANFAHR_IAE "Maximales Soll-Moment im Anfahren" MAP 0x2225F4 kf_si16_S6_S3 1100 UMR_NM__1_1_0_S6_S3 -100 1000
 /begin AXIS_DESCR STD_AXIS iIaeSigna.nd_mot_iae UMR_U_MIN_1_1_0_S6_S3 6 -8160 8160 DEPOSIT ABSOLUTE MONOTONY MON_INCREASE /end AXIS_DESCR
 /begin AXIS_DESCR STD_AXIS NO_INPUT_QUANTITY UMR_PROZENT__20_51_0_S6_S3 4 0 100 DEPOSIT ABSOLUTE MONOTONY MON_INCREASE /end AXIS_DESCR
/end CHARACTERISTIC
/begin CHARACTERISTIC KL_MSOLLMINANFAHR_IAE "Min. Anfahrmomentengrenze" CURVE 0x222640 kl_si16_S6_S3 200 UMR_NM__1_1_0_S6_S3 0 200
 /begin AXIS_DESCR STD_AXIS NO_INPUT_QUANTITY UMR_NM__1_1_0_S6_S3 6 -200 1000 DEPOSIT ABSOLUTE MONOTONY MON_INCREASE /end AXIS_DESCR
/end CHARACTERISTIC
/begin CHARACTERISTIC KL_MSMOTINIT_PT2_IAE "Motormomentenschwelle zur Initialisierung des Sollanfahrdrehzahlfilter" CURVE 0x22265C kl_si16_S6_S3 300 UMR_NM__1_1_0_S6_S3 -100 200
 /begin AXIS_DESCR STD_AXIS NO_INPUT_QUANTITY UMR_PROZENT__20_51_0_S6_S3 6 0 100 DEPOSIT ABSOLUTE MONOTONY MON_INCREASE /end AXIS_DESCR
/end CHARACTERISTIC
/begin CHARACTERISTIC KL_NSMOTINIT_PT2_IAE "Motordrehzahlschwelle zur Initialisierung des Sollanfahrdrehzahlfilter" CURVE 0x222678 kl_si16_S6_S3 300 UMR_U_MIN_1_1_0_S6_S3 -100 200
 /begin AXIS_DESCR STD_AXIS NO_INPUT_QUANTITY UMR_PROZENT__20_51_0_S6_S3 6 0 100 DEPOSIT ABSOLUTE MONOTONY MON_INCREASE /end AXIS_DESCR
/end CHARACTERISTIC
/begin CHARACTERISTIC KF_FDYNANFAHR_IAE "Fahrdynamikoffset für Anfahren IAE" MAP 0x222694 kf_si16_S6_S3 8000 UMR_NM__1_1_0_S6_S3 -2000 6000
 /begin AXIS_DESCR STD_AXIS NO_INPUT_QUANTITY UMR_PROZENT__20_51_0_S6_S3 6 0 100 DEPOSIT ABSOLUTE MONOTONY MON_INCREASE /end AXIS_DESCR
 /begin AXIS_DESCR STD_AXIS NO_INPUT_QUANTITY UMR_PROZENT_SEC_20_51_0_S6_S3 6 -11764.7058824 11764.7058824 DEPOSIT ABSOLUTE MONOTONY MON_INCREASE /end AXIS_DESCR
/end CHARACTERISTIC
/begin CHARACTERISTIC KF_TSYNCGMTHINSYN21 "Zeit vor sync. fur Rampenstart Haltephase in Synchron" MAP 0x236E24 kf_ui8_S6_S3 2550 UMR_MSEC__10_1_M255_S6_S3 -2550 0
 /begin AXIS_DESCR STD_AXIS zff_atsys._.iSignale._.obj.sig_c_getr UMR_GRADC__1_1_M40_S6_S3 4 -40 215 DEPOSIT ABSOLUTE MONOTONY MON_INCREASE /end AXIS_DESCR
 /begin AXIS_DESCR STD_AXIS zff_atsys._.iSignale._.obj.sig_m_t8 UMR_NM__8_1_M50_S6_S3 4 -400 1640 DEPOSIT ABSOLUTE MONOTONY MON_INCREASE /end AXIS_DESCR
/end CHARACTERISTIC
/begin CHARACTERISTIC KF_TSYNCGMTHINSYNRA21 "Zeit vor sync. fur Rampenende Haltephase in Synchron" MAP 0x236E44 kf_ui8_S6_S3 2550 UMR_MSEC__10_1_M255_S6_S3 -2550 0
 /begin AXIS_DESCR STD_AXIS zff_atsys._.iSignale._.obj.sig_c_getr UMR_GRADC__1_1_M40_S6_S3 4 -40 215 DEPOSIT ABSOLUTE MONOTONY MON_INCREASE /end AXIS_DESCR
 /begin AXIS_DESCR STD_AXIS zff_atsys._.iSignale._.obj.sig_m_t8 UMR_NM__8_1_M50_S6_S3 4 -400 1640 DEPOSIT ABSOLUTE MONOTONY MON_INCREASE /end AXIS_DESCR
/end CHARACTERISTIC
/begin CHARACTERISTIC KF_TSYNCGMTHINSYN32 "Zeit vor sync. fur Rampenstart Haltephase in Synchron" MAP 0x236E64 kf_ui8_S6_S3 2550 UMR_MSEC__10_1_M255_S6_S3 -2550 0
 /begin AXIS_DESCR STD_AXIS zff_atsys._.iSignale._.obj.sig_c_getr UMR_GRADC__1_1_M40_S6_S3 4 -40 215 DEPOSIT ABSOLUTE MONOTONY MON_INCREASE /end AXIS_DESCR
 /begin AXIS_DESCR STD_AXIS zff_atsys._.iSignale._.obj.sig_m_t8 UMR_NM__8_1_M50_S6_S3 4 -400 1640 DEPOSIT ABSOLUTE MONOTONY MON_INCREASE /end AXIS_DESCR
/end CHARACTERISTIC
/begin CHARACTERISTIC KF_TSYNCGMTHINSYNRA32 "Zeit vor sync. fur Rampenende Haltephase in Synchron" MAP 0x236E84 kf_ui8_S6_S3 2550 UMR_MSEC__10_1_M255_S6_S3 -2550 0
 /begin AXIS_DESCR STD_AXIS zff_atsys._.iSignale._.obj.sig_c_getr UMR_GRADC__1_1_M40_S6_S3 4 -40 215 DEPOSIT ABSOLUTE MONOTONY MON_INCREASE /end AXIS_DESCR
 /begin AXIS_DESCR STD_AXIS zff_atsys._.iSignale._.obj.sig_m_t8 UMR_NM__8_1_M50_S6_S3 4 -400 1640 DEPOSIT ABSOLUTE MONOTONY MON_INCREASE /end AXIS_DESCR
/end CHARACTERISTIC
/begin CHARACTERISTIC KF_TSYNCGMTHINSYN43 "Zeit vor sync. fur Rampenstart Haltephase in Synchron" MAP 0x236EA4 kf_ui8_S6_S3 2550 UMR_MSEC__10_1_M255_S6_S3 -2550 0
 /begin AXIS_DESCR STD_AXIS zff_atsys._.iSignale._.obj.sig_c_getr UMR_GRADC__1_1_M40_S6_S3 4 -40 215 DEPOSIT ABSOLUTE MONOTONY MON_INCREASE /end AXIS_DESCR
 /begin AXIS_DESCR STD_AXIS zff_atsys._.iSignale._.obj.sig_m_t8 UMR_NM__8_1_M50_S6_S3 4 -400 1640 DEPOSIT ABSOLUTE MONOTONY MON_INCREASE /end AXIS_DESCR
/end CHARACTERISTIC
/begin CHARACTERISTIC KF_TSYNCGMTHINSYNRA43 "Zeit vor sync. fur Rampenende Haltephase in Synchron" MAP 0x236EC4 kf_ui8_S6_S3 2550 UMR_MSEC__10_1_M255_S6_S3 -2550 0
 /begin AXIS_DESCR STD_AXIS zff_atsys._.iSignale._.obj.sig_c_getr UMR_GRADC__1_1_M40_S6_S3 4 -40 215 DEPOSIT ABSOLUTE MONOTONY MON_INCREASE /end AXIS_DESCR
 /begin AXIS_DESCR STD_AXIS zff_atsys._.iSignale._.obj.sig_m_t8 UMR_NM__8_1_M50_S6_S3 4 -400 1640 DEPOSIT ABSOLUTE MONOTONY MON_INCREASE /end AXIS_DESCR
/end CHARACTERISTIC
/begin CHARACTERISTIC KF_TSYNCGMTHINSYN54 "Zeit vor sync. fur Rampenstart Haltephase in Synchron" MAP 0x236EE4 kf_ui8_S6_S3 2550 UMR_MSEC__10_1_M255_S6_S3 -2550 0
 /begin AXIS_DESCR STD_AXIS zff_atsys._.iSignale._.obj.sig_c_getr UMR_GRADC__1_1_M40_S6_S3 4 -40 215 DEPOSIT ABSOLUTE MONOTONY MON_INCREASE /end AXIS_DESCR
 /begin AXIS_DESCR STD_AXIS zff_atsys._.iSignale._.obj.sig_m_t8 UMR_NM__8_1_M50_S6_S3 4 -400 1640 DEPOSIT ABSOLUTE MONOTONY MON_INCREASE /end AXIS_DESCR
/end CHARACTERISTIC
/begin CHARACTERISTIC KF_TSYNCGMTHINSYNRA54 "Zeit vor sync. fur Rampenende Haltephase in Synchron" MAP 0x236F04 kf_ui8_S6_S3 2550 UMR_MSEC__10_1_M255_S6_S3 -2550 0
 /begin AXIS_DESCR STD_AXIS zff_atsys._.iSignale._.obj.sig_c_getr UMR_GRADC__1_1_M40_S6_S3 4 -40 215 DEPOSIT ABSOLUTE MONOTONY MON_INCREASE /end AXIS_DESCR
 /begin AXIS_DESCR STD_AXIS zff_atsys._.iSignale._.obj.sig_m_t8 UMR_NM__8_1_M50_S6_S3 4 -400 1640 DEPOSIT ABSOLUTE MONOTONY MON_INCREASE /end AXIS_DESCR
/end CHARACTERISTIC
/begin CHARACTERISTIC KF_TSYNCGMTHINSYN65 "Zeit vor sync. fur Rampenstart Haltephase in Synchron" MAP 0x236F24 kf_ui8_S6_S3 2550 UMR_MSEC__10_1_M255_S6_S3 -2550 0
 /begin AXIS_DESCR STD_AXIS zff_atsys._.iSignale._.obj.sig_c_getr UMR_GRADC__1_1_M40_S6_S3 4 -40 215 DEPOSIT ABSOLUTE MONOTONY MON_INCREASE /end AXIS_DESCR
 /begin AXIS_DESCR STD_AXIS zff_atsys._.iSignale._.obj.sig_m_t8 UMR_NM__8_1_M50_S6_S3 4 -400 1640 DEPOSIT ABSOLUTE MONOTONY MON_INCREASE /end AXIS_DESCR
/end CHARACTERISTIC
/begin CHARACTERISTIC KF_TSYNCGMTHINSYNRA65 "Zeit vor sync. fur Rampenende Haltephase in Synchron" MAP 0x236F44 kf_ui8_S6_S3 2550 UMR_MSEC__10_1_M255_S6_S3 -2550 0
 /begin AXIS_DESCR STD_AXIS zff_atsys._.iSignale._.obj.sig_c_getr UMR_GRADC__1_1_M40_S6_S3 4 -40 215 DEPOSIT ABSOLUTE MONOTONY MON_INCREASE /end AXIS_DESCR
 /begin AXIS_DESCR STD_AXIS zff_atsys._.iSignale._.obj.sig_m_t8 UMR_NM__8_1_M50_S6_S3 4 -400 1640 DEPOSIT ABSOLUTE MONOTONY MON_INCREASE /end AXIS_DESCR
/end CHARACTERISTIC
/begin CHARACTERISTIC KF_TSYNCGMTHINSYN76 "Zeit vor sync. fur Rampenstart Haltephase in Synchron" MAP 0x236F64 kf_ui8_S6_S3 2550 UMR_MSEC__10_1_M255_S6_S3 -2550 0
 /begin AXIS_DESCR STD_AXIS zff_atsys._.iSignale._.obj.sig_c_getr UMR_GRADC__1_1_M40_S6_S3 4 -40 215 DEPOSIT ABSOLUTE MONOTONY MON_INCREASE /end AXIS_DESCR
 /begin AXIS_DESCR STD_AXIS zff_atsys._.iSignale._.obj.sig_m_t8 UMR_NM__8_1_M50_S6_S3 4 -400 1640 DEPOSIT ABSOLUTE MONOTONY MON_INCREASE /end AXIS_DESCR
/end CHARACTERISTIC
/begin CHARACTERISTIC KF_TSYNCGMTHINSYNRA76 "Zeit vor sync. fur Rampenende Haltephase in Synchron" MAP 0x236F84 kf_ui8_S6_S3 2550 UMR_MSEC__10_1_M255_S6_S3 -2550 0
 /begin AXIS_DESCR STD_AXIS zff_atsys._.iSignale._.obj.sig_c_getr UMR_GRADC__1_1_M40_S6_S3 4 -40 215 DEPOSIT ABSOLUTE MONOTONY MON_INCREASE /end AXIS_DESCR
 /begin AXIS_DESCR STD_AXIS zff_atsys._.iSignale._.obj.sig_m_t8 UMR_NM__8_1_M50_S6_S3 4 -400 1640 DEPOSIT ABSOLUTE MONOTONY MON_INCREASE /end AXIS_DESCR
/end CHARACTERISTIC
/begin CHARACTERISTIC KF_TSYNCGMTHINSYN87 "Zeit vor sync. fur Rampenstart Haltephase in Synchron" MAP 0x236FA4 kf_ui8_S6_S3 2550 UMR_MSEC__10_1_M255_S6_S3 -2550 0
 /begin AXIS_DESCR STD_AXIS zff_atsys._.iSignale._.obj.sig_c_getr UMR_GRADC__1_1_M40_S6_S3 4 -40 215 DEPOSIT ABSOLUTE MONOTONY MON_INCREASE /end AXIS_DESCR
 /begin AXIS_DESCR STD_AXIS zff_atsys._.iSignale._.obj.sig_m_t8 UMR_NM__8_1_M50_S6_S3 4 -400 1640 DEPOSIT ABSOLUTE MONOTONY MON_INCREASE /end AXIS_DESCR
/end CHARACTERISTIC
/begin CHARACTERISTIC KF_TSYNCGMTHINSYNRA87 "Zeit vor sync. fur Rampenende Haltephase in Synchron" MAP 0x236FC4 kf_ui8_S6_S3 2550 UMR_MSEC__10_1_M255_S6_S3 -2550 0
 /begin AXIS_DESCR STD_AXIS zff_atsys._.iSignale._.obj.sig_c_getr UMR_GRADC__1_1_M40_S6_S3 4 -40 215 DEPOSIT ABSOLUTE MONOTONY MON_INCREASE /end AXIS_DESCR
 /begin AXIS_DESCR STD_AXIS zff_atsys._.iSignale._.obj.sig_m_t8 UMR_NM__8_1_M50_S6_S3 4 -400 1640 DEPOSIT ABSOLUTE MONOTONY MON_INCREASE /end AXIS_DESCR
/end CHARACTERISTIC
/begin CHARACTERISTIC KF_TSYNCGMTHINSYNSP21 "Zeit vor sync. fur Rampenstart Haltephase in Synchron" MAP 0x236FE4 kf_ui8_S6_S3 2550 UMR_MSEC__10_1_M255_S6_S3 -2550 0
 /begin AXIS_DESCR STD_AXIS zff_atsys._.iSignale._.obj.sig_c_getr UMR_GRADC__1_1_M40_S6_S3 4 -40 215 DEPOSIT ABSOLUTE MONOTONY MON_INCREASE /end AXIS_DESCR
 /begin AXIS_DESCR STD_AXIS zff_atsys._.iSignale._.obj.sig_m_t8 UMR_NM__8_1_M50_S6_S3 4 -400 1640 DEPOSIT ABSOLUTE MONOTONY MON_INCREASE /end AXIS_DESCR
/end CHARACTERISTIC
/begin CHARACTERISTIC KF_TSYNCGMTHINSYNRASP21 "Zeit vor sync. fur Rampenende Haltephase in Synchron" MAP 0x237004 kf_ui8_S6_S3 2550 UMR_MSEC__10_1_M255_S6_S3 -2550 0
 /begin AXIS_DESCR STD_AXIS zff_atsys._.iSignale._.obj.sig_c_getr UMR_GRADC__1_1_M40_S6_S3 4 -40 215 DEPOSIT ABSOLUTE MONOTONY MON_INCREASE /end AXIS_DESCR
 /begin AXIS_DESCR STD_AXIS zff_atsys._.iSignale._.obj.sig_m_t8 UMR_NM__8_1_M50_S6_S3 4 -400 1640 DEPOSIT ABSOLUTE MONOTONY MON_INCREASE /end AXIS_DESCR
/end CHARACTERISTIC
/begin CHARACTERISTIC KF_TSYNCGMTHINSYNSP32 "Zeit vor sync. fur Rampenstart Haltephase in Synchron" MAP 0x237024 kf_ui8_S6_S3 2550 UMR_MSEC__10_1_M255_S6_S3 -2550 0
 /begin AXIS_DESCR STD_AXIS zff_atsys._.iSignale._.obj.sig_c_getr UMR_GRADC__1_1_M40_S6_S3 4 -40 215 DEPOSIT ABSOLUTE MONOTONY MON_INCREASE /end AXIS_DESCR
 /begin AXIS_DESCR STD_AXIS zff_atsys._.iSignale._.obj.sig_m_t8 UMR_NM__8_1_M50_S6_S3 4 -400 1640 DEPOSIT ABSOLUTE MONOTONY MON_INCREASE /end AXIS_DESCR
/end CHARACTERISTIC
/begin CHARACTERISTIC KF_TSYNCGMTHINSYNRASP32 "Zeit vor sync. fur Rampenende Haltephase in Synchron" MAP 0x237044 kf_ui8_S6_S3 2550 UMR_MSEC__10_1_M255_S6_S3 -2550 0
 /begin AXIS_DESCR STD_AXIS zff_atsys._.iSignale._.obj.sig_c_getr UMR_GRADC__1_1_M40_S6_S3 4 -40 215 DEPOSIT ABSOLUTE MONOTONY MON_INCREASE /end AXIS_DESCR
 /begin AXIS_DESCR STD_AXIS zff_atsys._.iSignale._.obj.sig_m_t8 UMR_NM__8_1_M50_S6_S3 4 -400 1640 DEPOSIT ABSOLUTE MONOTONY MON_INCREASE /end AXIS_DESCR
/end CHARACTERISTIC
/begin CHARACTERISTIC KF_TSYNCGMTHINSYNSP43 "Zeit vor sync. fur Rampenstart Haltephase in Synchron" MAP 0x237064 kf_ui8_S6_S3 2550 UMR_MSEC__10_1_M255_S6_S3 -2550 0
 /begin AXIS_DESCR STD_AXIS zff_atsys._.iSignale._.obj.sig_c_getr UMR_GRADC__1_1_M40_S6_S3 4 -40 215 DEPOSIT ABSOLUTE MONOTONY MON_INCREASE /end AXIS_DESCR
 /begin AXIS_DESCR STD_AXIS zff_atsys._.iSignale._.obj.sig_m_t8 UMR_NM__8_1_M50_S6_S3 4 -400 1640 DEPOSIT ABSOLUTE MONOTONY MON_INCREASE /end AXIS_DESCR
/end CHARACTERISTIC
/begin CHARACTERISTIC KF_TSYNCGMTHINSYNRASP43 "Zeit vor sync. fur Rampenende Haltephase in Synchron" MAP 0x237084 kf_ui8_S6_S3 2550 UMR_MSEC__10_1_M255_S6_S3 -2550 0
 /begin AXIS_DESCR STD_AXIS zff_atsys._.iSignale._.obj.sig_c_getr UMR_GRADC__1_1_M40_S6_S3 4 -40 215 DEPOSIT ABSOLUTE MONOTONY MON_INCREASE /end AXIS_DESCR
 /begin AXIS_DESCR STD_AXIS zff_atsys._.iSignale._.obj.sig_m_t8 UMR_NM__8_1_M50_S6_S3 4 -400 1640 DEPOSIT ABSOLUTE MONOTONY MON_INCREASE /end AXIS_DESCR
/end CHARACTERISTIC
/begin CHARACTERISTIC KF_TSYNCGMTHINSYNSP54 "Zeit vor sync. fur Rampenstart Haltephase in Synchron" MAP 0x2370A4 kf_ui8_S6_S3 2550 UMR_MSEC__10_1_M255_S6_S3 -2550 0
 /begin AXIS_DESCR STD_AXIS zff_atsys._.iSignale._.obj.sig_c_getr UMR_GRADC__1_1_M40_S6_S3 4 -40 215 DEPOSIT ABSOLUTE MONOTONY MON_INCREASE /end AXIS_DESCR
 /begin AXIS_DESCR STD_AXIS zff_atsys._.iSignale._.obj.sig_m_t8 UMR_NM__8_1_M50_S6_S3 4 -400 1640 DEPOSIT ABSOLUTE MONOTONY MON_INCREASE /end AXIS_DESCR
/end CHARACTERISTIC
/begin CHARACTERISTIC KF_TSYNCGMTHINSYNRASP54 "Zeit vor sync. fur Rampenende Haltephase in Synchron" MAP 0x2370C4 kf_ui8_S6_S3 2550 UMR_MSEC__10_1_M255_S6_S3 -2550 0
 /begin AXIS_DESCR STD_AXIS zff_atsys._.iSignale._.obj.sig_c_getr UMR_GRADC__1_1_M40_S6_S3 4 -40 215 DEPOSIT ABSOLUTE MONOTONY MON_INCREASE /end AXIS_DESCR
 /begin AXIS_DESCR STD_AXIS zff_atsys._.iSignale._.obj.sig_m_t8 UMR_NM__8_1_M50_S6_S3 4 -400 1640 DEPOSIT ABSOLUTE MONOTONY MON_INCREASE /end AXIS_DESCR
/end CHARACTERISTIC
/begin CHARACTERISTIC KF_TSYNCGMTHINSYNSP65 "Zeit vor sync. fur Rampenstart Haltephase in Synchron" MAP 0x2370E4 kf_ui8_S6_S3 2550 UMR_MSEC__10_1_M255_S6_S3 -2550 0
 /begin AXIS_DESCR STD_AXIS zff_atsys._.iSignale._.obj.sig_c_getr UMR_GRADC__1_1_M40_S6_S3 4 -40 215 DEPOSIT ABSOLUTE MONOTONY MON_INCREASE /end AXIS_DESCR
 /begin AXIS_DESCR STD_AXIS zff_atsys._.iSignale._.obj.sig_m_t8 UMR_NM__8_1_M50_S6_S3 4 -400 1640 DEPOSIT ABSOLUTE MONOTONY MON_INCREASE /end AXIS_DESCR
/end CHARACTERISTIC
/begin CHARACTERISTIC KF_TSYNCGMTHINSYNRASP65 "Zeit vor sync. fur Rampenende Haltephase in Synchron" MAP 0x237104 kf_ui8_S6_S3 2550 UMR_MSEC__10_1_M255_S6_S3 -2550 0
 /begin AXIS_DESCR STD_AXIS zff_atsys._.iSignale._.obj.sig_c_getr UMR_GRADC__1_1_M40_S6_S3 4 -40 215 DEPOSIT ABSOLUTE MONOTONY MON_INCREASE /end AXIS_DESCR
 /begin AXIS_DESCR STD_AXIS zff_atsys._.iSignale._.obj.sig_m_t8 UMR_NM__8_1_M50_S6_S3 4 -400 1640 DEPOSIT ABSOLUTE MONOTONY MON_INCREASE /end AXIS_DESCR
/end CHARACTERISTIC
/begin CHARACTERISTIC KF_TSYNCGMTHINSYNSP76 "Zeit vor sync. fur Rampenstart Haltephase in Synchron" MAP 0x237124 kf_ui8_S6_S3 2550 UMR_MSEC__10_1_M255_S6_S3 -2550 0
 /begin AXIS_DESCR STD_AXIS zff_atsys._.iSignale._.obj.sig_c_getr UMR_GRADC__1_1_M40_S6_S3 4 -40 215 DEPOSIT ABSOLUTE MONOTONY MON_INCREASE /end AXIS_DESCR
 /begin AXIS_DESCR STD_AXIS zff_atsys._.iSignale._.obj.sig_m_t8 UMR_NM__8_1_M50_S6_S3 4 -400 1640 DEPOSIT ABSOLUTE MONOTONY MON_INCREASE /end AXIS_DESCR
/end CHARACTERISTIC
/begin CHARACTERISTIC KF_TSYNCGMTHINSYNRASP76 "Zeit vor sync. fur Rampenende Haltephase in Synchron" MAP 0x237144 kf_ui8_S6_S3 2550 UMR_MSEC__10_1_M255_S6_S3 -2550 0
 /begin AXIS_DESCR STD_AXIS zff_atsys._.iSignale._.obj.sig_c_getr UMR_GRADC__1_1_M40_S6_S3 4 -40 215 DEPOSIT ABSOLUTE MONOTONY MON_INCREASE /end AXIS_DESCR
 /begin AXIS_DESCR STD_AXIS zff_atsys._.iSignale._.obj.sig_m_t8 UMR_NM__8_1_M50_S6_S3 4 -400 1640 DEPOSIT ABSOLUTE MONOTONY MON_INCREASE /end AXIS_DESCR
/end CHARACTERISTIC
/begin CHARACTERISTIC KF_TSYNCGMTHINSYNSP87 "Zeit vor sync. fur Rampenstart Haltephase in Synchron" MAP 0x237164 kf_ui8_S6_S3 2550 UMR_MSEC__10_1_M255_S6_S3 -2550 0
 /begin AXIS_DESCR STD_AXIS zff_atsys._.iSignale._.obj.sig_c_getr UMR_GRADC__1_1_M40_S6_S3 4 -40 215 DEPOSIT ABSOLUTE MONOTONY MON_INCREASE /end AXIS_DESCR
 /begin AXIS_DESCR STD_AXIS zff_atsys._.iSignale._.obj.sig_m_t8 UMR_NM__8_1_M50_S6_S3 4 -400 1640 DEPOSIT ABSOLUTE MONOTONY MON_INCREASE /end AXIS_DESCR
/end CHARACTERISTIC
/begin CHARACTERISTIC KF_TSYNCGMTHINSYNRASP87 "Zeit vor sync. fur Rampenende Haltephase in Synchron" MAP 0x237184 kf_ui8_S6_S3 2550 UMR_MSEC__10_1_M255_S6_S3 -2550 0
 /begin AXIS_DESCR STD_AXIS zff_atsys._.iSignale._.obj.sig_c_getr UMR_GRADC__1_1_M40_S6_S3 4 -40 215 DEPOSIT ABSOLUTE MONOTONY MON_INCREASE /end AXIS_DESCR
 /begin AXIS_DESCR STD_AXIS zff_atsys._.iSignale._.obj.sig_m_t8 UMR_NM__8_1_M50_S6_S3 4 -400 1640 DEPOSIT ABSOLUTE MONOTONY MON_INCREASE /end AXIS_DESCR
/end CHARACTERISTIC
/begin CHARACTERISTIC KF_TSYNCGMTHINSYNSP31 "Zeit vor sync. fur Rampenstart Haltephase in Synchron" MAP 0x2371A4 kf_ui8_S6_S3 2550 UMR_MSEC__10_1_M255_S6_S3 -2550 0
 /begin AXIS_DESCR STD_AXIS zff_atsys._.iSignale._.obj.sig_c_getr UMR_GRADC__1_1_M40_S6_S3 4 -40 215 DEPOSIT ABSOLUTE MONOTONY MON_INCREASE /end AXIS_DESCR
 /begin AXIS_DESCR STD_AXIS zff_atsys._.iSignale._.obj.sig_m_t8 UMR_NM__8_1_M50_S6_S3 4 -400 1640 DEPOSIT ABSOLUTE MONOTONY MON_INCREASE /end AXIS_DESCR
/end CHARACTERISTIC
/begin CHARACTERISTIC KF_TSYNCGMTHINSYNRASP31 "Zeit vor sync. fur Rampenende Haltephase in Synchron" MAP 0x2371C4 kf_ui8_S6_S3 2550 UMR_MSEC__10_1_M255_S6_S3 -2550 0
 /begin AXIS_DESCR STD_AXIS zff_atsys._.iSignale._.obj.sig_c_getr UMR_GRADC__1_1_M40_S6_S3 4 -40 215 DEPOSIT ABSOLUTE MONOTONY MON_INCREASE /end AXIS_DESCR
 /begin AXIS_DESCR STD_AXIS zff_atsys._.iSignale._.obj.sig_m_t8 UMR_NM__8_1_M50_S6_S3 4 -400 1640 DEPOSIT ABSOLUTE MONOTONY MON_INCREASE /end AXIS_DESCR
/end CHARACTERISTIC
/begin CHARACTERISTIC KF_TSYNCGMTHINSYNSP42 "Zeit vor sync. fur Rampenstart Haltephase in Synchron" MAP 0x2371E4 kf_ui8_S6_S3 2550 UMR_MSEC__10_1_M255_S6_S3 -2550 0
 /begin AXIS_DESCR STD_AXIS zff_atsys._.iSignale._.obj.sig_c_getr UMR_GRADC__1_1_M40_S6_S3 4 -40 215 DEPOSIT ABSOLUTE MONOTONY MON_INCREASE /end AXIS_DESCR
 /begin AXIS_DESCR STD_AXIS zff_atsys._.iSignale._.obj.sig_m_t8 UMR_NM__8_1_M50_S6_S3 4 -400 1640 DEPOSIT ABSOLUTE MONOTONY MON_INCREASE /end AXIS_DESCR
/end CHARACTERISTIC
/begin CHARACTERISTIC KF_TSYNCGMTHINSYNRASP42 "Zeit vor sync. fur Rampenende Haltephase in Synchron" MAP 0x237204 kf_ui8_S6_S3 2550 UMR_MSEC__10_1_M255_S6_S3 -2550 0
 /begin AXIS_DESCR STD_AXIS zff_atsys._.iSignale._.obj.sig_c_getr UMR_GRADC__1_1_M40_S6_S3 4 -40 215 DEPOSIT ABSOLUTE MONOTONY MON_INCREASE /end AXIS_DESCR
 /begin AXIS_DESCR STD_AXIS zff_atsys._.iSignale._.obj.sig_m_t8 UMR_NM__8_1_M50_S6_S3 4 -400 1640 DEPOSIT ABSOLUTE MONOTONY MON_INCREASE /end AXIS_DESCR
/end CHARACTERISTIC
/begin CHARACTERISTIC KF_TSYNCGMTHINSYNSP51 "Zeit vor sync. fur Rampenstart Haltephase in Synchron" MAP 0x237224 kf_ui8_S6_S3 2550 UMR_MSEC__10_1_M255_S6_S3 -2550 0
 /begin AXIS_DESCR STD_AXIS zff_atsys._.iSignale._.obj.sig_c_getr UMR_GRADC__1_1_M40_S6_S3 4 -40 215 DEPOSIT ABSOLUTE MONOTONY MON_INCREASE /end AXIS_DESCR
 /begin AXIS_DESCR STD_AXIS zff_atsys._.iSignale._.obj.sig_m_t8 UMR_NM__8_1_M50_S6_S3 4 -400 1640 DEPOSIT ABSOLUTE MONOTONY MON_INCREASE /end AXIS_DESCR
/end CHARACTERISTIC
/begin CHARACTERISTIC KF_TSYNCGMTHINSYNRASP51 "Zeit vor sync. fur Rampenende Haltephase in Synchron" MAP 0x237244 kf_ui8_S6_S3 2550 UMR_MSEC__10_1_M255_S6_S3 -2550 0
 /begin AXIS_DESCR STD_AXIS zff_atsys._.iSignale._.obj.sig_c_getr UMR_GRADC__1_1_M40_S6_S3 4 -40 215 DEPOSIT ABSOLUTE MONOTONY MON_INCREASE /end AXIS_DESCR
 /begin AXIS_DESCR STD_AXIS zff_atsys._.iSignale._.obj.sig_m_t8 UMR_NM__8_1_M50_S6_S3 4 -400 1640 DEPOSIT ABSOLUTE MONOTONY MON_INCREASE /end AXIS_DESCR
/end CHARACTERISTIC
/begin CHARACTERISTIC KF_TSYNCGMTHINSYNSP53 "Zeit vor sync. fur Rampenstart Haltephase in Synchron" MAP 0x237264 kf_ui8_S6_S3 2550 UMR_MSEC__10_1_M255_S6_S3 -2550 0
 /begin AXIS_DESCR STD_AXIS zff_atsys._.iSignale._.obj.sig_c_getr UMR_GRADC__1_1_M40_S6_S3 4 -40 215 DEPOSIT ABSOLUTE MONOTONY MON_INCREASE /end AXIS_DESCR
 /begin AXIS_DESCR STD_AXIS zff_atsys._.iSignale._.obj.sig_m_t8 UMR_NM__8_1_M50_S6_S3 4 -400 1640 DEPOSIT ABSOLUTE MONOTONY MON_INCREASE /end AXIS_DESCR
/end CHARACTERISTIC
/begin CHARACTERISTIC KF_TSYNCGMTHINSYNRASP53 "Zeit vor sync. fur Rampenende Haltephase in Synchron" MAP 0x237284 kf_ui8_S6_S3 2550 UMR_MSEC__10_1_M255_S6_S3 -2550 0
 /begin AXIS_DESCR STD_AXIS zff_atsys._.iSignale._.obj.sig_c_getr UMR_GRADC__1_1_M40_S6_S3 4 -40 215 DEPOSIT ABSOLUTE MONOTONY MON_INCREASE /end AXIS_DESCR
 /begin AXIS_DESCR STD_AXIS zff_atsys._.iSignale._.obj.sig_m_t8 UMR_NM__8_1_M50_S6_S3 4 -400 1640 DEPOSIT ABSOLUTE MONOTONY MON_INCREASE /end AXIS_DESCR
/end CHARACTERISTIC
/begin CHARACTERISTIC KF_TSYNCGMTHINSYNSP63 "Zeit vor sync. fur Rampenstart Haltephase in Synchron" MAP 0x2372A4 kf_ui8_S6_S3 2550 UMR_MSEC__10_1_M255_S6_S3 -2550 0
 /begin AXIS_DESCR STD_AXIS zff_atsys._.iSignale._.obj.sig_c_getr UMR_GRADC__1_1_M40_S6_S3 4 -40 215 DEPOSIT ABSOLUTE MONOTONY MON_INCREASE /end AXIS_DESCR
 /begin AXIS_DESCR STD_AXIS zff_atsys._.iSignale._.obj.sig_m_t8 UMR_NM__8_1_M50_S6_S3 4 -400 1640 DEPOSIT ABSOLUTE MONOTONY MON_INCREASE /end AXIS_DESCR
/end CHARACTERISTIC
/begin CHARACTERISTIC KF_TSYNCGMTHINSYNRASP63 "Zeit vor sync. fur Rampenende Haltephase in Synchron" MAP 0x2372C4 kf_ui8_S6_S3 2550 UMR_MSEC__10_1_M255_S6_S3 -2550 0
 /begin AXIS_DESCR STD_AXIS zff_atsys._.iSignale._.obj.sig_c_getr UMR_GRADC__1_1_M40_S6_S3 4 -40 215 DEPOSIT ABSOLUTE MONOTONY MON_INCREASE /end AXIS_DESCR
 /begin AXIS_DESCR STD_AXIS zff_atsys._.iSignale._.obj.sig_m_t8 UMR_NM__8_1_M50_S6_S3 4 -400 1640 DEPOSIT ABSOLUTE MONOTONY MON_INCREASE /end AXIS_DESCR
/end CHARACTERISTIC
/begin CHARACTERISTIC KF_TSYNCGMTHINSYNSP64 "Zeit vor sync. fur Rampenstart Haltephase in Synchron" MAP 0x2372E4 kf_ui8_S6_S3 2550 UMR_MSEC__10_1_M255_S6_S3 -2550 0
 /begin AXIS_DESCR STD_AXIS zff_atsys._.iSignale._.obj.sig_c_getr UMR_GRADC__1_1_M40_S6_S3 4 -40 215 DEPOSIT ABSOLUTE MONOTONY MON_INCREASE /end AXIS_DESCR
 /begin AXIS_DESCR STD_AXIS zff_atsys._.iSignale._.obj.sig_m_t8 UMR_NM__8_1_M50_S6_S3 4 -400 1640 DEPOSIT ABSOLUTE MONOTONY MON_INCREASE /end AXIS_DESCR
/end CHARACTERISTIC
/begin CHARACTERISTIC KF_TSYNCGMTHINSYNRASP64 "Zeit vor sync. fur Rampenende Haltephase in Synchron" MAP 0x237304 kf_ui8_S6_S3 2550 UMR_MSEC__10_1_M255_S6_S3 -2550 0
 /begin AXIS_DESCR STD_AXIS zff_atsys._.iSignale._.obj.sig_c_getr UMR_GRADC__1_1_M40_S6_S3 4 -40 215 DEPOSIT ABSOLUTE MONOTONY MON_INCREASE /end AXIS_DESCR
 /begin AXIS_DESCR STD_AXIS zff_atsys._.iSignale._.obj.sig_m_t8 UMR_NM__8_1_M50_S6_S3 4 -400 1640 DEPOSIT ABSOLUTE MONOTONY MON_INCREASE /end AXIS_DESCR
/end CHARACTERISTIC
/begin CHARACTERISTIC KF_TSYNCGMTHINSYNSP71 "Zeit vor sync. fur Rampenstart Haltephase in Synchron" MAP 0x237324 kf_ui8_S6_S3 2550 UMR_MSEC__10_1_M255_S6_S3 -2550 0
 /begin AXIS_DESCR STD_AXIS zff_atsys._.iSignale._.obj.sig_c_getr UMR_GRADC__1_1_M40_S6_S3 4 -40 215 DEPOSIT ABSOLUTE MONOTONY MON_INCREASE /end AXIS_DESCR
 /begin AXIS_DESCR STD_AXIS zff_atsys._.iSignale._.obj.sig_m_t8 UMR_NM__8_1_M50_S6_S3 4 -400 1640 DEPOSIT ABSOLUTE MONOTONY MON_INCREASE /end AXIS_DESCR
/end CHARACTERISTIC
/begin CHARACTERISTIC KF_TSYNCGMTHINSYNRASP71 "Zeit vor sync. fur Rampenende Haltephase in Synchron" MAP 0x237344 kf_ui8_S6_S3 2550 UMR_MSEC__10_1_M255_S6_S3 -2550 0
 /begin AXIS_DESCR STD_AXIS zff_atsys._.iSignale._.obj.sig_c_getr UMR_GRADC__1_1_M40_S6_S3 4 -40 215 DEPOSIT ABSOLUTE MONOTONY MON_INCREASE /end AXIS_DESCR
 /begin AXIS_DESCR STD_AXIS zff_atsys._.iSignale._.obj.sig_m_t8 UMR_NM__8_1_M50_S6_S3 4 -400 1640 DEPOSIT ABSOLUTE MONOTONY MON_INCREASE /end AXIS_DESCR
/end CHARACTERISTIC
/begin CHARACTERISTIC KF_TSYNCGMTHINSYNSP75 "Zeit vor sync. fur Rampenstart Haltephase in Synchron" MAP 0x237364 kf_ui8_S6_S3 2550 UMR_MSEC__10_1_M255_S6_S3 -2550 0
 /begin AXIS_DESCR STD_AXIS zff_atsys._.iSignale._.obj.sig_c_getr UMR_GRADC__1_1_M40_S6_S3 4 -40 215 DEPOSIT ABSOLUTE MONOTONY MON_INCREASE /end AXIS_DESCR
 /begin AXIS_DESCR STD_AXIS zff_atsys._.iSignale._.obj.sig_m_t8 UMR_NM__8_1_M50_S6_S3 4 -400 1640 DEPOSIT ABSOLUTE MONOTONY MON_INCREASE /end AXIS_DESCR
/end CHARACTERISTIC
/begin CHARACTERISTIC KF_TSYNCGMTHINSYNRASP75 "Zeit vor sync. fur Rampenende Haltephase in Synchron" MAP 0x237384 kf_ui8_S6_S3 2550 UMR_MSEC__10_1_M255_S6_S3 -2550 0
 /begin AXIS_DESCR STD_AXIS zff_atsys._.iSignale._.obj.sig_c_getr UMR_GRADC__1_1_M40_S6_S3 4 -40 215 DEPOSIT ABSOLUTE MONOTONY MON_INCREASE /end AXIS_DESCR
 /begin AXIS_DESCR STD_AXIS zff_atsys._.iSignale._.obj.sig_m_t8 UMR_NM__8_1_M50_S6_S3 4 -400 1640 DEPOSIT ABSOLUTE MONOTONY MON_INCREASE /end AXIS_DESCR
/end CHARACTERISTIC
/begin CHARACTERISTIC KF_TSYNCGMTHINSYNSP82 "Zeit vor sync. fur Rampenstart Haltephase in Synchron" MAP 0x2373A4 kf_ui8_S6_S3 2550 UMR_MSEC__10_1_M255_S6_S3 -2550 0
 /begin AXIS_DESCR STD_AXIS zff_atsys._.iSignale._.obj.sig_c_getr UMR_GRADC__1_1_M40_S6_S3 4 -40 215 DEPOSIT ABSOLUTE MONOTONY MON_INCREASE /end AXIS_DESCR
 /begin AXIS_DESCR STD_AXIS zff_atsys._.iSignale._.obj.sig_m_t8 UMR_NM__8_1_M50_S6_S3 4 -400 1640 DEPOSIT ABSOLUTE MONOTONY MON_INCREASE /end AXIS_DESCR
/end CHARACTERISTIC
/begin CHARACTERISTIC KF_TSYNCGMTHINSYNRASP82 "Zeit vor sync. fur Rampenende Haltephase in Synchron" MAP 0x2373C4 kf_ui8_S6_S3 2550 UMR_MSEC__10_1_M255_S6_S3 -2550 0
 /begin AXIS_DESCR STD_AXIS zff_atsys._.iSignale._.obj.sig_c_getr UMR_GRADC__1_1_M40_S6_S3 4 -40 215 DEPOSIT ABSOLUTE MONOTONY MON_INCREASE /end AXIS_DESCR
 /begin AXIS_DESCR STD_AXIS zff_atsys._.iSignale._.obj.sig_m_t8 UMR_NM__8_1_M50_S6_S3 4 -400 1640 DEPOSIT ABSOLUTE MONOTONY MON_INCREASE /end AXIS_DESCR
/end CHARACTERISTIC
/begin CHARACTERISTIC KF_TSYNCGMTHINSYNSP84 "Zeit vor sync. fur Rampenstart Haltephase in Synchron" MAP 0x2373E4 kf_ui8_S6_S3 2550 UMR_MSEC__10_1_M255_S6_S3 -2550 0
 /begin AXIS_DESCR STD_AXIS zff_atsys._.iSignale._.obj.sig_c_getr UMR_GRADC__1_1_M40_S6_S3 4 -40 215 DEPOSIT ABSOLUTE MONOTONY MON_INCREASE /end AXIS_DESCR
 /begin AXIS_DESCR STD_AXIS zff_atsys._.iSignale._.obj.sig_m_t8 UMR_NM__8_1_M50_S6_S3 4 -400 1640 DEPOSIT ABSOLUTE MONOTONY MON_INCREASE /end AXIS_DESCR
/end CHARACTERISTIC
/begin CHARACTERISTIC KF_TSYNCGMTHINSYNRASP84 "Zeit vor sync. fur Rampenende Haltephase in Synchron" MAP 0x237404 kf_ui8_S6_S3 2550 UMR_MSEC__10_1_M255_S6_S3 -2550 0
 /begin AXIS_DESCR STD_AXIS zff_atsys._.iSignale._.obj.sig_c_getr UMR_GRADC__1_1_M40_S6_S3 4 -40 215 DEPOSIT ABSOLUTE MONOTONY MON_INCREASE /end AXIS_DESCR
 /begin AXIS_DESCR STD_AXIS zff_atsys._.iSignale._.obj.sig_m_t8 UMR_NM__8_1_M50_S6_S3 4 -400 1640 DEPOSIT ABSOLUTE MONOTONY MON_INCREASE /end AXIS_DESCR
/end CHARACTERISTIC
/begin CHARACTERISTIC KF_TSYNCGMTHINSYNSP86 "Zeit vor sync. fur Rampenstart Haltephase in Synchron" MAP 0x237424 kf_ui8_S6_S3 2550 UMR_MSEC__10_1_M255_S6_S3 -2550 0
 /begin AXIS_DESCR STD_AXIS zff_atsys._.iSignale._.obj.sig_c_getr UMR_GRADC__1_1_M40_S6_S3 4 -40 215 DEPOSIT ABSOLUTE MONOTONY MON_INCREASE /end AXIS_DESCR
 /begin AXIS_DESCR STD_AXIS zff_atsys._.iSignale._.obj.sig_m_t8 UMR_NM__8_1_M50_S6_S3 4 -400 1640 DEPOSIT ABSOLUTE MONOTONY MON_INCREASE /end AXIS_DESCR
/end CHARACTERISTIC
/begin CHARACTERISTIC KF_TSYNCGMTHINSYNRASP86 "Zeit vor sync. fur Rampenende Haltephase in Synchron" MAP 0x237444 kf_ui8_S6_S3 2550 UMR_MSEC__10_1_M255_S6_S3 -2550 0
 /begin AXIS_DESCR STD_AXIS zff_atsys._.iSignale._.obj.sig_c_getr UMR_GRADC__1_1_M40_S6_S3 4 -40 215 DEPOSIT ABSOLUTE MONOTONY MON_INCREASE /end AXIS_DESCR
 /begin AXIS_DESCR STD_AXIS zff_atsys._.iSignale._.obj.sig_m_t8 UMR_NM__8_1_M50_S6_S3 4 -400 1640 DEPOSIT ABSOLUTE MONOTONY MON_INCREASE /end AXIS_DESCR
/end CHARACTERISTIC
/begin CHARACTERISTIC KF_TSYNCGMTHINSYNSPORT21 "Zeit vor sync. fur Rampenstart Haltephase in Synchron" MAP 0x237464 kf_ui8_S6_S3 2550 UMR_MSEC__10_1_M255_S6_S3 -2550 0
 /begin AXIS_DESCR STD_AXIS zff_atsys._.iSignale._.obj.sig_c_getr UMR_GRADC__1_1_M40_S6_S3 4 -40 215 DEPOSIT ABSOLUTE MONOTONY MON_INCREASE /end AXIS_DESCR
 /begin AXIS_DESCR STD_AXIS zff_atsys._.iSignale._.obj.sig_m_t8 UMR_NM__8_1_M50_S6_S3 4 -400 1640 DEPOSIT ABSOLUTE MONOTONY MON_INCREASE /end AXIS_DESCR
/end CHARACTERISTIC
/begin CHARACTERISTIC KF_TSYNCGMTHINSYNRASPORT21 "Zeit vor sync. fur Rampenende Haltephase in Synchron" MAP 0x237484 kf_ui8_S6_S3 2550 UMR_MSEC__10_1_M255_S6_S3 -2550 0
 /begin AXIS_DESCR STD_AXIS zff_atsys._.iSignale._.obj.sig_c_getr UMR_GRADC__1_1_M40_S6_S3 4 -40 215 DEPOSIT ABSOLUTE MONOTONY MON_INCREASE /end AXIS_DESCR
 /begin AXIS_DESCR STD_AXIS zff_atsys._.iSignale._.obj.sig_m_t8 UMR_NM__8_1_M50_S6_S3 4 -400 1640 DEPOSIT ABSOLUTE MONOTONY MON_INCREASE /end AXIS_DESCR
/end CHARACTERISTIC
/begin CHARACTERISTIC KF_TSYNCGMTHINSYNSPORT32 "Zeit vor sync. fur Rampenstart Haltephase in Synchron" MAP 0x2374A4 kf_ui8_S6_S3 2550 UMR_MSEC__10_1_M255_S6_S3 -2550 0
 /begin AXIS_DESCR STD_AXIS zff_atsys._.iSignale._.obj.sig_c_getr UMR_GRADC__1_1_M40_S6_S3 4 -40 215 DEPOSIT ABSOLUTE MONOTONY MON_INCREASE /end AXIS_DESCR
 /begin AXIS_DESCR STD_AXIS zff_atsys._.iSignale._.obj.sig_m_t8 UMR_NM__8_1_M50_S6_S3 4 -400 1640 DEPOSIT ABSOLUTE MONOTONY MON_INCREASE /end AXIS_DESCR
/end CHARACTERISTIC
/begin CHARACTERISTIC KF_TSYNCGMTHINSYNRASPORT32 "Zeit vor sync. fur Rampenende Haltephase in Synchron" MAP 0x2374C4 kf_ui8_S6_S3 2550 UMR_MSEC__10_1_M255_S6_S3 -2550 0
 /begin AXIS_DESCR STD_AXIS zff_atsys._.iSignale._.obj.sig_c_getr UMR_GRADC__1_1_M40_S6_S3 4 -40 215 DEPOSIT ABSOLUTE MONOTONY MON_INCREASE /end AXIS_DESCR
 /begin AXIS_DESCR STD_AXIS zff_atsys._.iSignale._.obj.sig_m_t8 UMR_NM__8_1_M50_S6_S3 4 -400 1640 DEPOSIT ABSOLUTE MONOTONY MON_INCREASE /end AXIS_DESCR
/end CHARACTERISTIC
/begin CHARACTERISTIC KF_TSYNCGMTHINSYNSPORT43 "Zeit vor sync. fur Rampenstart Haltephase in Synchron" MAP 0x2374E4 kf_ui8_S6_S3 2550 UMR_MSEC__10_1_M255_S6_S3 -2550 0
 /begin AXIS_DESCR STD_AXIS zff_atsys._.iSignale._.obj.sig_c_getr UMR_GRADC__1_1_M40_S6_S3 4 -40 215 DEPOSIT ABSOLUTE MONOTONY MON_INCREASE /end AXIS_DESCR
 /begin AXIS_DESCR STD_AXIS zff_atsys._.iSignale._.obj.sig_m_t8 UMR_NM__8_1_M50_S6_S3 4 -400 1640 DEPOSIT ABSOLUTE MONOTONY MON_INCREASE /end AXIS_DESCR
/end CHARACTERISTIC
/begin CHARACTERISTIC KF_TSYNCGMTHINSYNRASPORT43 "Zeit vor sync. fur Rampenende Haltephase in Synchron" MAP 0x237504 kf_ui8_S6_S3 2550 UMR_MSEC__10_1_M255_S6_S3 -2550 0
 /begin AXIS_DESCR STD_AXIS zff_atsys._.iSignale._.obj.sig_c_getr UMR_GRADC__1_1_M40_S6_S3 4 -40 215 DEPOSIT ABSOLUTE MONOTONY MON_INCREASE /end AXIS_DESCR
 /begin AXIS_DESCR STD_AXIS zff_atsys._.iSignale._.obj.sig_m_t8 UMR_NM__8_1_M50_S6_S3 4 -400 1640 DEPOSIT ABSOLUTE MONOTONY MON_INCREASE /end AXIS_DESCR
/end CHARACTERISTIC
/begin CHARACTERISTIC KF_TSYNCGMTHINSYNSPORT54 "Zeit vor sync. fur Rampenstart Haltephase in Synchron" MAP 0x237524 kf_ui8_S6_S3 2550 UMR_MSEC__10_1_M255_S6_S3 -2550 0
 /begin AXIS_DESCR STD_AXIS zff_atsys._.iSignale._.obj.sig_c_getr UMR_GRADC__1_1_M40_S6_S3 4 -40 215 DEPOSIT ABSOLUTE MONOTONY MON_INCREASE /end AXIS_DESCR
 /begin AXIS_DESCR STD_AXIS zff_atsys._.iSignale._.obj.sig_m_t8 UMR_NM__8_1_M50_S6_S3 4 -400 1640 DEPOSIT ABSOLUTE MONOTONY MON_INCREASE /end AXIS_DESCR
/end CHARACTERISTIC
/begin CHARACTERISTIC KF_TSYNCGMTHINSYNRASPORT54 "Zeit vor sync. fur Rampenende Haltephase in Synchron" MAP 0x237544 kf_ui8_S6_S3 2550 UMR_MSEC__10_1_M255_S6_S3 -2550 0
 /begin AXIS_DESCR STD_AXIS zff_atsys._.iSignale._.obj.sig_c_getr UMR_GRADC__1_1_M40_S6_S3 4 -40 215 DEPOSIT ABSOLUTE MONOTONY MON_INCREASE /end AXIS_DESCR
 /begin AXIS_DESCR STD_AXIS zff_atsys._.iSignale._.obj.sig_m_t8 UMR_NM__8_1_M50_S6_S3 4 -400 1640 DEPOSIT ABSOLUTE MONOTONY MON_INCREASE /end AXIS_DESCR
/end CHARACTERISTIC
/begin CHARACTERISTIC KF_TSYNCGMTHINSYNSPORT65 "Zeit vor sync. fur Rampenstart Haltephase in Synchron" MAP 0x237564 kf_ui8_S6_S3 2550 UMR_MSEC__10_1_M255_S6_S3 -2550 0
 /begin AXIS_DESCR STD_AXIS zff_atsys._.iSignale._.obj.sig_c_getr UMR_GRADC__1_1_M40_S6_S3 4 -40 215 DEPOSIT ABSOLUTE MONOTONY MON_INCREASE /end AXIS_DESCR
 /begin AXIS_DESCR STD_AXIS zff_atsys._.iSignale._.obj.sig_m_t8 UMR_NM__8_1_M50_S6_S3 4 -400 1640 DEPOSIT ABSOLUTE MONOTONY MON_INCREASE /end AXIS_DESCR
/end CHARACTERISTIC
/begin CHARACTERISTIC KF_TSYNCGMTHINSYNRASPORT65 "Zeit vor sync. fur Rampenende Haltephase in Synchron" MAP 0x237584 kf_ui8_S6_S3 2550 UMR_MSEC__10_1_M255_S6_S3 -2550 0
 /begin AXIS_DESCR STD_AXIS zff_atsys._.iSignale._.obj.sig_c_getr UMR_GRADC__1_1_M40_S6_S3 4 -40 215 DEPOSIT ABSOLUTE MONOTONY MON_INCREASE /end AXIS_DESCR
 /begin AXIS_DESCR STD_AXIS zff_atsys._.iSignale._.obj.sig_m_t8 UMR_NM__8_1_M50_S6_S3 4 -400 1640 DEPOSIT ABSOLUTE MONOTONY MON_INCREASE /end AXIS_DESCR
/end CHARACTERISTIC
/begin CHARACTERISTIC KF_TSYNCGMTHINSYNSPORT76 "Zeit vor sync. fur Rampenstart Haltephase in Synchron" MAP 0x2375A4 kf_ui8_S6_S3 2550 UMR_MSEC__10_1_M255_S6_S3 -2550 0
 /begin AXIS_DESCR STD_AXIS zff_atsys._.iSignale._.obj.sig_c_getr UMR_GRADC__1_1_M40_S6_S3 4 -40 215 DEPOSIT ABSOLUTE MONOTONY MON_INCREASE /end AXIS_DESCR
 /begin AXIS_DESCR STD_AXIS zff_atsys._.iSignale._.obj.sig_m_t8 UMR_NM__8_1_M50_S6_S3 4 -400 1640 DEPOSIT ABSOLUTE MONOTONY MON_INCREASE /end AXIS_DESCR
/end CHARACTERISTIC
/begin CHARACTERISTIC KF_TSYNCGMTHINSYNRASPORT76 "Zeit vor sync. fur Rampenende Haltephase in Synchron" MAP 0x2375C4 kf_ui8_S6_S3 2550 UMR_MSEC__10_1_M255_S6_S3 -2550 0
 /begin AXIS_DESCR STD_AXIS zff_atsys._.iSignale._.obj.sig_c_getr UMR_GRADC__1_1_M40_S6_S3 4 -40 215 DEPOSIT ABSOLUTE MONOTONY MON_INCREASE /end AXIS_DESCR
 /begin AXIS_DESCR STD_AXIS zff_atsys._.iSignale._.obj.sig_m_t8 UMR_NM__8_1_M50_S6_S3 4 -400 1640 DEPOSIT ABSOLUTE MONOTONY MON_INCREASE /end AXIS_DESCR
/end CHARACTERISTIC
/begin CHARACTERISTIC KF_TSYNCGMTHINSYNSPORT87 "Zeit vor sync. fur Rampenstart Haltephase in Synchron" MAP 0x2375E4 kf_ui8_S6_S3 2550 UMR_MSEC__10_1_M255_S6_S3 -2550 0
 /begin AXIS_DESCR STD_AXIS zff_atsys._.iSignale._.obj.sig_c_getr UMR_GRADC__1_1_M40_S6_S3 4 -40 215 DEPOSIT ABSOLUTE MONOTONY MON_INCREASE /end AXIS_DESCR
 /begin AXIS_DESCR STD_AXIS zff_atsys._.iSignale._.obj.sig_m_t8 UMR_NM__8_1_M50_S6_S3 4 -400 1640 DEPOSIT ABSOLUTE MONOTONY MON_INCREASE /end AXIS_DESCR
/end CHARACTERISTIC
/begin CHARACTERISTIC KF_TSYNCGMTHINSYNRASPORT87 "Zeit vor sync. fur Rampenende Haltephase in Synchron" MAP 0x237604 kf_ui8_S6_S3 2550 UMR_MSEC__10_1_M255_S6_S3 -2550 0
 /begin AXIS_DESCR STD_AXIS zff_atsys._.iSignale._.obj.sig_c_getr UMR_GRADC__1_1_M40_S6_S3 4 -40 215 DEPOSIT ABSOLUTE MONOTONY MON_INCREASE /end AXIS_DESCR
 /begin AXIS_DESCR STD_AXIS zff_atsys._.iSignale._.obj.sig_m_t8 UMR_NM__8_1_M50_S6_S3 4 -400 1640 DEPOSIT ABSOLUTE MONOTONY MON_INCREASE /end AXIS_DESCR
/end CHARACTERISTIC
/begin COMPU_METHOD SAB_04883PROZENT100000_M127_S2_S3 "int = ((phys * 100000) / 4883) - (-127) -" RAT_FUNC "%5.3" "-" COEFFS 0 100000 620141 0 0 4883 /end COMPU_METHOD
/begin COMPU_METHOD SAB_M250_S2_S3 "int = ((phys * 250) / 1) - (0) -" RAT_FUNC "%5.3" "-" COEFFS 0 250 -0 0 0 1 /end COMPU_METHOD
/begin COMPU_METHOD SAB_M10_S2_S3 "int = ((phys * 10) / 1) - (0) -" RAT_FUNC "%5.3" "-" COEFFS 0 10 -0 0 0 1 /end COMPU_METHOD
/begin COMPU_METHOD SAB_1PROZENT_M125_S2_S3 "int = ((phys * 1) / 1) - (-125) %" RAT_FUNC "%2.0" "%" COEFFS 0 1 125 0 0 1 /end COMPU_METHOD
/begin COMPU_METHOD SAB_M125_S2_S3 "int = ((phys * 1) / 1) - (-125) -" RAT_FUNC "%2.0" "-" COEFFS 0 1 125 0 0 1 /end COMPU_METHOD
/begin COMPU_METHOD SAB_PROZENT2_S2_S3 "int = ((phys * 2) / 1) - (0) %" RAT_FUNC "%5.3" "%" COEFFS 0 2 -0 0 0 1 /end COMPU_METHOD
/begin COMPU_METHOD SAB_PROZENT4_S2_S3 "int = ((phys * 4) / 1) - (0) %" RAT_FUNC "%5.3" "%" COEFFS 0 4 -0 0 0 1 /end COMPU_METHOD
/begin COMPU_METHOD SAB_PROZENT40_S2_S3 "int = ((phys * 40) / 1) - (0) %" RAT_FUNC "%5.3" "%" COEFFS 0 40 -0 0 0 1 /end COMPU_METHOD
/begin COMPU_METHOD SAB_PROZENT128_S2_S3 "int = ((phys * 128) / 1) - (0) %" RAT_FUNC "%5.3" "%" COEFFS 0 128 -0 0 0 1 /end COMPU_METHOD
/begin COMPU_METHOD UMR___1_1000_0_S6_S3 "int = ((phys * 1000) / 1) - (0) [-]" RAT_FUNC "%5.3" "[-]" COEFFS 0 1000 -0 0 0 1 /end COMPU_METHOD
/begin COMPU_METHOD UMR___1_100_0_S6_S3 "int = ((phys * 100) / 1) - (0) [-]" RAT_FUNC "%4.2" "[-]" COEFFS 0 100 -0 0 0 1 /end COMPU_METHOD
/begin COMPU_METHOD UMR___1_1_0_S6_S3 "int = ((phys * 1) / 1) - (0) [-]" RAT_FUNC "%2.0" "[-]" COEFFS 0 1 -0 0 0 1 /end COMPU_METHOD
/begin COMPU_METHOD UMR___1_1_0_3_S6_S3 "int = ((phys * 1) / 1) - (0) [-]" RAT_FUNC "%2.0" "[-]" COEFFS 0 1 -0 0 0 1 /end COMPU_METHOD
/begin COMPU_METHOD UMR___1_1_M1_S6_S3 "int = ((phys * 1) / 1) - (-1) [-]" RAT_FUNC "%2.0" "[-]" COEFFS 0 1 1 0 0 1 /end COMPU_METHOD
/begin COMPU_METHOD UMR_NM__1_1_0_S6_S3 "int = ((phys * 1) / 1) - (0) [Nm]" RAT_FUNC "%2.0" "[Nm]" COEFFS 0 1 -0 0 0 1 /end COMPU_METHOD
/begin COMPU_METHOD UMR_NM__8_1_M50_S6_S3 "int = ((phys * 1) / 8) - (-50) [Nm]" RAT_FUNC "%2.0" "[Nm]" COEFFS 0 1 400 0 0 8 /end COMPU_METHOD
/begin COMPU_METHOD UMR_NM_SEC_1_1_0_S6_S3 "int = ((phys * 1) / 1) - (0) [Nm/s]" RAT_FUNC "%2.0" "[Nm/s]" COEFFS 0 1 -0 0 0 1 /end COMPU_METHOD
/begin COMPU_METHOD UMR_NM_BAR_1_1_0_S6_S3 "int = ((phys * 1) / 1) - (0) [Nm/bar]" RAT_FUNC "%2.0" "[Nm/bar]" COEFFS 0 1 -0 0 0 1 /end COMPU_METHOD
/begin COMPU_METHOD UMR_MBAR__1_1_0_S6_S3 "int = ((phys * 1) / 1) - (0) [mbar]" RAT_FUNC "%2.0" "[mbar]" COEFFS 0 1 -0 0 0 1 /end COMPU_METHOD
/begin COMPU_METHOD UMR_BAR__1_1000_0_S6_S3 "int = ((phys * 1000) / 1) - (0) [bar]" RAT_FUNC "%5.3" "[bar]" COEFFS 0 1000 -0 0 0 1 /end COMPU_METHOD
/begin COMPU_METHOD UMR_BAR__1_100_0_S6_S3 "int = ((phys * 100) / 1) - (0) [bar]" RAT_FUNC "%4.2" "[bar]" COEFFS 0 100 -0 0 0 1 /end COMPU_METHOD
/begin COMPU_METHOD UMR_BAR_SEC_1_10_0_S6_S3 "int = ((phys * 10) / 1) - (0) [bar/s]" RAT_FUNC "%3.1" "[bar/s]" COEFFS 0 10 -0 0 0 1 /end COMPU_METHOD
/begin COMPU_METHOD UMR_U_MIN_1_1_0_S6_S3 "int = ((phys * 1) / 1) - (0) [U/min]" RAT_FUNC "%2.0" "[U/min]" COEFFS 0 1 -0 0 0 1 /end COMPU_METHOD
/begin COMPU_METHOD UMR_U_MINMSEC_1_1_0_S6_S3 "int = ((phys * 1) / 1) - (0) [U/(min*ms)]" RAT_FUNC "%2.0" "[U/(min*ms)]" COEFFS 0 1 -0 0 0 1 /end COMPU_METHOD
/begin COMPU_METHOD UMR_U_MINSEC_1_1_0_S6_S3 "int = ((phys * 1) / 1) - (0) [U/(min*s)]" RAT_FUNC "%2.0" "[U/(min*s)]" COEFFS 0 1 -0 0 0 1 /end COMPU_METHOD
/begin COMPU_METHOD UMR_MSEC__1_1_0_S6_S3 "int = ((phys * 1) / 1) - (0) [ms]" RAT_FUNC "%2.0" "[ms]" COEFFS 0 1 -0 0 0 1 /end COMPU_METHOD
/begin COMPU_METHOD UMR_MSEC__10_1_0_S6_S3 "int = ((phys * 1) / 10) - (0) [ms]" RAT_FUNC "%2.0" "[ms]" COEFFS 0 1 -0 0 0 10 /end COMPU_METHOD
/begin COMPU_METHOD UMR_MSEC__10_1_M255_S6_S3 "int = ((phys * 1) / 10) - (-255) [ms]" RAT_FUNC "%2.0" "[ms]" COEFFS 0 1 2550 0 0 10 /end COMPU_METHOD
/begin COMPU_METHOD UMR_SEC__1_1000_0_S6_S3 "int = ((phys * 1000) / 1) - (0) [s]" RAT_FUNC "%5.3" "[s]" COEFFS 0 1000 -0 0 0 1 /end COMPU_METHOD
/begin COMPU_METHOD UMR_SEC__1_100_0_S6_S3 "int = ((phys * 100) / 1) - (0) [s]" RAT_FUNC "%4.2" "[s]" COEFFS 0 100 -0 0 0 1 /end COMPU_METHOD
/begin COMPU_METHOD UMR_SEC__1_1_0_S6_S3 "int = ((phys * 1) / 1) - (0) [s]" RAT_FUNC "%2.0" "[s]" COEFFS 0 1 -0 0 0 1 /end COMPU_METHOD
/begin COMPU_METHOD UMR__SEC_1_1_0_S6_S3 "int = ((phys * 1) / 1) - (0) [1/s]" RAT_FUNC "%2.0" "[1/s]" COEFFS 0 1 -0 0 0 1 /end COMPU_METHOD
/begin COMPU_METHOD UMR_GRADC__1_1_0_S6_S3 "int = ((phys * 1) / 1) - (0) [°C]" RAT_FUNC "%2.0" "[°C]" COEFFS 0 1 -0 0 0 1 /end COMPU_METHOD
/begin COMPU_METHOD UMR_GRADC__1_1_M40_S6_S3 "int = ((phys * 1) / 1) - (-40) [°C]" RAT_FUNC "%2.0" "[°C]" COEFFS 0 1 40 0 0 1 /end COMPU_METHOD
/begin COMPU_METHOD UMR_GRADC__1_1_M48_S6_S3 "int = ((phys * 1) / 1) - (-48) [°C]" RAT_FUNC "%2.0" "[°C]" COEFFS 0 1 48 0 0 1 /end COMPU_METHOD
/begin COMPU_METHOD UMR_KSEC__1_1_0_S6_S3 "int = ((phys * 1) / 1) - (0) [K*s]" RAT_FUNC "%2.0" "[K*s]" COEFFS 0 1 -0 0 0 1 /end COMPU_METHOD
/begin COMPU_METHOD UMR_K_SEC_1_1_0_S6_S3 "int = ((phys * 1) / 1) - (0) [K/s]" RAT_FUNC "%2.0" "[K/s]" COEFFS 0 1 -0 0 0 1 /end COMPU_METHOD
/begin COMPU_METHOD UMR_PROZENT__1_100_0_S6_S3 "int = ((phys * 100) / 1) - (0) [%]" RAT_FUNC "%4.2" "[%]" COEFFS 0 100 -0 0 0 1 /end COMPU_METHOD
/begin COMPU_METHOD UMR_PROZENT__20_51_0_S6_S3 "int = ((phys * 51) / 20) - (0) [%]" RAT_FUNC "%6.4" "[%]" COEFFS 0 51 -0 0 0 20 /end COMPU_METHOD
/begin COMPU_METHOD UMR_PROZENT__16_10_0_S6_S3 "int = ((phys * 10) / 16) - (0) [%]" RAT_FUNC "%3.1" "[%]" COEFFS 0 10 -0 0 0 16 /end COMPU_METHOD
/begin COMPU_METHOD UMR_PROZENT_SEC_20_51_0_S6_S3 "int = ((phys * 51) / 20) - (0) [%/s]" RAT_FUNC "%6.4" "[%/s]" COEFFS 0 51 -0 0 0 20 /end COMPU_METHOD
/begin COMPU_METHOD UMR_KGM2__1_1000_0_S6_S3 "int = ((phys * 1000) / 1) - (0) [kg*m^2]" RAT_FUNC "%5.3" "[kg*m^2]" COEFFS 0 1000 -0 0 0 1 /end COMPU_METHOD
/begin COMPU_METHOD UMR_KGM2__1_100_0_S6_S3 "int = ((phys * 100) / 1) - (0) [kg*m^2]" RAT_FUNC "%4.2" "[kg*m^2]" COEFFS 0 100 -0 0 0 1 /end COMPU_METHOD
/begin COMPU_METHOD UMR_KM_H_1_16_0_S6_S3 "int = ((phys * 16) / 1) - (0) [km/h]" RAT_FUNC "%4.2" "[km/h]" COEFFS 0 16 -0 0 0 1 /end COMPU_METHOD
/begin COMPU_METHOD UMR_GRAD__1_3_M128_S6_S3 "int = ((phys * 3) / 1) - (-128) [Grad]" RAT_FUNC "%5.3" "[Grad]" COEFFS 0 3 128 0 0 1 /end COMPU_METHOD
/begin COMPU_METHOD UMR_W__1_1_0_S6_S3 "int = ((phys * 1) / 1) - (0) [W]" RAT_FUNC "%2.0" "[W]" COEFFS 0 1 -0 0 0 1 /end COMPU_METHOD
/begin COMPU_METHOD UMR_KW__1_1000_0_S6_S3 "int = ((phys * 1000) / 1) - (0) [KW]" RAT_FUNC "%5.3" "[KW]" COEFFS 0 1000 -0 0 0 1 /end COMPU_METHOD
/begin COMPU_METHOD UMR_KW__1_10_0_S6_S3 "int = ((phys * 10) / 1) - (0) [KW]" RAT_FUNC "%3.1" "[KW]" COEFFS 0 10 -0 0 0 1 /end COMPU_METHOD
/begin COMPU_METHOD UMR_W_K_1_1_0_S6_S3 "int = ((phys * 1) / 1) - (0) [W/K]" RAT_FUNC "%2.0" "[W/K]" COEFFS 0 1 -0 0 0 1 /end COMPU_METHOD
/begin COMPU_METHOD UMR_J_K_1_1_0_S6_S3 "int = ((phys * 1) / 1) - (0) [J/(K)]" RAT_FUNC "%2.0" "[J/(K)]" COEFFS 0 1 -0 0 0 1 /end COMPU_METHOD
/begin COMPU_METHOD UMR_LITER_MIN_1_10_0_S6_S3 "int = ((phys * 10) / 1) - (0) [Liter/min]" RAT_FUNC "%3.1" "[Liter/min]" COEFFS 0 10 -0 0 0 1 /end COMPU_METHOD
/begin COMPU_METHOD UMR_M_SEC2_1_32_0_S6_S3 "int = ((phys * 32) / 1) - (0) [m/s^2]" RAT_FUNC "%4.2" "[m/s^2]" COEFFS 0 32 -0 0 0 1 /end COMPU_METHOD
/begin FUNCTION jKasEkopl_Fktn "Applikationesgroessen Instanz jKasEkopl"
 /begin DEF_CHARACTERISTIC KF_F_RAMPEOEFFNEN_ENTKOPPL KF_F_SCHLIESSEN_ENTKOPPL KF_MGSOLL_MDIF_ENTKOPPL KF_MGSOLL_NDG_ENTKOPPL KF_MOSOLLLASTNMOT_ENTKOPPL KF_MOSOLLNDIAETIMER_ENTKOPPL KF_MOZIEL_ENTKOPPL KF_MO_RAMPEOEFFNEN_ENTKOPPL KF_MPT_MO_ENTKOPPL KF_MS_MOSTART_ENTKOPPL KF_M_SOLL_MIN_ENTKOPPL SWI_MO_ENTKOPPL TAB_HYS_NDS_ENTKOPPL TAB_MSLASTFREI_ENTKOPPL TAB_NDS_ZU_ENTKOPPL TAB_TSLASTFREI_ENTKOPPL T_NDS_ZU_ENTKOPPL /end DEF_CHARACTERISTIC
/end FUNCTION
/begin FUNCTION dKasEkoplX_Fktn "Applikationesgroessen der Komponente dKasEkoplX"
 /begin SUB_FUNCTION jKasEkoplR_Fktn jKasEkopl1_Fktn jKasEkopl2_Fktn jKasEkopl3_Fktn jKasEkopl4_Fktn jKasEkopl5_Fktn /end SUB_FUNCTION
/end FUNCTION
/begin FUNCTION jKasEkoplR_Fktn "Applikationesgroessen Instanz jKasEkoplR" /begin DEF_CHARACTERISTIC KF_RAMPEOEFFNEN_ENTKOPPL_R /end DEF_CHARACTERISTIC /end FUNCTION
/begin FUNCTION jKasEkopl1_Fktn "Applikationesgroessen Instanz jKasEkopl1" /begin DEF_CHARACTERISTIC KF_RAMPEOEFFNEN_ENTKOPPL_1 /end DEF_CHARACTERISTIC /end FUNCTION
/begin FUNCTION jKasEkopl2_Fktn "Applikationesgroessen Instanz jKasEkopl2" /begin DEF_CHARACTERISTIC KF_RAMPEOEFFNEN_ENTKOPPL_2 /end DEF_CHARACTERISTIC /end FUNCTION
/begin FUNCTION jKasEkopl3_Fktn "Applikationesgroessen Instanz jKasEkopl3" /begin DEF_CHARACTERISTIC KF_RAMPEOEFFNEN_ENTKOPPL_3 /end DEF_CHARACTERISTIC /end FUNCTION
/begin FUNCTION jKasEkopl4_Fktn "Applikationesgroessen Instanz jKasEkopl4" /begin DEF_CHARACTERISTIC KF_RAMPEOEFFNEN_ENTKOPPL_4 /end DEF_CHARACTERISTIC /end FUNCTION
/begin FUNCTION jKasEkopl5_Fktn "Applikationesgroessen Instanz jKasEkopl5" /begin DEF_CHARACTERISTIC KF_RAMPEOEFFNEN_ENTKOPPL_5 /end DEF_CHARACTERISTIC /end FUNCTION
/begin FUNCTION dIaeAdauf_Fktn "Applikationesgroessen der Komponente dIaeAdauf" /begin SUB_FUNCTION jIaeAdauf_Fktn /end SUB_FUNCTION /end FUNCTION
/begin FUNCTION jIaeAdauf_Fktn "Applikationesgroessen Instanz jIaeAdauf"
 /begin DEF_CHARACTERISTIC CS_START_MAX_UEFIAE CS_START_MIN_UEFIAE DO_MUEMAX_UEFIAE KL_J_KOR_UEFIAE MSTELL_ABBR_UEFIAE MS_MOTIST_ABBR_UEFIAE MS_START_MAX_UEFIAE MS_START_MIN_UEFIAE MUE_IST_MAX_UEFIAE MUE_IST_MIN_UEFIAE M_MOTIST_START_MAX_UEFIAE M_MOTIST_START_MIN_UEFIAE NDGS_START_MAX_UEFIAE NDGS_START_MIN_UEFIAE NDS_ABBR_UEFIAE NDS_START_MAX_UEFIAE NDS_START_MIN_UEFIAE NGS_ABBR_UEFIAE NGS_MOT_START_MAX_UEFIAE NGS_MOT_START_MIN_UEFIAE PSTELL_ABBR_UEFIAE TAB_MTM_MOT_UEFIAE T_LAUF_UEFIAE /end DEF_CHARACTERISTIC
/end FUNCTION
/begin FUNCTION dIaeAnfahEcoX_Fktn "Applikationesgroessen der Komponente dIaeAnfahEcoX"
 /begin SUB_FUNCTION jIaeAnfahEl_Fktn jIaeAnfahHy_Fktn jIaeAnfahElEco_Fktn jIaeAnfahHyEco_Fktn /end SUB_FUNCTION
/end FUNCTION
/begin FUNCTION jIaeAnfahEl_Fktn "Applikationesgroessen Instanz jIaeAnfahEl"
 /begin DEF_CHARACTERISTIC KF_F_M_ANFAHRT_E_IAE KF_NMOTANFAHR_SOLL_E_IAE KF_NMOTANFAHR_SOLL_STALL_E_IAE KL_NGMOTANFAHRINIT_E_IAE /end DEF_CHARACTERISTIC
/end FUNCTION
/begin FUNCTION jIaeAnfahHy_Fktn "Applikationesgroessen Instanz jIaeAnfahHy"
 /begin DEF_CHARACTERISTIC KF_F_M_ANFAHRT_H_IAE KF_NMOTANFAHR_SOLL_H_IAE KF_NMOTANFAHR_SOLL_STALL_H_IAE KL_NGMOTANFAHRINIT_H_IAE /end DEF_CHARACTERISTIC
/end FUNCTION
/begin FUNCTION jIaeAnfahElEco_Fktn "Applikationesgroessen Instanz jIaeAnfahElEco"
 /begin DEF_CHARACTERISTIC KF_F_M_ANFAHRT_E_ECO_IAE KF_NMOTANFAHR_SOLL_E_ECO_IAE KF_NMOTANFAHR_SOLL_STALL_E_ECO_IAE KL_NGMOTANFAHRINIT_E_ECO_IAE /end DEF_CHARACTERISTIC
/end FUNCTION
/begin FUNCTION jIaeAnfahHyEco_Fktn "Applikationesgroessen Instanz jIaeAnfahHyEco"
 /begin DEF_CHARACTERISTIC KF_F_M_ANFAHRT_H_ECO_IAE KF_NMOTANFAHR_SOLL_H_ECO_IAE KF_NMOTANFAHR_SOLL_STALL_H_ECO_IAE KL_NGMOTANFAHRINIT_H_ECO_IAE /end DEF_CHARACTERISTIC
/end FUNCTION
/begin FUNCTION dIaeMomen_Fktn "Applikationesgroessen der Komponente dIaeMomen" /begin SUB_FUNCTION jIaeMomen_Fktn /end SUB_FUNCTION /end FUNCTION
/begin FUNCTION jIaeMomen_Fktn "Applikationesgroessen Instanz jIaeMomen"
 /begin DEF_CHARACTERISTIC CS_GETR_ANFMODUS_IAE F_MKRIECH_ANF_IAE KF_AMPUEBTEMPPULS_IAE KF_F_AMPUEBTEMPPULS_IAE KF_F_MAUFNMOTPBREMS_IAE KF_F_M_AUF_IAE KF_F_M_KRIECH_MAX_IAE KF_F_M_SCHLEPP_IAE KF_F_NDMOTANFAHR_IAE KF_J_ANFAHRT_IAE KF_KI_KRIECH_IAE KF_KP_KRIECH_IAE KF_MGSOLLSYNC_IAE KF_MOSOLLLASTNMOT_IAE KF_MOSOLLNDIAETIMER_IAE KF_MO_ZU_IAE KF_MPT_ISTUETZSCHALT_IAE KF_MSOLL_KALTANFAHR_IAE KF_M_ANGELEGT_PBREMSDKI_IAE KF_M_KRIECH_IAE KF_M_KRIECH_MAX_IAE KF_M_KRIECH_MIN_IAE KF_M_SCHLEPP_GETR_IAE KF_M_SCHLEPP_IAE KF_ND_IAESOLLKRIECH_IAE KF_NMOTANFAHRMAXC_IAE KF_NMOTANFAHR_SOLL_NEIGUNG_IAE KF_OG_M_AUF_FAKTOR_IAE KF_T_PT2_M_IST_IAE KF_T_UEF_I_STUETZ_IAE KF_T_UEF_KRIECH_IAE KF_T_UEF_MANF_ANGL_IAE KF_T_UEF_MANF_KRIECH_IAE KF_T_UEF_M_ANGELEGT_KRIECH_IAE KF_T_UEF_M_KRIECH_ANGELEGT_IAE KF_T_UEF_M_VOR_ANF_IAE KF_T_UEF_M_VOR_ANF_KRIANG_IAE KF_T_UEF_ZU_ANF_IAE KF_T_UEF_ZU_KRIECH_ANGL_IAE KI_ZU_IAE KL_CSMOT_ANFMODUS_IAE KL_FNMOTANFAHRLL_IAE KL_FNMOTANFAHRMOTSTRESS_IAE KL_F_AMPUEBTEMPPULS_NEIG_IAE KL_F_MOSCHALT_ZU_IAE KL_F_M_ANGELEGT_IAE KL_F_M_KRIECH_MAX_NEIGUNG_IAE KL_F_M_SCHLEPP_CGETR_IAE KL_F_M_SCHLEPP_IAE KL_F_NDIAESOLLKRIECH_IAE KL_F_NGMOTANFAHRINITGE_IAE KL_F_ONMOTANFAHR_IAE KL_F_T_UEF_ZU_ANF_IAE KL_F_T_UEF_ZU_KRIECH_ANGL_IAE KL_MAXIREGZU_IAE KL_MAXOGNMOTANFAHR_SOLL_IAE KL_MG_ZU_IAE KL_MO_ASRREGELT_ZU_IAE KL_MSOLLMINANFAHR_MAX_IAE KL_M_ANGELEGT_ND_IAE KL_M_KRIECHMAX_CGETR_IAE KL_M_KRIECHMAX_FAS_IAE KL_M_KRIECHMAX_MOTSTRESS_IAE KL_M_MAX_BASIS_ANF_KORR_IAE KL_M_SCHLEPP_GETRPN_IAE KL_NMOTANFAHRMMOTMAX_IAE KL_ONMOTANFAHR_IAE KL_START_UEBTEMPPULS_IAE KL_TYP_UEF_1_IAE KL_TYP_UEF_2_IAE KL_TYP_UEF_3_IAE KL_TYP_UEF_4_IAE KL_T_PT2_NMOTANFENTKOPPL_IAE KL_T_UEF_MSOLLANFAHR_IAE KL_T_UEF_MSOLLEENTK_IAE KL_T_UEF_MSOLLEHANF_IAE KL_T_UEF_M_AUF_GA_IAE KL_T_UEF_M_AUF_GA_IAE_EL KL_T_UEF_M_AUF_GE_IAE KL_T_UEF_M_AUF_GE_IAE_EL MG_ANKRIECHEN_IAE MG_ANKRIECHNEG_IAE MG_KRIECHMAXNEG_IAE MG_KRIECHMAXPOS_IAE MG_SOLL_ENPGFIX_IAE MO_ANGELEGT_KRIECH_IAE MO_IAEAUF_IAE MO_ZU_ANFAHR_IAE MPT_F_M_BASIS_ANFAHRT_IAE MPT_J_ANFAHRT_IAE MPT_NMOTSOLLANFAHR_ENTK_IAE M_ANGELEGT_AUTOHOLD_IAE M_AUF_MIN_IAE M_KRIECHMAX_FSTBR_IAE NDS_ANFAHRINIT_IAE NS_ABMINANKRIECHEN_IAE NS_ABREGINITKRIECH_HYS_IAE NS_ABREGINITKRIECH_IAE NS_MOTANFAHRMAXC_IAE N_EMKNICK_ERSATZ_IAE OG_M_AUF_REST_IAE SWI_F_M_BASIS_IAE SWI_KRIECHAKTIVNDS_IAE SWI_MIAEAUF_ANFAHREN_IAE SWI_M_IAEAUF_SCHLEPP_IAE SWI_NSOLLH_SLST_IAE SWI_PT2INITEH_ANFAHRT_IAE SWI_PT2INIT_ANFAHRT_IAE TAB_F_MMAX_KRIECH_IAE TAB_F_MMIN_KRIECH_IAE TAB_F_MVST_KRIECH_IAE TAB_STUETZFAKTOR_IAE TAB_UEF_I_STUETZ_IAE TS_MAXANKRIECHEN_IAE TYP_UEF_I_STUETZ_IAE TYP_UEF_KALTANFAHR_IAE TYP_UEF_KRIECH_IAE TYP_UEF_MANF_ANGL_IAE TYP_UEF_MANF_KRIECH_IAE TYP_UEF_MSOLLANFAHR_IAE TYP_UEF_MSOLLEENTK_IAE TYP_UEF_MSOLLEHANF_IAE TYP_UEF_M_ANGELEGT_KRIECH_IAE TYP_UEF_M_AUF_IAE TYP_UEF_M_KRIECH_ANGELEGT_IAE TYP_UEF_M_VOR_ANF_IAE TYP_UEF_M_VOR_ANF_KRIANG_IAE TYP_UEF_ZU_ANF_IAE TYP_UEF_ZU_KRIECH_ANGL_IAE T_UEBTEMPPULS_IAE T_UEF_KALTANFAHR_IAE T_XDG_REGLER_IAE XDS_ZU_IAE /end DEF_CHARACTERISTIC
/end FUNCTION
/begin FUNCTION dIaeTempm_Fktn "Applikationesgroessen der Komponente dIaeTempm" /begin SUB_FUNCTION jIaeTempm_Fktn /end SUB_FUNCTION /end FUNCTION
/begin FUNCTION jIaeTempm_Fktn "Applikationesgroessen Instanz jIaeTempm"
 /begin DEF_CHARACTERISTIC KF_ALPHA_SCHLUPF_IAE KL_ALPHA_AUF_IAE KL_ALPHA_ZU_IAE KL_CG_KUEHL_IAE KL_CO_KUEHL_IAE KL_F_CIAEINI_IAE TAB_MVG_C_IAE T_WARTEN_CIAEINI_IAE WAERMEKAP_IAE /end DEF_CHARACTERISTIC
/end FUNCTION
/begin FUNCTION dIaeMotmx_Fktn "Applikationesgroessen der Komponente dIaeMotmx" /begin SUB_FUNCTION jIaeMotmx_Fktn /end SUB_FUNCTION /end FUNCTION
/begin FUNCTION jIaeMotmx_Fktn "Applikationesgroessen Instanz jIaeMotmx"
 /begin DEF_CHARACTERISTIC DKIS_STALL_IAE KF_MMOTMAXC_IAE KF_MMOTMAXND_IAE KF_M_MOTMAXSTALL_IAE KL_F_MMOTMAXC_IAE KL_MMOTMAXXD_IAE KL_M_MOT_MAX_TEMP_TIMER_IAE KL_M_STELLMAX_IAE MG_MOTAUFREGELSTALL_IAE MG_M_MOTMAX_IAE MPT_MMOTMAX_IAE NEIGUNG_STALL_IAE NS_NDMOTSTALL_IAE PS_BREMS_STALL_IAE SWI_BLS_STALL_IAE SWI_FESTSTELLBREMSE_STALL_IAE /end DEF_CHARACTERISTIC
/end FUNCTION
/begin FUNCTION dIaeKordi_Fktn "Applikationesgroessen der Komponente dIaeKordi" /begin SUB_FUNCTION jIaeKordi_Fktn /end SUB_FUNCTION /end FUNCTION
/begin FUNCTION jIaeKordi_Fktn "Applikationesgroessen Instanz jIaeKordi"
 /begin DEF_CHARACTERISTIC DKIS_ANFAHRT_HYS_IAE DKIS_ANFAHRT_IAE GS_ANFAHRT_IAE GS_ANGELEGT_SCHALT_IAE KF_PS_BREMS_ANFAHRT_IAE KL_NDMOTVMSTARTBEGINN_IAE KL_NDS_ANGELEGT_KRIECH_IAE KL_ONSENTKOPPL_ANGELEGT_IAE MS_K0VMSTARTBEGINN_IAE MS_MOTSOLLREKUEND_IAE MS_SOLL_ENPGFIX_IAE NDO_TORQUEFUSE_IAE NDS_MOTINITREG_IAE NDS_SYNC_EKS_IAE NDS_SYNC_IAE NDS_ZU_HYS_IAE NDS_ZU_IAE NGS_ASRREGELT_IAE NO_EM_HEANF_IAE NO_VM_EHANF_IAE NS_AB_ANFAHRT_IAE NS_HYS_MOTKRIECH_IAE NS_MOTKRIECH_IAE PS_HYS_BREMS_IAE SWI_ANFAHRVERB_RS_IAE SWI_ANGELEGT_SCHALT_IAE TAB_MVG_MSTELL_IAE TAB_MVG_ND_IAE TAB_SWI_HSCHALTVERHIAE_ZZS TAB_SWI_SCHALTVERHIAE_ZZS T_NDS_ZU_IAE T_RAMAXSNYC_IAE /end DEF_CHARACTERISTIC
/end FUNCTION
/begin FUNCTION dIaeKuehl_Fktn "Applikationesgroessen der Komponente dIaeKuehl" /begin SUB_FUNCTION jIaeKuehl_Fktn /end SUB_FUNCTION /end FUNCTION
/begin FUNCTION jIaeKuehl_Fktn "Applikationesgroessen Instanz jIaeKuehl"
 /begin DEF_CHARACTERISTIC CS_GETR_VPKUEHLMIN_IAE CS_SLGRENZ_IAE F_KUEHLOELV_IAE KF_VP_KUEHL_SOLL_IAE KF_VP_LECKAGE_IAE KL_CS_NACHKUEHL_IAE KL_CS_NMOTLLSOLL_IAE KL_F_VP_KUEHL_IAE KL_PO_KUEHL_IAE KL_P_KUEHL_IAE MPT_KUEHL_IAE MPT_KUEHL_KORR_IAE NDS_KUEHLOFFEN_IAE ND_HYS_KUEHLOFFEN_IAE PWS_KUEHL_INAKTIV_IAE TS_EFAHREN_IAE T_KUEHL_INAKTIV_IAE VP_KUEHLOFFEN_IAE VP_KUEHL_MAX_IAE VP_KUEHL_MIN_IAE ZIELGANG_NACHKUEHL_IAE /end DEF_CHARACTERISTIC
/end FUNCTION
/begin FUNCTION dIaeDiagn_Fktn "Applikationesgroessen der Komponente dIaeDiagn" /begin SUB_FUNCTION jIaeDiagn_Fktn /end SUB_FUNCTION /end FUNCTION
/begin FUNCTION jIaeDiagn_Fktn "Applikationesgroessen Instanz jIaeDiagn"
 /begin DEF_CHARACTERISTIC AXS_CLOSE_DIAGIAE AX_MAX_CLOSE_DIAGIAE CS_CGETR_NOCLOSE_DIAGIAE CS_MAX_DIAGIAE CS_MAX_HYS_DIAGIAE CTR_HOT_MAX_DIAGIAE F_MMOT_NOCLOSE_DIAGIAE F_NSOLL_NOCLOSE_DIAGIAE KF_MDI_DIAGIAE KF_ND_NOOPEN_DIAGIAE KL_F_ND_RESET_DIAGIAE KL_MDI_CLOSE_DIAGIAE KL_MDI_NOOPEN_DIAGIAE KL_NGS_NAB_CLOSE_DIAGIAE MO_MMOT_NOCLOSE_DIAGIAE MPT_MDI_DIAGIAE M_SOLLMAX_CLOSE_DIAGIAE NDS_NDIAE_NOCLOSE_DIAGIAE NGS_NMOT_NOCLOSE_DIAGIAE NO_NSOLL_NOCLOSE_DIAGIAE NS_NAB_CLOSE_DIAGIAE N_STOER_KFC_NOCLOSE_DIAGIAE PS_BREMS_NOOPEN_DIAGIAE SWI_CLOSE_AKTIV_DIAG_IAE SWI_NDMOT_DIAGIAE SWI_NOCLOSE_AKTIV_DIAG_IAE SWI_NOOPEN_AKTIV_DIAG_IAE TAB_ZMODUS_CLOSE_DIAGIAE TAB_ZMODUS_NOOPEN_DIAGIAE TS_AX_CLOSE_DIAGIAE T_LWREAKT_DIAGIAE T_ND_RESET_DIAGIAE T_NOCLOSE_DIAGIAE T_NOOPEN_DIAGIAE VDS_WHEEL_CLOSE_DIAGIAE /end DEF_CHARACTERISTIC
/end FUNCTION
/begin FUNCTION dIaeSigna_Fktn "Applikationesgroessen der Komponente dIaeSigna" /begin SUB_FUNCTION jIaeSigna_Fktn /end SUB_FUNCTION /end FUNCTION
/begin FUNCTION jIaeSigna_Fktn "Applikationesgroessen Instanz jIaeSigna"
 /begin DEF_CHARACTERISTIC F_MMOTIST_GEM_IAE F_MMOTSOLL_GEM_IAE F_MMOT_GEM_IAE F_NG_AB_NEIGUNG_IAE KF_MOT_LAST_IAE KF_NDMOT_POSN_IAE KF_NS_SYNC_E_IAE KF_NS_SYNC_HYS_E_ECO_IAE KF_NS_SYNC_HYS_E_IAE KF_NS_SYNC_HYS_H_ECO_IAE KF_NS_SYNC_HYS_H_IAE KF_NS_SYNC_H_IAE KL_FNSSYNC_IAE KL_F_FDYNANFAHR_IAE KL_F_NUE_IAE KL_MOTSTRESSPAIR_IAE KL_MSCHLEPPOFFEN_IAE KL_NS_ASRREGELT_SYNC_IAE KL_NS_ENPG3_SYNC_IAE KL_NS_GETREIN_OEFFNEN_MIN_IAE KL_ONS_SYNC_IAE KL_T_PT2_NEIGUNG_IAE KL_VZ_MMOTGEM_IAE KL_VZ_MMOTISTOE_IAE KL_VZ_MMOTIST_IAE KL_VZ_MMOTSOLLOE_IAE MDT_DKIG_IAE MDT_MG_MOTIST_IAE MDT_NDG_IAE MDT_NG_AB_IAE MDT_NG_GETREIN_IAE MDT_NG_MOT_IAE MDT_PG_BREMS_IAE MO_MOTISTOE_IAE MO_MOTIST_IAE MO_MOTSOLLOE_IAE MPT_AX_REF_DIAGIAE MPT_DKI_IAE MPT_MMOTGEM_IAE MPT_MMOTISTOE_IAE MPT_MMOTIST_IAE MPT_MMOTSOLLOE_IAE MPT_NAB_IAE MPT_ND_GETREIN_IAE MPT_ND_IAE MPT_ND_MOT_IAE MPT_NMOT_IAE MPT_NT_IAE MPT_NUE_IAE MPT_PBREMS_IAE NDS_HYSMREIBZU_IAE NDS_MREIBZU_IAE NDS_NDIAE_POSN_IAE NDS_POSN_IAE ND_MOTPOSN_RSETZ_IAE NEIG_D_IAE NEIG_HYS_IAE NEIG_R_IAE NGS_AB_POSN_IAE NGS_GETREIN_POSN_IAE NGS_HYSAB_POSN_IAE NGS_HYSGETREIN_POSN_IAE NGS_MOT_POSN_IAE NS_ABNEIG_IAE NS_ABPOSN_RSETZ_IAE NS_ASRREGELT_SYNC_HYS_E_IAE NS_ASRREGELT_SYNC_HYS_H_IAE NS_EMLL_MIN_IAE NS_HYS_ABNEIG_IAE NS_NDGETREINLLBASIS_IAE PS_BREMS_POSN_IAE SWI_BREMS_SOLLNEUTRAL_IAE SWI_MOT_LAST_IAE SWI_NDGETREINLLBASIS_IAE SWI_NEIGUNGGEF_IAE SWI_NMOTLLREG_AKTIV_IAE SWI_NMOTSOLL_LL_E_IAE SWI_NS_SYNC_IAE TAB_SWI_ASRREGELT_IAE TAB_ZIELGANGPOSN_IAE VZ_NAB_IAE VZ_NT_IAE /end DEF_CHARACTERISTIC
/end FUNCTION
/begin FUNCTION dIaeDraus_Fktn "Applikationesgroessen der Komponente dIaeDraus" /begin SUB_FUNCTION jIaeDraus_Fktn /end SUB_FUNCTION /end FUNCTION
/begin FUNCTION jIaeDraus_Fktn "Applikationesgroessen Instanz jIaeDraus"
 /begin DEF_CHARACTERISTIC KF_MUE_IAE KF_MUE_OFFSET_IAE KF_PO_DYN_ANFAHR_IAE KL_F_MUE_IAE KL_F_PO_DYN_KRIECH_IAE KL_PO_DYN_ANFAHR_IAE KL_PO_DYN_KRIECH_IAE KL_PO_HYSKOMP_IAE KL_T_HALTE_HYSKOMP_IAE KL_T_PO_DYN_ANFAHR_IAE KL_T_PO_DYN_KRIECH_IAE MPT_MUE_IAE MPT_PO_DYN_ANFAHR_IAE MPT_PO_DYN_KRIECH_IAE MPT_PO_HYSKOMP_IAE MPT_PSTELLBASIS_IAE MS_HYSKOMP_KRIECHEN_IAE PDS_HYS_SCHLEIFE_IAE PG_HYSKOMP_IAE PO_HYSKOMP_ZIEL_IAE PS_BREMS_HYSKOMP_KRIECH_IAE SWI_HYSKOMP_KRIECH_IAE SWI_PO_DYN_ANFAHR_IAE SWI_PO_DYN_KRIECH_IAE TAB_F_PO_DYN_ANFAHR_IAE TAB_MIN_ND_IAEKFMUE_ENTKOPPL TAB_MIN_ND_IAEKFMUE_IAE TAB_MPT_P_HYS_SCHLEIFE_IAE TAB_P_HYS_SCHLEIFE_IAE TAB_SWI_HYS_SCHLEIFE_IAE TAB_SWI_P_STELL_MAX_IAE TAB_T_P_HYS_SCHLEIFE_IAE TS_INITHYS_SCHLEIFE_IAE /end DEF_CHARACTERISTIC
/end FUNCTION
/begin FUNCTION dIaeAnfahX_Fktn "Applikationesgroessen der Komponente dIaeAnfahX" /begin SUB_FUNCTION jIaeAnfahE_Fktn jIaeAnfahH_Fktn /end SUB_FUNCTION /end FUNCTION
/begin FUNCTION jIaeAnfahE_Fktn "Applikationesgroessen Instanz jIaeAnfahE"
 /begin DEF_CHARACTERISTIC KF_F_KD_ANFAHRT_E_IAE KF_F_KI_ANFAHRT_E_IAE KF_F_KP_ANFAHRT_E_IAE KF_KD_ANFAHRT_E_IAE KF_KI_ANFAHRT_E_IAE KF_KP_ANFAHRT_E_IAE KF_OGNMOTANFAHR_SOLL_E_IAE KF_T_PT2_NMOTANFAHR_E_IAE KL_F_M_PUAUF_ANFAHRT_E_IAE KL_F_M_SCHLEPP_ANFAHRT_E_IAE KL_MPT_NMOTSOLLANFAHR_ROH_E_IAE SWI_M_BASIS_ANFAHRT_E_IAE SWI_M_BASIS_ANFAHRT_MIN_E_IAE /end DEF_CHARACTERISTIC
/end FUNCTION
/begin FUNCTION jIaeAnfahH_Fktn "Applikationesgroessen Instanz jIaeAnfahH"
 /begin DEF_CHARACTERISTIC KF_F_KD_ANFAHRT_H_IAE KF_F_KI_ANFAHRT_H_IAE KF_F_KP_ANFAHRT_H_IAE KF_KD_ANFAHRT_H_IAE KF_KI_ANFAHRT_H_IAE KF_KP_ANFAHRT_H_IAE KF_OGNMOTANFAHR_SOLL_H_IAE KF_T_PT2_NMOTANFAHR_H_IAE KL_F_M_PUAUF_ANFAHRT_H_IAE KL_F_M_SCHLEPP_ANFAHRT_H_IAE KL_MPT_NMOTSOLLANFAHR_ROH_H_IAE SWI_M_BASIS_ANFAHRT_H_IAE SWI_M_BASIS_ANFAHRT_MIN_H_IAE /end DEF_CHARACTERISTIC
/end FUNCTION
/begin FUNCTION dIaeParaEcoX_Fktn "Applikationesgroessen der Komponente dIaeParaEcoX" /begin SUB_FUNCTION jIaeParaEco_Fktn jIaePara_Fktn /end SUB_FUNCTION /end FUNCTION
/begin FUNCTION jIaeParaEco_Fktn "Applikationesgroessen Instanz jIaeParaEco"
 /begin DEF_CHARACTERISTIC KF_FDYNANFAHR_ECO_IAE KF_MSOLLMAXANFAHR_ECO_IAE KL_MSMOTINIT_PT2_ECO_IAE KL_MSOLLMINANFAHR_ECO_IAE KL_NSMOTINIT_PT2_ECO_IAE /end DEF_CHARACTERISTIC
/end FUNCTION
/begin FUNCTION jIaePara_Fktn "Applikationesgroessen Instanz jIaePara"
 /begin DEF_CHARACTERISTIC KF_FDYNANFAHR_IAE KF_MSOLLMAXANFAHR_IAE KL_MSMOTINIT_PT2_IAE KL_MSOLLMINANFAHR_IAE KL_NSMOTINIT_PT2_IAE /end DEF_CHARACTERISTIC
/end FUNCTION
/begin FUNCTION dSasGloRSP_Fktn "Applikationesgroessen der Komponente dSasGloRSP"
 /begin SUB_FUNCTION jSasGloRSP121_Fktn jSasGloRSP132_Fktn jSasGloRSP143_Fktn jSasGloRSP154_Fktn jSasGloRSP165_Fktn jSasGloRSP176_Fktn jSasGloRSP187_Fktn jSasGloRSP221_Fktn jSasGloRSP232_Fktn jSasGloRSP243_Fktn jSasGloRSP254_Fktn jSasGloRSP265_Fktn jSasGloRSP276_Fktn jSasGloRSP287_Fktn jSasGloRSP231_Fktn jSasGloRSP242_Fktn jSasGloRSP251_Fktn jSasGloRSP253_Fktn jSasGloRSP263_Fktn jSasGloRSP264_Fktn jSasGloRSP271_Fktn jSasGloRSP275_Fktn jSasGloRSP282_Fktn jSasGloRSP284_Fktn jSasGloRSP286_Fktn jSasGloRSP321_Fktn jSasGloRSP332_Fktn jSasGloRSP343_Fktn jSasGloRSP354_Fktn jSasGloRSP365_Fktn jSasGloRSP376_Fktn jSasGloRSP387_Fktn jSasGloRSP331_Fktn jSasGloRSP342_Fktn jSasGloRSP351_Fktn jSasGloRSP353_Fktn jSasGloRSP363_Fktn jSasGloRSP364_Fktn jSasGloRSP371_Fktn jSasGloRSP375_Fktn jSasGloRSP382_Fktn jSasGloRSP384_Fktn jSasGloRSP386_Fktn /end SUB_FUNCTION
/end FUNCTION
/begin FUNCTION jSasGloRSP121_Fktn "Applikationesgroessen Instanz jSasGloRSP121" /begin DEF_CHARACTERISTIC KF_TSYNCGMTHINSYN21 KF_TSYNCGMTHINSYNRA21 /end DEF_CHARACTERISTIC /end FUNCTION
/begin FUNCTION jSasGloRSP132_Fktn "Applikationesgroessen Instanz jSasGloRSP132" /begin DEF_CHARACTERISTIC KF_TSYNCGMTHINSYN32 KF_TSYNCGMTHINSYNRA32 /end DEF_CHARACTERISTIC /end FUNCTION
/begin FUNCTION jSasGloRSP143_Fktn "Applikationesgroessen Instanz jSasGloRSP143" /begin DEF_CHARACTERISTIC KF_TSYNCGMTHINSYN43 KF_TSYNCGMTHINSYNRA43 /end DEF_CHARACTERISTIC /end FUNCTION
/begin FUNCTION jSasGloRSP154_Fktn "Applikationesgroessen Instanz jSasGloRSP154" /begin DEF_CHARACTERISTIC KF_TSYNCGMTHINSYN54 KF_TSYNCGMTHINSYNRA54 /end DEF_CHARACTERISTIC /end FUNCTION
/begin FUNCTION jSasGloRSP165_Fktn "Applikationesgroessen Instanz jSasGloRSP165" /begin DEF_CHARACTERISTIC KF_TSYNCGMTHINSYN65 KF_TSYNCGMTHINSYNRA65 /end DEF_CHARACTERISTIC /end FUNCTION
/begin FUNCTION jSasGloRSP176_Fktn "Applikationesgroessen Instanz jSasGloRSP176" /begin DEF_CHARACTERISTIC KF_TSYNCGMTHINSYN76 KF_TSYNCGMTHINSYNRA76 /end DEF_CHARACTERISTIC /end FUNCTION
/begin FUNCTION jSasGloRSP187_Fktn "Applikationesgroessen Instanz jSasGloRSP187" /begin DEF_CHARACTERISTIC KF_TSYNCGMTHINSYN87 KF_TSYNCGMTHINSYNRA87 /end DEF_CHARACTERISTIC /end FUNCTION
/begin FUNCTION jSasGloRSP221_Fktn "Applikationesgroessen Instanz jSasGloRSP221" /begin DEF_CHARACTERISTIC KF_TSYNCGMTHINSYNRASP21 KF_TSYNCGMTHINSYNSP21 /end DEF_CHARACTERISTIC /end FUNCTION
/begin FUNCTION jSasGloRSP232_Fktn "Applikationesgroessen Instanz jSasGloRSP232" /begin DEF_CHARACTERISTIC KF_TSYNCGMTHINSYNRASP32 KF_TSYNCGMTHINSYNSP32 /end DEF_CHARACTERISTIC /end FUNCTION
/begin FUNCTION jSasGloRSP243_Fktn "Applikationesgroessen Instanz jSasGloRSP243" /begin DEF_CHARACTERISTIC KF_TSYNCGMTHINSYNRASP43 KF_TSYNCGMTHINSYNSP43 /end DEF_CHARACTERISTIC /end FUNCTION
/begin FUNCTION jSasGloRSP254_Fktn "Applikationesgroessen Instanz jSasGloRSP254" /begin DEF_CHARACTERISTIC KF_TSYNCGMTHINSYNRASP54 KF_TSYNCGMTHINSYNSP54 /end DEF_CHARACTERISTIC /end FUNCTION
/begin FUNCTION jSasGloRSP265_Fktn "Applikationesgroessen Instanz jSasGloRSP265" /begin DEF_CHARACTERISTIC KF_TSYNCGMTHINSYNRASP65 KF_TSYNCGMTHINSYNSP65 /end DEF_CHARACTERISTIC /end FUNCTION
/begin FUNCTION jSasGloRSP276_Fktn "Applikationesgroessen Instanz jSasGloRSP276" /begin DEF_CHARACTERISTIC KF_TSYNCGMTHINSYNRASP76 KF_TSYNCGMTHINSYNSP76 /end DEF_CHARACTERISTIC /end FUNCTION
/begin FUNCTION jSasGloRSP287_Fktn "Applikationesgroessen Instanz jSasGloRSP287" /begin DEF_CHARACTERISTIC KF_TSYNCGMTHINSYNRASP87 KF_TSYNCGMTHINSYNSP87 /end DEF_CHARACTERISTIC /end FUNCTION
/begin FUNCTION jSasGloRSP231_Fktn "Applikationesgroessen Instanz jSasGloRSP231" /begin DEF_CHARACTERISTIC KF_TSYNCGMTHINSYNRASP31 KF_TSYNCGMTHINSYNSP31 /end DEF_CHARACTERISTIC /end FUNCTION
/begin FUNCTION jSasGloRSP242_Fktn "Applikationesgroessen Instanz jSasGloRSP242" /begin DEF_CHARACTERISTIC KF_TSYNCGMTHINSYNRASP42 KF_TSYNCGMTHINSYNSP42 /end DEF_CHARACTERISTIC /end FUNCTION
/begin FUNCTION jSasGloRSP251_Fktn "Applikationesgroessen Instanz jSasGloRSP251" /begin DEF_CHARACTERISTIC KF_TSYNCGMTHINSYNRASP51 KF_TSYNCGMTHINSYNSP51 /end DEF_CHARACTERISTIC /end FUNCTION
/begin FUNCTION jSasGloRSP253_Fktn "Applikationesgroessen Instanz jSasGloRSP253" /begin DEF_CHARACTERISTIC KF_TSYNCGMTHINSYNRASP53 KF_TSYNCGMTHINSYNSP53 /end DEF_CHARACTERISTIC /end FUNCTION
/begin FUNCTION jSasGloRSP263_Fktn "Applikationesgroessen Instanz jSasGloRSP263" /begin DEF_CHARACTERISTIC KF_TSYNCGMTHINSYNRASP63 KF_TSYNCGMTHINSYNSP63 /end DEF_CHARACTERISTIC /end FUNCTION
/begin FUNCTION jSasGloRSP264_Fktn "Applikationesgroessen Instanz jSasGloRSP264" /begin DEF_CHARACTERISTIC KF_TSYNCGMTHINSYNRASP64 KF_TSYNCGMTHINSYNSP64 /end DEF_CHARACTERISTIC /end FUNCTION
/begin FUNCTION jSasGloRSP271_Fktn "Applikationesgroessen Instanz jSasGloRSP271" /begin DEF_CHARACTERISTIC KF_TSYNCGMTHINSYNRASP71 KF_TSYNCGMTHINSYNSP71 /end DEF_CHARACTERISTIC /end FUNCTION
/begin FUNCTION jSasGloRSP275_Fktn "Applikationesgroessen Instanz jSasGloRSP275" /begin DEF_CHARACTERISTIC KF_TSYNCGMTHINSYNRASP75 KF_TSYNCGMTHINSYNSP75 /end DEF_CHARACTERISTIC /end FUNCTION
/begin FUNCTION jSasGloRSP282_Fktn "Applikationesgroessen Instanz jSasGloRSP282" /begin DEF_CHARACTERISTIC KF_TSYNCGMTHINSYNRASP82 KF_TSYNCGMTHINSYNSP82 /end DEF_CHARACTERISTIC /end FUNCTION
/begin FUNCTION jSasGloRSP284_Fktn "Applikationesgroessen Instanz jSasGloRSP284" /begin DEF_CHARACTERISTIC KF_TSYNCGMTHINSYNRASP84 KF_TSYNCGMTHINSYNSP84 /end DEF_CHARACTERISTIC /end FUNCTION
/begin FUNCTION jSasGloRSP286_Fktn "Applikationesgroessen Instanz jSasGloRSP286" /begin DEF_CHARACTERISTIC KF_TSYNCGMTHINSYNRASP86 KF_TSYNCGMTHINSYNSP86 /end DEF_CHARACTERISTIC /end FUNCTION
/begin FUNCTION jSasGloRSP321_Fktn "Applikationesgroessen Instanz jSasGloRSP321" /begin DEF_CHARACTERISTIC KF_TSYNCGMTHINSYNRASPORT21 KF_TSYNCGMTHINSYNSPORT21 /end DEF_CHARACTERISTIC /end FUNCTION
/begin FUNCTION jSasGloRSP332_Fktn "Applikationesgroessen Instanz jSasGloRSP332" /begin DEF_CHARACTERISTIC KF_TSYNCGMTHINSYNRASPORT32 KF_TSYNCGMTHINSYNSPORT32 /end DEF_CHARACTERISTIC /end FUNCTION
/begin FUNCTION jSasGloRSP343_Fktn "Applikationesgroessen Instanz jSasGloRSP343" /begin DEF_CHARACTERISTIC KF_TSYNCGMTHINSYNRASPORT43 KF_TSYNCGMTHINSYNSPORT43 /end DEF_CHARACTERISTIC /end FUNCTION
/begin FUNCTION jSasGloRSP354_Fktn "Applikationesgroessen Instanz jSasGloRSP354" /begin DEF_CHARACTERISTIC KF_TSYNCGMTHINSYNRASPORT54 KF_TSYNCGMTHINSYNSPORT54 /end DEF_CHARACTERISTIC /end FUNCTION
/begin FUNCTION jSasGloRSP365_Fktn "Applikationesgroessen Instanz jSasGloRSP365" /begin DEF_CHARACTERISTIC KF_TSYNCGMTHINSYNRASPORT65 KF_TSYNCGMTHINSYNSPORT65 /end DEF_CHARACTERISTIC /end FUNCTION
/begin FUNCTION jSasGloRSP376_Fktn "Applikationesgroessen Instanz jSasGloRSP376" /begin DEF_CHARACTERISTIC KF_TSYNCGMTHINSYNRASPORT76 KF_TSYNCGMTHINSYNSPORT76 /end DEF_CHARACTERISTIC /end FUNCTION
/begin FUNCTION jSasGloRSP387_Fktn "Applikationesgroessen Instanz jSasGloRSP387" /begin DEF_CHARACTERISTIC KF_TSYNCGMTHINSYNRASPORT87 KF_TSYNCGMTHINSYNSPORT87 /end DEF_CHARACTERISTIC /end FUNCTION
/begin RECORD_LAYOUT kw_bool8_S6_S3 FNC_VALUES 1 UBYTE COLUMN_DIR DIRECT /end RECORD_LAYOUT
/begin RECORD_LAYOUT kw_ui8_S6_S3 FNC_VALUES 1 UBYTE COLUMN_DIR DIRECT /end RECORD_LAYOUT
/begin RECORD_LAYOUT kw_ui16_S6_S3 FNC_VALUES 1 UWORD COLUMN_DIR DIRECT /end RECORD_LAYOUT
/begin RECORD_LAYOUT kw_si8_S6_S3 FNC_VALUES 1 SBYTE COLUMN_DIR DIRECT /end RECORD_LAYOUT
/begin RECORD_LAYOUT kw_si16_S6_S3 FNC_VALUES 1 SWORD COLUMN_DIR DIRECT /end RECORD_LAYOUT
/begin RECORD_LAYOUT kw_fl32_S6_S3 FNC_VALUES 1 FLOAT32_IEEE COLUMN_DIR DIRECT /end RECORD_LAYOUT
/begin RECORD_LAYOUT tab_bool8_S6_S3 FNC_VALUES 2 UBYTE COLUMN_DIR DIRECT NO_AXIS_PTS_X 1 ULONG /end RECORD_LAYOUT
/begin RECORD_LAYOUT tab_ui8_S6_S3 FNC_VALUES 2 UBYTE COLUMN_DIR DIRECT NO_AXIS_PTS_X 1 ULONG /end RECORD_LAYOUT
/begin RECORD_LAYOUT tab_ui16_S6_S3 FNC_VALUES 2 UWORD COLUMN_DIR DIRECT NO_AXIS_PTS_X 1 ULONG /end RECORD_LAYOUT
/begin RECORD_LAYOUT tab_si16_S6_S3 FNC_VALUES 2 SWORD COLUMN_DIR DIRECT NO_AXIS_PTS_X 1 ULONG /end RECORD_LAYOUT
/begin RECORD_LAYOUT kl_ui8_S6_S3 FNC_VALUES 3 UBYTE COLUMN_DIR DIRECT AXIS_PTS_X 2 UBYTE INDEX_INCR DIRECT NO_AXIS_PTS_X 1 ULONG /end RECORD_LAYOUT
/begin RECORD_LAYOUT kl_ui16_S6_S3 FNC_VALUES 3 UWORD COLUMN_DIR DIRECT AXIS_PTS_X 2 UWORD INDEX_INCR DIRECT NO_AXIS_PTS_X 1 ULONG /end RECORD_LAYOUT
/begin RECORD_LAYOUT kl_si16_S6_S3 FNC_VALUES 3 SWORD COLUMN_DIR DIRECT AXIS_PTS_X 2 SWORD INDEX_INCR DIRECT NO_AXIS_PTS_X 1 ULONG /end RECORD_LAYOUT
/begin RECORD_LAYOUT kl_fl32_S6_S3 FNC_VALUES 3 FLOAT32_IEEE COLUMN_DIR DIRECT AXIS_PTS_X 2 FLOAT32_IEEE INDEX_INCR DIRECT NO_AXIS_PTS_X 1 ULONG /end RECORD_LAYOUT
/begin RECORD_LAYOUT kf_ui8_S6_S3 FNC_VALUES 5 UBYTE ROW_DIR DIRECT AXIS_PTS_X 3 UBYTE INDEX_INCR DIRECT AXIS_PTS_Y 4 UBYTE INDEX_INCR DIRECT NO_AXIS_PTS_X 1 ULONG NO_AXIS_PTS_Y 2 ULONG /end RECORD_LAYOUT
/begin RECORD_LAYOUT kf_ui16_S6_S3 FNC_VALUES 5 UWORD ROW_DIR DIRECT AXIS_PTS_X 3 UWORD INDEX_INCR DIRECT AXIS_PTS_Y 4 UWORD INDEX_INCR DIRECT NO_AXIS_PTS_X 1 ULONG NO_AXIS_PTS_Y 2 ULONG /end RECORD_LAYOUT
/begin RECORD_LAYOUT kf_si16_S6_S3 FNC_VALUES 5 SWORD ROW_DIR DIRECT AXIS_PTS_X 3 SWORD INDEX_INCR DIRECT AXIS_PTS_Y 4 SWORD INDEX_INCR DIRECT NO_AXIS_PTS_X 1 ULONG NO_AXIS_PTS_Y 2 ULONG /end RECORD_LAYOUT
/begin RECORD_LAYOUT kf_fl32_S6_S3 FNC_VALUES 5 FLOAT32_IEEE ROW_DIR DIRECT AXIS_PTS_X 3 FLOAT32_IEEE INDEX_INCR DIRECT AXIS_PTS_Y 4 FLOAT32_IEEE INDEX_INCR DIRECT NO_AXIS_PTS_X 1 ULONG NO_AXIS_PTS_Y 2 ULONG /end RECORD_LAYOUT
/end MODULE
/end PROJECT
