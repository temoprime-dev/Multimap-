ASAP2_VERSION 1 51
/begin PROJECT _929_929 "Gen2_BMW_System_Supplier_Lib"
/begin HEADER "" VERSION "C_03_03" PROJECT_NO _929_929 /end HEADER
/begin MODULE DIM ""
/begin MOD_COMMON "" BYTE_ORDER MSB_FIRST ALIGNMENT_BYTE 1 ALIGNMENT_WORD 2 ALIGNMENT_LONG 4 ALIGNMENT_FLOAT32_IEEE 4 /end MOD_COMMON
/begin CHARACTERISTIC AbstellPosOpt "Aufruf FOp ABO" VALUE 0x26EB20 UBYTE_COL_DIRECT_M_S7_S3 0 void_int_M_S7_S3 0 16 /end CHARACTERISTIC
/begin CHARACTERISTIC BM_ERSFKT_ALA_FRK_HAS "Bitmaske zur Festlegung der Diagnose Ersatzfunktionen die zur Aktivierung der Anlasserstartanforderung fuehren" VALUE 0x263364 ULONG_COL_DIRECT_M_S7_S3 0 b_int_M_S7_S3 0 4294967295 /end CHARACTERISTIC
/begin CHARACTERISTIC BM_ERSFKT_DEAKTIV_ABO_FRK_HAS "Bitmaske zur Festlegung der Diagnose Ersatzfunktionen die zum Austritt aus der ABO Fkt. fuehren" VALUE 0x263368 ULONG_COL_DIRECT_M_S7_S3 0 b_int_M_S7_S3 0 4294967295 /end CHARACTERISTIC
/begin CHARACTERISTIC BM_ERSFKT_HI_96_ALA_FRK_HAS "Bitmaske zur Festlegung der Diagnose Ersatzfunktionen (HI-96) die zur Aktivierung der Anlasserstartanforderung fuehren" VALUE 0x26336C ULONG_COL_DIRECT_M_S7_S3 0 b_int_M_S7_S3 0 4294967295 /end CHARACTERISTIC
/begin CHARACTERISTIC BM_ERSFKT_HI_96_DEAKTIV_ABO_FRK_HAS "Bitmaske zur Festlegung der Diagnose Ersatzfunktionen (HI-96) die zum Austritt aus der ABO Fkt. fuehren" VALUE 0x263370 ULONG_COL_DIRECT_M_S7_S3 0 b_int_M_S7_S3 0 4294967295 /end CHARACTERISTIC
/begin CHARACTERISTIC BM_ERSFKT_HI_96_VMSTARTVERBOT_FRK_HAS "Bitmaske zur Festlegung der Diagnose Ersatzfunktionen (HI-96) die zur zweiten Anforderung der Beeinflussung der MSA-Funktionalitaet bei aktiver Diagnose-Ersatzfunktion" VALUE 0x263374 ULONG_COL_DIRECT_M_S7_S3 0 b_int_M_S7_S3 0 4294967295 /end CHARACTERISTIC
/begin CHARACTERISTIC BM_ERSFKT_HI_96_ZUST_INIT_FRK_HAS "Bitmaske zur Festlegung der Diagnose Ersatzfunktionen (HI-96) die zum Ruecksprung des Soll-Betriebszustands der Hybrid-Zustandssteuerung
in den Initialisierungszustand fuehren" VALUE 0x263378 ULONG_COL_DIRECT_M_S7_S3 0 b_int_M_S7_S3 0 4294967295 /end CHARACTERISTIC
/begin CHARACTERISTIC BM_ERSFKT_HI_ALA_FRK_HAS "Bitmaske zur Festlegung der Diagnose Ersatzfunktionen (HI-Byte) die zur Aktivierung der Anlasserstartanforderung fuehren" VALUE 0x26337C ULONG_COL_DIRECT_M_S7_S3 0 b_int_M_S7_S3 0 4294967295 /end CHARACTERISTIC
/begin CHARACTERISTIC BM_ERSFKT_HI_DEAKTIV_ABO_FRK_HAS "Bitmaske zur Festlegung der Diagnose Ersatzfunktionen (HI-Byte) die zum Austritt aus der ABO Fkt. fuehren" VALUE 0x263380 ULONG_COL_DIRECT_M_S7_S3 0 b_int_M_S7_S3 0 4294967295 /end CHARACTERISTIC
/begin CHARACTERISTIC BM_ERSFKT_HI_VMSTARTVERBOT_FRK_HAS "Bitmaske zur Festlegung der Diagnose Ersatzfunktionen (HI-Byte) die zur zweiten Anforderung der Beeinflussung der MSA-FunktionalitDit bei aktiver Diagnose-Ersatzfunktion" VALUE 0x263384 ULONG_COL_DIRECT_M_S7_S3 0 b_int_M_S7_S3 0 4294967295 /end CHARACTERISTIC
/begin CHARACTERISTIC BM_ERSFKT_HI_ZUST_INIT_FRK_HAS "Bitmaske zur Festlegung der Diagnose Ersatzfunktionen (HI-Byte) die zum Ruecksprung des Soll-Betriebszustands der Hybrid-Zustandssteuerung in den Initialisierungszustand fuehren" VALUE 0x263388 ULONG_COL_DIRECT_M_S7_S3 0 b_int_M_S7_S3 0 4294967295 /end CHARACTERISTIC
/begin CHARACTERISTIC BM_ERSFKT_VMSTARTVERBOT_FRK_HAS "Bitmaske zur Festlegung der Diagnose Ersatzfunktionen die zur zweiten Anforderung der Beeinflussung der MSA-Funktionalitaet bei aktiv
er Diagnose-Ersatzfunktion" VALUE 0x26338C ULONG_COL_DIRECT_M_S7_S3 0 b_int_M_S7_S3 0 4294967295 /end CHARACTERISTIC
/begin CHARACTERISTIC BM_ERSFKT_ZUST_INIT_FRK_HAS "Bitmaske zur Festlegung der Diagnose Ersatzfunktionen die zum Ruecksprung des Soll-Betriebszustands der Hybrid-Zustandssteuerung in den Initialisierungszustand fuehren" VALUE 0x263390 ULONG_COL_DIRECT_M_S7_S3 0 b_int_M_S7_S3 0 4294967295 /end CHARACTERISTIC
/begin CHARACTERISTIC BM_LLS_OELVERSFEHLER_ERK_HAS "Bitmaske zur Festlegung, welche Einzelfunktion der Leerlaufsimulation der HAS zur Erkennung des  Oelversorgungsfehlers fuehren kann - Codierung wie z_lls_fktaktiv_has_sbe" VALUE 0x2634AC ULONG_COL_DIRECT_M_S7_S3 0 void_int_f_M_S7_S3 0 4294967295 /end CHARACTERISTIC
/begin CHARACTERISTIC BM_LLSGABBED_LAU_ABST "Bitmaske zur Festlegung, welche Einzel-funktion der Leerlaufsimulation den Uebergang nach 'VM gefuehrt Abstellen' verhindert im Zustand 'Last-Uebernahme' beim VM Abstellen - Codierung wie z_lls_fktaktiv_has_sbe" VALUE 0x264A38 ULONG_COL_DIRECT_M_S7_S3 0 void_int_f_M_S7_S3 0 4294967295 /end CHARACTERISTIC
/begin CHARACTERISTIC CG_MINDAT_LLS_HAS "Minimaler Temperaturgradient der DAT-Modell-Temperatur der Minimaldrehzahlvorgabe zur Verhinderung DAT-Massenanschlagen (DAT) zur Ausgabe als minimale EM-Drehzahl der Leerlaufsimulation der HAS (LLS)" VALUE 0x264554 FLOAT32_IEEE_COL_DIRECT_M_S7_S3 0 cg_fl_M_S7_S3 -500 0 /end CHARACTERISTIC
/begin CHARACTERISTIC FK_MGMOT_HAS "Filterkoeffizient zur Berechnung Gradient Motormoment" VALUE 0x2648B8 FLOAT32_IEEE_COL_DIRECT_M_S7_S3 0 void_fl_M_S7_S3 0 1 /end CHARACTERISTIC
/begin CHARACTERISTIC FK_MGWUNSCHFPW_HAS "Filterkoeffizient zur Berechnung Gradient Fahrsollmoment" VALUE 0x2648BC FLOAT32_IEEE_COL_DIRECT_M_S7_S3 0 void_fl_M_S7_S3 0 1 /end CHARACTERISTIC
/begin CHARACTERISTIC FK_MK0MBERZUS_HAS "Filterkoeffizient zur PT1-Filterung des K0-Moments der HAS zur Motormomentbe-grenzung in der SAB beim Zustart" VALUE 0x26458C FLOAT32_IEEE_COL_DIRECT_M_S7_S3 0 void_fl_M_S7_S3 0 1 /end CHARACTERISTIC
/begin CHARACTERISTIC FK_NDGK0_HAS "Filterkoeffizient zu Berechnung Gradient Differenzdrehzahl K0" VALUE 0x2648C0 FLOAT32_IEEE_COL_DIRECT_M_S7_S3 0 void_fl_M_S7_S3 0 1 /end CHARACTERISTIC
/begin CHARACTERISTIC FK_NGEM_ZUS "Filterkonstante zur Berechnung des EM-Drehzahlgradienten beim Zustart" VALUE 0x26D050 FLOAT32_IEEE_COL_DIRECT_M_S7_S3 0 void_fl_M_S7_S3 0 1 /end CHARACTERISTIC
/begin CHARACTERISTIC FK_NGVM_AST_ABST "Zusaetzliche PT1-Filterung von ng_vm_in zum Vergleich mit der VM-Drehzahlgradientenschwelle zur Vorgabe K0 OEFFNENSW im Zustand VM-Abstellen beim VM Abstellen" VALUE 0x264A3C FLOAT32_IEEE_COL_DIRECT_M_S7_S3 0 ng_fl_M_S7_S3 0 5 /end CHARACTERISTIC
/begin CHARACTERISTIC FK_NGVM_HAS "Filterkoeffizient zu Berechnung Gradient Differenzdrehzahl VM" VALUE 0x2648C4 FLOAT32_IEEE_COL_DIRECT_M_S7_S3 0 void_fl_M_S7_S3 0 1 /end CHARACTERISTIC
/begin CHARACTERISTIC FK_NSOLLVM_ANH_ZUS "Filterung der VM Solldrehzahl beim VM Start Variante Zustarten" VALUE 0x26D054 FLOAT32_IEEE_COL_DIRECT_M_S7_S3 0 void_fl_M_S7_S3 0 1 /end CHARACTERISTIC
/begin CHARACTERISTIC FK_NSOLLVM_SAK_ZUS "Filterung der VM-Solldrehzahl im Zustand Schaltung aktiv beim Zustart" VALUE 0x26D058 FLOAT32_IEEE_COL_DIRECT_M_S7_S3 0 void_fl_M_S7_S3 0 1 /end CHARACTERISTIC
/begin CHARACTERISTIC FK_NSOLLVM_ZND_ANS "Filterung der VM-Solldrehzahl im Zustand VM Zuenden beim Schleppstart" VALUE 0x26AA94 FLOAT32_IEEE_COL_DIRECT_M_S7_S3 0 t_fl_M_S7_S3 0 1 /end CHARACTERISTIC
/begin CHARACTERISTIC FK_NSOLLVM_ZST_ZUS "Filterung der VM Solldrehzahl beim VM Start Variante Zustarten" VALUE 0x26D05C FLOAT32_IEEE_COL_DIRECT_M_S7_S3 0 void_fl_M_S7_S3 0 1 /end CHARACTERISTIC
/begin CHARACTERISTIC FK_VGF_HAS "Filterkoeffizient zur Berechnung des Fahrzeuggeschwindigkeitsgradienten in der Hybridablaufsteuerung" VALUE 0x2648C8 FLOAT32_IEEE_COL_DIRECT_M_S7_S3 0 void_fl_M_S7_S3 0 1 /end CHARACTERISTIC
/begin CHARACTERISTIC K_SVH_RESET_LAU_ABST "Ruecksetzen einer Schaltverhinderung waehrend VM-Abstellen im Zustand Last Uebernahme mit EM (255 = alle Arten von Schaltungen zuruecksetzen, 0 = keine Schaltung zuruecksetzen)  Bit-Codierung siehe Handbuch" VALUE 0x26EDD8 UBYTE_COL_DIRECT_M_S7_S3 0 sts_int_M_S7_S3 0 255 /end CHARACTERISTIC
/begin CHARACTERISTIC K_SVH_RESET_SAK_ABST "Ruecksetzen einer Schaltverhinderung waehrend VM-Abstellen im Zustand Last Uebernahme mit EM (255 = alle Arten von Schaltungen zuruecksetzen, 0 = keine Schaltung zuruecksetzen)  Bit-Codierung siehe Handbuch" VALUE 0x26EDD9 UBYTE_COL_DIRECT_M_S7_S3 0 b_int_b_M_S7_S3 0 255 /end CHARACTERISTIC
/begin CHARACTERISTIC K_SVH_RESETLAUS_SRT_ABST "Ruecksetzen einer Schaltverhinderung bei bereits laufender Schaltung waehrend VM-Abstellen im Zustand Start (255 = alle Arten von Schaltungen
zuruecksetzen, 0 = keine Schaltung zuruecksetzen) - > Bit-Codierung siehe Handbuch" VALUE 0x26EDD7 UBYTE_COL_DIRECT_M_S7_S3 0 sts_int_M_S7_S3 0 255 /end CHARACTERISTIC
/begin CHARACTERISTIC KF_NSEMBED_GAB_ABST_W "EM-Drehzahlschwelle als Uebergangsbedingung nach 'VM-Abstellen' d.h. zum Oeffnen der K0 in Abhaengigkeit der Getrie-beoeltemperatur und der VM-Temperatur im Zustand 'VM gefuehrt Abstellen' beim VM Abstellen" MAP 0x264918 FLOAT32_IEEE_COL_DIRECT_M_S7_S3 0 n_fl_M_S7_S3 0 10000
 /begin AXIS_DESCR COM_AXIS c_getriebe_egs_in c_fl_M_S7_S3 5 -3.40282E+038 3.40282E+038 AXIS_PTS_REF KF_NSEMBED_GAB_ABST_X /end AXIS_DESCR
 /begin AXIS_DESCR COM_AXIS c_vm_in c_fl_M_S7_S3 4 -3.40282E+038 3.40282E+038 AXIS_PTS_REF KF_NSEMBED_GAB_ABST_Y /end AXIS_DESCR
/end CHARACTERISTIC
/begin CHARACTERISTIC KL_KSVHABBRLAUSFST_ABST_Y "Festlegung der Schaltart der von der Fahrstrategie abzubrechenden laufenden Schaltungen in Abhaengigkeit des aktuellen Zustands beim Abstellen -> Bit-Codierung wie z_ablauf_shv_reset_has" CURVE 0x26EDD0 UBYTE_COL_DIRECT_M_S7_S3 0 b_int_b_M_S7_S3 0 255
 /begin AXIS_DESCR COM_AXIS st_ablauf_fkt st_int_g_M_S7_S3 7 0 65535 AXIS_PTS_REF KL_KSVHABBRLAUSFST_ABST_X /end AXIS_DESCR
/end CHARACTERISTIC
/begin CHARACTERISTIC KL_KSVHRESET_AST_ABST_Y "Ruecksetzen einer Schaltverhinderung in Abhaengigkeit des Istgangs im Zustand VM-Abstellen beim VM Abstellen (255 = alle Arten von Schaltungen zuruecksetzen, 0 = keine Schaltung zuruecksetzen) -> Bit-Codierung siehe Handbuch" CURVE 0x264A1C UBYTE_COL_DIRECT_M_S7_S3 0 b_int_b_M_S7_S3 0 255
 /begin AXIS_DESCR COM_AXIS istgang_egs_in void_int_M_S7_S3 8 -128 127 AXIS_PTS_REF KL_KSVHRESET_AST_ABST_X /end AXIS_DESCR
/end CHARACTERISTIC
/begin CHARACTERISTIC KL_MK0MODINIT_LAU_ABST_Y "Basismoment zur Initialisierung des modi-fizierten K0 Moments in Abhaengigkeit des VM-Sollmoments im Zustand Last-Uebernahme beim Abstellen" CURVE 0x2649A4 FLOAT32_IEEE_COL_DIRECT_M_S7_S3 0 trq_fl_a_M_S7_S3 -1000 1000
 /begin AXIS_DESCR COM_AXIS m_soll_vm_l_hst_in trq_fl_a_M_S7_S3 6 -1000 1000 AXIS_PTS_REF KL_MK0MODINIT_LAU_ABST_X /end AXIS_DESCR
/end CHARACTERISTIC
/begin CHARACTERISTIC KL_MOSOLLK0MVM_LAU_ABST_Y "Offset auf den Betrag des VM-Basismoments zur Berechnung  des K0-Sollmoments im Zustand Last-Uebernahme beim VM Abstellen" CURVE 0x2649D4 FLOAT32_IEEE_COL_DIRECT_M_S7_S3 0 trq_fl_a_M_S7_S3 -1000 1000
 /begin AXIS_DESCR COM_AXIS NO_INPUT_QUANTITY trq_fl_a_M_S7_S3 6 -1000 1000 AXIS_PTS_REF KL_MOSOLLK0MVM_LAU_ABST_X /end AXIS_DESCR
/end CHARACTERISTIC
/begin CHARACTERISTIC KL_MSOLLK0ZIEL_GAB_ABST_Y "Zielwert des K0-Sollmoments in Abhaengigkeit des Betrags des EM-Istmoments im Zustand 'VM gefuehrt Abstellen' beim VM Abstellen" CURVE 0x264A00 FLOAT32_IEEE_COL_DIRECT_M_S7_S3 0 trq_fl_a_M_S7_S3 -1000 1000
 /begin AXIS_DESCR COM_AXIS NO_INPUT_QUANTITY trq_fl_a_M_S7_S3 5 -3.40282E+038 3.40282E+038 AXIS_PTS_REF KL_MSOLLK0ZIEL_GAB_ABST_X /end AXIS_DESCR
/end CHARACTERISTIC
/begin CHARACTERISTIC KL_MSSOLLEMAKTIV_ANS_Y "Momentschwelle fuer Aktiveriung EM-Sollmomentueberwachung" CURVE 0x26A3B8 FLOAT32_IEEE_COL_DIRECT_M_S7_S3 0 trq_fl_a_M_S7_S3 -1000 1000
 /begin AXIS_DESCR COM_AXIS NO_INPUT_QUANTITY void_fl_M_S7_S3 10 -1 10 AXIS_PTS_REF KL_MSSOLLEMAKTIV_ANS_X /end AXIS_DESCR
/end CHARACTERISTIC
/begin CHARACTERISTIC KL_MSSOLLEMAKTIVSTKRAFTFL_ANS_Y "Flag zur Deaktivierung des Timers fuer mstoerk0em" CURVE 0x26F0DD UBYTE_COL_DIRECT_M_S7_S3 0 sts_int_M_S7_S3 0 1
 /begin AXIS_DESCR COM_AXIS NO_INPUT_QUANTITY sts_int_M_S7_S3 7 0 6 AXIS_PTS_REF KL_MSSOLLEMAKTIVSTKRAFTFL_ANS_X /end AXIS_DESCR
/end CHARACTERISTIC
/begin CHARACTERISTIC KL_NOEMOELVERSFEHLER_ERK_HAS_Y "Temperaturabhaengiges Drehzahloffset auf die EM-Istdrehzahl, das bei der Oelversorgungsueberwachung toleriert wird." CURVE 0x263434 FLOAT32_IEEE_COL_DIRECT_M_S7_S3 0 n_fl_M_S7_S3 0 10000
 /begin AXIS_DESCR COM_AXIS c_getriebe_egs_in c_fl_M_S7_S3 8 -1000 1000 AXIS_PTS_REF KL_NOEMOELVERSFEHLER_ERK_HAS_X /end AXIS_DESCR
/end CHARACTERISTIC
/begin CHARACTERISTIC KL_SVHSTKRAFTFLUSS_ANS_Y "Mod. z_ablauf_svh_reset_has = f(status_kraftfluss_egs)" CURVE 0x26F0F9 UBYTE_COL_DIRECT_M_S7_S3 0 swi_int_o_M_S7_S3 0 1
 /begin AXIS_DESCR COM_AXIS NO_INPUT_QUANTITY sts_int_M_S7_S3 7 0 6 AXIS_PTS_REF KL_SVHSTKRAFTFLUSS_ANS_X /end AXIS_DESCR
/end CHARACTERISTIC
/begin CHARACTERISTIC M_K0MODHAS_ZIEL_LAU_ABST "Zielwert beim gradientenbegrenzten Ab-senken des modifizierten K0-Moments in den Zustaenden Last-Uebernahme und K0-Oeffnen beim VM Abstellen" VALUE 0x264A80 FLOAT32_IEEE_COL_DIRECT_M_S7_S3 0 trq_fl_a_M_S7_S3 -1000 1000 /end CHARACTERISTIC
/begin CHARACTERISTIC M_K0MODMIN_SAK_ABST "Minimalwert des modifizierten K0-Moments im Zustand 'Schaltung aktiv' beim VM Abstellen" VALUE 0x264A84 FLOAT32_IEEE_COL_DIRECT_M_S7_S3 0 trq_fl_a_M_S7_S3 -1000 1000 /end CHARACTERISTIC
/begin CHARACTERISTIC M_K0MODMIN_SRT_ABST "Minimalwert des modifizierten K0-Moments im Zustand 'Start' beim VM Abstellen" VALUE 0x264A88 FLOAT32_IEEE_COL_DIRECT_M_S7_S3 0 trq_fl_a_M_S7_S3 -1000 1000 /end CHARACTERISTIC
/begin CHARACTERISTIC M_SOLLK0INI_NST_NOS "Startwert des K0-Sollmoments bei Beginn der Momentenvorgabe an die K0 (Gradientenbegrenzer wird darauf initialisiert) im Zustand Notstarten" VALUE 0x26AC40 FLOAT32_IEEE_COL_DIRECT_M_S7_S3 0 trq_fl_a_M_S7_S3 0 1000 /end CHARACTERISTIC
/begin CHARACTERISTIC M_SOLLK0MAXABBRUCH_PASSIV_HAS "Maximalwert des K0-Sollmoments nach dem Abbruch eines Betriebszustandsuebergangs der Hybrid Zustandssteuerung" VALUE 0x26AC6C FLOAT32_IEEE_COL_DIRECT_M_S7_S3 0 trq_fl_a_M_S7_S3 0 1000 /end CHARACTERISTIC
/begin CHARACTERISTIC M_SOLLK0ZIEL1_NOS "Zielwert des K0-Sollmoments bis Umschaltzeitpunkt" VALUE 0x26AC44 FLOAT32_IEEE_COL_DIRECT_M_S7_S3 0 trq_fl_a_M_S7_S3 0 1000 /end CHARACTERISTIC
/begin CHARACTERISTIC M_SOLLK0ZIEL2_NOS "Zielwert des K0-Sollmoments ab Umschaltzeitpunkt" VALUE 0x26AC48 FLOAT32_IEEE_COL_DIRECT_M_S7_S3 0 trq_fl_a_M_S7_S3 0 1000 /end CHARACTERISTIC
/begin CHARACTERISTIC MDS_MOTBREMSREKU_LAU_ABST "Differenzmomentschwelle zur Erkennung der aktiven Bremsrekuperation im Zustand 'Last-Uebernahme' beim VM Abstellen" VALUE 0x264A40 FLOAT32_IEEE_COL_DIRECT_M_S7_S3 0 trq_fl_a_M_S7_S3 -1000 1000 /end CHARACTERISTIC
/begin CHARACTERISTIC MG_K0MBERZUSNEG_HAS "Negativer Grenzgradient des K0-Moments der HAS zur Motormomentbegrenzung in der SAB beim Zustart" VALUE 0x2645BC FLOAT32_IEEE_COL_DIRECT_M_S7_S3 0 trqg_fl_k_M_S7_S3 -50000 0 /end CHARACTERISTIC
/begin CHARACTERISTIC MG_K0MBERZUSPOS_HAS "Positiver Grenzgradient des K0-Moments der HAS zur Motormomentbegrenzung in der SAB beim Zustart" VALUE 0x2645C0 FLOAT32_IEEE_COL_DIRECT_M_S7_S3 0 trqg_fl_k_M_S7_S3 0 50000 /end CHARACTERISTIC
/begin CHARACTERISTIC MG_K0MODHAS_LAU_ABST "Gradient zum Abbau des modifizierten K0-Moments im Zustand Last-Uebernahme beim VM Abstellen" VALUE 0x264A4C FLOAT32_IEEE_COL_DIRECT_M_S7_S3 0 trqg_fl_k_M_S7_S3 -10000 0 /end CHARACTERISTIC
/begin CHARACTERISTIC MG_K0MODHASSA_LAU_ABST "Gradient zum Abbau des modifizierten K0-Moments bei aktiver VM Schubab-schaltung im Zustand 'Last-Uebernahme' beim VM Abstellen" VALUE 0x264A48 FLOAT32_IEEE_COL_DIRECT_M_S7_S3 0 trqg_fl_k_M_S7_S3 -10000 0 /end CHARACTERISTIC
/begin CHARACTERISTIC MG_K0MODHASSAREKU_LAU_ABST "Gradient zum Abbau des modifizierten K0-Moments bei aktiver VM Schubab-schaltung und aktiver Bremsrekuperation im Zustand 'Last-Uebernahme' beim VM Abstellen" VALUE 0x264A44 FLOAT32_IEEE_COL_DIRECT_M_S7_S3 0 trqg_fl_k_M_S7_S3 -10000 0 /end CHARACTERISTIC
/begin CHARACTERISTIC MG_K0SOLL1_NST_NOS "Gradient der ersten Momentenrampe des K0-Sollmoments (vor Umschaltung) im Zustand Notstarten" VALUE 0x26AC30 FLOAT32_IEEE_COL_DIRECT_M_S7_S3 0 trqg_fl_k_M_S7_S3 0 5000 /end CHARACTERISTIC
/begin CHARACTERISTIC MG_K0SOLL2_NST_NOS "Gradient der zweiten Momentenrampe des K0-Sollmoments (nach Umschaltung) im Zustand Notstarten" VALUE 0x26AC34 FLOAT32_IEEE_COL_DIRECT_M_S7_S3 0 trqg_fl_k_M_S7_S3 0 5000 /end CHARACTERISTIC
/begin CHARACTERISTIC MG_SOLLK0_ABB_NOS "Gradienten fuer das K0-Sollmoments der HAS im Zustand Abbruch Nostart beim Notstart" VALUE 0x26AC38 FLOAT32_IEEE_COL_DIRECT_M_S7_S3 0 trqg_fl_k_M_S7_S3 0 50000 /end CHARACTERISTIC
/begin CHARACTERISTIC MG_SOLLK0_ABB_ZUS "Gradienten fuer das K0-Sollmoments der HAS im Zustand Abbruch Zustart beim Zustart" VALUE 0x26D0D8 FLOAT32_IEEE_COL_DIRECT_M_S7_S3 0 trqg_fl_k_M_S7_S3 0 50000 /end CHARACTERISTIC
/begin CHARACTERISTIC MG_SOLLK0MIN_SYN_ZUS "Minimaler Gradient des K0-Sollmoments im Zustand K0 Synchronisieren beim Zustart" VALUE 0x26D098 FLOAT32_IEEE_COL_DIRECT_M_S7_S3 0 trqg_fl_k_M_S7_S3 -10000 0 /end CHARACTERISTIC
/begin CHARACTERISTIC MG_SOLLK0NEG_ABF_ZUS "Negativer Gradient des K0 Sollmoments zum Abfangen des VM bei einem Abbruch VM Abstellen im Zustand VM Abfangen beim Zustart" VALUE 0x26D0A4 FLOAT32_IEEE_COL_DIRECT_M_S7_S3 0 trqg_fl_k_M_S7_S3 -10000 0 /end CHARACTERISTIC
/begin CHARACTERISTIC MG_SOLLK0NEG_ANH_ZUS "Negativer Gradient des K0 Sollmoments zur Begrenzung der K0 Vorsteuerung im Zustand Drehzahlanhebung beim VM Zustart" VALUE 0x26D0A8 FLOAT32_IEEE_COL_DIRECT_M_S7_S3 0 trqg_fl_k_M_S7_S3 -10000 0 /end CHARACTERISTIC
/begin CHARACTERISTIC MG_SOLLK0NEG_GAB_ABST "Gradient zum Abbau des K0 Sollmoments im Zustand 'VM gefuehrt Abstellen' beim VM Abstellen" VALUE 0x264A50 FLOAT32_IEEE_COL_DIRECT_M_S7_S3 0 trqg_fl_k_M_S7_S3 -10000 0 /end CHARACTERISTIC
/begin CHARACTERISTIC MG_SOLLK0POS_ABF_ZUS "Positiver Gradient des K0 Sollmoments zum Abfangen des VM bei einem Abbruch VM Abstellen im Zustand VM Abfangen beim Zustart" VALUE 0x26D0C0 FLOAT32_IEEE_COL_DIRECT_M_S7_S3 0 trqg_fl_k_M_S7_S3 0 10000 /end CHARACTERISTIC
/begin CHARACTERISTIC MG_SOLLK0POS_ANH_ZUS "Positiver Gradient des K0 Sollmoments zur Begrenzung der K0 Vorsteuerung im Zustand Drehzahlanhebung beim VM Zustart" VALUE 0x26D0C4 FLOAT32_IEEE_COL_DIRECT_M_S7_S3 0 trqg_fl_k_M_S7_S3 0 10000 /end CHARACTERISTIC
/begin CHARACTERISTIC MG_SOLLK0POS_GAB_ABST "Gradient zum Anheben des K0 Sollmo-ments im Zustand 'VM gefuehrt Abstellen' beim VM Abstellen" VALUE 0x264A54 FLOAT32_IEEE_COL_DIRECT_M_S7_S3 0 trqg_fl_k_M_S7_S3 0 10000 /end CHARACTERISTIC
/begin CHARACTERISTIC MG_SOLLK0UVSNEG_ZST_ZUS "Negativer Gradient des K0 Sollmoments bei Anforderung einer K0-Unterstuetzung des VM Startsystems durch die HAS Zustandssteuerung (OML) im Zustand Zustarten beim VM Zustart" VALUE 0x26D0D0 FLOAT32_IEEE_COL_DIRECT_M_S7_S3 0 trqg_fl_k_M_S7_S3 -10000 0 /end CHARACTERISTIC
/begin CHARACTERISTIC MG_SOLLK0UVSPOS_ZST_ZUS "Positiver Gradient des K0 Sollmoments bei Anforderung einer K0-Unterstuetzung des VM Startsystems durch die HAS Zustandssteuerung (OML) im Zustand Zustarten beim VM Zustart" VALUE 0x26D0D4 FLOAT32_IEEE_COL_DIRECT_M_S7_S3 0 trqg_fl_k_M_S7_S3 0 10000 /end CHARACTERISTIC
/begin CHARACTERISTIC MO_K0MODHASK0OEFFNEN_LAU_ABST "Offset auf das modifizierte K0-Moment als Uebergangsbedingung nach K0-Oeffnen im Zustand Last-Uebernahme beim VM Abstellen" VALUE 0x264A58 FLOAT32_IEEE_COL_DIRECT_M_S7_S3 0 trq_fl_a_M_S7_S3 -1000 1000 /end CHARACTERISTIC
/begin CHARACTERISTIC MO_K0OEFFNENBED_LAU_ABST "Offset auf das K0 Sollmoment zur Abfrage des K0-Moments als Uebergangsbedingung nach K0-Oeffnen im Zustand Last-Uebernahme beim VM Abstellen" VALUE 0x264A5C FLOAT32_IEEE_COL_DIRECT_M_S7_S3 0 trq_fl_a_M_S7_S3 -1000 1000 /end CHARACTERISTIC
/begin CHARACTERISTIC MO_K0REGELN_GAB_ABST "Offset auf das K0-.Moment zur Initialisie-rung des K0-Sollmoments beim Wechsel SCHLUPFREGELUNG nach DRUCK-STELLUNG im Zustand 'VM gefuehrt Ab-stellen' beim VM Abstellen" VALUE 0x264A60 FLOAT32_IEEE_COL_DIRECT_M_S7_S3 0 trq_fl_a_M_S7_S3 -1000 1000 /end CHARACTERISTIC
/begin CHARACTERISTIC MO_K0REGELN_KOE_ABST "Offset auf das K0-.Moment zur Initialisierung des K0-Sollmoments beim Wechsel SCHLUPFREGELUNG nach DRUCKSTELLUNG im Zustand K0-Oeffnen beim VM Abstellen" VALUE 0x264A64 FLOAT32_IEEE_COL_DIRECT_M_S7_S3 0 trq_fl_a_M_S7_S3 -1000 1000 /end CHARACTERISTIC
/begin CHARACTERISTIC MO_SOLLK0BEGRK0SREG_LAU_ABST "Offset auf das K0-Istmoment zur Bestim-mung des Begrenzungsmoment des K0 Sollmoments bei vor dem Ablauf aktiver K0 Schlupfregelung und unterdrueckter Aktivierung der K0 Schlupfregelung im Zustand 'Last-Uebernahme' beim VM Ab-stellen" VALUE 0x264A68 FLOAT32_IEEE_COL_DIRECT_M_S7_S3 0 trq_fl_a_M_S7_S3 -1000 1000 /end CHARACTERISTIC
/begin CHARACTERISTIC MO_VMK0ZUBED_KSA_ABST "Offset auf das VM-Moment zum Vergleich mit dem K0-Moment als Uebergangsbedingung nach Uebergabe Abbruch im Zustand K0-Schliessen Abbruch beim VM Abstellen" VALUE 0x264A6C FLOAT32_IEEE_COL_DIRECT_M_S7_S3 0 trq_fl_a_M_S7_S3 -1000 1000 /end CHARACTERISTIC
/begin CHARACTERISTIC MPT_MWUNSCHFPWHST "Filterkoeffizient Fahrerwunschmoment" VALUE 0x2648DC FLOAT32_IEEE_COL_DIRECT_M_S7_S3 0 void_fl_M_S7_S3 0 1 /end CHARACTERISTIC
/begin CHARACTERISTIC MS_K0_ABB_NOS "K0-Momentenschwelle fuer den Uebergang von ABB nach UEA" VALUE 0x26AC3C FLOAT32_IEEE_COL_DIRECT_M_S7_S3 0 trq_fl_a_M_S7_S3 -1000 1000 /end CHARACTERISTIC
/begin CHARACTERISTIC MS_K0BED_AST_ABST "K0-Momentenschwelle als Uebergangsbedingung nach Uebergabe  in Verbindung mit K0 Status OFFEN im Zustand VM-Abstellen beim VM Abstellen " VALUE 0x264A70 FLOAT32_IEEE_COL_DIRECT_M_S7_S3 0 trq_fl_a_M_S7_S3 -1000 1000 /end CHARACTERISTIC
/begin CHARACTERISTIC MS_K0OEFFNENBED_LAU_ABST "K0-Momentschwelle als Uebergangsbedingung nach K0-Oeffnen im Zustand Last-Uebernahme beim VM Abstellen" VALUE 0x264A74 FLOAT32_IEEE_COL_DIRECT_M_S7_S3 0 trq_fl_a_M_S7_S3 -1000 1000 /end CHARACTERISTIC
/begin CHARACTERISTIC MS_K0VMABSTBED_KOE_ABST "Schwelle des K0-Momants als Uebergangsbedingung nach VM-Abstellen im Zustand K0-Oeffnen beim VM Abstellen" VALUE 0x264A78 FLOAT32_IEEE_COL_DIRECT_M_S7_S3 0 trq_fl_a_M_S7_S3 -1000 1000 /end CHARACTERISTIC
/begin CHARACTERISTIC MS_MMAXIAEINAKTIV_ANS "Maxmoment der IAE" VALUE 0x26AB10 FLOAT32_IEEE_COL_DIRECT_M_S7_S3 0 trq_fl_a_M_S7_S3 -1000 1000 /end CHARACTERISTIC
/begin CHARACTERISTIC MS_VMK0OEFFNEN_LAU_ABST "Schwelle fuer den Betrag des VM Moments als Uebergangsbedingung nach K0-Oeffnen im Zustand Last-Uebernahme beim VM Abstellen" VALUE 0x264A7C FLOAT32_IEEE_COL_DIRECT_M_S7_S3 0 trq_fl_a_M_S7_S3 -1000 1000 /end CHARACTERISTIC
/begin CHARACTERISTIC NDS_K0_NST_NOS "K0-Differenzdrehzahlschwelle als Uebergangsbedingung vom Zustand Notstarten in den Zustand K0-Schliessen" VALUE 0x26AC4C FLOAT32_IEEE_COL_DIRECT_M_S7_S3 0 n_fl_M_S7_S3 0 500 /end CHARACTERISTIC
/begin CHARACTERISTIC NDS_K0VMABSTBED_KOE_ABST "Schwelle des Betrags der K0-Differenzdrehzahl als Uebergangsbedingung nach VM-Abstellen im Zustand K0-Oeffnen beim VM Abstellen" VALUE 0x264A8C FLOAT32_IEEE_COL_DIRECT_M_S7_S3 0 n_fl_M_S7_S3 0 10000 /end CHARACTERISTIC
/begin CHARACTERISTIC NG_EMMODRSMIN_SYN_ZUS "Minimaler Gradient der modifizierten EM-Drehzahl als Basisdrehzahl zur Bestimmung der VM Solldrehzahl bei RS beim K0 Synchronisieren beim Zustart" VALUE 0x26D178 FLOAT32_IEEE_COL_DIRECT_M_S7_S3 0 ng_fl_M_S7_S3 -50000 0 /end CHARACTERISTIC
/begin CHARACTERISTIC NGS_VMK0OEFFNEN_AST_ABST "VM Drehzahlgradientenschwelle zur Vorgabe K0 OEFFNENSW im Zustand VM-Abstellen beim VM Abstellen" VALUE 0x264A90 FLOAT32_IEEE_COL_DIRECT_M_S7_S3 0 ng_fl_M_S7_S3 -10000 10000 /end CHARACTERISTIC
/begin CHARACTERISTIC NOG_SECIAEMINCRVKRI_LLS_HAS "Gradient zum Abbau des Drehzahl-Offset auf die sekundaere IAE-Drehzahl der Creep-Ruckel-Verhinderung (CRV) der Minimaldrehzahlvorgabe bei Kriechbetrieb (KRI) der Leerlaufsimulation der HAS (LLS)" VALUE 0x264618 FLOAT32_IEEE_COL_DIRECT_M_S7_S3 0 ng_fl_M_S7_S3 -50000 0 /end CHARACTERISTIC
/begin CHARACTERISTIC NS_EMMINBED_KOE_ABST "EM Drehzahlschwelle zur Erkennung 'EM faellt zu frueh ab' als Uebergangsbedingung nach 'VM-Abstellen'  im Zustand 'K0-Oeffnen' beim VM Abstellen" VALUE 0x264A94 FLOAT32_IEEE_COL_DIRECT_M_S7_S3 0 n_fl_M_S7_S3 0 10000 /end CHARACTERISTIC
/begin CHARACTERISTIC NS_EMMINBED_LAU_ABST "EM Drehzahlschwelle zur Erkennung 'EM faellt zu frueh ab' als Uebergangsbedingung nach 'K0-Oeffnen' im Zustand 'Last-Uebernahme' beim VM Abstellen" VALUE 0x264A98 FLOAT32_IEEE_COL_DIRECT_M_S7_S3 0 n_fl_M_S7_S3 0 10000 /end CHARACTERISTIC
/begin CHARACTERISTIC NS_EMMINBED_NST_NOS "minimale EM-Drehzahlschwelle als Uebergangsbedin-gung vom Zustand Notstarten (st_notstarten_nos) in den Zustand K0-Schliessen (st_k0schliessen_nos)" VALUE 0x26AC50 FLOAT32_IEEE_COL_DIRECT_M_S7_S3 0 n_fl_M_S7_S3 0 10000 /end CHARACTERISTIC
/begin CHARACTERISTIC NS_EMMINBED_SAK_ABST "EM Drehzahlschwelle zur Erkennung 'EM faellt zu frueh ab' als Uebergangsbedingung nach 'Last-Uebernahme' im Zustand  'Schaltung Aktiv'  beim VM Abstellen" VALUE 0x264A9C FLOAT32_IEEE_COL_DIRECT_M_S7_S3 0 n_fl_M_S7_S3 0 10000 /end CHARACTERISTIC
/begin CHARACTERISTIC NS_EMMINBED_SCL_NOS "minimale EM-Drehzahlschwelle als Uebergangsbedin-gung vom Zustand K0-Schliessen (st_k0schliessen_nos) in den Zustand Uebergabe (st_uebergabe)" VALUE 0x26AC54 FLOAT32_IEEE_COL_DIRECT_M_S7_S3 0 n_fl_M_S7_S3 0 10000 /end CHARACTERISTIC
/begin CHARACTERISTIC NS_EMOELVERSFEHLERKALT_ERK_HAS "Drehzahlschwelle, die die EM waehrend Zustartablauf in Kaltstartvariante mindestens erreichen muss, bei Oel-versorgungsueberwachung" VALUE 0x2634DC FLOAT32_IEEE_COL_DIRECT_M_S7_S3 0 n_fl_M_S7_S3 0 10000 /end CHARACTERISTIC
/begin CHARACTERISTIC NS_MINEMGABBED_LAU_ABST "Schwellwert  der minimalen EM Drehzahl der Leerlaufsimulation als Uebergangsbedingung nach 'VM gefuehrt Abstellen' im Zustand 'Last-Uebernahme' beim VM Ab-stellen" VALUE 0x264AA0 FLOAT32_IEEE_COL_DIRECT_M_S7_S3 0 n_fl_M_S7_S3 0 10000 /end CHARACTERISTIC
/begin CHARACTERISTIC NS_VM_UMS_NST_NOS "VM-Drehzahlschwelle als Umschaltbedingung vom Zustand Notstarten in den Zustand K0-Schliessen" VALUE 0x26AC58 FLOAT32_IEEE_COL_DIRECT_M_S7_S3 0 n_fl_M_S7_S3 0 3000 /end CHARACTERISTIC
/begin CHARACTERISTIC NS_VMAUSBED_AST_ABST "VM Drehzahlschwelle zur Erkennung VM-aus als Uebergangsbedingung nach Uebergabe im Zustand VM-Abstellen beim VM Abstellen" VALUE 0x264AA4 FLOAT32_IEEE_COL_DIRECT_M_S7_S3 0 n_fl_M_S7_S3 0 10000 /end CHARACTERISTIC
/begin CHARACTERISTIC NS_VMK0OEFFNEN_AST_ABST "VM Drehzahlschwelle zur Vorgabe K0 OEFFNENSW im Zustand VM-Abstellen beim VM Abstellen" VALUE 0x264AA8 FLOAT32_IEEE_COL_DIRECT_M_S7_S3 0 n_fl_M_S7_S3 0 1000 /end CHARACTERISTIC
/begin CHARACTERISTIC STATUS_ABL_AST_ABST "Projektspezifische Statusrueckmeldung an HST im Zustand VM-Abstellen beim VM Abstellen" VALUE 0x26EDDA UBYTE_COL_DIRECT_M_S7_S3 0 sts_int_M_S7_S3 0 255 /end CHARACTERISTIC
/begin CHARACTERISTIC STATUS_ABL_GAB_ABST "Projektspezifische Statusrueckmeldung an HST im Zustand 'VM gefuehrt Abstellen' beim VM Abstellen" VALUE 0x26EDDB UBYTE_COL_DIRECT_M_S7_S3 0 sts_int_M_S7_S3 0 255 /end CHARACTERISTIC
/begin CHARACTERISTIC STATUS_ABL_GEFABST_AST_ABST "Projektspezifische Statusrueckmeldung an HST bei vorherigem 'Gefuehrten Abstellen' im Zustand 'VM-Abstellen' beim VM Ab-stellen" VALUE 0x26EDDC UBYTE_COL_DIRECT_M_S7_S3 0 sts_int_M_S7_S3 0 255 /end CHARACTERISTIC
/begin CHARACTERISTIC STATUS_ABL_KOE_ABST "Projektspezifische Statusrueckmeldung an HST im Zustand K0-Oeffnen beim VM Abstellen" VALUE 0x26EDDD UBYTE_COL_DIRECT_M_S7_S3 0 sts_int_M_S7_S3 0 255 /end CHARACTERISTIC
/begin CHARACTERISTIC STATUS_ABL_KON_NOS "Statusrueckmeldung der HAS an HSTim Zustand Konditionieren" VALUE 0x26F17E UBYTE_COL_DIRECT_M_S7_S3 0 sts_int_M_S7_S3 0 15 /end CHARACTERISTIC
/begin CHARACTERISTIC STATUS_ABL_LAU_ABST "Projektspezifische Statusrueckmeldung an HST im Zustand Last-Uebernahme beim VM Abstellen" VALUE 0x26EDDE UBYTE_COL_DIRECT_M_S7_S3 0 sts_int_M_S7_S3 0 255 /end CHARACTERISTIC
/begin CHARACTERISTIC STATUS_ABL_NST_NOS "Statusrueckmeldung der HAS an HSTim Zustand Notstarten" VALUE 0x26F17F UBYTE_COL_DIRECT_M_S7_S3 0 sts_int_M_S7_S3 0 15 /end CHARACTERISTIC
/begin CHARACTERISTIC STATUS_ABL_SAK_ABST "Projektspezifische Statusrueckmeldung an HST im Zustand 'Schaltung Aktiv' beim VM Abstellen" VALUE 0x26EDDF UBYTE_COL_DIRECT_M_S7_S3 0 sts_int_M_S7_S3 0 255 /end CHARACTERISTIC
/begin CHARACTERISTIC STATUS_ABL_SAK_ANS "Projektspezifische Vorgabe des Zahlenwerts fuer den Ablaufstatus status_ablauf_has in den einzelnen Zustaenden eines Hybridablaufs" VALUE 0x26F131 UBYTE_COL_DIRECT_M_S7_S3 0 void_int_M_S7_S3 0 15 /end CHARACTERISTIC
/begin CHARACTERISTIC STATUS_ABL_SCL_ANS "Projektspezifische Vorgabe des Zahlenwerts fuer den Ablaufstatus status_ablauf_has in den einzelnen Zustaenden eines Hybridablaufs" VALUE 0x26F132 UBYTE_COL_DIRECT_M_S7_S3 0 void_int_M_S7_S3 0 15 /end CHARACTERISTIC
/begin CHARACTERISTIC STATUS_ABL_SCL_NOS "Statusrueckmeldung der HAS an HSTim Zustand K0-Schliessen" VALUE 0x26F180 UBYTE_COL_DIRECT_M_S7_S3 0 sts_int_M_S7_S3 0 15 /end CHARACTERISTIC
/begin CHARACTERISTIC STATUS_ABL_SRT_ABST "Projektspezifische Statusrueckmeldung an HST im Zustand Start beim VM Abstellen" VALUE 0x26EDE0 UBYTE_COL_DIRECT_M_S7_S3 0 sts_int_M_S7_S3 0 255 /end CHARACTERISTIC
/begin CHARACTERISTIC STATUS_ABL_SRT_NOS "Statusrueckmeldung der HAS an HST im Zustand Start (st_start)" VALUE 0x26F181 UBYTE_COL_DIRECT_M_S7_S3 0 sts_int_M_S7_S3 0 15 /end CHARACTERISTIC
/begin CHARACTERISTIC STATUS_ABL_SYN_ANS "Projektspezifische Vorgabe des Zahlenwerts fuer den Ablaufstatus status_ablauf_has in den einzelnen Zustaenden eines Hybridablaufs" VALUE 0x26F135 UBYTE_COL_DIRECT_M_S7_S3 0 void_int_M_S7_S3 0 15 /end CHARACTERISTIC
/begin CHARACTERISTIC SWI_ABBRUCH_AKTIV_ABBSTG "Flag (Bit 31) fuer Abbruch Aktiv" VALUE 0x26378C ULONG_COL_DIRECT_M_S7_S3 0 void_int_f_M_S7_S3 0 2147483648 /end CHARACTERISTIC
/begin CHARACTERISTIC SWI_ABBRUCH_AKTIV_ABST "SWI fuer die Aktivierung des Abbruch Ablauf Abstellen" VALUE 0x26EDE1 UBYTE_COL_DIRECT_M_S7_S3 0 swi_int_M_S7_S3 0 1 /end CHARACTERISTIC
/begin CHARACTERISTIC SWI_ABBRUCH_AKTIV_NOS "SWI fuer die Aktivierung des Abbruch Ablauf Notstart" VALUE 0x26F182 UBYTE_COL_DIRECT_M_S7_S3 0 b_int_h_M_S7_S3 0 1 /end CHARACTERISTIC
/begin CHARACTERISTIC SWI_AKTPASSIVABB_OML "Nur im Testmode Handshake K0Close gueltig" VALUE 0x26EB21 UBYTE_COL_DIRECT_M_S7_S3 0 void_int_d_M_S7_S3 0 1 /end CHARACTERISTIC
/begin CHARACTERISTIC SWI_BREMSREKUBERMODUS_LAU_ABST "Schalter zur Auswahl der Berechnungsart zur Erkennung der Bremsrekuperation im Zustand Lastuebernahme beim VM Abstellen: 0 = Standard, 1 = ohne VM-Minimalmoment, 2 = mit speziellem VM-Minimalmoment" VALUE 0x26EDE2 UBYTE_COL_DIRECT_M_S7_S3 0 swi_int_o_M_S7_S3 0 2 /end CHARACTERISTIC
/begin CHARACTERISTIC SWI_K0ANSTEUERUNG_AST_ABST "Schalter zur Festlegung der K0 Ansteuerung bei Kraftfluss vorhanden im Zustand VM-Abstellen beim VM Abstellen: 1 = DRUCKSTELLUNG, 0 = OEFFNENSW" VALUE 0x26EDE3 UBYTE_COL_DIRECT_M_S7_S3 0 swi_int_M_S7_S3 0 1 /end CHARACTERISTIC
/begin CHARACTERISTIC SWI_K0SREGAKTIV_LAU_ABST "Bedingte Aktivierung der K0 Schlupfregelung im Zustand 'Last-Uebernahme' beim VM Abstellen" VALUE 0x26EDE4 UBYTE_COL_DIRECT_M_S7_S3 0 swi_int_M_S7_S3 0 1 /end CHARACTERISTIC
/begin CHARACTERISTIC SWI_KLMK0MODINIT_LAU_ABST "Auswahl der Y-Achse fuer KL_MK0MODINIT_LAU_ABST zur Initialisierung des modifizierten K0-Istmoments im Zustand Last-Uebernahme beim VM Abstellen: 0 = m_soll_vm_hst_in, 1 = m_soll_vm_l_hst_in" VALUE 0x26EDE5 UBYTE_COL_DIRECT_M_S7_S3 0 swi_int_M_S7_S3 0 1 /end CHARACTERISTIC
/begin CHARACTERISTIC SWI_MK0MODINIT_LAU_ABST "Auswahl des VM-Basismoments fuer die Initialisierung des modifizierten K0 Mo-ments im Zustand Last-Uebernahme beim VM Abstellen: 0 = m_soll_vm_hst_in bzw. m_soll_vm_l_hst_in , 1 = m_vm_in" VALUE 0x26EDE6 UBYTE_COL_DIRECT_M_S7_S3 0 swi_int_M_S7_S3 0 1 /end CHARACTERISTIC
/begin CHARACTERISTIC SWI_MSOLLK0BASIS_LAU_ABST "Auswahl des VM-Basismoments fuer die Bestimmung des K0-Moments im Zustand Last-Uebernahme beim VM Abstellen: 0 = m_soll_vm_hst_in, 1 = m_vm_in" VALUE 0x26EDE7 UBYTE_COL_DIRECT_M_S7_S3 0 swi_int_M_S7_S3 0 1 /end CHARACTERISTIC
/begin CHARACTERISTIC SWI_PDEAK_OELVERSFEHLER_ERK_HAS "Schalter, mit dem die Oelversorgungs-ueberwachung in Waehlhebelposition P deaktiviert werden kann" VALUE 0x26EB0C UBYTE_COL_DIRECT_M_S7_S3 0 swi_int_M_S7_S3 0 1 /end CHARACTERISTIC
/begin CHARACTERISTIC SWI_STATUSABL_SAVM_LAU_ABST "Schalter zur Beeinflussung des Ablaufstatus entsprechend aktiver VM Schubab-schaltung im Zustand 'Last-Uebernahme' beim VM Abstellen" VALUE 0x26EDE8 UBYTE_COL_DIRECT_M_S7_S3 0 swi_int_M_S7_S3 0 1 /end CHARACTERISTIC
/begin CHARACTERISTIC SWI_STATUSK0K0SREG_LAU_ABST "Schalter zur Aktivierung der Beruecksichti-gung des K0 Status SCHLUPFGERE-GELT bei der bedingten Aktivierung der K0 Schlupfregelung im Zustand 'Last-Uebernahme' beim VM Abstellen" VALUE 0x26EDE9 UBYTE_COL_DIRECT_M_S7_S3 0 swi_int_M_S7_S3 0 1 /end CHARACTERISTIC
/begin CHARACTERISTIC SWI_TESTMODE "Einschalten des TESTMODE Emulation Handshake" VALUE 0x26EB22 UBYTE_COL_DIRECT_M_S7_S3 0 void_int_M_S7_S3 0 1 /end CHARACTERISTIC
/begin CHARACTERISTIC SWI_TESTMODE_HS_STAPS "Einschalten des TESTMODE Anpassung Passiv Abbruch" VALUE 0x26EB23 UBYTE_COL_DIRECT_M_S7_S3 0 void_int_M_S7_S3 0 1 /end CHARACTERISTIC
/begin CHARACTERISTIC SWI_ZK0REGELN_LAU_ABST "Schalter zur Vorgabe des K0 Ansteuer-modus  GESCHLOSSEN im Zustand 'Last-Uebernahme' beim VM Abstellen" VALUE 0x26EDEA UBYTE_COL_DIRECT_M_S7_S3 0 swi_int_M_S7_S3 0 1 /end CHARACTERISTIC
/begin CHARACTERISTIC SWI_ZPHYSK0_ABB_NOS "SWI fuer die Hysteresenkompensation K0 im Zustand Not-start beim Abbruch Notstart: 0 = Druckanteil p_hys_k0_has inaktiv, 1 = Druckanteil p_hys_k0_has aktiv" VALUE 0x26F183 UBYTE_COL_DIRECT_M_S7_S3 0 b_int_h_M_S7_S3 0 1 /end CHARACTERISTIC
/begin CHARACTERISTIC SWI_ZPHYSK0_KON_NOS "Schalter zur (De)Aktivierung der K0-Hysteresekompensation im Zustand Konditionieren" VALUE 0x26F184 UBYTE_COL_DIRECT_M_S7_S3 0 b_int_h_M_S7_S3 0 1 /end CHARACTERISTIC
/begin CHARACTERISTIC SWI_ZPHYSK0_KSA_ABST "Schalter fuer die Hysteresekompensation K0 im Zustand K0-Schliessen Abbruch beim VM Abstellen: 0 = Druckanteil p_hys_k0_has inaktiv, 1 = Druckanteil p_hys_k0_has aktiv" VALUE 0x26EDEB UBYTE_COL_DIRECT_M_S7_S3 0 swi_int_M_S7_S3 0 1 /end CHARACTERISTIC
/begin CHARACTERISTIC SWI_ZPHYSK0_NST_NOS "Schalter zur (De)Aktivierung der K0-Hysteresekompensation im Zustand Notstarten" VALUE 0x26F185 UBYTE_COL_DIRECT_M_S7_S3 0 b_int_h_M_S7_S3 0 1 /end CHARACTERISTIC
/begin CHARACTERISTIC SWI_ZPHYSK0_SCL_NOS "Schalter zur (De)Aktivierung der K0-Hysteresekompensation im Zustand K0-Schliessen" VALUE 0x26F186 UBYTE_COL_DIRECT_M_S7_S3 0 b_int_h_M_S7_S3 0 1 /end CHARACTERISTIC
/begin CHARACTERISTIC SWI_ZPHYSK0_SRT_NOS "Schalter zur (De)Aktivierung der K0-Hysteresekompensation im Zustand Start" VALUE 0x26F187 UBYTE_COL_DIRECT_M_S7_S3 0 b_int_h_M_S7_S3 0 1 /end CHARACTERISTIC
/begin CHARACTERISTIC SWI_ZPHYSK0_UAB_ABST "Schalter fuer die Hysteresekompensation K0 im Zustand Uebergabe Abbruch beim VM Abstellen: 0 = Druckanteil p_hys_k0_has inaktiv, 1 = Druckanteil p_hys_k0_has aktiv" VALUE 0x26EDEC UBYTE_COL_DIRECT_M_S7_S3 0 swi_int_M_S7_S3 0 1 /end CHARACTERISTIC
/begin CHARACTERISTIC SWI_ZPHYSK0_UEA_NOS "SWI fuer die Hysteresenkompensation K0 im Zustand Notstart beim Abbruch Uebergabe: 0 = Druckanteil p_hys_k0_has inaktiv, 1 = Druckanteil p_hys_k0_has aktiv" VALUE 0x26F188 UBYTE_COL_DIRECT_M_S7_S3 0 b_int_h_M_S7_S3 0 1 /end CHARACTERISTIC
/begin CHARACTERISTIC SWI_ZPHYSK0_UEB_NOS "Schalter zur (De)Aktivierung der K0-Hysteresekompensation im Zustand Uebrgabe" VALUE 0x26F189 UBYTE_COL_DIRECT_M_S7_S3 0 b_int_h_M_S7_S3 0 1 /end CHARACTERISTIC
/begin CHARACTERISTIC SWI_ZPONRABBRAKTIV_HAS "Schalter zur Aktivierung der Beruecksichtigung des Umkehrgrenzpunkts der Hybridfunktionen bei der Abbruchsteuerung der Hybrid-Zustandssteuerung der HAS" VALUE 0x26EB24 UBYTE_COL_DIRECT_M_S7_S3 0 void_int_d_M_S7_S3 0 1 /end CHARACTERISTIC
/begin CHARACTERISTIC T_MAX_ABB_NOS "Maximale Verweildauer im Zustand Abbruch beim Notstart" VALUE 0x26E330 UWORD_COL_DIRECT_M_S7_S3 0 t_int_n_M_S7_S3 0 10 /end CHARACTERISTIC
/begin CHARACTERISTIC T_MAX_AST_ABST "Maximale Verweildauer im Zustand VM-Abstellen beim VM Abstellen" VALUE 0x264AAC FLOAT32_IEEE_COL_DIRECT_M_S7_S3 0 t_fl_M_S7_S3 0 10 /end CHARACTERISTIC
/begin CHARACTERISTIC T_MAX_GAB_ABST "Maximale Verweildauer im Zustand 'VM gefuehrt Abstellen' beim VM Abstellen" VALUE 0x264AB0 FLOAT32_IEEE_COL_DIRECT_M_S7_S3 0 t_fl_M_S7_S3 0 10 /end CHARACTERISTIC
/begin CHARACTERISTIC T_MAX_GEFABST_AST_ABST "Maximale Verweildauer bei vorherigem 'Gefuehrten Abstellen' im Zustand 'VM-Abstellen' beim VM Abstellen" VALUE 0x264AB4 FLOAT32_IEEE_COL_DIRECT_M_S7_S3 0 t_fl_M_S7_S3 0 10 /end CHARACTERISTIC
/begin CHARACTERISTIC T_MAX_KOE_ABST "Maximale Verweildauer im Zustand K0-Oeffnen beim VM Abstellen" VALUE 0x264AB8 FLOAT32_IEEE_COL_DIRECT_M_S7_S3 0 t_fl_M_S7_S3 0 10 /end CHARACTERISTIC
/begin CHARACTERISTIC T_MAX_KSA_ABST "Maximale Verweildauer im Zustand K0-Schliessen Abbruch beim VM Abstellen" VALUE 0x264ABC FLOAT32_IEEE_COL_DIRECT_M_S7_S3 0 t_fl_M_S7_S3 0 10 /end CHARACTERISTIC
/begin CHARACTERISTIC T_MAX_LAU_ABST "Maximale Verweildauer im Zustand Last-Uebernahme beim VM Abstellen" VALUE 0x264AC0 FLOAT32_IEEE_COL_DIRECT_M_S7_S3 0 t_fl_M_S7_S3 0 10 /end CHARACTERISTIC
/begin CHARACTERISTIC T_MAX_NST_NOS "maximale Verweildauer im Zustand Notstarten (151)" VALUE 0x26E332 UWORD_COL_DIRECT_M_S7_S3 0 t_int_n_M_S7_S3 0 10 /end CHARACTERISTIC
/begin CHARACTERISTIC T_MAX_SAK_ABST "Maximale Verweildauer im Zustand 'Schaltung Aktiv' beim VM Abstellen" VALUE 0x264AC4 FLOAT32_IEEE_COL_DIRECT_M_S7_S3 0 t_fl_M_S7_S3 0 10 /end CHARACTERISTIC
/begin CHARACTERISTIC T_MAX_SCL_NOS "maximale Verweildauer im Zustand K0-Schliessen (152)" VALUE 0x26E334 UWORD_COL_DIRECT_M_S7_S3 0 t_int_n_M_S7_S3 0 10 /end CHARACTERISTIC
/begin CHARACTERISTIC T_MSOLLEMAKTIVMAX_ANS "Max.-Zeit zur Ueberwachung Ausgabe m_soll_em_has " VALUE 0x26E318 UWORD_COL_DIRECT_M_S7_S3 0 t_int_n_M_S7_S3 0 1 /end CHARACTERISTIC
/begin CHARACTERISTIC T_MSOLLEMHST_HAS "Verzoegerungszeit des EM Sollmoment der HST fuer die Berechnung des Fahrerwunschmoments der HST" VALUE 0x2637B8 FLOAT32_IEEE_COL_DIRECT_M_S7_S3 0 t_fl_M_S7_S3 0 0.1 /end CHARACTERISTIC
/begin CHARACTERISTIC T_MSOLLVMHST_HAS "Verzoegerungszeit des VM Sollmoment der HST fuer die Berechnung des Fahrerwunschmoments der HST" VALUE 0x2637BC FLOAT32_IEEE_COL_DIRECT_M_S7_S3 0 t_fl_M_S7_S3 0 0.1 /end CHARACTERISTIC
/begin CHARACTERISTIC T_NDSK0_NST_NOS "minimale Verweildauer, in der die K0-Differenzdrehzahl unterhalb einer applizierbaren Schwelle ist; im Zustand Notstarten (151)" VALUE 0x26E336 UWORD_COL_DIRECT_M_S7_S3 0 t_int_n_M_S7_S3 0 10 /end CHARACTERISTIC
/begin CHARACTERISTIC T_NGSVMK0OEFFNEN_AST_ABST "Verzoegerungszeit zur Abfrage der VM Drehzahlgradientenschwelle zur Vorgabe K0 OEFFNENSW im Zustand VM-Abstellen beim VM Abstellen" VALUE 0x264AC8 FLOAT32_IEEE_COL_DIRECT_M_S7_S3 0 t_fl_M_S7_S3 0 10 /end CHARACTERISTIC
/begin CHARACTERISTIC T_UMS_NST_NOS "maximale Umschaltdauer im Zustand Notstarten (151)" VALUE 0x26E338 UWORD_COL_DIRECT_M_S7_S3 0 t_int_n_M_S7_S3 0 10 /end CHARACTERISTIC
/begin CHARACTERISTIC T_VK0FIXABBRUCH_PASSIV_HAS "Verzoegerungszeit zum Halten der K0-Ansteuerung nach dem Abbruch eines Betriebszustandsuebergangs der Hybrid Zustandssteuerung" VALUE 0x26E33A UWORD_COL_DIRECT_M_S7_S3 0 t_int_n_M_S7_S3 0 1 /end CHARACTERISTIC
/begin CHARACTERISTIC T_VK0OEFFNEN_LAU_ABST "Verzoegerungszeit als Uebergangsbedingung nach K0-Oeffnen im Zustand Last-Uebernahme beim VM Abstellen" VALUE 0x264ACC FLOAT32_IEEE_COL_DIRECT_M_S7_S3 0 t_fl_M_S7_S3 0 5 /end CHARACTERISTIC
/begin CHARACTERISTIC TAB_ABBRUCHKODIERUNG_Y "Kodierung zur Steurung der Abbrueche" CURVE 0x26363C ULONG_COL_DIRECT_M_S7_S3 0 void_int_f_M_S7_S3 8912896 2612590447
 /begin AXIS_DESCR COM_AXIS NO_INPUT_QUANTITY void_int_f_M_S7_S3 84 100000 899999 AXIS_PTS_REF TAB_ABBRUCHKODIERUNG_X /end AXIS_DESCR
/end CHARACTERISTIC
/begin CHARACTERISTIC TAB_MGSOLLK0ABLVAR_KOE_ABST "Gradient des K0 Sollmoments in Abhaengigkeit der Ablaufvariante der Zustandssteuerung im Zustand K0-Oeffnen beim VM Abstellen" VAL_BLK 0x264A24 FLOAT32_IEEE_COL_DIRECT_M_S7_S3 0 trqg_fl_k_M_S7_S3 -25000 0 NUMBER 5 /end CHARACTERISTIC
/begin CHARACTERISTIC TAB_ZPHYSK0_PASSIV_HAS "Festlegung des K0-Hystereseflags der HAS ausserhalb von Zustandsuebergaengen (Passiv) in Abhaengigkeit des Ist-Betriebszustands der Hybrid Zustandssteuerung" VAL_BLK 0x26AC5C UBYTE_COL_DIRECT_M_S7_S3 0 sts_int_e_M_S7_S3 0 1 NUMBER 16 /end CHARACTERISTIC
/begin CHARACTERISTIC XP_MAX "" VALUE 0x264914 FLOAT32_IEEE_COL_DIRECT_M_S7_S3 0 void_fl_M_S7_S3 -3.40282E+038 3.40282E+038 /end CHARACTERISTIC
/begin CHARACTERISTIC Z_ABLAUFVARIANTE_GEFABST_ABST "Anforderung der Variante Gefuehrtes Ab-stellen durch die HAS Zustandssteuerung (OML) beim VM Abstellen (z_ablaufvariante_has_stg) " VALUE 0x26EDED UBYTE_COL_DIRECT_M_S7_S3 0 sts_int_M_S7_S3 0 100 /end CHARACTERISTIC
/begin CHARACTERISTIC Z_ABLAUFVARIANTE_K0SOEF_ABST "Anforderung der Variante K0 Schnelloeffnen durch die HAS Zustandssteuerung (OML) beim VM Abstellen (z_ablaufvariante_has_stg) " VALUE 0x26EDEE UBYTE_COL_DIRECT_M_S7_S3 0 sts_int_M_S7_S3 0 100 /end CHARACTERISTIC
/begin AXIS_PTS KF_NSEMBED_GAB_ABST_X "" 0x264968 c_getriebe_egs_in FLOAT32_IEEE_X_INCR_DIRECT_M_S7_S3 0 c_fl_M_S7_S3 5 -3.40282E+038 3.40282E+038 /end AXIS_PTS
/begin AXIS_PTS KF_NSEMBED_GAB_ABST_Y "" 0x26497C c_vm_in FLOAT32_IEEE_X_INCR_DIRECT_M_S7_S3 0 c_fl_M_S7_S3 4 -3.40282E+038 3.40282E+038 /end AXIS_PTS
/begin AXIS_PTS KL_KSVHABBRLAUSFST_ABST_X "Festlegung der Schaltart der von der Fahrstrategie abzubrechenden laufenden Schaltungen in Abhaengigkeit des aktuellen Zustands beim Abstellen -> Bit-Codierung wie z_ablauf_shv_reset_has" 0x26E19A st_ablauf_fkt UWORD_X_INCR_DIRECT_M_S7_S3 0 st_int_g_M_S7_S3 7 0 65535 /end AXIS_PTS
/begin AXIS_PTS KL_KSVHRESET_AST_ABST_X "Ruecksetzen einer Schaltverhinderung in Abhaengigkeit des Istgangs im Zustand VM-Abstellen beim VM Abstellen (255 = alle Arten von Schaltungen zuruecksetzen, 0 = keine Schaltung zuruecksetzen) -> Bit-Codierung siehe Handbuch" 0x264A14 istgang_egs_in SBYTE_X_INCR_DIRECT_M_S7_S3 0 void_int_M_S7_S3 8 -128 127 /end AXIS_PTS
/begin AXIS_PTS KL_MK0MODINIT_LAU_ABST_X "Basismoment zur Initialisierung des modifizierten K0 Moments in Abhaengigkeit des VM-Sollmoments im Zustand Last-Uebernahme beim Abstellen" 0x26498C NO_INPUT_QUANTITY FLOAT32_IEEE_X_INCR_DIRECT_M_S7_S3 0 trq_fl_a_M_S7_S3 6 -1000 1000 /end AXIS_PTS
/begin AXIS_PTS KL_MOSOLLK0MVM_LAU_ABST_X "Offset auf den Betrag des VM-Basismoments zur Berechnung  des K0-Sollmoments im Zustand Last-Uebernahme beim VM Abstellen" 0x2649BC NO_INPUT_QUANTITY FLOAT32_IEEE_X_INCR_DIRECT_M_S7_S3 0 trq_fl_a_M_S7_S3 6 -1000 1000 /end AXIS_PTS
/begin AXIS_PTS KL_MSOLLK0ZIEL_GAB_ABST_X "Zielwert des K0-Sollmoments in Abhaengigkeit des Betrags des EM-Istmoments im Zustand 'VM gefuehrt Abstellen' beim VM Abstellen" 0x2649EC NO_INPUT_QUANTITY FLOAT32_IEEE_X_INCR_DIRECT_M_S7_S3 0 trq_fl_a_M_S7_S3 5 -3.40282E+038 3.40282E+038 /end AXIS_PTS
/begin AXIS_PTS KL_MSSOLLEMAKTIV_ANS_X "X-Achse: istgang_egs_in" 0x26A390 NO_INPUT_QUANTITY FLOAT32_IEEE_X_INCR_DIRECT_M_S7_S3 0 void_fl_M_S7_S3 10 -1 10 /end AXIS_PTS
/begin AXIS_PTS KL_MSSOLLEMAKTIVSTKRAFTFL_ANS_X "X-Achse: status_kraftfluss_egs_in" 0x26F0D6 NO_INPUT_QUANTITY UBYTE_X_INCR_DIRECT_M_S7_S3 0 sts_int_M_S7_S3 7 0 6 /end AXIS_PTS
/begin AXIS_PTS KL_NOEMOELVERSFEHLER_ERK_HAS_X "Temperaturabhaengiges Drehzahloffset auf die EM-Istdrehzahl, das bei der Oelversorgungsueberwachung toleriert wird." 0x263414 c_getriebe_egs_in FLOAT32_IEEE_X_INCR_DIRECT_M_S7_S3 0 c_fl_M_S7_S3 8 -1000 1000 /end AXIS_PTS
/begin AXIS_PTS KL_SVHSTKRAFTFLUSS_ANS_X "X-Achse: status_kraftfluss_egs_in" 0x26F0F2 NO_INPUT_QUANTITY UBYTE_X_INCR_DIRECT_M_S7_S3 0 sts_int_M_S7_S3 7 0 6 /end AXIS_PTS
/begin AXIS_PTS TAB_ABBRUCHKODIERUNG_X "ID fuer die ein Abbruch definiert ist" 0x2634EC NO_INPUT_QUANTITY ULONG_X_INCR_DIRECT_M_S7_S3 0 void_int_f_M_S7_S3 84 100000 899999 /end AXIS_PTS
/begin MEASUREMENT abstellpos_vm_in "Abstellposition VM vor naechstem ZOT" UWORD void_int_c_M_S7_S3 1 100 0 360 ECU_ADDRESS 0xFFF86784 /end MEASUREMENT
/begin MEASUREMENT abstellpos_vm_status_in "Status Abstellposition VM" UBYTE void_int_M_S7_S3 1 100 0 2 ECU_ADDRESS 0xFFF86CC5 /end MEASUREMENT
/begin MEASUREMENT analyse_has_sbe "Bestimmung der Monitoring-Variante fuer die MVG VM-Start " UBYTE void_int_M_S7_S3 1 100 0 8 ECU_ADDRESS 0xFFF86C73 /end MEASUREMENT
/begin MEASUREMENT bCl1Closed "Kupplung sicher geschlossen" UBYTE b_int_h_M_S7_S3 1 100 0 1 ECU_ADDRESS 0xFFF868D9 /end MEASUREMENT
/begin MEASUREMENT bCl2Available "Zweite Kupplung vorhanden (Anfahrelement)" UBYTE b_int_h_M_S7_S3 1 100 0 1 ECU_ADDRESS 0xFFF868DA /end MEASUREMENT
/begin MEASUREMENT bEngCoupleAllowed "VM Ankoppeln erlaubt" UBYTE b_int_h_M_S7_S3 1 100 0 1 ECU_ADDRESS 0xFFF868DB /end MEASUREMENT
/begin MEASUREMENT bErrorHybrid "Anforderung der Strategieanpassung, die Zustandssteuerung (OML) im Error-Modus zu betreiben" UBYTE sts_int_M_S7_S3 1 100 0 1 ECU_ADDRESS 0xFFF86C80 /end MEASUREMENT
/begin MEASUREMENT bExceptionHybrid "Anforderung der Strategieanpassung, die Zustandssteuerung (OML) im Exception-Modus zu betreiben" UBYTE sts_int_M_S7_S3 1 100 0 1 ECU_ADDRESS 0xFFF86C81 /end MEASUREMENT
/begin MEASUREMENT bIgnitionOffVerified "Zuendung aus bestaetigt" UBYTE b_int_h_M_S7_S3 1 100 0 1 ECU_ADDRESS 0xFFF868DC /end MEASUREMENT
/begin MEASUREMENT bInitHybrid "OMD Init-Mode angefordert" UBYTE b_int_h_M_S7_S3 1 100 0 1 ECU_ADDRESS 0xFFF868DD /end MEASUREMENT
/begin MEASUREMENT bIsShifting "Schaltung aktiv" UBYTE b_int_h_M_S7_S3 1 100 0 1 ECU_ADDRESS 0xFFF868DE /end MEASUREMENT
/begin MEASUREMENT bReInitNormalMode "Anforderung ReInit OMD-NormalMode" UBYTE b_int_h_M_S7_S3 1 100 0 1 ECU_ADDRESS 0xFFF868DF /end MEASUREMENT
/begin MEASUREMENT bremspedal_in "Signal Bremsschalter" UBYTE E_BREMSPED_M_S7_S3 1 100 0 1 ECU_ADDRESS 0xFFF86C9B /end MEASUREMENT
/begin MEASUREMENT bTrmsCtrlRequest "Anforderung Transmission Command" UBYTE b_int_h_M_S7_S3 1 100 0 1 ECU_ADDRESS 0xFFF868E0 /end MEASUREMENT
/begin MEASUREMENT c_getriebe_egs_in "" FLOAT32_IEEE c_int_M_S7_S3 1 100 -40 215 ECU_ADDRESS 0xFFF86214 /end MEASUREMENT
/begin MEASUREMENT c_umgebung_in "Aussentemperatur gefiltert" FLOAT32_IEEE c_fl_M_S7_S3 1 100 -40 85 ECU_ADDRESS 0xFFF86284 /end MEASUREMENT
/begin MEASUREMENT c_vm_in "" FLOAT32_IEEE c_fl_M_S7_S3 1 100 -3.40282E+038 3.40282E+038 ECU_ADDRESS 0xFFF86288 /end MEASUREMENT
/begin MEASUREMENT ctrlAbort_req "Abbruch OpFkt angefordert" ULONG ctrl_int_j_M_S7_S3 1 100 0 4294967295 ECU_ADDRESS 0xFFF85B74 /end MEASUREMENT
/begin MEASUREMENT ctrlDrivelineMode_req "Angeforderte Betriebsart" UBYTE E_DLM_M_S7_S3 1 100 1 8 ECU_ADDRESS 0xFFF868E1 /end MEASUREMENT
/begin MEASUREMENT ctrlOperatingModeOMD_req "Anforderung der Aktivierung einer Hybridfunktion durch die Hyrid-Zustandssteuerung" UBYTE E_DLM_M_S7_S3 1 100 1 8 ECU_ADDRESS 0xFFF868E2 /end MEASUREMENT
/begin MEASUREMENT ctrlSequence_req "Steuerung Ablauf" UBYTE ctrl_int_M_S7_S3 1 100 0 15 ECU_ADDRESS 0xFFF868E4 /end MEASUREMENT
/begin MEASUREMENT ctrlSequenceOMD_req "Zusaetzliche Steuergroesse zur Ablaufsteuerung" UBYTE ctrl_int_M_S7_S3 1 100 0 15 ECU_ADDRESS 0xFFF868E3 /end MEASUREMENT
/begin MEASUREMENT ctrlVariant_req "Variantenvorgabe an OMD" UBYTE ctrl_int_M_S7_S3 1 100 0 15 ECU_ADDRESS 0xFFF868E6 /end MEASUREMENT
/begin MEASUREMENT ctrlVariantOMD_req "Ablaufvariante, die  die OMD ausgibt" UBYTE ctrl_int_M_S7_S3 1 100 0 99 ECU_ADDRESS 0xFFF868E5 /end MEASUREMENT
/begin MEASUREMENT drehrichtung_nab_in "Drehrichtung Abtriebsdrehzahl" UBYTE E_DREHRICH_M_S7_S3 1 100 0 2 ECU_ADDRESS 0xFFF86C9C /end MEASUREMENT
/begin MEASUREMENT drehrichtung_nem_in "Drehrichtung der E-Maschine" UBYTE E_DREHRICH_M_S7_S3 1 100 0 2 ECU_ADDRESS 0xFFF86C9D /end MEASUREMENT
/begin MEASUREMENT fpw_in "Prozent Fahrpedalstellung" UBYTE rel_int_M_S7_S3 1 100 0 255 ECU_ADDRESS 0xFFF86C9E /end MEASUREMENT
/begin MEASUREMENT gangwechsel_egs_in "Flag waehrend laufender Schaltung, bei synchron verlassen bis synchron erreicht" UBYTE void_int_M_S7_S3 1 100 0 1 ECU_ADDRESS 0xFFF86C9F /end MEASUREMENT
/begin MEASUREMENT HCSoProc_dummy "Dummy Ausgang Signalaufbereitung Out" UBYTE st_int_M_S7_S3 1 100 0 255 ECU_ADDRESS 0xFFF868D8 /end MEASUREMENT
/begin MEASUREMENT i_gang_lev2_egs_in "Uebergabe der aktuellen Ganguebersetzung i_gang nach ASILB ermittelt aus den Kupplungsstroemen" FLOAT32_IEEE void_fl_M_S7_S3 1 100 -3.40282E+038 3.40282E+038 ECU_ADDRESS 0xFFF86218 /end MEASUREMENT
/begin MEASUREMENT i_istgang_egs "Uebersetzung des aktuellen Gangs" FLOAT32_IEEE ratio_fl_M_S7_S3 1 100 0 8 ECU_ADDRESS 0xFFF861B4 /end MEASUREMENT
/begin MEASUREMENT i_zielgang_egs "Uebersetzung des Zielgangs" FLOAT32_IEEE ratio_fl_M_S7_S3 1 100 0 8 ECU_ADDRESS 0xFFF861B8 /end MEASUREMENT
/begin MEASUREMENT istgang_egs_in "" SBYTE void_int_M_S7_S3 1 100 -128 127 ECU_ADDRESS 0xFFF86CA0 /end MEASUREMENT
/begin MEASUREMENT kolbenpos_k0_in "" FLOAT32_IEEE sts_fl_M_S7_S3 1 100 -3.40282E+038 3.40282E+038 ECU_ADDRESS 0xFFF8621C /end MEASUREMENT
/begin MEASUREMENT m_em_in "" FLOAT32_IEEE trq_fl_a_M_S7_S3 1 100 -1024 1024 ECU_ADDRESS 0xFFF86220 /end MEASUREMENT
/begin MEASUREMENT m_iae_in "" FLOAT32_IEEE trq_fl_a_M_S7_S3 1 100 -32768 32767 ECU_ADDRESS 0xFFF86224 /end MEASUREMENT
/begin MEASUREMENT m_k0_has_sbe "K0 Istmoment der Funktion Bestimmung des K0 Istmoments der HAS" FLOAT32_IEEE trq_fl_a_M_S7_S3 1 100 -1000 1000 ECU_ADDRESS 0xFFF861EC /end MEASUREMENT
/begin MEASUREMENT m_k0_in "" FLOAT32_IEEE trq_fl_a_M_S7_S3 1 100 -32768 32767 ECU_ADDRESS 0xFFF86228 /end MEASUREMENT
/begin MEASUREMENT m_k0_mber_has_sbe "K0-Moment der HAS zur Motormomentbegrenzung in der SAB" FLOAT32_IEEE trq_fl_a_M_S7_S3 1 100 -3.40282E+038 3.40282E+038 ECU_ADDRESS 0xFFF861F0 /end MEASUREMENT
/begin MEASUREMENT m_k0_mber_zus_gbegr "Gradientenbegrenzter Basiswert des K0 Moments beim Zustart zur Bestimmung des K0-Moments der HAS zur Motormomentbegrenzung in der SAB" FLOAT32_IEEE trq_fl_a_M_S7_S3 1 100 -3.40282E+038 3.40282E+038 ECU_ADDRESS 0xFFF98304 /end MEASUREMENT
/begin MEASUREMENT m_k0_mod_has_fkt "" FLOAT32_IEEE trq_fl_a_M_S7_S3 1 100 -1200 1200 ECU_ADDRESS 0xFFF86184 /end MEASUREMENT
/begin MEASUREMENT m_k0_mod_max_syn_zus "Maximalwert des modifizierten K0-Istmoments der HAS beim K0 Synchronisieren beim Zustart" FLOAT32_IEEE trq_fl_a_M_S7_S3 1 100 -1000 1000 ECU_ADDRESS 0xFFF86088 /end MEASUREMENT
/begin MEASUREMENT m_k0integral_ans "Momentenintegral in Nms zur Bestimmung des status_k0befuellung_ans" FLOAT32_IEEE trq_fl_a_M_S7_S3 1 100 -1000 1000 ECU_ADDRESS 0xFFF85E38 /end MEASUREMENT
/begin MEASUREMENT m_max_dyn_em_in "" FLOAT32_IEEE trq_fl_a_M_S7_S3 1 100 -3.40282E+038 3.40282E+038 ECU_ADDRESS 0xFFF8622C /end MEASUREMENT
/begin MEASUREMENT m_max_em_has_fkt "" FLOAT32_IEEE trq_fl_a_M_S7_S3 1 100 -1200 1200 ECU_ADDRESS 0xFFF86188 /end MEASUREMENT
/begin MEASUREMENT m_max_iae_has_fkt "" FLOAT32_IEEE trq_fl_a_M_S7_S3 1 100 -1200 1200 ECU_ADDRESS 0xFFF8618C /end MEASUREMENT
/begin MEASUREMENT m_min_dyn_em_in "" FLOAT32_IEEE trq_fl_a_M_S7_S3 1 100 -3.40282E+038 3.40282E+038 ECU_ADDRESS 0xFFF86230 /end MEASUREMENT
/begin MEASUREMENT m_min_em_has_fkt "" FLOAT32_IEEE trq_fl_a_M_S7_S3 1 100 -1200 1200 ECU_ADDRESS 0xFFF86190 /end MEASUREMENT
/begin MEASUREMENT m_min_vm_in "" FLOAT32_IEEE trq_fl_a_M_S7_S3 1 100 -3.40282E+038 3.40282E+038 ECU_ADDRESS 0xFFF8628C /end MEASUREMENT
/begin MEASUREMENT m_mot_in "" FLOAT32_IEEE trq_fl_a_M_S7_S3 1 100 -1024 1024 ECU_ADDRESS 0xFFF86234 /end MEASUREMENT
/begin MEASUREMENT m_motmax_has_sbe "Maximal zulaessiges Motormoment des Gefuehrten Getriebeschutz der HAS" FLOAT32_IEEE trq_fl_a_M_S7_S3 1 100 -5000 5000 ECU_ADDRESS 0xFFF861F4 /end MEASUREMENT
/begin MEASUREMENT m_soll_em_has_fkt "" FLOAT32_IEEE trq_fl_a_M_S7_S3 1 100 -1200 1200 ECU_ADDRESS 0xFFF86194 /end MEASUREMENT
/begin MEASUREMENT m_soll_em_hst_in "" FLOAT32_IEEE trq_fl_a_M_S7_S3 1 100 -32768 32767 ECU_ADDRESS 0xFFF86238 /end MEASUREMENT
/begin MEASUREMENT m_soll_em_hst_verz "Verzoegertes EM Sollmoment der HST fuer die Berechnung des Fahrerwunschmoments der HST" FLOAT32_IEEE trq_fl_a_M_S7_S3 1 100 -3.40282E+038 3.40282E+038 ECU_ADDRESS 0xFFF982E8 /end MEASUREMENT
/begin MEASUREMENT m_soll_k0_has_fkt "" FLOAT32_IEEE trq_fl_a_M_S7_S3 1 100 -1200 1200 ECU_ADDRESS 0xFFF86198 /end MEASUREMENT
/begin MEASUREMENT m_soll_k0_has_sbe "K0 Sollmoment der Bestimmung des K0 Sollmoments der HAS" FLOAT32_IEEE trq_fl_a_M_S7_S3 1 100 -1000 1000 ECU_ADDRESS 0xFFF861F8 /end MEASUREMENT
/begin MEASUREMENT m_soll_k0_ziel_nos "Zielwert des K0-Sollmoments m_soll_k0_has im Zustand Notstarten beim Notstart" SWORD trq_int_M_S7_S3 1 100 -1000 1000 ECU_ADDRESS 0xFFF984EC /end MEASUREMENT
/begin MEASUREMENT m_soll_res_em_bas_sbe "Basis-Reservemoment fuer den VM-Start" FLOAT32_IEEE trq_fl_a_M_S7_S3 1 100 -3.40282E+038 3.40282E+038 ECU_ADDRESS 0xFFF861FC /end MEASUREMENT
/begin MEASUREMENT m_soll_res_em_has_fkt "" FLOAT32_IEEE trq_fl_a_M_S7_S3 1 100 -1200 1200 ECU_ADDRESS 0xFFF8619C /end MEASUREMENT
/begin MEASUREMENT m_soll_res_em_has_sbe "Reservemoment fuer den VM-Start" FLOAT32_IEEE trq_fl_a_M_S7_S3 1 100 -3.40282E+038 3.40282E+038 ECU_ADDRESS 0xFFF86200 /end MEASUREMENT
/begin MEASUREMENT m_soll_vm_has_abst "" FLOAT32_IEEE trq_fl_a_M_S7_S3 1 100 -1200 1200 ECU_ADDRESS 0xFFF85DDC /end MEASUREMENT
/begin MEASUREMENT m_soll_vm_hst_in "" FLOAT32_IEEE trq_fl_a_M_S7_S3 1 100 -32768 32767 ECU_ADDRESS 0xFFF8623C /end MEASUREMENT
/begin MEASUREMENT m_soll_vm_hst_verz "Verzoegertes VM Sollmoment der HST fuer die Berechnung des Fahrerwunschmoments der HST" FLOAT32_IEEE trq_fl_a_M_S7_S3 1 100 -3.40282E+038 3.40282E+038 ECU_ADDRESS 0xFFF982EC /end MEASUREMENT
/begin MEASUREMENT m_soll_vm_l_has_abst "" FLOAT32_IEEE trq_fl_a_M_S7_S3 1 100 -1200 1200 ECU_ADDRESS 0xFFF85DE0 /end MEASUREMENT
/begin MEASUREMENT m_soll_vm_l_hst_in "" FLOAT32_IEEE trq_fl_a_M_S7_S3 1 100 -3.40282E+038 3.40282E+038 ECU_ADDRESS 0xFFF86290 /end MEASUREMENT
/begin MEASUREMENT m_sollk0begrk0sreg_lau_abst "Begrenzung des K0 Sollmoments bei vor dem Ab-lauf aktiver K0 Schlupfregelung und unterdrueckter Aktivierung der K0 Schlupfregelung im Zustand 'Last-Uebernahme' beim VM Abstellen" SWORD trq_int_M_S7_S3 1 100 -1000 1000 ECU_ADDRESS 0xFFF86638 /end MEASUREMENT
/begin MEASUREMENT m_vm_in "" FLOAT32_IEEE trq_fl_a_M_S7_S3 1 100 -1024 1023.5 ECU_ADDRESS 0xFFF86240 /end MEASUREMENT
/begin MEASUREMENT m_vm_start_in "" FLOAT32_IEEE trq_fl_a_M_S7_S3 1 100 -1024 1023.5 ECU_ADDRESS 0xFFF86244 /end MEASUREMENT
/begin MEASUREMENT m_wunsch_fpw_hst_fil "Gefiltertes Wunschmoment" FLOAT32_IEEE trqg_fl_k_M_S7_S3 1 100 -2000 2000 ECU_ADDRESS 0xFFF861BC /end MEASUREMENT
/begin MEASUREMENT m_wunsch_fpw_hst_in "" FLOAT32_IEEE trq_fl_a_M_S7_S3 1 100 -3.40282E+038 3.40282E+038 ECU_ADDRESS 0xFFF86294 /end MEASUREMENT
/begin MEASUREMENT m_wunsch_fpw_in "" FLOAT32_IEEE trq_fl_a_M_S7_S3 1 100 -32768 32767 ECU_ADDRESS 0xFFF86248 /end MEASUREMENT
/begin MEASUREMENT m_ziel_k0_hst_in "Target torque of K0 sent by ECU" FLOAT32_IEEE trq_fl_a_M_S7_S3 1 100 -1000 2000 ECU_ADDRESS 0xFFF8624C /end MEASUREMENT
/begin MEASUREMENT m_ziel_vm_has_ans "Zielmoment des VM beim Schleppstart" FLOAT32_IEEE trq_fl_a_M_S7_S3 1 100 -1000 1000 ECU_ADDRESS 0xFFF85E4C /end MEASUREMENT
/begin MEASUREMENT mg_k0_mod_max_zus "Maximaler Gradient des modifizierten K0-Moments der HAS im K0 Schliessen beim Zustart" FLOAT32_IEEE trqg_fl_k_M_S7_S3 1 100 0 50000 ECU_ADDRESS 0xFFF860A4 /end MEASUREMENT
/begin MEASUREMENT mg_mot_in "Gradient des Getriebeeingangsmoment" FLOAT32_IEEE trqg_fl_k_M_S7_S3 1 100 -2000 2000 ECU_ADDRESS 0xFFF861C0 /end MEASUREMENT
/begin MEASUREMENT mg_soll_k0_has_fkt "" FLOAT32_IEEE trqg_fl_k_M_S7_S3 1 100 -3000 3000 ECU_ADDRESS 0xFFF861A0 /end MEASUREMENT
/begin MEASUREMENT mg_soll_k0_max_zus "Maximaler Gradient des K0-Soll-Moments der HAS im K0 Schliessen beim Zustart" FLOAT32_IEEE trqg_fl_k_M_S7_S3 1 100 0 50000 ECU_ADDRESS 0xFFF860A8 /end MEASUREMENT
/begin MEASUREMENT mg_soll_k0_syn_zus "Gradient des K0-Soll-Moments im K0 Synchronisieren beim Zustart" FLOAT32_IEEE trqg_fl_k_M_S7_S3 1 100 0 50000 ECU_ADDRESS 0xFFF860AC /end MEASUREMENT
/begin MEASUREMENT mg_wunsch_fpw_hst_in "Gradient des gefilterten oder koordinierten Fahrerwunschmoments aus Fahrpedalinterpretation" FLOAT32_IEEE trqg_fl_k_M_S7_S3 1 100 -2000 2000 ECU_ADDRESS 0xFFF861C4 /end MEASUREMENT
/begin MEASUREMENT mg_wunsch_fpw_in "Gradient des Fahrerwunschmoments aus Fahrpedalinterpretation" FLOAT32_IEEE trqg_fl_k_M_S7_S3 1 100 -2000 2000 ECU_ADDRESS 0xFFF861C8 /end MEASUREMENT
/begin MEASUREMENT modus_e_fahren_hst_in "Electric driving mode concerning state of charging mode of high voltage battery" UBYTE E_MODUSEFAH_M_S7_S3 1 100 0 1 ECU_ADDRESS 0xFFF86CC6 /end MEASUREMENT
/begin MEASUREMENT n_ab_egs_in "" FLOAT32_IEEE n_fl_M_S7_S3 1 100 0 65535 ECU_ADDRESS 0xFFF86250 /end MEASUREMENT
/begin MEASUREMENT n_em_in "" FLOAT32_IEEE n_fl_M_S7_S3 1 100 -3.40282E+038 3.40282E+038 ECU_ADDRESS 0xFFF86254 /end MEASUREMENT
/begin MEASUREMENT n_em_verz "Verzoegerte EM-Drehzahl zur Bestimmung der K0_Differenzdrehlzahl" FLOAT32_IEEE n_fl_M_S7_S3 1 100 0 10000 ECU_ADDRESS 0xFFF98330 /end MEASUREMENT
/begin MEASUREMENT n_min_em_has_sbe "Minimale EM Drehzahl der Leerlaufsimulation der HAS (LLS)" FLOAT32_IEEE n_fl_M_S7_S3 1 100 -32767 32767 ECU_ADDRESS 0xFFF86204 /end MEASUREMENT
/begin MEASUREMENT n_min_em_psys_lp3_has_sbe "Mindestdrehzahl der EM zur Sicherstellung des Leistungspunkt 3 der Bestimmung des Status Systemdruck der HAS" FLOAT32_IEEE n_fl_M_S7_S3 1 100 0 10000 ECU_ADDRESS 0xFFF861CC /end MEASUREMENT
/begin MEASUREMENT n_mot_soll_iae_in "" FLOAT32_IEEE n_fl_M_S7_S3 1 100 -3.40282E+038 3.40282E+038 ECU_ADDRESS 0xFFF86258 /end MEASUREMENT
/begin MEASUREMENT n_sec_iae "Sekundaere IAE-Drehzahl" FLOAT32_IEEE n_fl_M_S7_S3 1 100 -10000 10000 ECU_ADDRESS 0xFFF861D0 /end MEASUREMENT
/begin MEASUREMENT n_sec_iae_ist_ans "Abtriebsseitige IAE-Drehzahl bezogen auf den Getriebeeeingang und den aktuellen  Istgang waehrend einer Schaltung beim Schleppstart" FLOAT32_IEEE n_fl_M_S7_S3 1 100 -10000 10000 ECU_ADDRESS 0xFFF85E74 /end MEASUREMENT
/begin MEASUREMENT n_sec_iae_mod "Sekundaerdrehzahl IAE" FLOAT32_IEEE n_fl_M_S7_S3 1 100 -3.40282E+038 3.40282E+038 ECU_ADDRESS 0xFFF98334 /end MEASUREMENT
/begin MEASUREMENT n_soll_em_has_fkt "" FLOAT32_IEEE n_fl_M_S7_S3 1 100 0 8000 ECU_ADDRESS 0xFFF861A4 /end MEASUREMENT
/begin MEASUREMENT n_soll_em_hst_in "" FLOAT32_IEEE n_fl_M_S7_S3 1 100 -3.40282E+038 3.40282E+038 ECU_ADDRESS 0xFFF86298 /end MEASUREMENT
/begin MEASUREMENT n_soll_ll_vm_in "" FLOAT32_IEEE n_fl_M_S7_S3 1 100 0 2540 ECU_ADDRESS 0xFFF8625C /end MEASUREMENT
/begin MEASUREMENT n_soll_vm_has_fkt "" FLOAT32_IEEE n_fl_M_S7_S3 1 100 0 8000 ECU_ADDRESS 0xFFF861A8 /end MEASUREMENT
/begin MEASUREMENT n_t_egs_in "" FLOAT32_IEEE n_fl_M_S7_S3 1 100 0 65535 ECU_ADDRESS 0xFFF86260 /end MEASUREMENT
/begin MEASUREMENT n_vm_in "" FLOAT32_IEEE n_fl_M_S7_S3 1 100 0 65535 ECU_ADDRESS 0xFFF86264 /end MEASUREMENT
/begin MEASUREMENT n_vm_verz "Verzoegerte VM-Drehzahl zur Bestimmung der K0_Differenzdrehlzahl" FLOAT32_IEEE n_fl_M_S7_S3 1 100 0 10000 ECU_ADDRESS 0xFFF98338 /end MEASUREMENT
/begin MEASUREMENT nd_iae_ans "Differenzdrehzahl der IAE bezogen auf den Getriebeeingang  (n_em_in - n_sec_iae_fil)" FLOAT32_IEEE n_fl_M_S7_S3 1 100 -10000 10000 ECU_ADDRESS 0xFFF85E8C /end MEASUREMENT
/begin MEASUREMENT nd_k0_in "Differenzdrehzahl der Trennkupplung" FLOAT32_IEEE n_fl_M_S7_S3 1 100 -10000 10000 ECU_ADDRESS 0xFFF861D4 /end MEASUREMENT
/begin MEASUREMENT nd_min_saf_has_fkt "Anforderung min. Drehzahlsprung an ASIS" FLOAT32_IEEE n_fl_M_S7_S3 1 100 0 8000 ECU_ADDRESS 0xFFF861AC /end MEASUREMENT
/begin MEASUREMENT nd_soll_iae_fkt "Differenzdrehzahl der Anfahrkupplung" FLOAT32_IEEE ng_fl_M_S7_S3 1 100 -8000 8000 ECU_ADDRESS 0xFFF861B0 /end MEASUREMENT
/begin MEASUREMENT ndg_k0_in "Gradienten der Differenzdrehzahl der Trennkupplung" FLOAT32_IEEE ng_fl_M_S7_S3 1 100 -10000 10000 ECU_ADDRESS 0xFFF861D8 /end MEASUREMENT
/begin MEASUREMENT ng_em_ans "Drehzahlgradient der EM-Ist-Drehzahl" FLOAT32_IEEE ng_fl_M_S7_S3 1 100 -10000 10000 ECU_ADDRESS 0xFFF85EAC /end MEASUREMENT
/begin MEASUREMENT ng_em_zus "EM-Drehzahlgradient beim Zustart" FLOAT32_IEEE ng_fl_M_S7_S3 1 100 -10000 10000 ECU_ADDRESS 0xFFF860D0 /end MEASUREMENT
/begin MEASUREMENT ng_emmodrsmax_syn_zus "Maximaler Gradient der modifizierten EM-Drehzahl als Basisdrehzahl zur Bestimmung der VM Solldrehzahl bei RS beim K0 Synchronisieren beim Zustart" FLOAT32_IEEE ng_fl_M_S7_S3 1 100 -50000 50000 ECU_ADDRESS 0xFFF860D4 /end MEASUREMENT
/begin MEASUREMENT ng_vm_gef_ast_abst "Gefilterter VM Drehzahlgradient im Zustand \"VM-Abstellen\" beim VM Abstellen" FLOAT32_IEEE ng_fl_M_S7_S3 1 100 -30000 30000 ECU_ADDRESS 0xFFF85DE4 /end MEASUREMENT
/begin MEASUREMENT ng_vm_in "Gradient der VM Drehzahl" FLOAT32_IEEE ng_fl_M_S7_S3 1 100 -10000 10000 ECU_ADDRESS 0xFFF861DC /end MEASUREMENT
/begin MEASUREMENT no_seciae_crv_kri_lls_has "Drehzahloffset auf die sekundaere IAE-Drehzahl bezogen auf den Getriebeeingang der Creep-Ruckel-Verhinderung (CRV) der Leerlaufsimulation der HAS (LLS) bei Kriechbetrieb" FLOAT32_IEEE n_fl_M_S7_S3 1 100 0 10000 ECU_ADDRESS 0xFFF85C30 /end MEASUREMENT
/begin MEASUREMENT osmode_next_in "" UBYTE sts_int_M_S7_S3 1 100 0 255 ECU_ADDRESS 0xFFF86CA1 /end MEASUREMENT
/begin MEASUREMENT p_bremse_fzg_in "" FLOAT32_IEEE p_fl_M_S7_S3 1 100 0 127 ECU_ADDRESS 0xFFF86268 /end MEASUREMENT
/begin MEASUREMENT phi_neigung_in "" FLOAT32_IEEE phigrad_fl_M_S7_S3 1 100 -3.40282E+038 3.40282E+038 ECU_ADDRESS 0xFFF8626C /end MEASUREMENT
/begin MEASUREMENT pos_egs_in "Waehlhebelposition" UBYTE E_POS_M_S7_S3 1 100 0 8 ECU_ADDRESS 0xFFF86CA2 /end MEASUREMENT
/begin MEASUREMENT schalt_mode_egs_in "" UWORD void_int_c_M_S7_S3 1 100 0 65535 ECU_ADDRESS 0xFFF86780 /end MEASUREMENT
/begin MEASUREMENT soc_in "Interface provides state of charge of high-voltage battery" UBYTE rel_int_M_S7_S3 1 100 0 100 ECU_ADDRESS 0xFFF86CC7 /end MEASUREMENT
/begin MEASUREMENT sollgang_egs_in "" SBYTE void_int_M_S7_S3 1 100 -128 127 ECU_ADDRESS 0xFFF86CA3 /end MEASUREMENT
/begin MEASUREMENT st_ablauf_fkt "Phase des Ablauf" UWORD st_int_g_M_S7_S3 1 100 0 65535 ECU_ADDRESS 0xFFF86774 /end MEASUREMENT
/begin MEASUREMENT st_ablauf_fkt_alt_abst "Phase des Ablauf" UWORD st_int_g_M_S7_S3 1 100 0 65535 ECU_ADDRESS 0xFFF86636 /end MEASUREMENT
/begin MEASUREMENT st_ist_bz_has_stg "Istzustand OML" UBYTE E_STBZHAS_M_S7_S3 1 100 0 15 ECU_ADDRESS 0xFFF86C55 /end MEASUREMENT
/begin MEASUREMENT st_ist_bz_hst_sta "Ist-Betriebszustand aus der Startegieanpassung als Eingangsgroesse der Hybridzustandssteuerung (OML)" UBYTE E_STBZHAS_M_S7_S3 1 100 0 15 ECU_ADDRESS 0xFFF86C82 /end MEASUREMENT
/begin MEASUREMENT st_ist_bz_hst_sta_abbrstg "Modifizierter Antriebsstrang Ist-Zustand" UBYTE st_int_M_S7_S3 1 100 0 15 ECU_ADDRESS 0xFFF868EB /end MEASUREMENT
/begin MEASUREMENT st_ist_hcomd_has_stg "Innere Zustaende der OML" UWORD st_int_g_M_S7_S3 1 100 0 4999 ECU_ADDRESS 0xFFF86772 /end MEASUREMENT
/begin MEASUREMENT st_soll_bz_has_hst "interner HST Soll-Betriebszustand der Strategieanpassung (variantenunabhaengig)" UBYTE sts_int_M_S7_S3 1 100 0 15 ECU_ADDRESS 0xFFF86C83 /end MEASUREMENT
/begin MEASUREMENT st_soll_bz_hst_sta "Soll-Betriebszustand aus der Strategieanpassung als Eingangsgroesse der Hybrid-Zustandssteuerung (OML)" UBYTE E_STBZHAS_M_S7_S3 1 100 0 15 ECU_ADDRESS 0xFFF86C84 /end MEASUREMENT
/begin MEASUREMENT st_soll_bz_hst_sta_abbrstg "Modifizierter Antriebsstrang Soll-Zustand" UBYTE st_int_M_S7_S3 1 100 0 15 ECU_ADDRESS 0xFFF868EC /end MEASUREMENT
/begin MEASUREMENT st_testmode_hs "Testmode" UBYTE st_int_M_S7_S3 1 100 0 50 ECU_ADDRESS 0xFFF868ED /end MEASUREMENT
/begin MEASUREMENT st_ziel_bz_has_stg "Zielzustand OML" UBYTE E_STBZHAS_M_S7_S3 1 100 0 15 ECU_ADDRESS 0xFFF86C56 /end MEASUREMENT
/begin MEASUREMENT status_ablauf_has_fkt "" UBYTE sts_int_M_S7_S3 1 100 0 50 ECU_ADDRESS 0xFFF86C5A /end MEASUREMENT
/begin MEASUREMENT status_abs_in "Information, ob aktuell ein Eingriff durch das ABS System vorgenommen wird" UBYTE E_STATUSABS_M_S7_S3 1 100 0 2 ECU_ADDRESS 0xFFF86CC8 /end MEASUREMENT
/begin MEASUREMENT status_alaengs_adaoff_in "Information, ob die Adaptionen aufgrund erkannter Laengsbeschleunigung deaktiviert wird. 0 = Adaption aktiv aufgrund erkannter Laengsbeschleunigung
1 = Adaption inaktiv aufgrund nicht erkannter Laengsbeschleunigung" UBYTE sts_int_M_S7_S3 1 100 0 1 ECU_ADDRESS 0xFFF86CA4 /end MEASUREMENT
/begin MEASUREMENT status_asr_in "Information, ob ein Regeleingriff durch ein Assistenzsystem (ESP, ASR) vorliegt" UBYTE E_STATUSASR_M_S7_S3 1 100 0 1 ECU_ADDRESS 0xFFF86CC9 /end MEASUREMENT
/begin MEASUREMENT status_autohold_in "Status der Systeme zur Fahrzeug- Rollverhinderung" UBYTE E_STATUSNAA_M_S7_S3 1 100 0 1 ECU_ADDRESS 0xFFF86CA5 /end MEASUREMENT
/begin MEASUREMENT status_betriebsbereit_hst_in "" UBYTE sts_int_M_S7_S3 1 100 0 1 ECU_ADDRESS 0xFFF86CCA /end MEASUREMENT
/begin MEASUREMENT status_c_k0_in "Interface returns information concerning energy balance of clutch 0" UBYTE E_STATUSCK0_M_S7_S3 1 100 0 2 ECU_ADDRESS 0xFFF86CA6 /end MEASUREMENT
/begin MEASUREMENT status_cumgebung_in "Statusinformation in GET_CKB_TOUT" UBYTE E_SIGSTATUS_M_S7_S3 1 100 0 2 ECU_ADDRESS 0xFFF86CCB /end MEASUREMENT
/begin MEASUREMENT status_efahren_has_sbe "Status E-Fahren der HAS zur Festlegung der entsprechenden Portout-Groesse in der HAS Signalaufbereitung_Out" UBYTE sts_int_M_S7_S3 1 100 0 1 ECU_ADDRESS 0xFFF86C74 /end MEASUREMENT
/begin MEASUREMENT status_fehler_iep_in "" UBYTE E_FEHLERIEP_M_S7_S3 1 100 0 1 ECU_ADDRESS 0xFFF86CA7 /end MEASUREMENT
/begin MEASUREMENT status_fehlererk_diho "Bitcodierte Sammelgroesse, welche Informationen ueber alle gesetzte Flags liefert." ULONG void_int_f_M_S7_S3 1 100 0 4294967295 ECU_ADDRESS 0xFFF85B6C /end MEASUREMENT
/begin MEASUREMENT status_getrbereit_in "Status des hydraulischen Drucks des Getriebes" UBYTE sts_int_M_S7_S3 1 100 0 255 ECU_ADDRESS 0xFFF86CCC /end MEASUREMENT
/begin MEASUREMENT status_hillhold_in "Status der Systeme zur Fahrzeug- Rollverhinderung" UBYTE E_STATUSNAA_M_S7_S3 1 100 0 1 ECU_ADDRESS 0xFFF86CA8 /end MEASUREMENT
/begin MEASUREMENT status_iae_adap_in "Status der Adaption des Integrierten Anfahrelements IAE" UBYTE E_STATUSADA_M_S7_S3 1 100 0 2 ECU_ADDRESS 0xFFF86CA9 /end MEASUREMENT
/begin MEASUREMENT status_iae_in "" UBYTE E_STATUSIAE_M_S7_S3 1 100 0 8 ECU_ADDRESS 0xFFF86CAA /end MEASUREMENT
/begin MEASUREMENT status_iep_in "" UBYTE E_STATUSIEP_M_S7_S3 1 100 0 4 ECU_ADDRESS 0xFFF86CAB /end MEASUREMENT
/begin MEASUREMENT status_k0_adap_in "" UBYTE E_STATUSADA_M_S7_S3 1 100 0 2 ECU_ADDRESS 0xFFF86CAC /end MEASUREMENT
/begin MEASUREMENT status_k0_adap_zaehler_in "Zaehler k0 adaption" UBYTE void_int_M_S7_S3 1 100 0 255 ECU_ADDRESS 0xFFF86CAD /end MEASUREMENT
/begin MEASUREMENT status_k0_befuellung_in "Interface provides the current filling mode of clutch 0" UBYTE E_STAK0BEF_M_S7_S3 1 100 0 3 ECU_ADDRESS 0xFFF86CAE /end MEASUREMENT
/begin MEASUREMENT status_k0_in "" UBYTE E_STATUSK0_M_S7_S3 1 100 0 5 ECU_ADDRESS 0xFFF86CAF /end MEASUREMENT
/begin MEASUREMENT status_k0sreg_lau_abst "Status der bedingten Aktivierung der K0 Schlupfregelung im Zustand Last-Uebernahme beim VM Abstellen" UBYTE sts_int_e_M_S7_S3 1 100 0 1 ECU_ADDRESS 0xFFF86A5E /end MEASUREMENT
/begin MEASUREMENT status_kl15_in "" UBYTE sts_int_M_S7_S3 1 100 0 1 ECU_ADDRESS 0xFFF86CCD /end MEASUREMENT
/begin MEASUREMENT status_kraftfluss_egs_in "" UBYTE E_STATUSKSL_M_S7_S3 1 100 0 6 ECU_ADDRESS 0xFFF86CB0 /end MEASUREMENT
/begin MEASUREMENT status_kraftfluss_lev2_egs_in "Power flow (controled) information concerning ASIL B" UBYTE sts_int_M_S7_S3 1 100 0 2 ECU_ADDRESS 0xFFF86CB1 /end MEASUREMENT
/begin MEASUREMENT status_ll_vm_in "" UBYTE sts_int_M_S7_S3 1 100 0 255 ECU_ADDRESS 0xFFF86CB2 /end MEASUREMENT
/begin MEASUREMENT status_nem_in "Status zur Drehzahl E-Motor" UBYTE E_SIGSTATUS_M_S7_S3 1 100 0 2 ECU_ADDRESS 0xFFF86CB3 /end MEASUREMENT
/begin MEASUREMENT status_nreg_em_hst_in "" UBYTE sts_int_M_S7_S3 1 100 0 255 ECU_ADDRESS 0xFFF86CCE /end MEASUREMENT
/begin MEASUREMENT status_nvm_in "Status zur Drehzahl VM-Motor" UBYTE E_SIGSTATUS_M_S7_S3 1 100 0 2 ECU_ADDRESS 0xFFF86CB4 /end MEASUREMENT
/begin MEASUREMENT status_posvueb_in "Erkennung PosV Diagnose" UBYTE sts_int_M_S7_S3 1 100 0 255 ECU_ADDRESS 0xFFF86CCF /end MEASUREMENT
/begin MEASUREMENT status_psys_has_sbe "Anzeige des Status Pumpendruck der HAS" UBYTE E_STATUSPSY_M_S7_S3 1 100 0 4 ECU_ADDRESS 0xFFF86C6C /end MEASUREMENT
/begin MEASUREMENT status_radschlupf_rse_has_sbe "Anzeige des Status der Radschlupferkennung (RSE) der HAS" UBYTE E_STATUSRSE_M_S7_S3 1 100 0 1 ECU_ADDRESS 0xFFF86C6D /end MEASUREMENT
/begin MEASUREMENT status_sa_vm_in "00 Keine Beeinflussung; 01 Schubabschaltung aktiv; 10 Nicht stellbarer Bereich; 11 Signal ungueltig" UBYTE sts_int_e_M_S7_S3 1 100 0 1 ECU_ADDRESS 0xFFF86CD0 /end MEASUREMENT
/begin MEASUREMENT status_sa_vm_lau_abst "Status VM Schubabschaltung im Zustand \"Last-Uebernahme\" beim VM Abstellen" UBYTE sts_int_e_M_S7_S3 1 100 0 1 ECU_ADDRESS 0xFFF86A5F /end MEASUREMENT
/begin MEASUREMENT status_schaltart_svh_has_sbe "Schaltart der angeforderten Schaltung der Schaltverhinderung der HAS (0 = keine Schaltung angefordert) - Bit-Codierung (m/oL = mit/ohne Lastanh.) =  bit0=ZRSmL, 1=ZHSmL, 2=SRSmL, 3=SHSmL, 4=ZRSoL, 5=ZHSoL, 6=SRSoL, 7=SHSoL" UBYTE sts_int_M_S7_S3 1 100 0 255 ECU_ADDRESS 0xFFF86C6E /end MEASUREMENT
/begin MEASUREMENT status_schaltung_egs_in "Anzeige ob Schaltung des Getriebes aktiv ist" SBYTE sts_int_M_S7_S3 1 100 -9 9 ECU_ADDRESS 0xFFF86C6F /end MEASUREMENT
/begin MEASUREMENT status_soc_in "Interface provides status information of soc_in" UBYTE E_SIGSTATUS_M_S7_S3 1 100 0 2 ECU_ADDRESS 0xFFF86CD1 /end MEASUREMENT
/begin MEASUREMENT status_sync_schaltung_sbe "Anzeige der Synchronerkennung der aktuellen Schaltung innerhalb der HAS" UBYTE sts_int_M_S7_S3 1 100 0 1 ECU_ADDRESS 0xFFF86C70 /end MEASUREMENT
/begin MEASUREMENT status_vf_in "Signalstatus fuer die Fahrzeugistgeschwindigkeit  gebildet aus der Getriebe-Abtriebsdrehzahl" UBYTE E_SIGSTATUS_M_S7_S3 1 100 0 2 ECU_ADDRESS 0xFFF86CB5 /end MEASUREMENT
/begin MEASUREMENT status_vfref_in "Signalstatus fuer die Fahrzeuggeschwindigkeit ueber Grund" UBYTE E_SIGSTATUS_M_S7_S3 1 100 0 2 ECU_ADDRESS 0xFFF86CB6 /end MEASUREMENT
/begin MEASUREMENT status_waschstr_in "" UBYTE sts_int_M_S7_S3 1 100 0 255 ECU_ADDRESS 0xFFF86CB7 /end MEASUREMENT
/begin MEASUREMENT stDrivelineMode_act "aktueller Triebstrang-Zustand (abhaengig von VM, K1, K2 und Getriebe)" UBYTE E_DLM_M_S7_S3 1 100 1 8 ECU_ADDRESS 0xFFF868E9 /end MEASUREMENT
/begin MEASUREMENT stDrivelineModeOMD_act "Zielzustand OMD" UBYTE E_DLM_M_S7_S3 1 100 1 8 ECU_ADDRESS 0xFFF868E7 /end MEASUREMENT
/begin MEASUREMENT stDrivelineModeOMD_tgt "Istzustand OMD" UBYTE E_DLM_M_S7_S3 1 100 1 8 ECU_ADDRESS 0xFFF868E8 /end MEASUREMENT
/begin MEASUREMENT stOMDID_act "Innere Zustaende der OMD" UWORD st_int_g_M_S7_S3 1 100 0 4999 ECU_ADDRESS 0xFFF8655E /end MEASUREMENT
/begin MEASUREMENT stsSequenceOp "Rueckmeldung Status OpFkt" UBYTE sts_int_M_S7_S3 1 100 0 50 ECU_ADDRESS 0xFFF868EA /end MEASUREMENT
/begin MEASUREMENT t_betrieb_pvu_has_ee_in "" ULONG t_int_M_S7_S3 1 100 0 10000 ECU_ADDRESS 0xFFF86270 /end MEASUREMENT
/begin MEASUREMENT t_betrieb_pvu_has_sbe "Betriebsdauer seit dem letzten Ablauf der Diagnosefunktion \"Positionsventil-Ueberwachung\" der Funktion zur Unterstuet-zung der Positionsventil-Ueberwachung der HAS" ULONG t_int_M_S7_S3 1 100 0 1000000 ECU_ADDRESS 0xFFF861E0 /end MEASUREMENT
/begin MEASUREMENT t_k0fixabbruch_passiv_has "Timer zum Halten der K0-Ansteuerung nach dem Abbruch eines Betriebszustandsuebergangs der Hybrid Zustandssteuerung" UWORD t_int_n_M_S7_S3 1 100 0 1 ECU_ADDRESS 0xFFF984F8 /end MEASUREMENT
/begin MEASUREMENT t_k0oeffnenbed_lau_abst "Timer der Verzoegerungszeit als Uebergangsbedingung nach \"K0-Oeffnen\" im Zustand \"Last-Uebernahme\" beim VM Abstellen" UWORD t_int_n_M_S7_S3 1 100 0 5 ECU_ADDRESS 0xFFF8663A /end MEASUREMENT
/begin MEASUREMENT t_max_abb_nos "Timer der maximalen Verweildauer im Zustand Abbruch" UWORD t_int_n_M_S7_S3 1 100 0 10 ECU_ADDRESS 0xFFF984EE /end MEASUREMENT
/begin MEASUREMENT t_max_nst_nos "Timer der maximalen Verweildauer im Zustand Notstarten" UWORD t_int_n_M_S7_S3 1 100 0 10 ECU_ADDRESS 0xFFF984F0 /end MEASUREMENT
/begin MEASUREMENT t_max_scl_nos "Timer der maximalen Verweildauer im Zustand K0-Schliessen" UWORD t_int_n_M_S7_S3 1 100 0 10 ECU_ADDRESS 0xFFF984F2 /end MEASUREMENT
/begin MEASUREMENT t_maxbed_ast_abst "Timer zur Ueberwachung der maximalen Verweildauer im Zustand \"VM-Abstellen\" beim VM Abstellen" UWORD t_int_n_M_S7_S3 1 100 0 10 ECU_ADDRESS 0xFFF8663C /end MEASUREMENT
/begin MEASUREMENT t_maxbed_gab_abst "Timer zur Ueberwachung der maximalen Verweildau-er im Zustand 'VM gefuehrt Abstellen' beim VM Ab-stellen" UWORD t_int_n_M_S7_S3 1 100 0 10 ECU_ADDRESS 0xFFF8663E /end MEASUREMENT
/begin MEASUREMENT t_maxbed_koe_abst "Timer zur Ueberwachung der maximalen Verweildauer im Zustand \"K0-Oeffnen\" beim VM Abstellen" UWORD t_int_n_M_S7_S3 1 100 0 10 ECU_ADDRESS 0xFFF86640 /end MEASUREMENT
/begin MEASUREMENT t_maxbed_ksa_abst "Timer zur Ueberwachung der maximalen Verweildauer im Zustand \"K0-Schliessen Abbruch\" beim VM Abstellen" UWORD t_int_n_M_S7_S3 1 100 0 10 ECU_ADDRESS 0xFFF86642 /end MEASUREMENT
/begin MEASUREMENT t_maxbed_lau_abst "Timer zur Ueberwachung der maximalen Verweildauer im Zustand \"Last-Uebernahme\" beim VM Abstellen" UWORD t_int_n_M_S7_S3 1 100 0 10 ECU_ADDRESS 0xFFF86644 /end MEASUREMENT
/begin MEASUREMENT t_maxbed_sak_abst "Zeit der maximale Verweildauer im Zustand 'Schaltung Aktiv' beim VM Abstellen" ULONG t_int_M_S7_S3 1 100 0 10000 ECU_ADDRESS 0xFFF85DE8 /end MEASUREMENT
/begin MEASUREMENT t_msollemaktiv_ans "Timer Ueberwachung Ausgabe m_soll_em_has (Max.-Zeit)" UWORD t_int_n_M_S7_S3 1 100 0 5 ECU_ADDRESS 0xFFF8667A /end MEASUREMENT
/begin MEASUREMENT t_ndsk0_nst_nos "Timer der minimalen Verweildauer, in der die K0-Differenzdrehzahl unterhalb einer applizierbaren Schwelle ist; im Zustand Notstarten" UWORD t_int_n_M_S7_S3 1 100 0 10 ECU_ADDRESS 0xFFF984F4 /end MEASUREMENT
/begin MEASUREMENT t_ngsvm_ast_abst "Timer der Verzoegerungszeit zur Abfrage der VM-Drehzahlgradientenschwelle zur Vorgabe \"K0 OEFFNENSW\" im Zustand \"VM-Abstellen\" beim VM Abstellen" UWORD t_int_n_M_S7_S3 1 100 0 10 ECU_ADDRESS 0xFFF86646 /end MEASUREMENT
/begin MEASUREMENT t_ums_nst_nos "Timer der maximalen Umschaltdauer im Zustand Notstarten" UWORD t_int_n_M_S7_S3 1 100 0 10 ECU_ADDRESS 0xFFF984F6 /end MEASUREMENT
/begin MEASUREMENT v_f_in "" FLOAT32_IEEE v_fl_M_S7_S3 1 100 0 500 ECU_ADDRESS 0xFFF86274 /end MEASUREMENT
/begin MEASUREMENT v_f_ref_in "Fahrzeuggeschwindigkeit ueber Grund" UWORD v_int_M_S7_S3 1 100 0 511 ECU_ADDRESS 0xFFF86782 /end MEASUREMENT
/begin MEASUREMENT v_f_sbe "Fahrzeuggeschwindigkeit auf Basis der Getriebeabtriebsdrehzahl in der  Hybridablaufsteuerung" FLOAT32_IEEE v_fl_M_S7_S3 1 100 0 500 ECU_ADDRESS 0xFFF861E4 /end MEASUREMENT
/begin MEASUREMENT vg_f_sbe "Fahrzeuggeschwindigkeitsgradient auf Basis der Getriebeabtriebsdrehzahl in der  Hybridablaufsteuerung" FLOAT32_IEEE vg_fl_M_S7_S3 1 100 -100 100 ECU_ADDRESS 0xFFF861E8 /end MEASUREMENT
/begin MEASUREMENT z_abbruch_abbrechen_hcomd_abbrstg "Abbruch wird abgebrochen" UBYTE void_int_d_M_S7_S3 1 100 0 1 ECU_ADDRESS 0xFFF868EE /end MEASUREMENT
/begin MEASUREMENT z_abbruchkodierung_hcomd_abbrstg "Ausgangsgroessen im Abbruchszustand (codiert)" ULONG ctrl_int_j_M_S7_S3 1 100 0 2612590447 ECU_ADDRESS 0xFFF85B78 /end MEASUREMENT
/begin MEASUREMENT z_ablauf_has_hst_in "" UBYTE sts_int_M_S7_S3 1 100 0 15 ECU_ADDRESS 0xFFF86CB8 /end MEASUREMENT
/begin MEASUREMENT z_ablauf_has_stg "Zusaetzliche Steuergroesse zur Ablaufsteuerung" UBYTE ctrl_int_M_S7_S3 1 100 0 15 ECU_ADDRESS 0xFFF86C57 /end MEASUREMENT
/begin MEASUREMENT z_ablauf_svh_reset_has_fkt "" UBYTE sts_int_M_S7_S3 1 100 0 255 ECU_ADDRESS 0xFFF86C5B /end MEASUREMENT
/begin MEASUREMENT z_ablaufvariante_has_hst_in "" UBYTE sts_int_M_S7_S3 1 100 0 99 ECU_ADDRESS 0xFFF86CB9 /end MEASUREMENT
/begin MEASUREMENT z_ablaufvariante_has_stg "Ablaufvariante, die  die OML ausgibt" UBYTE sts_int_M_S7_S3 1 100 0 99 ECU_ADDRESS 0xFFF86C58 /end MEASUREMENT
/begin MEASUREMENT z_ablaufvariante_kalt_zus "Anzeige der aktiven Ablaufvariante Kaltstart beim Zustart - 0 = kein Kaltstart, 1 = Kaltstart mit abgesenkter EM-Drehzahl" UBYTE st_int_M_S7_S3 1 100 0 255 ECU_ADDRESS 0xFFF86C5C /end MEASUREMENT
/begin MEASUREMENT z_ba_has_k0_hst_in "" UBYTE st_int_M_S7_S3 1 100 0 1 ECU_ADDRESS 0xFFF86CD2 /end MEASUREMENT
/begin MEASUREMENT z_ba_has_vm_hst_in "" UBYTE st_int_M_S7_S3 1 100 0 1 ECU_ADDRESS 0xFFF86CD3 /end MEASUREMENT
/begin MEASUREMENT z_diag_ersfkt_has_in "Funktionsschnittstelle zur Ermittlung ob irgendeine Ersatzmassnahme in der Diagnoseverwaltung aktiv ist" ULONG b_int_M_S7_S3 1 100 0 4294967295 ECU_ADDRESS 0xFFF86278 /end MEASUREMENT
/begin MEASUREMENT z_diag_ersfkt_hi_96_has_in "Anzeige ob Ersatzmassnahme in der Diagnoseverwaltung aktiv ist bit 64...95" ULONG b_int_M_S7_S3 1 100 0 4294967295 ECU_ADDRESS 0xFFF8627C /end MEASUREMENT
/begin MEASUREMENT z_diag_ersfkt_hi_has_in "Funktionsschnittstelle zur Ermittlung ob irgendeine Ersatzmassnahme in der Diagnoseverwaltung aktiv ist" ULONG b_int_M_S7_S3 1 100 0 4294967295 ECU_ADDRESS 0xFFF86280 /end MEASUREMENT
/begin MEASUREMENT z_diag_notgang_has_in "Notganginformation" UBYTE b_int_b_M_S7_S3 1 100 0 255 ECU_ADDRESS 0xFFF86CBA /end MEASUREMENT
/begin MEASUREMENT z_emaktiv_fuw_zus_fkt "Anzeige der EM Fehlfuntion der Funktionsueberwachung der EM beim Zustart" UBYTE b_int_h_M_S7_S3 1 100 0 1 ECU_ADDRESS 0xFFF86C5D /end MEASUREMENT
/begin MEASUREMENT z_fehler15_eh_fkt "" UBYTE st_int_M_S7_S3 1 100 0 1 ECU_ADDRESS 0xFFF86C5E /end MEASUREMENT
/begin MEASUREMENT z_freigabe_pvu_has_sbe "Freigabe zur Aktivierung der Diagnosefunktion \"Positionsventil-Ueberwachung\" der Funktion zur Unterstuetzung der Positi-onsventil-Ueberwachung der HAS" UBYTE st_int_M_S7_S3 1 100 0 1 ECU_ADDRESS 0xFFF86C71 /end MEASUREMENT
/begin MEASUREMENT z_gefabstbed_lau_abst "Bedingung zur Aktivierung der Ablaufvariante \"Gefuehrtes Abstellen\" im Zustand 'Last-Uebernahme' beim VM Abstellen" UBYTE st_int_l_M_S7_S3 1 100 0 1 ECU_ADDRESS 0xFFF86A60 /end MEASUREMENT
/begin MEASUREMENT z_hss1off_ehi_has "Zeigt an, ob die Ersmassnahme KMN_CAPTARGETNVM aktiv ist" UBYTE sts_int_e_M_S7_S3 1 100 0 1 ECU_ADDRESS 0xFFF86879 /end MEASUREMENT
/begin MEASUREMENT z_hybfkt_stg "Anforderung der Aktivierung einer Hybridfunktion durch die Hyrid-Zustandssteuerung" UBYTE E_HYBFKT_M_S7_S3 1 100 0 15 ECU_ADDRESS 0xFFF86C59 /end MEASUREMENT
/begin MEASUREMENT z_iae_entkoppelt_ans "Zeigt an, ob eine Entkopplung fuer die Ausgabe der EM-Solldrehzahl vorliegt." UBYTE void_int_d_M_S7_S3 1 100 0 1 ECU_ADDRESS 0xFFF86A8C /end MEASUREMENT
/begin MEASUREMENT z_iep_in "" UBYTE E_ZIEP_M_S7_S3 1 100 0 4 ECU_ADDRESS 0xFFF86CBB /end MEASUREMENT
/begin MEASUREMENT z_init "" UBYTE st_int_M_S7_S3 1 100 0 1 ECU_ADDRESS 0xFFF86A61 /end MEASUREMENT
/begin MEASUREMENT z_init_nos "" UBYTE st_int_M_S7_S3 1 100 0 1 ECU_ADDRESS 0xFFF86B48 /end MEASUREMENT
/begin MEASUREMENT z_init_sta "Anforderung der Initialisierung der Zustandssteuerung (OML) durch die Strategieanpassung" UBYTE sts_int_M_S7_S3 1 100 0 1 ECU_ADDRESS 0xFFF86C85 /end MEASUREMENT
/begin MEASUREMENT z_k0_befuellopt_has_fkt "" UBYTE st_int_M_S7_S3 1 100 0 1 ECU_ADDRESS 0xFFF86C5F /end MEASUREMENT
/begin MEASUREMENT z_k0_fst_in "" UBYTE E_ZK0FSTIN_M_S7_S3 1 100 0 3 ECU_ADDRESS 0xFFF86CBC /end MEASUREMENT
/begin MEASUREMENT z_k0_has_fkt "" UBYTE E_ZK0_M_S7_S3 1 100 0 5 ECU_ADDRESS 0xFFF86C60 /end MEASUREMENT
/begin MEASUREMENT z_k0_has_fkt_alt_abst "" UBYTE E_ZK0_M_S7_S3 1 100 0 5 ECU_ADDRESS 0xFFF86A62 /end MEASUREMENT
/begin MEASUREMENT z_k0_has_sbe "K0 Sollzustand der Priorisierung der K0-Ansteuerung der HAS" UBYTE E_ZK0_M_S7_S3 1 100 0 5 ECU_ADDRESS 0xFFF86C75 /end MEASUREMENT
/begin MEASUREMENT z_k0entkaktiv_ans "Anzeige an, ob aus dem Ablauf heraus eine K0-Momentenabsenkung (K0-Entkoppelung) angefordert wird" UBYTE sts_int_e_M_S7_S3 1 100 0 1 ECU_ADDRESS 0xFFF86A91 /end MEASUREMENT
/begin MEASUREMENT z_kps_stada_in "Sollvorgabe fuer die Trennkupplung K0 durch die Stillstandsadaption" UBYTE sts_int_M_S7_S3 1 100 0 255 ECU_ADDRESS 0xFFF86CBD /end MEASUREMENT
/begin MEASUREMENT z_lls_fktaktiv_has_sbe "Aktive LLS-Funktion - Codierung bit0=STAT,1=IEP,2=CGETR,3=BEFFZP,4=GE,5=KFL,6=PAUS,7=PARKSP,8=RANG,9=MANH,10=IAE,11=SAS,12=KRI,13=DAT,14=IAEADA,15=K0ADA,16=STADA,17-18=frei,19=FKT,20=BZ,21-22=frei,23=VGF,24=ALAE,25-26=frei,27=PVU,28-30=frei,31=DIAG" ULONG sts_int_m_M_S7_S3 1 100 0 4294967295 ECU_ADDRESS 0xFFF86208 /end MEASUREMENT
/begin MEASUREMENT z_m_max_iae_has_fkt "" UBYTE st_int_M_S7_S3 1 100 0 50 ECU_ADDRESS 0xFFF86C61 /end MEASUREMENT
/begin MEASUREMENT z_m_max_iae_has_in "Gemessen in St_Konditionieren_En_St" UBYTE void_int_d_M_S7_S3 1 100 0 1 ECU_ADDRESS 0xFFF86A95 /end MEASUREMENT
/begin MEASUREMENT z_m_max_stiae_has "Gemessen in St_Konditionieren_En_St" UBYTE void_int_d_M_S7_S3 1 100 0 1 ECU_ADDRESS 0xFFF86A96 /end MEASUREMENT
/begin MEASUREMENT z_m_soll_em_has_fkt "" UBYTE st_int_l_M_S7_S3 1 100 0 1 ECU_ADDRESS 0xFFF86C62 /end MEASUREMENT
/begin MEASUREMENT z_m_soll_vm_has_abst "" UBYTE st_int_l_M_S7_S3 1 100 0 1 ECU_ADDRESS 0xFFF86A63 /end MEASUREMENT
/begin MEASUREMENT z_modus_em_hst_in "" UBYTE sts_int_M_S7_S3 1 100 0 255 ECU_ADDRESS 0xFFF86CBE /end MEASUREMENT
/begin MEASUREMENT z_modus_iae_has_sbe "" UBYTE E_ZMODUSIAE_M_S7_S3 1 100 0 2 ECU_ADDRESS 0xFFF86C76 /end MEASUREMENT
/begin MEASUREMENT z_modus_iep_has_sbe "Vorgabe des Betriebsmodus der IEP durch die HAS" UBYTE E_ZMODUSIEP_M_S7_S3 1 100 0 4 ECU_ADDRESS 0xFFF86C77 /end MEASUREMENT
/begin MEASUREMENT z_msa_avh_moni_has_sbe "Anforderung einer Schaltverhinderung der HAS" UBYTE st_int_M_S7_S3 1 100 0 255 ECU_ADDRESS 0xFFF86C78 /end MEASUREMENT
/begin MEASUREMENT z_msa_eaf_moni_has_sbe "Anforderung einer Schaltverhinderung der HAS" UBYTE st_int_M_S7_S3 1 100 0 255 ECU_ADDRESS 0xFFF86C79 /end MEASUREMENT
/begin MEASUREMENT z_msa_fst_in "Anforderung einer Abschaltverhinderung durch die Fahrstrategie ASIS" UBYTE sts_int_M_S7_S3 1 100 0 255 ECU_ADDRESS 0xFFF86CBF /end MEASUREMENT
/begin MEASUREMENT z_msa_has_sbe "Anforderung der Beeinflussung der MSA-Funktionalitaet durch die Hybridablaufsteuerung - Codierung: bit0 = AVZ, bit1 = AVH, bit2 = EAF, bit3 = EVH, bit4 = Deaktivierung, bit7 = Stoerungsbedingt" UBYTE sts_int_M_S7_S3 1 100 0 255 ECU_ADDRESS 0xFFF86C7A /end MEASUREMENT
/begin MEASUREMENT z_msa_stada_in "Anforderung einer Abschaltverhinderung durch die Stillstandadaption" UBYTE sts_int_M_S7_S3 1 100 0 6 ECU_ADDRESS 0xFFF86CD4 /end MEASUREMENT
/begin MEASUREMENT z_n_min_em_parksp_has_in "Anforderung einer EM-Drehzahlanhebung beim Auslegen der Parksperre infolge unzureichender Oelversorgung" UBYTE b_int_b_M_S7_S3 1 100 0 1 ECU_ADDRESS 0xFFF86CC0 /end MEASUREMENT
/begin MEASUREMENT z_n_soll_em_has_fkt "" UBYTE st_int_M_S7_S3 1 100 0 50 ECU_ADDRESS 0xFFF86C63 /end MEASUREMENT
/begin MEASUREMENT z_n_soll_vm_has_fkt "" UBYTE st_int_M_S7_S3 1 100 0 50 ECU_ADDRESS 0xFFF86C64 /end MEASUREMENT
/begin MEASUREMENT z_nllsoll_iae_in "Anforderung der IAE, dass eine definierte LL-Drehzahl durch den Motor eingestellt werden soll" UBYTE E_ZNLLSOLL_M_S7_S3 1 100 0 3 ECU_ADDRESS 0xFFF86CC1 /end MEASUREMENT
/begin MEASUREMENT z_nllsoll_iep_in "" UBYTE void_int_d_M_S7_S3 1 100 0 1 ECU_ADDRESS 0xFFF86CC2 /end MEASUREMENT
/begin MEASUREMENT z_nmineminit_lls_has "Flag zur Initialisierung des Gradientenbegrenzers und des PT2-Filters der EM-Drehzahlfuehrung der Leerlaufsimulation der HAS (LLS)" UBYTE st_int_l_M_S7_S3 1 100 0 1 ECU_ADDRESS 0xFFF8697A /end MEASUREMENT
/begin MEASUREMENT z_nminemmodus_has_sbe "Modus der Vorgabe der minimalen EM-Drehzahl der HAS" UBYTE E_ZNMODUS_M_S7_S3 1 100 0 4 ECU_ADDRESS 0xFFF86C7B /end MEASUREMENT
/begin MEASUREMENT z_nsollvmaktiv_ans "Anzeige an, ob aus dem Ablauf heraus eine VM-Solldrehzahl angefordert wird" UBYTE sts_int_e_M_S7_S3 1 100 0 1 ECU_ADDRESS 0xFFF86A9C /end MEASUREMENT
/begin MEASUREMENT z_oea_hst_in "Anforderung fuer das gebrueckte E-Anfahren der HST" UBYTE sts_int_M_S7_S3 1 100 0 1 ECU_ADDRESS 0xFFF86CC3 /end MEASUREMENT
/begin MEASUREMENT z_p_hys_k0_has_fkt "Hysteresekompensation" UBYTE st_int_M_S7_S3 1 100 0 1 ECU_ADDRESS 0xFFF86C65 /end MEASUREMENT
/begin MEASUREMENT z_ponr_fkt "point of no return" UBYTE st_int_M_S7_S3 1 100 0 1 ECU_ADDRESS 0xFFF86C66 /end MEASUREMENT
/begin MEASUREMENT z_pvu_has_sbe "Beeinflussung des Hybridsystems zur Unterstuetzung der Positionsventil- Ueberwachung der HAS-Codierung: 0 = keine Beeinflussung, 1 = Beeinflussung Stufe 1, 2 = Beeinflussung Stufe 2" UBYTE st_int_M_S7_S3 1 100 0 2 ECU_ADDRESS 0xFFF86C72 /end MEASUREMENT
/begin MEASUREMENT z_respschlepp_sas_fkt "" UBYTE st_int_M_S7_S3 1 100 0 1 ECU_ADDRESS 0xFFF86C67 /end MEASUREMENT
/begin MEASUREMENT z_saf_has_fkt "Schaltanforderung 1...aktiv" UBYTE st_int_M_S7_S3 1 100 0 1 ECU_ADDRESS 0xFFF86C68 /end MEASUREMENT
/begin MEASUREMENT z_sas_has_sbe "Aendert im Wahrheitsfall die KupplungsBefuellreihenfolge" UBYTE st_int_M_S7_S3 1 100 0 1 ECU_ADDRESS 0xFFF86C7C /end MEASUREMENT
/begin MEASUREMENT z_sbe_has_fkt "Schaltbeeinflussung  1...aktiv" UBYTE st_int_M_S7_S3 1 100 0 1 ECU_ADDRESS 0xFFF86C69 /end MEASUREMENT
/begin MEASUREMENT z_start_modus_has_sbe "Anforderung eines Anlasserstarts" UBYTE st_int_M_S7_S3 1 100 0 3 ECU_ADDRESS 0xFFF86C7D /end MEASUREMENT
/begin MEASUREMENT z_status_psys_mps_sbe "Anforderung der Modifikation des Pumpendruckstatus durch die Hybrid Ablaufsteuerung (MPS)" UBYTE sts_int_M_S7_S3 1 100 0 1 ECU_ADDRESS 0xFFF86C7E /end MEASUREMENT
/begin MEASUREMENT z_svh_abbrlaus_fst_abst "Anzeige des Abbruchs einer laufenden Schaltung durch die Fahrstrategie beim VM Abtellen" UBYTE st_int_M_S7_S3 1 100 0 1 ECU_ADDRESS 0xFFF86A6C /end MEASUREMENT
/begin MEASUREMENT z_svh_has_sbe "Anforderung einer Schaltverhinderung der HAS" UBYTE st_int_M_S7_S3 1 100 0 1 ECU_ADDRESS 0xFFF86C7F /end MEASUREMENT
/begin MEASUREMENT z_svh_reset_zustand_abst "Anzeige der Schaltart der in den einzelnen Zustaenden des Ablaufs freigegebenen Schaltungen beim VM Abtellen -> Bit-Codierung wie z_ablauf_shv_reset_has" UBYTE b_int_b_M_S7_S3 1 100 0 255 ECU_ADDRESS 0xFFF86A64 /end MEASUREMENT
/begin MEASUREMENT z_t_k0oeffnenbed_lau_abst "Timer zur Ueberwachung der maximalen Verweildauer im Zustand \"VM-Abstellen\" beim VM Abstellen" UBYTE st_int_l_M_S7_S3 1 100 0 1 ECU_ADDRESS 0xFFF86A65 /end MEASUREMENT
/begin MEASUREMENT z_t_max_abb_nos "" UBYTE st_int_l_M_S7_S3 1 100 0 1 ECU_ADDRESS 0xFFF86B49 /end MEASUREMENT
/begin MEASUREMENT z_t_max_nst_nos "" UBYTE st_int_l_M_S7_S3 1 100 0 1 ECU_ADDRESS 0xFFF86B4A /end MEASUREMENT
/begin MEASUREMENT z_t_max_scl_nos "" UBYTE st_int_l_M_S7_S3 1 100 0 1 ECU_ADDRESS 0xFFF86B4B /end MEASUREMENT
/begin MEASUREMENT z_t_maxbed_ast_abst "Timer zur Ueberwachung der maximalen Verweildauer im Zustand \"VM-Abstellen\" beim VM Abstellen" UBYTE st_int_l_M_S7_S3 1 100 0 1 ECU_ADDRESS 0xFFF86A66 /end MEASUREMENT
/begin MEASUREMENT z_t_maxbed_gab_abst "Timer zur Ueberwachung der maximalen Verweildauer im Zustand 'VM gefuehrt Abstellen' beim VM Ab-stellen" UBYTE st_int_l_M_S7_S3 1 100 0 1 ECU_ADDRESS 0xFFF86A67 /end MEASUREMENT
/begin MEASUREMENT z_t_maxbed_koe_abst "Timer zur Ueberwachung der maximalen Verweildauer im Zustand \"K0-Oeffnen\" beim VM Abstellen" UBYTE st_int_l_M_S7_S3 1 100 0 1 ECU_ADDRESS 0xFFF86A68 /end MEASUREMENT
/begin MEASUREMENT z_t_maxbed_ksa_abst "Timer zur Ueberwachung der maximalen Verweildauer im Zustand \"K0-Schliessen Abbruch\" beim VM Abstellen" UBYTE st_int_l_M_S7_S3 1 100 0 1 ECU_ADDRESS 0xFFF86A69 /end MEASUREMENT
/begin MEASUREMENT z_t_maxbed_lau_abst "Timer zur Ueberwachung der maximalen Verweildauer im Zustand 'Last-Uebernahme' " UBYTE st_int_l_M_S7_S3 1 100 0 1 ECU_ADDRESS 0xFFF86A6A /end MEASUREMENT
/begin MEASUREMENT z_t_maxbed_sak_abst "Timer zur Ueberwachung der maximalen Verweildauer im Zustand 'Schaltung aktiv' beim VM Abstellen" UBYTE st_int_l_M_S7_S3 1 100 0 1 ECU_ADDRESS 0xFFF86A6B /end MEASUREMENT
/begin MEASUREMENT z_t_msollemaktiv_ans "Timer Ueberwachung Ausgabe m_soll_em_has (Max.-Zeit)" UBYTE void_int_d_M_S7_S3 1 100 0 1 ECU_ADDRESS 0xFFF86AA5 /end MEASUREMENT
/begin MEASUREMENT z_t_ndsk0_nst_nos "" UBYTE st_int_l_M_S7_S3 1 100 0 1 ECU_ADDRESS 0xFFF86B4C /end MEASUREMENT
/begin MEASUREMENT z_zuendfreigabe_vm_fkt "" UBYTE st_int_M_S7_S3 1 100 0 1 ECU_ADDRESS 0xFFF86C6A /end MEASUREMENT
/begin MEASUREMENT z_zuendfreigabe_vm_has_fkt "" UBYTE st_int_M_S7_S3 1 100 0 1 ECU_ADDRESS 0xFFF86C6B /end MEASUREMENT
/begin MEASUREMENT zielgang_egs_in "" SBYTE sts_int_M_S7_S3 1 100 -128 127 ECU_ADDRESS 0xFFF86CC4 /end MEASUREMENT
/begin COMPU_METHOD SAB_P_3BAR10_M30_S2_S3 "int = ((phys * 10) / 3) - (-100) bar" RAT_FUNC "%5.3" "bar" COEFFS 0 10 300 0 0 3 /end COMPU_METHOD
/begin COMPU_METHOD SAB_P_3BAR10_M100_S2_S3 "int = ((phys * 10) / 3) - (-100) bar" RAT_FUNC "%5.3" "bar" COEFFS 0 10 300 0 0 3 /end COMPU_METHOD
/begin COMPU_METHOD SAB_P_3BAR10_S2_S3 "int = ((phys * 10) / 3) - (0) bar" RAT_FUNC "%5.3" "bar" COEFFS 0 10 -0 0 0 3 /end COMPU_METHOD
/begin COMPU_METHOD SAB_P_5BAR10_S2_S3 "int = ((phys * 10) / 5) - (0) bar" RAT_FUNC "%5.3" "bar" COEFFS 0 10 -0 0 0 5 /end COMPU_METHOD
/begin COMPU_METHOD SAB_P_781MBAR100_S2_S3 "int = ((phys * 100) / 781) - (0) mbar" RAT_FUNC "%7.5" "mbar" COEFFS 0 100 -0 0 0 781 /end COMPU_METHOD
/begin COMPU_METHOD SAB_P_BAR5_S2_S3 "int = ((phys * 5) / 1) - (0) bar" RAT_FUNC "%5.3" "bar" COEFFS 0 5 -0 0 0 1 /end COMPU_METHOD
/begin COMPU_METHOD SAB_P_2396KPA100_M2444_S2_S3 "int = ((phys * 100) / 2396) - (-102) kPa" RAT_FUNC "%5.3" "kPa" COEFFS 0 100 244392 0 0 2396 /end COMPU_METHOD
/begin COMPU_METHOD SAB_P_8KPA_S2_S3 "int = ((phys * 1) / 8) - (0) kPa" RAT_FUNC "%5.3" "kPa" COEFFS 0 1 -0 0 0 8 /end COMPU_METHOD
/begin COMPU_METHOD SAB_P_20KPA_S2_S3 "int = ((phys * 1) / 20) - (0) kPa" RAT_FUNC "%5.3" "kPa" COEFFS 0 1 -0 0 0 20 /end COMPU_METHOD
/begin COMPU_METHOD SAB_P_MMHG10_S2_S3 "int = ((phys * 10) / 1) - (0) mmHg" RAT_FUNC "%5.3" "mmHg" COEFFS 0 10 -0 0 0 1 /end COMPU_METHOD
/begin COMPU_METHOD SAB_PHI_STEERING_ANGLE_45GRAD1024_S2_S3 "int = ((phys * 1024) / 45) - (0) grad" RAT_FUNC "%5.3" "grad" COEFFS 0 1024 -0 0 0 45 /end COMPU_METHOD
/begin COMPU_METHOD SAB_PHI_STEERING_ANGLE_7GRAD160_S2_S3 "int = ((phys * 160) / 7) - (0) grad" RAT_FUNC "%5.3" "grad" COEFFS 0 160 -0 0 0 7 /end COMPU_METHOD
/begin COMPU_METHOD SAB_PHI_7GRAD160_S2_S3 "int = ((phys * 160) / 7) - (0) grad" RAT_FUNC "%5.3" "grad" COEFFS 0 160 -0 0 0 7 /end COMPU_METHOD
/begin COMPU_METHOD SAB_PHI_GRAD4_M31_S2_S3 "int = ((phys * 4) / 1) - (-124) grad" RAT_FUNC "%5.3" "grad" COEFFS 0 4 124 0 0 1 /end COMPU_METHOD
/begin COMPU_METHOD SAB_PHI_GRAD10_M720_S2_S3 "int = ((phys * 10) / 1) - (-7200) grad" RAT_FUNC "%5.3" "grad" COEFFS 0 10 7200 0 0 1 /end COMPU_METHOD
/begin COMPU_METHOD SAB_PHI_STEERING_ANGLE_GRAD10_S2_S3 "int = ((phys * 10) / 1) - (0) grad" RAT_FUNC "%5.3" "grad" COEFFS 0 10 -0 0 0 1 /end COMPU_METHOD
/begin COMPU_METHOD SAB_PHI_STEERING_ANGLE_GRAD10_M780_S2_S3 "int = ((phys * 10) / 1) - (-7800) grad" RAT_FUNC "%5.3" "grad" COEFFS 0 10 7800 0 0 1 /end COMPU_METHOD
/begin COMPU_METHOD SAB_PHI_STEERING_ANGLE_1GRAD2_M2048_S2_S3 "int = ((phys * 2) / 1) - (-4096) grad" RAT_FUNC "%5.3" "grad" COEFFS 0 2 4096 0 0 1 /end COMPU_METHOD
/begin COMPU_METHOD SAB_PHI_GRAD2_M2048_S2_S3 "int = ((phys * 2) / 1) - (-4096) GRAD" RAT_FUNC "%5.3" "GRAD" COEFFS 0 2 4096 0 0 1 /end COMPU_METHOD
/begin COMPU_METHOD SAB_PHI_GRAD_M125_S2_S3 "int = ((phys * 1) / 1) - (-125) grad" RAT_FUNC "%2.0" "grad" COEFFS 0 1 125 0 0 1 /end COMPU_METHOD
/begin COMPU_METHOD SAB_PHI_STEERING_ANGLE_5GRAD_S2_S3 "int = ((phys * 1) / 5) - (0) grad" RAT_FUNC "%5.3" "grad" COEFFS 0 1 -0 0 0 5 /end COMPU_METHOD
/begin COMPU_METHOD SAB_PHI_STEERING_ANGLE_1GRAD_S2_S3 "int = ((phys * 1) / 1) - (0) grad" RAT_FUNC "%2.0" "grad" COEFFS 0 1 -0 0 0 1 /end COMPU_METHOD
/begin COMPU_METHOD SAB_PHI_GRAD10_S2_S3 "int = ((phys * 10) / 1) - (0) grad" RAT_FUNC "%5.3" "grad" COEFFS 0 10 -0 0 0 1 /end COMPU_METHOD
/begin COMPU_METHOD b_int_M_S7_S3 "Bit Feld" RAT_FUNC "%10.0" "-" COEFFS 0 1 0 0 0 1 /end COMPU_METHOD
/begin COMPU_METHOD b_int_b_M_S7_S3 "Bit Feld" RAT_FUNC "%3.0" "-" COEFFS 0 1 0 0 0 1 /end COMPU_METHOD
/begin COMPU_METHOD b_int_h_M_S7_S3 "Bit Feld" RAT_FUNC "%1.0" "-" COEFFS 0 1 0 0 0 1 /end COMPU_METHOD
/begin COMPU_METHOD c_fl_M_S7_S3 "Temperatur" RAT_FUNC "%12.6" "°C" COEFFS 0 1 0 0 0 1 /end COMPU_METHOD
/begin COMPU_METHOD c_int_M_S7_S3 "Temperatur" RAT_FUNC "%12.6" "°C" COEFFS 0 1 0 0 0 1 /end COMPU_METHOD
/begin COMPU_METHOD cg_fl_M_S7_S3 "Temperaturgradient" RAT_FUNC "%12.6" "°K/s" COEFFS 0 1 0 0 0 1 /end COMPU_METHOD
/begin COMPU_METHOD ctrl_int_M_S7_S3 "Steuerwort" RAT_FUNC "%3.0" "-" COEFFS 0 1 0 0 0 1 /end COMPU_METHOD
/begin COMPU_METHOD ctrl_int_j_M_S7_S3 "Steuerwort" RAT_FUNC "%10.0" "-" COEFFS 0 1 0 0 0 1 /end COMPU_METHOD
/begin COMPU_METHOD E_BREMSPED_M_S7_S3 "" TAB_VERB "%12.6" "" COMPU_TAB_REF CONV_TAB_E_BREMSPED_M_S7_S3 /end COMPU_METHOD
/begin COMPU_METHOD E_DLM_M_S7_S3 "" TAB_VERB "%12.6" "" COMPU_TAB_REF CONV_TAB_E_DLM_M_S7_S3 /end COMPU_METHOD
/begin COMPU_METHOD E_DREHRICH_M_S7_S3 "" TAB_VERB "%12.6" "" COMPU_TAB_REF CONV_TAB_E_DREHRICH_M_S7_S3 /end COMPU_METHOD
/begin COMPU_METHOD E_FEHLERIEP_M_S7_S3 "" TAB_VERB "%12.6" "" COMPU_TAB_REF CONV_TAB_E_FEHLERIEP_M_S7_S3 /end COMPU_METHOD
/begin COMPU_METHOD E_HYBFKT_M_S7_S3 "" TAB_VERB "%12.6" "" COMPU_TAB_REF CONV_TAB_E_HYBFKT_M_S7_S3 /end COMPU_METHOD
/begin COMPU_METHOD E_MODUSEFAH_M_S7_S3 "" TAB_VERB "%12.6" "" COMPU_TAB_REF CONV_TAB_E_MODUSEFAH_M_S7_S3 /end COMPU_METHOD
/begin COMPU_METHOD E_POS_M_S7_S3 "" TAB_VERB "%12.6" "" COMPU_TAB_REF CONV_TAB_E_POS_M_S7_S3 /end COMPU_METHOD
/begin COMPU_METHOD E_SIGSTATUS_M_S7_S3 "" TAB_VERB "%12.6" "" COMPU_TAB_REF CONV_TAB_E_SIGSTATUS_M_S7_S3 /end COMPU_METHOD
/begin COMPU_METHOD E_STAK0BEF_M_S7_S3 "" TAB_VERB "%12.6" "" COMPU_TAB_REF CONV_TAB_E_STAK0BEF_M_S7_S3 /end COMPU_METHOD
/begin COMPU_METHOD E_STATUSABS_M_S7_S3 "" TAB_VERB "%12.6" "" COMPU_TAB_REF CONV_TAB_E_STATUSABS_M_S7_S3 /end COMPU_METHOD
/begin COMPU_METHOD E_STATUSADA_M_S7_S3 "" TAB_VERB "%12.6" "" COMPU_TAB_REF CONV_TAB_E_STATUSADA_M_S7_S3 /end COMPU_METHOD
/begin COMPU_METHOD E_STATUSASR_M_S7_S3 "" TAB_VERB "%12.6" "" COMPU_TAB_REF CONV_TAB_E_STATUSASR_M_S7_S3 /end COMPU_METHOD
/begin COMPU_METHOD E_STATUSCK0_M_S7_S3 "" TAB_VERB "%12.6" "" COMPU_TAB_REF CONV_TAB_E_STATUSCK0_M_S7_S3 /end COMPU_METHOD
/begin COMPU_METHOD E_STATUSIAE_M_S7_S3 "" TAB_VERB "%12.6" "" COMPU_TAB_REF CONV_TAB_E_STATUSIAE_M_S7_S3 /end COMPU_METHOD
/begin COMPU_METHOD E_STATUSIEP_M_S7_S3 "" TAB_VERB "%12.6" "" COMPU_TAB_REF CONV_TAB_E_STATUSIEP_M_S7_S3 /end COMPU_METHOD
/begin COMPU_METHOD E_STATUSK0_M_S7_S3 "" TAB_VERB "%12.6" "" COMPU_TAB_REF CONV_TAB_E_STATUSK0_M_S7_S3 /end COMPU_METHOD
/begin COMPU_METHOD E_STATUSKSL_M_S7_S3 "" TAB_VERB "%12.6" "" COMPU_TAB_REF CONV_TAB_E_STATUSKSL_M_S7_S3 /end COMPU_METHOD
/begin COMPU_METHOD E_STATUSNAA_M_S7_S3 "" TAB_VERB "%12.6" "" COMPU_TAB_REF CONV_TAB_E_STATUSNAA_M_S7_S3 /end COMPU_METHOD
/begin COMPU_METHOD E_STATUSPSY_M_S7_S3 "" TAB_VERB "%12.6" "" COMPU_TAB_REF CONV_TAB_E_STATUSPSY_M_S7_S3 /end COMPU_METHOD
/begin COMPU_METHOD E_STATUSRSE_M_S7_S3 "" TAB_VERB "%12.6" "" COMPU_TAB_REF CONV_TAB_E_STATUSRSE_M_S7_S3 /end COMPU_METHOD
/begin COMPU_METHOD E_STBZHAS_M_S7_S3 "" TAB_VERB "%12.6" "" COMPU_TAB_REF CONV_TAB_E_STBZHAS_M_S7_S3 /end COMPU_METHOD
/begin COMPU_METHOD E_ZIEP_M_S7_S3 "" TAB_VERB "%12.6" "" COMPU_TAB_REF CONV_TAB_E_ZIEP_M_S7_S3 /end COMPU_METHOD
/begin COMPU_METHOD E_ZK0_M_S7_S3 "" TAB_VERB "%12.6" "" COMPU_TAB_REF CONV_TAB_E_ZK0_M_S7_S3 /end COMPU_METHOD
/begin COMPU_METHOD E_ZK0FSTIN_M_S7_S3 "" TAB_VERB "%12.6" "" COMPU_TAB_REF CONV_TAB_E_ZK0FSTIN_M_S7_S3 /end COMPU_METHOD
/begin COMPU_METHOD E_ZMODUSIAE_M_S7_S3 "" TAB_VERB "%12.6" "" COMPU_TAB_REF CONV_TAB_E_ZMODUSIAE_M_S7_S3 /end COMPU_METHOD
/begin COMPU_METHOD E_ZMODUSIEP_M_S7_S3 "" TAB_VERB "%12.6" "" COMPU_TAB_REF CONV_TAB_E_ZMODUSIEP_M_S7_S3 /end COMPU_METHOD
/begin COMPU_METHOD E_ZNLLSOLL_M_S7_S3 "" TAB_VERB "%12.6" "" COMPU_TAB_REF CONV_TAB_E_ZNLLSOLL_M_S7_S3 /end COMPU_METHOD
/begin COMPU_METHOD E_ZNMODUS_M_S7_S3 "" TAB_VERB "%12.6" "" COMPU_TAB_REF CONV_TAB_E_ZNMODUS_M_S7_S3 /end COMPU_METHOD
/begin COMPU_METHOD n_fl_M_S7_S3 "Drehzahl" RAT_FUNC "%12.6" "1/min" COEFFS 0 1 0 0 0 1 /end COMPU_METHOD
/begin COMPU_METHOD ng_fl_M_S7_S3 "Drehzahlgradient" RAT_FUNC "%12.6" "1/min/s" COEFFS 0 1 0 0 0 1 /end COMPU_METHOD
/begin COMPU_METHOD p_fl_M_S7_S3 "Druck" RAT_FUNC "%12.6" "bar" COEFFS 0 1 0 0 0 1 /end COMPU_METHOD
/begin COMPU_METHOD phigrad_fl_M_S7_S3 "Winkel in grad" RAT_FUNC "%12.6" "grad" COEFFS 0 1 0 0 0 1 /end COMPU_METHOD
/begin COMPU_METHOD ratio_fl_M_S7_S3 "Uebersetzungsverhaeltnis" RAT_FUNC "%12.6" "-" COEFFS 0 1 0 0 0 1 /end COMPU_METHOD
/begin COMPU_METHOD rel_int_M_S7_S3 "Relative Groesse" RAT_FUNC "%3.0" "%" COEFFS 0 1 0 0 0 1 /end COMPU_METHOD
/begin COMPU_METHOD st_int_M_S7_S3 "Zustandsgroesse" RAT_FUNC "%3.0" "-" COEFFS 0 1 0 0 0 1 /end COMPU_METHOD
/begin COMPU_METHOD st_int_g_M_S7_S3 "Zustandsgroesse" RAT_FUNC "%5.0" "-" COEFFS 0 1 0 0 0 1 /end COMPU_METHOD
/begin COMPU_METHOD st_int_l_M_S7_S3 "Zustandsgroesse" RAT_FUNC "%1.0" "-" COEFFS 0 1 0 0 0 1 /end COMPU_METHOD
/begin COMPU_METHOD sts_fl_M_S7_S3 "Status" RAT_FUNC "%12.6" "-" COEFFS 0 1 0 0 0 1 /end COMPU_METHOD
/begin COMPU_METHOD sts_int_M_S7_S3 "Status" RAT_FUNC "%3.0" "-" COEFFS 0 1 0 0 0 1 /end COMPU_METHOD
/begin COMPU_METHOD sts_int_e_M_S7_S3 "Status" RAT_FUNC "%1.0" "-" COEFFS 0 1 0 0 0 1 /end COMPU_METHOD
/begin COMPU_METHOD sts_int_m_M_S7_S3 "Status" RAT_FUNC "%10.0" "-" COEFFS 0 1 0 0 0 1 /end COMPU_METHOD
/begin COMPU_METHOD swi_int_M_S7_S3 "Schalter" RAT_FUNC "%1.0" "-" COEFFS 0 1 0 0 0 1 /end COMPU_METHOD
/begin COMPU_METHOD swi_int_o_M_S7_S3 "Schalter" RAT_FUNC "%3.0" "-" COEFFS 0 1 0 0 0 1 /end COMPU_METHOD
/begin COMPU_METHOD t_fl_M_S7_S3 "Zeit" RAT_FUNC "%12.6" "s" COEFFS 0 1 0 0 0 1 /end COMPU_METHOD
/begin COMPU_METHOD t_int_M_S7_S3 "Zeit" RAT_FUNC "%11.2" "s" COEFFS 0 1 0 0 0 0.01 /end COMPU_METHOD
/begin COMPU_METHOD t_int_n_M_S7_S3 "Zeit" RAT_FUNC "%6.2" "s" COEFFS 0 1 0 0 0 0.01 /end COMPU_METHOD
/begin COMPU_METHOD trq_fl_a_M_S7_S3 "Moment" RAT_FUNC "%12.6" "Nm" COEFFS 0 1 0 0 0 1 /end COMPU_METHOD
/begin COMPU_METHOD trq_int_M_S7_S3 "Moment" RAT_FUNC "%5.0" "Nm" COEFFS 0 1 0 0 0 1 /end COMPU_METHOD
/begin COMPU_METHOD trqg_fl_k_M_S7_S3 "Momentengradient" RAT_FUNC "%12.6" "Nm/s" COEFFS 0 1 0 0 0 1 /end COMPU_METHOD
/begin COMPU_METHOD v_fl_M_S7_S3 "Geschwindigkeit" RAT_FUNC "%12.6" "km/h" COEFFS 0 1 0 0 0 1 /end COMPU_METHOD
/begin COMPU_METHOD v_int_M_S7_S3 "Geschwindigkeit" RAT_FUNC "%5.0" "km/h" COEFFS 0 1 0 0 0 1 /end COMPU_METHOD
/begin COMPU_METHOD vg_fl_M_S7_S3 "Geschwindigkeitsgradient" RAT_FUNC "%12.6" "km/h/s" COEFFS 0 1 0 0 0 1 /end COMPU_METHOD
/begin COMPU_METHOD void_fl_M_S7_S3 "ohne Umrechnung" RAT_FUNC "%12.6" "-" COEFFS 0 1 0 0 0 1 /end COMPU_METHOD
/begin COMPU_METHOD void_int_M_S7_S3 "ohne Umrechnung" RAT_FUNC "%3.0" "-" COEFFS 0 1 0 0 0 1 /end COMPU_METHOD
/begin COMPU_METHOD void_int_c_M_S7_S3 "ohne Umrechnung" RAT_FUNC "%5.0" "-" COEFFS 0 1 0 0 0 1 /end COMPU_METHOD
/begin COMPU_METHOD void_int_d_M_S7_S3 "ohne Umrechnung" RAT_FUNC "%1.0" "-" COEFFS 0 1 0 0 0 1 /end COMPU_METHOD
/begin COMPU_METHOD void_int_f_M_S7_S3 "ohne Umrechnung" RAT_FUNC "%10.0" "-" COEFFS 0 1 0 0 0 1 /end COMPU_METHOD
/begin COMPU_VTAB CONV_TAB_E_BREMSPED_M_S7_S3 "Conversion table" TAB_VERB 2 0 "NICHT_GETRETEN" 1 "GETRETEN" /end COMPU_VTAB
/begin COMPU_VTAB CONV_TAB_E_DLM_M_S7_S3 "Conversion table" TAB_VERB 8 1 "S1_Coupled" 2 "S2_Decoupled" 3 "S3_EDrive" 4 "S4_Stop" 5 "S5_Charge" 6 "S6_DecoupledEngOn" 7 "S7_EDriveEngOn" 8 "S8_HybridDrive" /end COMPU_VTAB
/begin COMPU_VTAB CONV_TAB_E_DREHRICH_M_S7_S3 "Conversion table" TAB_VERB 3 0 "UNBESTIMMT" 1 "VORWAERTS" 2 "RUECKWAERTS" /end COMPU_VTAB
/begin COMPU_VTAB CONV_TAB_E_FEHLERIEP_M_S7_S3 "Conversion table" TAB_VERB 2 0 "NORMALBETRIEB" 1 "FEHLER" /end COMPU_VTAB
/begin COMPU_VTAB CONV_TAB_E_HYBFKT_M_S7_S3 "Conversion table" TAB_VERB 14 0 "PASSIV" 1 "ANKOPPELN_VM" 3 "GANGEINLEGEN" 4 "GANGAUSLEGEN" 5 "OHNABLAUFFKT" 7 "VM_ZUSTART" 8 "ABSTELLEN_VM" 9 "NICHTDEFINIERT_4" 10 "VM_SCHLEPPSTART" 11 "VM_NOTSTART" 12 "VM_EIN" 13 "VM_AUS" 14 "ABSTELLPOSOPT_VM" 15 "FEHLER" /end COMPU_VTAB
/begin COMPU_VTAB CONV_TAB_E_MODUSEFAH_M_S7_S3 "Conversion table" TAB_VERB 2 0 "LADUNG_ABBAUEN" 1 "LADUNG_ERHALTEN" /end COMPU_VTAB
/begin COMPU_VTAB CONV_TAB_E_POS_M_S7_S3 "Conversion table" TAB_VERB 9 0 "D1" 1 "D2" 2 "D3" 3 "D4" 4 "D5" 5 "D" 6 "N" 7 "R" 8 "P" /end COMPU_VTAB
/begin COMPU_VTAB CONV_TAB_E_SIGSTATUS_M_S7_S3 "Conversion table" TAB_VERB 3 0 "SIGNAL_OK" 1 "ERSATZWERT" 2 "SIGNAL_FEHLER" /end COMPU_VTAB
/begin COMPU_VTAB CONV_TAB_E_STAK0BEF_M_S7_S3 "Conversion table" TAB_VERB 4 0 "NICHT_AKTIV" 1 "STANDARD_BEF" 2 "OPTIMIERTBEF" 3 "REDUZIERTBEF" /end COMPU_VTAB
/begin COMPU_VTAB CONV_TAB_E_STATUSABS_M_S7_S3 "Conversion table" TAB_VERB 3 1 "AKTIV" 0 "NICHT_AKTIV" 2 "FEHLER" /end COMPU_VTAB
/begin COMPU_VTAB CONV_TAB_E_STATUSADA_M_S7_S3 "Conversion table" TAB_VERB 3 0 "KEINADAPTION" 1 "TOUCHPOINT_ADAPTION" 2 "REIBWERT_ADAPTION" /end COMPU_VTAB
/begin COMPU_VTAB CONV_TAB_E_STATUSASR_M_S7_S3 "Conversion table" TAB_VERB 2 0 "NICHT_AKTIV" 1 "AKTIV" /end COMPU_VTAB
/begin COMPU_VTAB CONV_TAB_E_STATUSCK0_M_S7_S3 "Conversion table" TAB_VERB 3 0 "NORMAL" 1 "ZU_HEISS" 2 "UEBERHITZT" /end COMPU_VTAB
/begin COMPU_VTAB CONV_TAB_E_STATUSIAE_M_S7_S3 "Conversion table" TAB_VERB 9 0 "NICHTDEFINIERT" 1 "OFFEN" 2 "ANGELEGT" 3 "ANFAHREN" 4 "ENTKOPPELT" 5 "ENTKOPPELT_ANFAHREN" 6 "SYNCHRONISIEREN" 7 "GESCHLOSSEN" 8 "OEFFNEN" /end COMPU_VTAB
/begin COMPU_VTAB CONV_TAB_E_STATUSIEP_M_S7_S3 "Conversion table" TAB_VERB 5 0 "AUS" 1 "SLEEP" 2 "LP1" 3 "LP2" 4 "LP3" /end COMPU_VTAB
/begin COMPU_VTAB CONV_TAB_E_STATUSK0_M_S7_S3 "Conversion table" TAB_VERB 6 0 "OFFEN" 1 "ANGELEGT" 2 "DRUCKSTELLUNG" 3 "SCHLUPFGEREGELT" 4 "GEREGELTGESCHL" 5 "GESCHLOSSEN" /end COMPU_VTAB
/begin COMPU_VTAB CONV_TAB_E_STATUSKSL_M_S7_S3 "Conversion table" TAB_VERB 7 0 "KEIN_KRAFTSCHLUSS" 1 "VORW_AUF_ABBAUEND" 2 "VORWAERTS" 3 "RUECKW_AUF_ABBAUEND" 4 "RUECKWAERTS" 5 "VORWAERTS_SCHLUPF" 6 "RUECKWAERTS_SCHLUPF" /end COMPU_VTAB
/begin COMPU_VTAB CONV_TAB_E_STATUSNAA_M_S7_S3 "Conversion table" TAB_VERB 2 0 "NICHT_AKTIV" 1 "AKTIV" /end COMPU_VTAB
/begin COMPU_VTAB CONV_TAB_E_STATUSPSY_M_S7_S3 "Conversion table" TAB_VERB 5 0 "AUS" 1 "NICHTDEFINIERT" 2 "LP1" 3 "LP2" 4 "LP3" /end COMPU_VTAB
/begin COMPU_VTAB CONV_TAB_E_STATUSRSE_M_S7_S3 "Conversion table" TAB_VERB 2 0 "KEIN_RADSCHLUPF" 1 "DURCHDREHEN_ERKANNT" /end COMPU_VTAB
/begin COMPU_VTAB CONV_TAB_E_STBZHAS_M_S7_S3 "Conversion table" TAB_VERB 16 0 "INIT_INAKTIV" 1 "ANGEKOPPELT" 2 "ENTKOPPELT" 3 "EFAHREN" 4 "STOP" 5 "LADEN" 6 "ENTK_VMEIN" 7 "EFAHREN_VMEIN" 8 "HYBRID" 9 "NICHTDEFINIERT_1" 10 "NICHTDEFINIERT_2" 11 "NICHTDEFINIERT_3" 12 "NICHTDEFINIERT_4" 13 "NICHTDEFINIERT_5" 14 "INIT_KL15" 15 "FEHLER" /end COMPU_VTAB
/begin COMPU_VTAB CONV_TAB_E_ZIEP_M_S7_S3 "Conversion table" TAB_VERB 5 0 "AUS" 1 "SLEEP" 2 "LP1" 3 "LP2" 4 "LP3" /end COMPU_VTAB
/begin COMPU_VTAB CONV_TAB_E_ZK0_M_S7_S3 "Conversion table" TAB_VERB 6 0 "OEFFNENSW" 1 "BEFUELLEN" 2 "DRUCKSTELLUNG" 3 "SCHLUPFREGELUNG" 4 "GEREGELTGESCHL" 5 "GESCHLOSSEN" /end COMPU_VTAB
/begin COMPU_VTAB CONV_TAB_E_ZK0FSTIN_M_S7_S3 "Conversion table" TAB_VERB 4 0 "OFFEN" 1 "SCHLUPFGEREGELT" 2 "GEREGELTGESCHL" 3 "GESCHLOSSEN" /end COMPU_VTAB
/begin COMPU_VTAB CONV_TAB_E_ZMODUSIAE_M_S7_S3 "Conversion table" TAB_VERB 3 0 "EFAHREN_SCHLUPF" 1 "EFAHREN_KRAFTSCHL" 2 "HYBRIDFAHREN" /end COMPU_VTAB
/begin COMPU_VTAB CONV_TAB_E_ZMODUSIEP_M_S7_S3 "Conversion table" TAB_VERB 5 0 "KEINVORGABE" 1 "AUS" 2 "LP1" 3 "LP2" 4 "LP3" /end COMPU_VTAB
/begin COMPU_VTAB CONV_TAB_E_ZNLLSOLL_M_S7_S3 "Conversion table" TAB_VERB 4 0 "KEINANF" 1 "ANF_ADAP" 2 "ANF_ALLG" 3 "ANF_ADAP_IEP" /end COMPU_VTAB
/begin COMPU_VTAB CONV_TAB_E_ZNMODUS_M_S7_S3 "Conversion table" TAB_VERB 5 0 "KEIN_AUFBAU" 1 "SCHNELL" 2 "ZUEGIG" 3 "KOMFORTABEL" 4 "UNTERDRUECKT" /end COMPU_VTAB
/begin FUNCTION Run_SFOp_SLST758_CL_PT1_14nsollvm "" /begin DEF_CHARACTERISTIC FK_NSOLLVM_ZND_ANS /end DEF_CHARACTERISTIC /end FUNCTION
/begin FUNCTION Run_SFOp_SLST99_abs_fl1 "" /begin LOC_MEASUREMENT nd_iae_ans /end LOC_MEASUREMENT /end FUNCTION
/begin FUNCTION Run_SFOp_Zus101_cLimiter_Gradient_MSollK0 "" /begin DEF_CHARACTERISTIC MG_SOLLK0MIN_SYN_ZUS /end DEF_CHARACTERISTIC /begin LOC_MEASUREMENT mg_soll_k0_syn_zus m_soll_k0_has_fkt /end LOC_MEASUREMENT /end FUNCTION
/begin FUNCTION Run_SFOp_Zus107_cLimiter_Gradient_m_k0_mod_has "" /begin LOC_MEASUREMENT m_k0_mod_max_syn_zus /end LOC_MEASUREMENT /end FUNCTION
/begin FUNCTION Run_SFOp_Zus116_abs_fl32 "" /begin LOC_MEASUREMENT nd_k0_in /end LOC_MEASUREMENT /end FUNCTION
/begin FUNCTION Run_SFOp_Zus137_cPT1_NVMSoll "" /begin DEF_CHARACTERISTIC FK_NSOLLVM_ANH_ZUS /end DEF_CHARACTERISTIC /begin LOC_MEASUREMENT n_soll_vm_has_fkt /end LOC_MEASUREMENT /end FUNCTION
/begin FUNCTION Run_SFOp_Zus142_cLimiter_Gradient_MSollK0 "" /begin DEF_CHARACTERISTIC NG_EMMODRSMIN_SYN_ZUS /end DEF_CHARACTERISTIC /begin LOC_MEASUREMENT ng_emmodrsmax_syn_zus /end LOC_MEASUREMENT /end FUNCTION
/begin FUNCTION Run_SFOp_Zus180_cPT1_NVMSoll "" /begin DEF_CHARACTERISTIC FK_NSOLLVM_SAK_ZUS /end DEF_CHARACTERISTIC /end FUNCTION
/begin FUNCTION Run_SFOp_Zus233_cLimiter_Gradient_m_k0_has "" /begin DEF_CHARACTERISTIC MG_SOLLK0NEG_ABF_ZUS MG_SOLLK0POS_ABF_ZUS /end DEF_CHARACTERISTIC /end FUNCTION
/begin FUNCTION Run_SFOp_Zus242_cPT1_NVMSoll "" /begin DEF_CHARACTERISTIC FK_NSOLLVM_ANH_ZUS /end DEF_CHARACTERISTIC /begin LOC_MEASUREMENT n_soll_vm_has_fkt /end LOC_MEASUREMENT /end FUNCTION
/begin FUNCTION Run_SFOp_Zus263_cLimiter_Gradient_m_soll_k0_basis_zus "" /begin DEF_CHARACTERISTIC MG_SOLLK0NEG_ANH_ZUS MG_SOLLK0POS_ANH_ZUS /end DEF_CHARACTERISTIC /end FUNCTION
/begin FUNCTION Run_SFOp_Zus283_cPT1_NVMSoll "" /begin DEF_CHARACTERISTIC FK_NSOLLVM_ANH_ZUS /end DEF_CHARACTERISTIC /end FUNCTION
/begin FUNCTION Run_SFOp_Zus297_cLimiter_Gradient_MSollK0 "" /begin DEF_CHARACTERISTIC MG_SOLLK0_ABB_ZUS /end DEF_CHARACTERISTIC /end FUNCTION
/begin FUNCTION Run_SFOp_Zus338_cPT1_NVMSoll "" /begin DEF_CHARACTERISTIC FK_NSOLLVM_ZST_ZUS /end DEF_CHARACTERISTIC /end FUNCTION
/begin FUNCTION Run_SFOp_Zus413_cDT1_ngem "" /begin DEF_CHARACTERISTIC FK_NGEM_ZUS /end DEF_CHARACTERISTIC /begin LOC_MEASUREMENT ng_em_zus n_em_in /end LOC_MEASUREMENT /end FUNCTION
/begin FUNCTION Run_SFOp_Zus42_abs_fl32 "" /begin LOC_MEASUREMENT nd_k0_in /end LOC_MEASUREMENT /end FUNCTION
/begin FUNCTION Run_SFOp_Zus422_cLimiter_Gradient_m_soll_k0_min_uvs_zus "" /begin DEF_CHARACTERISTIC MG_SOLLK0UVSNEG_ZST_ZUS MG_SOLLK0UVSPOS_ZST_ZUS /end DEF_CHARACTERISTIC /end FUNCTION
/begin FUNCTION Run_SFOp_Zus43_cLimiter_Gradient_m_mod_has "" /begin LOC_MEASUREMENT mg_k0_mod_max_zus m_k0_mod_has_fkt /end LOC_MEASUREMENT /end FUNCTION
/begin FUNCTION Run_SFOp_Zus44_cLimiter_Gradient_m_soll_k0_has "" /begin LOC_MEASUREMENT mg_soll_k0_max_zus /end LOC_MEASUREMENT /end FUNCTION
/begin FUNCTION Run_SFOp_Zus458_abs_fl32 "" /begin LOC_MEASUREMENT nd_k0_in /end LOC_MEASUREMENT /end FUNCTION
/begin FUNCTION Run_SFOp_Zus461_abs_fl32 "" /begin LOC_MEASUREMENT ndg_k0_in /end LOC_MEASUREMENT /end FUNCTION
/begin FUNCTION Run_SFOp_Zus92_abs_fl32 "" /begin LOC_MEASUREMENT ndg_k0_in /end LOC_MEASUREMENT /end FUNCTION
/begin FUNCTION Run_SFSBI23_cDT1_ndgvm "" /begin DEF_CHARACTERISTIC XP_MAX FK_NGVM_HAS /end DEF_CHARACTERISTIC /begin LOC_MEASUREMENT ng_vm_in n_vm_in /end LOC_MEASUREMENT /end FUNCTION
/begin FUNCTION Run_SFSBI24_cDT1_vg_f "" /begin DEF_CHARACTERISTIC XP_MAX FK_VGF_HAS /end DEF_CHARACTERISTIC /begin LOC_MEASUREMENT vg_f_sbe v_f_sbe /end LOC_MEASUREMENT /end FUNCTION
/begin FUNCTION Run_SFSBI27_cPt1nseciae "" /begin LOC_MEASUREMENT n_sec_iae_mod n_sec_iae /end LOC_MEASUREMENT /end FUNCTION
/begin FUNCTION Run_SFSBI30_cDT1_ndgk0 "" /begin DEF_CHARACTERISTIC FK_NDGK0_HAS XP_MAX /end DEF_CHARACTERISTIC /begin LOC_MEASUREMENT nd_k0_in ndg_k0_in /end LOC_MEASUREMENT /end FUNCTION
/begin FUNCTION Run_SFSBI31_cDelayEM "" /begin LOC_MEASUREMENT n_em_verz n_em_in /end LOC_MEASUREMENT /end FUNCTION
/begin FUNCTION Run_SFSBI32_cDelayNVM "" /begin LOC_MEASUREMENT n_vm_verz n_vm_in /end LOC_MEASUREMENT /end FUNCTION
/begin FUNCTION Run_SFSBI63_cDT1MgMot "" /begin DEF_CHARACTERISTIC XP_MAX FK_MGMOT_HAS /end DEF_CHARACTERISTIC /begin LOC_MEASUREMENT mg_mot_in m_mot_in /end LOC_MEASUREMENT /end FUNCTION
/begin FUNCTION Run_SFSBI64_cDT1MgWunsch "" /begin DEF_CHARACTERISTIC XP_MAX FK_MGWUNSCHFPW_HAS /end DEF_CHARACTERISTIC /begin LOC_MEASUREMENT mg_wunsch_fpw_in m_wunsch_fpw_in /end LOC_MEASUREMENT /end FUNCTION
/begin FUNCTION Run_SFSBI65_cDT1MgWunschHST "" /begin DEF_CHARACTERISTIC XP_MAX FK_MGWUNSCHFPW_HAS /end DEF_CHARACTERISTIC /begin LOC_MEASUREMENT mg_wunsch_fpw_hst_in m_wunsch_fpw_hst_in /end LOC_MEASUREMENT /end FUNCTION
/begin FUNCTION Run_SFSBI66_cPT1MWunsch "" /begin DEF_CHARACTERISTIC MPT_MWUNSCHFPWHST /end DEF_CHARACTERISTIC /begin LOC_MEASUREMENT m_wunsch_fpw_hst_fil m_wunsch_fpw_hst_in /end LOC_MEASUREMENT /end FUNCTION
/begin FUNCTION Run_SFSBo185_CL_PT1 "" /begin LOC_MEASUREMENT z_nmineminit_lls_has /end LOC_MEASUREMENT /end FUNCTION
/begin FUNCTION Run_SFSBo186_CL_PT1_1 "" /begin LOC_MEASUREMENT z_nmineminit_lls_has /end LOC_MEASUREMENT /end FUNCTION
/begin FUNCTION Run_SFSBo204_cLimiter_Gradient_ "" /begin DEF_CHARACTERISTIC CG_MINDAT_LLS_HAS /end DEF_CHARACTERISTIC /end FUNCTION
/begin FUNCTION Run_SFSBo209_cLimiter_Gradient_ "" /begin DEF_CHARACTERISTIC NOG_SECIAEMINCRVKRI_LLS_HAS /end DEF_CHARACTERISTIC /begin LOC_MEASUREMENT no_seciae_crv_kri_lls_has /end LOC_MEASUREMENT /end FUNCTION
/begin FUNCTION Run_SFSBo210_cLimiter_Gradient_1 "" /begin DEF_CHARACTERISTIC NOG_SECIAEMINCRVKRI_LLS_HAS /end DEF_CHARACTERISTIC /end FUNCTION
/begin FUNCTION Run_SFSBo371_abs_fl32 "" /begin LOC_MEASUREMENT vg_f_sbe /end LOC_MEASUREMENT /end FUNCTION
/begin FUNCTION Run_SFSBo74_CL_PT1_m_k0_mber_has_sbe "" /begin DEF_CHARACTERISTIC FK_MK0MBERZUS_HAS /end DEF_CHARACTERISTIC /begin LOC_MEASUREMENT m_k0_mber_zus_gbegr m_k0_mod_has_fkt /end LOC_MEASUREMENT /end FUNCTION
/begin FUNCTION Run_SFSBo75_cLimiter_Gradient_m_k0_mber_zus_gbegr "" /begin DEF_CHARACTERISTIC MG_K0MBERZUSNEG_HAS MG_K0MBERZUSPOS_HAS /end DEF_CHARACTERISTIC /begin LOC_MEASUREMENT m_k0_mber_zus_gbegr /end LOC_MEASUREMENT /end FUNCTION
/begin FUNCTION Run_SSAi89_cDelay_m_soll_em "" /begin DEF_CHARACTERISTIC T_MSOLLEMHST_HAS /end DEF_CHARACTERISTIC /begin LOC_MEASUREMENT m_soll_em_hst_verz m_soll_em_hst_in /end LOC_MEASUREMENT /end FUNCTION
/begin FUNCTION Run_SSAi90_cDelay_m_soll_vm "" /begin DEF_CHARACTERISTIC T_MSOLLVMHST_HAS /end DEF_CHARACTERISTIC /begin LOC_MEASUREMENT m_soll_vm_hst_verz m_soll_vm_hst_in /end LOC_MEASUREMENT /end FUNCTION
/begin FUNCTION Run_TL_FSBi_SignalBerechnung_in ""
 /begin LOC_MEASUREMENT z_hybfkt_stg st_ziel_bz_has_stg st_ist_bz_has_stg st_ist_hcomd_has_stg z_ablauf_has_stg z_ablaufvariante_has_stg m_k0_mod_has_fkt m_max_em_has_fkt m_max_iae_has_fkt m_min_em_has_fkt m_soll_em_has_fkt m_soll_k0_has_fkt m_soll_res_em_has_fkt mg_soll_k0_has_fkt n_soll_em_has_fkt n_soll_vm_has_fkt nd_min_saf_has_fkt nd_soll_iae_fkt st_ablauf_fkt status_ablauf_has_fkt z_ablauf_svh_reset_has_fkt z_ablaufvariante_kalt_zus z_emaktiv_fuw_zus_fkt z_fehler15_eh_fkt z_k0_befuellopt_has_fkt z_k0_has_fkt z_m_max_iae_has_fkt z_m_soll_em_has_fkt z_n_soll_em_has_fkt z_n_soll_vm_has_fkt z_p_hys_k0_has_fkt z_ponr_fkt z_respschlepp_sas_fkt z_saf_has_fkt z_sbe_has_fkt z_zuendfreigabe_vm_fkt z_zuendfreigabe_vm_has_fkt i_istgang_egs i_zielgang_egs m_wunsch_fpw_hst_fil mg_wunsch_fpw_in mg_wunsch_fpw_hst_in n_sec_iae nd_k0_in ndg_k0_in ng_vm_in status_schaltung_egs_in n_min_em_psys_lp3_has_sbe status_psys_has_sbe vg_f_sbe v_f_sbe status_sync_schaltung_sbe z_pvu_has_sbe z_freigabe_pvu_has_sbe t_betrieb_pvu_has_sbe mg_mot_in status_radschlupf_rse_has_sbe status_schaltart_svh_has_sbe z_modus_em_hst_in c_getriebe_egs_in istgang_egs_in m_em_in m_iae_in m_k0_in m_max_dyn_em_in m_soll_em_hst_in m_soll_vm_hst_in m_vm_in m_vm_start_in m_wunsch_fpw_in n_ab_egs_in n_em_in n_soll_ll_vm_in n_t_egs_in n_vm_in osmode_next_in p_bremse_fzg_in sollgang_egs_in status_fehler_iep_in status_iae_in status_iep_in status_k0_in pos_egs_in z_ablauf_has_hst_in z_ablaufvariante_has_hst_in zielgang_egs_in z_k0_fst_in m_mot_in status_iae_adap_in z_diag_ersfkt_has_in z_diag_ersfkt_hi_has_in z_diag_notgang_has_in status_k0_adap_in status_waschstr_in status_kraftfluss_egs_in z_n_min_em_parksp_has_in n_mot_soll_iae_in status_alaengs_adaoff_in gangwechsel_egs_in z_nllsoll_iae_in status_nem_in status_nvm_in kolbenpos_k0_in z_kps_stada_in t_betrieb_pvu_has_ee_in status_ll_vm_in z_msa_fst_in m_min_dyn_em_in phi_neigung_in v_f_in drehrichtung_nem_in fpw_in drehrichtung_nab_in schalt_mode_egs_in m_ziel_k0_hst_in status_kraftfluss_lev2_egs_in i_gang_lev2_egs_in status_c_k0_in bremspedal_in status_autohold_in status_hillhold_in status_vf_in v_f_ref_in status_vfref_in z_diag_ersfkt_hi_96_has_in status_k0_adap_zaehler_in status_k0_befuellung_in z_oea_hst_in z_iep_in z_nllsoll_iep_in c_vm_in n_soll_em_hst_in abstellpos_vm_in abstellpos_vm_status_in status_nreg_em_hst_in m_min_vm_in m_soll_vm_l_hst_in z_msa_stada_in m_wunsch_fpw_hst_in status_getrbereit_in status_betriebsbereit_hst_in status_sa_vm_in z_ba_has_vm_hst_in z_ba_has_k0_hst_in status_abs_in status_asr_in modus_e_fahren_hst_in status_kl15_in status_posvueb_in soc_in status_soc_in c_umgebung_in status_cumgebung_in m_motmax_has_sbe z_k0_has_sbe z_svh_has_sbe m_soll_res_em_has_sbe m_soll_res_em_bas_sbe z_modus_iae_has_sbe z_sas_has_sbe z_modus_iep_has_sbe z_msa_has_sbe status_efahren_has_sbe n_min_em_has_sbe z_msa_avh_moni_has_sbe z_msa_eaf_moni_has_sbe z_start_modus_has_sbe m_k0_mber_has_sbe z_lls_fktaktiv_has_sbe z_status_psys_mps_sbe m_k0_has_sbe m_soll_k0_has_sbe analyse_has_sbe z_nminemmodus_has_sbe /end LOC_MEASUREMENT
 /begin SUB_FUNCTION SFSBI10_Radschlupferkennung SFSBI9_N_Min_Psys_EM SFSBI5_Drehzahlen_input SFSBI4_Bestimmung_Schaltart SFSBI8_Momente_input SFSBI11_Unterstuetzung_Positionsventilueberwachung SFSBI6_Getriebe_input /end SUB_FUNCTION
/end FUNCTION
/begin FUNCTION SDIAGi32_IfActionSubsystem2 ""
 /begin DEF_CHARACTERISTIC BM_ERSFKT_ALA_FRK_HAS BM_ERSFKT_HI_96_ALA_FRK_HAS BM_ERSFKT_HI_ALA_FRK_HAS /end DEF_CHARACTERISTIC
 /begin LOC_MEASUREMENT z_diag_ersfkt_has_in z_diag_ersfkt_hi_has_in status_nem_in z_diag_ersfkt_hi_96_has_in /end LOC_MEASUREMENT
 /begin SUB_FUNCTION SDIAGi34_Bitwise_AND_ui32_2 SDIAGi33_Bitwise_AND_ui32_1 SDIAGi35_Bitwise_AND_ui32_3 /end SUB_FUNCTION
/end FUNCTION
/begin FUNCTION SDIAGi33_Bitwise_AND_ui32_1 "" /begin DEF_CHARACTERISTIC BM_ERSFKT_HI_ALA_FRK_HAS /end DEF_CHARACTERISTIC /begin LOC_MEASUREMENT z_diag_ersfkt_hi_has_in /end LOC_MEASUREMENT /end FUNCTION
/begin FUNCTION SDIAGi34_Bitwise_AND_ui32_2 "" /begin DEF_CHARACTERISTIC BM_ERSFKT_ALA_FRK_HAS /end DEF_CHARACTERISTIC /begin LOC_MEASUREMENT z_diag_ersfkt_has_in /end LOC_MEASUREMENT /end FUNCTION
/begin FUNCTION SDIAGi35_Bitwise_AND_ui32_3 "" /begin DEF_CHARACTERISTIC BM_ERSFKT_HI_96_ALA_FRK_HAS /end DEF_CHARACTERISTIC /begin LOC_MEASUREMENT z_diag_ersfkt_hi_96_has_in /end LOC_MEASUREMENT /end FUNCTION
/begin FUNCTION SDIAGi40_Bitwise_AND_ui16_1 "" /begin DEF_CHARACTERISTIC BM_ERSFKT_HI_DEAKTIV_ABO_FRK_HAS /end DEF_CHARACTERISTIC /begin LOC_MEASUREMENT z_diag_ersfkt_hi_has_in /end LOC_MEASUREMENT /end FUNCTION
/begin FUNCTION SDIAGi41_Bitwise_AND_ui32 "" /begin DEF_CHARACTERISTIC BM_ERSFKT_DEAKTIV_ABO_FRK_HAS /end DEF_CHARACTERISTIC /begin LOC_MEASUREMENT z_diag_ersfkt_has_in /end LOC_MEASUREMENT /end FUNCTION
/begin FUNCTION SDIAGi42_Bitwise_AND_ui32_2 "" /begin DEF_CHARACTERISTIC BM_ERSFKT_HI_96_DEAKTIV_ABO_FRK_HAS /end DEF_CHARACTERISTIC /begin LOC_MEASUREMENT z_diag_ersfkt_hi_96_has_in /end LOC_MEASUREMENT /end FUNCTION
/begin FUNCTION SDIAGi43_Bitwise_AND_ui32 "" /begin DEF_CHARACTERISTIC BM_ERSFKT_ZUST_INIT_FRK_HAS /end DEF_CHARACTERISTIC /begin LOC_MEASUREMENT z_diag_ersfkt_has_in /end LOC_MEASUREMENT /end FUNCTION
/begin FUNCTION SDIAGi44_Bitwise_AND_ui32_1 "" /begin DEF_CHARACTERISTIC BM_ERSFKT_HI_ZUST_INIT_FRK_HAS /end DEF_CHARACTERISTIC /begin LOC_MEASUREMENT z_diag_ersfkt_hi_has_in /end LOC_MEASUREMENT /end FUNCTION
/begin FUNCTION SDIAGi45_Bitwise_AND_ui32_2 "" /begin DEF_CHARACTERISTIC BM_ERSFKT_HI_96_ZUST_INIT_FRK_HAS /end DEF_CHARACTERISTIC /begin LOC_MEASUREMENT z_diag_ersfkt_hi_96_has_in /end LOC_MEASUREMENT /end FUNCTION
/begin FUNCTION SDIAGi52_IfActionSubsystem2 "" /begin LOC_MEASUREMENT z_hss1off_ehi_has /end LOC_MEASUREMENT /end FUNCTION
/begin FUNCTION SDIAGi56_Bitwise_AND_ui32 "" /begin DEF_CHARACTERISTIC BM_ERSFKT_VMSTARTVERBOT_FRK_HAS /end DEF_CHARACTERISTIC /begin LOC_MEASUREMENT z_diag_ersfkt_has_in /end LOC_MEASUREMENT /end FUNCTION
/begin FUNCTION SDIAGi57_Bitwise_AND_ui32_1 "" /begin DEF_CHARACTERISTIC BM_ERSFKT_HI_VMSTARTVERBOT_FRK_HAS /end DEF_CHARACTERISTIC /begin LOC_MEASUREMENT z_diag_ersfkt_hi_has_in /end LOC_MEASUREMENT /end FUNCTION
/begin FUNCTION SDIAGi58_Bitwise_AND_ui32_2 "" /begin DEF_CHARACTERISTIC BM_ERSFKT_HI_96_VMSTARTVERBOT_FRK_HAS /end DEF_CHARACTERISTIC /begin LOC_MEASUREMENT z_diag_ersfkt_hi_96_has_in /end LOC_MEASUREMENT /end FUNCTION
/begin FUNCTION SDIAGo105_Fehler_liegt_nicht_vor "" /begin DEF_CHARACTERISTIC NS_EMOELVERSFEHLERKALT_ERK_HAS /end DEF_CHARACTERISTIC /begin LOC_MEASUREMENT n_em_in /end LOC_MEASUREMENT /end FUNCTION
/begin FUNCTION SDIAGo106_Fehler_liegt_nicht_vor_Kaltstart ""
 /begin DEF_CHARACTERISTIC KL_NOEMOELVERSFEHLER_ERK_HAS_Y KL_NOEMOELVERSFEHLER_ERK_HAS_X BM_LLS_OELVERSFEHLER_ERK_HAS SWI_PDEAK_OELVERSFEHLER_ERK_HAS /end DEF_CHARACTERISTIC
 /begin LOC_MEASUREMENT n_min_em_has_sbe z_lls_fktaktiv_has_sbe c_getriebe_egs_in n_em_in pos_egs_in status_betriebsbereit_hst_in /end LOC_MEASUREMENT
 /begin SUB_FUNCTION SDIAGo110_Bitwise_AND_ui32 /end SUB_FUNCTION
/end FUNCTION
/begin FUNCTION SDIAGo110_Bitwise_AND_ui32 "" /begin DEF_CHARACTERISTIC BM_LLS_OELVERSFEHLER_ERK_HAS /end DEF_CHARACTERISTIC /begin LOC_MEASUREMENT z_lls_fktaktiv_has_sbe /end LOC_MEASUREMENT /end FUNCTION
/begin FUNCTION SDIAGo89_VM_Schleppstart "" /begin LOC_MEASUREMENT st_ablauf_fkt /end LOC_MEASUREMENT /end FUNCTION
/begin FUNCTION SDIAGo90_VM_Zustart "" /begin LOC_MEASUREMENT st_ablauf_fkt /end LOC_MEASUREMENT /end FUNCTION
/begin FUNCTION SDIAGo93_Encoder_ui32 "" /begin LOC_MEASUREMENT status_fehlererk_diho /end LOC_MEASUREMENT /end FUNCTION
/begin FUNCTION SFHC12_Abbruchsteuerung "" /begin DEF_CHARACTERISTIC SWI_ZPONRABBRAKTIV_HAS /end DEF_CHARACTERISTIC
 /begin LOC_MEASUREMENT st_ziel_bz_has_stg st_ist_bz_has_stg st_ist_hcomd_has_stg z_ablauf_has_stg status_ablauf_has_fkt st_soll_bz_hst_sta st_ist_bz_hst_sta z_ablauf_has_hst_in z_ablaufvariante_has_hst_in z_abbruch_abbrechen_hcomd_abbrstg /end LOC_MEASUREMENT
 /begin SUB_FUNCTION SFHC27_Abbruchsteuerung_NormalMode /end SUB_FUNCTION
/end FUNCTION
/begin FUNCTION SFHC27_Abbruchsteuerung_NormalMode "" /begin DEF_CHARACTERISTIC SWI_ABBRUCH_AKTIV_ABBSTG /end DEF_CHARACTERISTIC
 /begin LOC_MEASUREMENT st_ziel_bz_has_stg st_ist_bz_has_stg st_ist_hcomd_has_stg z_ablauf_has_stg status_ablauf_has_fkt st_soll_bz_hst_sta st_ist_bz_hst_sta z_ablauf_has_hst_in z_ablaufvariante_has_hst_in /end LOC_MEASUREMENT
 /begin SUB_FUNCTION SFHC31_Abbruchueberwachung SFHC37_Einbindung_2_Uebergangsbedingungen SFHC41_Einbindung_1_Austrittsbedingungen SFHC42_Einbindung_2_Austrittsbedingungen SFHC36_Einbindung_1_Uebergangsbedingungen /end SUB_FUNCTION
/end FUNCTION
/begin FUNCTION SFHC31_Abbruchueberwachung ""
 /begin LOC_MEASUREMENT st_ist_hcomd_has_stg st_soll_bz_hst_sta z_ablaufvariante_has_hst_in /end LOC_MEASUREMENT
 /begin SUB_FUNCTION SFHC48_Detektion_abbrechbarer_Uebrgaenge /end SUB_FUNCTION
/end FUNCTION
/begin FUNCTION SFHC36_Einbindung_1_Uebergangsbedingungen "" /begin LOC_MEASUREMENT z_ablauf_has_hst_in /end LOC_MEASUREMENT /begin SUB_FUNCTION SFHC38_Uebergangsbedingungen_HST_1 /end SUB_FUNCTION /end FUNCTION
/begin FUNCTION SFHC37_Einbindung_2_Uebergangsbedingungen "" /begin LOC_MEASUREMENT status_ablauf_has_fkt /end LOC_MEASUREMENT /begin SUB_FUNCTION SFHC40_Uebergangsbedingungen_HST_2 /end SUB_FUNCTION /end FUNCTION
/begin FUNCTION SFHC38_Uebergangsbedingungen_HST_1 "" /begin LOC_MEASUREMENT z_ablauf_has_hst_in /end LOC_MEASUREMENT /end FUNCTION
/begin FUNCTION SFHC40_Uebergangsbedingungen_HST_2 "" /begin LOC_MEASUREMENT status_ablauf_has_fkt /end LOC_MEASUREMENT /end FUNCTION
/begin FUNCTION SFHC41_Einbindung_1_Austrittsbedingungen ""
 /begin LOC_MEASUREMENT status_ablauf_has_fkt st_soll_bz_hst_sta st_ist_bz_hst_sta z_ablauf_has_hst_in /end LOC_MEASUREMENT
/end FUNCTION
/begin FUNCTION SFHC42_Einbindung_2_Austrittsbedingungen "" /begin LOC_MEASUREMENT status_ablauf_has_fkt /end LOC_MEASUREMENT /end FUNCTION
/begin FUNCTION SFHC48_Detektion_abbrechbarer_Uebrgaenge ""
 /begin LOC_MEASUREMENT st_ist_hcomd_has_stg st_soll_bz_hst_sta z_ablaufvariante_has_hst_in /end LOC_MEASUREMENT
 /begin SUB_FUNCTION SFHC58_Check_AbbruchID_ohne_Variante SFHC57_Check_AbbruchID_mit_Variante SFHC59_Mapping_Ablaufvariante_HCOMDintern /end SUB_FUNCTION
/end FUNCTION
/begin FUNCTION SFHC5_HCOMD_OpreatingModeDetermination_fcn "" /begin DEF_CHARACTERISTIC SWI_ABBRUCH_AKTIV_ABBSTG AbstellPosOpt /end DEF_CHARACTERISTIC
 /begin LOC_MEASUREMENT ctrlOperatingModeOMD_req stDrivelineModeOMD_tgt stDrivelineModeOMD_act stOMDID_act ctrlSequenceOMD_req ctrlVariantOMD_req bReInitNormalMode ctrlAbort_req ctrlDrivelineMode_req stDrivelineMode_act ctrlSequence_req ctrlVariant_req stsSequenceOp bInitHybrid bTrmsCtrlRequest bIsShifting bEngCoupleAllowed bIgnitionOffVerified bCl1Closed bCl2Available bExceptionHybrid bErrorHybrid /end LOC_MEASUREMENT
/end FUNCTION
/begin FUNCTION SFHC57_Check_AbbruchID_mit_Variante "" /begin SUB_FUNCTION SFHC61_Variantenabhaengiger_Abbruch_detektiert /end SUB_FUNCTION /end FUNCTION
/begin FUNCTION SFHC58_Check_AbbruchID_ohne_Variante "" /begin DEF_CHARACTERISTIC TAB_ABBRUCHKODIERUNG_Y TAB_ABBRUCHKODIERUNG_X /end DEF_CHARACTERISTIC /end FUNCTION
/begin FUNCTION SFHC59_Mapping_Ablaufvariante_HCOMDintern "" /begin LOC_MEASUREMENT z_ablaufvariante_has_hst_in /end LOC_MEASUREMENT /end FUNCTION
/begin FUNCTION SFHC6_HCSiProc_Signalprocessing_fcn "" /begin DEF_CHARACTERISTIC SWI_AKTPASSIVABB_OML /end DEF_CHARACTERISTIC
 /begin LOC_MEASUREMENT bReInitNormalMode ctrlAbort_req ctrlDrivelineMode_req stDrivelineMode_act ctrlSequence_req ctrlVariant_req stsSequenceOp bInitHybrid bTrmsCtrlRequest bIsShifting bEngCoupleAllowed bIgnitionOffVerified bCl1Closed bCl2Available HCSoProc_dummy z_hybfkt_stg st_ziel_bz_has_stg st_ist_bz_has_stg st_ist_hcomd_has_stg z_ablauf_has_stg z_ablaufvariante_has_stg m_k0_mod_has_fkt m_max_em_has_fkt m_max_iae_has_fkt m_min_em_has_fkt m_soll_em_has_fkt m_soll_k0_has_fkt m_soll_res_em_has_fkt mg_soll_k0_has_fkt n_soll_em_has_fkt n_soll_vm_has_fkt nd_min_saf_has_fkt nd_soll_iae_fkt st_ablauf_fkt status_ablauf_has_fkt z_ablauf_svh_reset_has_fkt z_ablaufvariante_kalt_zus z_emaktiv_fuw_zus_fkt z_fehler15_eh_fkt z_k0_befuellopt_has_fkt z_k0_has_fkt z_m_max_iae_has_fkt z_m_soll_em_has_fkt z_n_soll_em_has_fkt z_n_soll_vm_has_fkt z_p_hys_k0_has_fkt z_ponr_fkt z_respschlepp_sas_fkt z_saf_has_fkt z_sbe_has_fkt z_zuendfreigabe_vm_fkt z_zuendfreigabe_vm_has_fkt st_soll_bz_has_hst z_init_sta st_soll_bz_hst_sta st_ist_bz_hst_sta bExceptionHybrid bErrorHybrid z_modus_em_hst_in c_getriebe_egs_in istgang_egs_in m_em_in m_iae_in m_k0_in m_max_dyn_em_in m_soll_em_hst_in m_soll_vm_hst_in m_vm_in m_vm_start_in m_wunsch_fpw_in n_ab_egs_in n_em_in n_soll_ll_vm_in n_t_egs_in n_vm_in osmode_next_in p_bremse_fzg_in sollgang_egs_in status_fehler_iep_in status_iae_in status_iep_in status_k0_in pos_egs_in z_ablauf_has_hst_in z_ablaufvariante_has_hst_in zielgang_egs_in z_k0_fst_in m_mot_in status_iae_adap_in z_diag_ersfkt_has_in z_diag_ersfkt_hi_has_in z_diag_notgang_has_in status_k0_adap_in status_waschstr_in status_kraftfluss_egs_in z_n_min_em_parksp_has_in n_mot_soll_iae_in status_alaengs_adaoff_in gangwechsel_egs_in z_nllsoll_iae_in status_nem_in status_nvm_in kolbenpos_k0_in z_kps_stada_in t_betrieb_pvu_has_ee_in status_ll_vm_in z_msa_fst_in m_min_dyn_em_in phi_neigung_in v_f_in drehrichtung_nem_in fpw_in drehrichtung_nab_in schalt_mode_egs_in m_ziel_k0_hst_in status_kraftfluss_lev2_egs_in i_gang_lev2_egs_in status_c_k0_in bremspedal_in status_autohold_in status_hillhold_in status_vf_in v_f_ref_in status_vfref_in z_diag_ersfkt_hi_96_has_in status_k0_adap_zaehler_in status_k0_befuellung_in z_oea_hst_in z_iep_in z_nllsoll_iep_in c_vm_in n_soll_em_hst_in abstellpos_vm_in abstellpos_vm_status_in status_nreg_em_hst_in m_min_vm_in m_soll_vm_l_hst_in z_msa_stada_in m_wunsch_fpw_hst_in status_getrbereit_in status_betriebsbereit_hst_in status_sa_vm_in z_ba_has_vm_hst_in z_ba_has_k0_hst_in status_abs_in status_asr_in modus_e_fahren_hst_in status_kl15_in status_posvueb_in soc_in status_soc_in c_umgebung_in status_cumgebung_in st_ist_bz_hst_sta_abbrstg st_soll_bz_hst_sta_abbrstg z_abbruchkodierung_hcomd_abbrstg /end LOC_MEASUREMENT
 /begin SUB_FUNCTION SFHC12_Abbruchsteuerung SFHC67_Zustandsautomat_Emul_HS /end SUB_FUNCTION
/end FUNCTION
/begin FUNCTION SFHC61_Variantenabhaengiger_Abbruch_detektiert "" /begin DEF_CHARACTERISTIC TAB_ABBRUCHKODIERUNG_Y TAB_ABBRUCHKODIERUNG_X /end DEF_CHARACTERISTIC /end FUNCTION
/begin FUNCTION SFHC67_Zustandsautomat_Emul_HS "" /begin DEF_CHARACTERISTIC SWI_TESTMODE /end DEF_CHARACTERISTIC /begin LOC_MEASUREMENT status_ablauf_has_fkt /end LOC_MEASUREMENT /begin SUB_FUNCTION SFHC68_Zustandsautomat_Emul_HS_SF /end SUB_FUNCTION /end FUNCTION
/begin FUNCTION SFHC68_Zustandsautomat_Emul_HS_SF "" /begin DEF_CHARACTERISTIC SWI_TESTMODE_HS_STAPS /end DEF_CHARACTERISTIC /begin LOC_MEASUREMENT status_ablauf_has_fkt st_testmode_hs /end LOC_MEASUREMENT /end FUNCTION
/begin FUNCTION SFHC7_HCSoProc_Signalprocessing_fcn ""
 /begin LOC_MEASUREMENT ctrlOperatingModeOMD_req stDrivelineModeOMD_tgt stDrivelineModeOMD_act stOMDID_act ctrlSequenceOMD_req ctrlVariantOMD_req bReInitNormalMode ctrlAbort_req ctrlDrivelineMode_req stDrivelineMode_act ctrlSequence_req ctrlVariant_req stsSequenceOp bInitHybrid bTrmsCtrlRequest bIsShifting bEngCoupleAllowed bIgnitionOffVerified bCl1Closed bCl2Available HCSoProc_dummy z_hybfkt_stg st_ziel_bz_has_stg st_ist_bz_has_stg st_ist_hcomd_has_stg z_ablauf_has_stg z_ablaufvariante_has_stg bExceptionHybrid bErrorHybrid /end LOC_MEASUREMENT
/end FUNCTION
/begin FUNCTION SFOp_ABST103_Ansteuervariante_1 "" /begin DEF_CHARACTERISTIC SWI_ZK0REGELN_LAU_ABST /end DEF_CHARACTERISTIC
 /begin LOC_MEASUREMENT z_t_k0oeffnenbed_lau_abst z_gefabstbed_lau_abst m_k0_mod_has_fkt m_soll_k0_has_fkt m_k0_in m_vm_in /end LOC_MEASUREMENT
/end FUNCTION
/begin FUNCTION SFOp_ABST104_Ansteuervariante_2 ""
 /begin DEF_CHARACTERISTIC KL_MOSOLLK0MVM_LAU_ABST_Y KL_MOSOLLK0MVM_LAU_ABST_X M_K0MODHAS_ZIEL_LAU_ABST MO_K0MODHASK0OEFFNEN_LAU_ABST MS_VMK0OEFFNEN_LAU_ABST SWI_MSOLLK0BASIS_LAU_ABST T_VK0OEFFNEN_LAU_ABST MDS_MOTBREMSREKU_LAU_ABST MG_K0MODHASSAREKU_LAU_ABST MG_K0MODHASSA_LAU_ABST MG_K0MODHAS_LAU_ABST SWI_BREMSREKUBERMODUS_LAU_ABST /end DEF_CHARACTERISTIC
 /begin LOC_MEASUREMENT z_t_k0oeffnenbed_lau_abst status_k0sreg_lau_abst z_gefabstbed_lau_abst status_sa_vm_lau_abst t_k0oeffnenbed_lau_abst m_k0_mod_has_fkt m_soll_k0_has_fkt z_ablaufvariante_has_stg m_vm_in m_soll_vm_hst_in m_mot_in m_min_vm_in n_min_em_has_sbe z_lls_fktaktiv_has_sbe /end LOC_MEASUREMENT
 /begin SUB_FUNCTION Run_SFOp_ABST114_cLimiter_Gradient_MK0modhas SFOp_ABST110_Ansteuervariante_2 Run_SFOp_ABST113_abs_fl32 /end SUB_FUNCTION
/end FUNCTION
/begin FUNCTION SFOp_ABST105_Initialisierung ""
 /begin DEF_CHARACTERISTIC KL_MK0MODINIT_LAU_ABST_Y KL_MK0MODINIT_LAU_ABST_X SWI_ZK0REGELN_LAU_ABST MO_SOLLK0BEGRK0SREG_LAU_ABST SWI_K0SREGAKTIV_LAU_ABST SWI_KLMK0MODINIT_LAU_ABST SWI_MK0MODINIT_LAU_ABST SWI_STATUSK0K0SREG_LAU_ABST /end DEF_CHARACTERISTIC
 /begin LOC_MEASUREMENT status_k0sreg_lau_abst m_sollk0begrk0sreg_lau_abst z_k0_has_fkt z_p_hys_k0_has_fkt z_ablauf_has_stg z_ablaufvariante_has_stg n_em_in status_k0_in m_k0_in n_vm_in m_vm_in z_ablauf_has_hst_in m_soll_vm_hst_in status_kraftfluss_egs_in m_mot_in c_getriebe_egs_in m_em_in istgang_egs_in sollgang_egs_in nd_k0_in status_schaltung_egs_in ng_vm_in status_schaltart_svh_has_sbe m_soll_vm_l_hst_in status_sa_vm_in m_min_vm_in c_vm_in n_min_em_has_sbe z_lls_fktaktiv_has_sbe z_svh_has_sbe /end LOC_MEASUREMENT
/end FUNCTION
/begin FUNCTION SFOp_ABST110_Ansteuervariante_2 ""
 /begin DEF_CHARACTERISTIC BM_LLSGABBED_LAU_ABST NS_MINEMGABBED_LAU_ABST Z_ABLAUFVARIANTE_GEFABST_ABST /end DEF_CHARACTERISTIC
 /begin LOC_MEASUREMENT z_ablaufvariante_has_stg n_min_em_has_sbe z_lls_fktaktiv_has_sbe /end LOC_MEASUREMENT
 /begin SUB_FUNCTION SFOp_ABST116_Bitwise_AND_ui32_ /end SUB_FUNCTION
/end FUNCTION
/begin FUNCTION SFOp_ABST116_Bitwise_AND_ui32_ "" /begin DEF_CHARACTERISTIC BM_LLSGABBED_LAU_ABST /end DEF_CHARACTERISTIC /begin LOC_MEASUREMENT z_lls_fktaktiv_has_sbe /end LOC_MEASUREMENT /end FUNCTION
/begin FUNCTION SFOp_ABST129_Initialisierung ""
 /begin DEF_CHARACTERISTIC STATUS_ABL_AST_ABST STATUS_ABL_LAU_ABST SWI_STATUSABL_SAVM_LAU_ABST /end DEF_CHARACTERISTIC
 /begin LOC_MEASUREMENT status_sa_vm_lau_abst st_ablauf_fkt status_ablauf_has_fkt z_ablauf_has_stg z_ablaufvariante_has_stg n_em_in status_k0_in m_k0_in n_vm_in m_vm_in z_ablauf_has_hst_in m_soll_vm_hst_in status_kraftfluss_egs_in m_mot_in c_getriebe_egs_in m_em_in istgang_egs_in sollgang_egs_in nd_k0_in status_schaltung_egs_in ng_vm_in status_schaltart_svh_has_sbe m_soll_vm_l_hst_in status_sa_vm_in m_min_vm_in c_vm_in n_min_em_has_sbe z_lls_fktaktiv_has_sbe z_svh_has_sbe /end LOC_MEASUREMENT
/end FUNCTION
/begin FUNCTION SFOp_ABST133_Initialisierung "" /begin DEF_CHARACTERISTIC K_SVH_RESET_LAU_ABST /end DEF_CHARACTERISTIC /begin LOC_MEASUREMENT z_svh_reset_zustand_abst /end LOC_MEASUREMENT /end FUNCTION
/begin FUNCTION SFOp_ABST134_Initialisierung ""
 /begin LOC_MEASUREMENT m_soll_vm_has_abst m_soll_vm_l_has_abst z_m_soll_vm_has_abst z_init z_t_maxbed_koe_abst z_t_maxbed_ast_abst z_t_k0oeffnenbed_lau_abst z_t_maxbed_lau_abst z_svh_reset_zustand_abst z_t_maxbed_ksa_abst z_t_maxbed_sak_abst status_k0sreg_lau_abst z_t_maxbed_gab_abst z_gefabstbed_lau_abst status_sa_vm_lau_abst m_max_em_has_fkt m_min_em_has_fkt m_k0_mod_has_fkt m_soll_em_has_fkt m_soll_k0_has_fkt n_soll_em_has_fkt st_ablauf_fkt status_ablauf_has_fkt z_k0_has_fkt z_m_soll_em_has_fkt z_n_soll_em_has_fkt z_n_soll_vm_has_fkt z_zuendfreigabe_vm_has_fkt z_p_hys_k0_has_fkt n_soll_vm_has_fkt /end LOC_MEASUREMENT
/end FUNCTION
/begin FUNCTION SFOp_ABST141_Initialisierung "" /begin DEF_CHARACTERISTIC STATUS_ABL_SAK_ABST /end DEF_CHARACTERISTIC /begin LOC_MEASUREMENT st_ablauf_fkt status_ablauf_has_fkt /end LOC_MEASUREMENT /end FUNCTION
/begin FUNCTION SFOp_ABST152_Initialisierung ""
 /begin LOC_MEASUREMENT m_max_em_has_fkt m_min_em_has_fkt m_soll_em_has_fkt n_soll_em_has_fkt z_m_soll_em_has_fkt z_n_soll_em_has_fkt /end LOC_MEASUREMENT
/end FUNCTION
/begin FUNCTION SFOp_ABST153_Initialisierung "" /begin DEF_CHARACTERISTIC M_K0MODMIN_SRT_ABST /end DEF_CHARACTERISTIC
 /begin LOC_MEASUREMENT m_k0_mod_has_fkt m_soll_k0_has_fkt z_k0_has_fkt z_p_hys_k0_has_fkt m_k0_in /end LOC_MEASUREMENT
/end FUNCTION
/begin FUNCTION SFOp_ABST154_Initialisierung "" /begin DEF_CHARACTERISTIC STATUS_ABL_SRT_ABST /end DEF_CHARACTERISTIC /begin LOC_MEASUREMENT z_init st_ablauf_fkt status_ablauf_has_fkt /end LOC_MEASUREMENT /end FUNCTION
/begin FUNCTION SFOp_ABST155_Initialisierung "" /begin DEF_CHARACTERISTIC K_SVH_RESETLAUS_SRT_ABST /end DEF_CHARACTERISTIC /begin LOC_MEASUREMENT z_svh_reset_zustand_abst status_schaltung_egs_in /end LOC_MEASUREMENT /end FUNCTION
/begin FUNCTION SFOp_ABST156_Initialisierung ""
 /begin LOC_MEASUREMENT m_soll_vm_has_abst m_soll_vm_l_has_abst z_m_soll_vm_has_abst z_n_soll_vm_has_fkt z_zuendfreigabe_vm_has_fkt n_soll_vm_has_fkt /end LOC_MEASUREMENT
/end FUNCTION
/begin FUNCTION SFOp_ABST163_Initialisierung ""
 /begin LOC_MEASUREMENT m_max_em_has_fkt m_min_em_has_fkt m_soll_em_has_fkt n_soll_em_has_fkt z_m_soll_em_has_fkt z_n_soll_em_has_fkt /end LOC_MEASUREMENT
/end FUNCTION
/begin FUNCTION SFOp_ABST164_Initialisierung ""
 /begin LOC_MEASUREMENT m_k0_mod_has_fkt m_soll_k0_has_fkt z_k0_has_fkt z_p_hys_k0_has_fkt /end LOC_MEASUREMENT
/end FUNCTION
/begin FUNCTION SFOp_ABST165_Initialisierung "" /begin LOC_MEASUREMENT st_ablauf_fkt status_ablauf_has_fkt /end LOC_MEASUREMENT /end FUNCTION
/begin FUNCTION SFOp_ABST166_Initialisierung ""
 /begin LOC_MEASUREMENT m_soll_vm_has_abst m_soll_vm_l_has_abst z_m_soll_vm_has_abst z_n_soll_vm_has_fkt z_zuendfreigabe_vm_has_fkt /end LOC_MEASUREMENT
/end FUNCTION
/begin FUNCTION SFOp_ABST173_Initialisierung "" /begin DEF_CHARACTERISTIC SWI_ZPHYSK0_UAB_ABST /end DEF_CHARACTERISTIC /begin LOC_MEASUREMENT z_p_hys_k0_has_fkt /end LOC_MEASUREMENT /end FUNCTION
/begin FUNCTION SFOp_ABST174_Initialisierung "" /begin LOC_MEASUREMENT st_ablauf_fkt status_ablauf_has_fkt /end LOC_MEASUREMENT /end FUNCTION
/begin FUNCTION SFOp_ABST180_Schaltungsbeeinflussung "" /begin DEF_CHARACTERISTIC KL_KSVHABBRLAUSFST_ABST_Y KL_KSVHABBRLAUSFST_ABST_X /end DEF_CHARACTERISTIC
 /begin LOC_MEASUREMENT m_soll_vm_has_abst m_soll_vm_l_has_abst z_m_soll_vm_has_abst z_init z_t_maxbed_koe_abst z_t_maxbed_ast_abst z_t_k0oeffnenbed_lau_abst z_t_maxbed_lau_abst z_svh_reset_zustand_abst z_t_maxbed_ksa_abst z_t_maxbed_sak_abst status_k0sreg_lau_abst z_t_maxbed_gab_abst z_gefabstbed_lau_abst z_svh_abbrlaus_fst_abst m_max_em_has_fkt m_min_em_has_fkt m_k0_mod_has_fkt m_soll_em_has_fkt m_soll_k0_has_fkt n_soll_em_has_fkt st_ablauf_fkt status_ablauf_has_fkt z_k0_has_fkt z_m_soll_em_has_fkt z_n_soll_em_has_fkt z_n_soll_vm_has_fkt z_zuendfreigabe_vm_has_fkt z_p_hys_k0_has_fkt n_soll_vm_has_fkt z_ablauf_has_stg z_ablaufvariante_has_stg n_em_in status_k0_in m_k0_in n_vm_in m_vm_in z_ablauf_has_hst_in m_soll_vm_hst_in status_kraftfluss_egs_in m_mot_in c_getriebe_egs_in m_em_in istgang_egs_in sollgang_egs_in nd_k0_in status_schaltung_egs_in ng_vm_in status_schaltart_svh_has_sbe m_soll_vm_l_hst_in status_sa_vm_in m_min_vm_in c_vm_in n_min_em_has_sbe z_lls_fktaktiv_has_sbe z_svh_has_sbe /end LOC_MEASUREMENT
/end FUNCTION
/begin FUNCTION SFOp_ABST196_Bitwise_AND_ui32_ "" /begin DEF_CHARACTERISTIC BM_LLSGABBED_LAU_ABST /end DEF_CHARACTERISTIC /begin LOC_MEASUREMENT z_lls_fktaktiv_has_sbe /end LOC_MEASUREMENT /end FUNCTION
/begin FUNCTION SFOp_ABST2_FOp_Abstellen ""
 /begin LOC_MEASUREMENT m_max_em_has_fkt m_min_em_has_fkt m_k0_mod_has_fkt m_soll_em_has_fkt m_soll_k0_has_fkt n_soll_em_has_fkt st_ablauf_fkt status_ablauf_has_fkt z_k0_has_fkt z_m_soll_em_has_fkt z_n_soll_em_has_fkt z_n_soll_vm_has_fkt z_zuendfreigabe_vm_has_fkt z_p_hys_k0_has_fkt z_ponr_fkt z_ablauf_svh_reset_has_fkt m_max_iae_has_fkt m_soll_res_em_has_fkt mg_soll_k0_has_fkt n_soll_vm_has_fkt nd_min_saf_has_fkt nd_soll_iae_fkt z_ablaufvariante_kalt_zus z_emaktiv_fuw_zus_fkt z_fehler15_eh_fkt z_k0_befuellopt_has_fkt z_m_max_iae_has_fkt z_respschlepp_sas_fkt z_saf_has_fkt z_sbe_has_fkt z_zuendfreigabe_vm_fkt z_hybfkt_stg st_ziel_bz_has_stg st_ist_bz_has_stg st_ist_hcomd_has_stg z_ablauf_has_stg z_ablaufvariante_has_stg n_em_in status_k0_in m_k0_in n_vm_in m_vm_in z_ablauf_has_hst_in m_soll_vm_hst_in status_kraftfluss_egs_in m_mot_in c_getriebe_egs_in m_em_in istgang_egs_in sollgang_egs_in z_modus_em_hst_in m_iae_in m_max_dyn_em_in m_soll_em_hst_in m_vm_start_in m_wunsch_fpw_in n_ab_egs_in n_soll_ll_vm_in n_t_egs_in osmode_next_in p_bremse_fzg_in status_fehler_iep_in status_iae_in status_iep_in pos_egs_in z_ablaufvariante_has_hst_in zielgang_egs_in z_k0_fst_in status_iae_adap_in z_diag_ersfkt_has_in z_diag_ersfkt_hi_has_in z_diag_notgang_has_in status_k0_adap_in status_waschstr_in z_n_min_em_parksp_has_in n_mot_soll_iae_in status_alaengs_adaoff_in gangwechsel_egs_in z_nllsoll_iae_in status_nem_in status_nvm_in kolbenpos_k0_in z_kps_stada_in t_betrieb_pvu_has_ee_in status_ll_vm_in z_msa_fst_in m_min_dyn_em_in phi_neigung_in v_f_in drehrichtung_nem_in fpw_in drehrichtung_nab_in schalt_mode_egs_in m_ziel_k0_hst_in status_kraftfluss_lev2_egs_in i_gang_lev2_egs_in status_c_k0_in bremspedal_in status_autohold_in status_hillhold_in status_vf_in v_f_ref_in status_vfref_in z_diag_ersfkt_hi_96_has_in status_k0_adap_zaehler_in status_k0_befuellung_in z_oea_hst_in z_iep_in z_nllsoll_iep_in nd_k0_in status_schaltung_egs_in ng_vm_in status_schaltart_svh_has_sbe i_istgang_egs i_zielgang_egs m_wunsch_fpw_hst_fil mg_wunsch_fpw_in mg_wunsch_fpw_hst_in n_sec_iae ndg_k0_in n_min_em_psys_lp3_has_sbe status_psys_has_sbe vg_f_sbe v_f_sbe status_sync_schaltung_sbe z_pvu_has_sbe z_freigabe_pvu_has_sbe t_betrieb_pvu_has_sbe mg_mot_in status_radschlupf_rse_has_sbe m_soll_vm_l_hst_in status_sa_vm_in m_min_vm_in c_vm_in n_soll_em_hst_in abstellpos_vm_in abstellpos_vm_status_in status_nreg_em_hst_in z_msa_stada_in m_wunsch_fpw_hst_in status_getrbereit_in status_betriebsbereit_hst_in z_ba_has_vm_hst_in z_ba_has_k0_hst_in status_abs_in status_asr_in modus_e_fahren_hst_in status_kl15_in status_posvueb_in soc_in status_soc_in c_umgebung_in status_cumgebung_in n_min_em_has_sbe z_lls_fktaktiv_has_sbe z_svh_has_sbe m_motmax_has_sbe z_k0_has_sbe m_soll_res_em_has_sbe m_soll_res_em_bas_sbe z_modus_iae_has_sbe z_sas_has_sbe z_modus_iep_has_sbe z_msa_has_sbe status_efahren_has_sbe z_msa_avh_moni_has_sbe z_msa_eaf_moni_has_sbe z_start_modus_has_sbe m_k0_mber_has_sbe z_status_psys_mps_sbe m_k0_has_sbe m_soll_k0_has_sbe analyse_has_sbe z_nminemmodus_has_sbe /end LOC_MEASUREMENT
 /begin SUB_FUNCTION SFOp_ABST8_PhaseControl SFOp_ABST7_Output SFOp_ABST4_CalcFcn SFOp_ABST6_Input /end SUB_FUNCTION
/end FUNCTION
/begin FUNCTION SFOp_ABST20_st_abstellen_abst ""
 /begin DEF_CHARACTERISTIC FK_NGVM_AST_ABST NGS_VMK0OEFFNEN_AST_ABST NS_VMK0OEFFNEN_AST_ABST T_NGSVMK0OEFFNEN_AST_ABST /end DEF_CHARACTERISTIC
 /begin LOC_MEASUREMENT m_soll_vm_has_abst m_soll_vm_l_has_abst z_m_soll_vm_has_abst z_init z_t_maxbed_koe_abst z_t_maxbed_ast_abst z_t_k0oeffnenbed_lau_abst z_t_maxbed_lau_abst z_svh_reset_zustand_abst z_t_maxbed_ksa_abst z_t_maxbed_sak_abst status_k0sreg_lau_abst z_t_maxbed_gab_abst z_gefabstbed_lau_abst st_ablauf_fkt_alt_abst z_k0_has_fkt_alt_abst ng_vm_gef_ast_abst t_ngsvm_ast_abst t_maxbed_ast_abst m_max_em_has_fkt m_min_em_has_fkt m_k0_mod_has_fkt m_soll_em_has_fkt m_soll_k0_has_fkt n_soll_em_has_fkt st_ablauf_fkt status_ablauf_has_fkt z_k0_has_fkt z_m_soll_em_has_fkt z_n_soll_em_has_fkt z_n_soll_vm_has_fkt z_zuendfreigabe_vm_has_fkt z_p_hys_k0_has_fkt n_soll_vm_has_fkt z_ablauf_has_stg z_ablaufvariante_has_stg n_em_in status_k0_in m_k0_in n_vm_in m_vm_in z_ablauf_has_hst_in m_soll_vm_hst_in status_kraftfluss_egs_in m_mot_in c_getriebe_egs_in m_em_in istgang_egs_in sollgang_egs_in nd_k0_in status_schaltung_egs_in ng_vm_in status_schaltart_svh_has_sbe m_soll_vm_l_hst_in status_sa_vm_in m_min_vm_in c_vm_in n_min_em_has_sbe z_lls_fktaktiv_has_sbe z_svh_has_sbe /end LOC_MEASUREMENT
 /begin SUB_FUNCTION SFOp_ABST48_Initialisierung SFOp_ABST43_Initialisierung SFOp_ABST36_Initialisierung Run_SFOp_ABST35_CL_PT1_ SFOp_ABST49_Initialisierung /end SUB_FUNCTION
/end FUNCTION
/begin FUNCTION SFOp_ABST203_Var_2 "" /begin DEF_CHARACTERISTIC MO_K0OEFFNENBED_LAU_ABST MS_K0OEFFNENBED_LAU_ABST /end DEF_CHARACTERISTIC
 /begin LOC_MEASUREMENT m_soll_vm_has_abst m_soll_vm_l_has_abst z_m_soll_vm_has_abst z_init z_t_maxbed_koe_abst z_t_maxbed_ast_abst z_t_k0oeffnenbed_lau_abst z_t_maxbed_lau_abst z_svh_reset_zustand_abst z_t_maxbed_ksa_abst z_t_maxbed_sak_abst status_k0sreg_lau_abst z_t_maxbed_gab_abst z_gefabstbed_lau_abst m_max_em_has_fkt m_min_em_has_fkt m_k0_mod_has_fkt m_soll_em_has_fkt m_soll_k0_has_fkt n_soll_em_has_fkt st_ablauf_fkt status_ablauf_has_fkt z_k0_has_fkt z_m_soll_em_has_fkt z_n_soll_em_has_fkt z_n_soll_vm_has_fkt z_zuendfreigabe_vm_has_fkt z_p_hys_k0_has_fkt n_soll_vm_has_fkt z_ablauf_has_stg z_ablaufvariante_has_stg n_em_in status_k0_in m_k0_in n_vm_in m_vm_in z_ablauf_has_hst_in m_soll_vm_hst_in status_kraftfluss_egs_in m_mot_in c_getriebe_egs_in m_em_in istgang_egs_in sollgang_egs_in nd_k0_in status_schaltung_egs_in ng_vm_in status_schaltart_svh_has_sbe m_soll_vm_l_hst_in status_sa_vm_in m_min_vm_in c_vm_in n_min_em_has_sbe z_lls_fktaktiv_has_sbe z_svh_has_sbe /end LOC_MEASUREMENT
/end FUNCTION
/begin FUNCTION SFOp_ABST206_Var_1 ""
 /begin LOC_MEASUREMENT m_soll_vm_has_abst m_soll_vm_l_has_abst z_m_soll_vm_has_abst z_init z_t_maxbed_koe_abst z_t_maxbed_ast_abst z_t_k0oeffnenbed_lau_abst z_t_maxbed_lau_abst z_svh_reset_zustand_abst z_t_maxbed_ksa_abst z_t_maxbed_sak_abst status_k0sreg_lau_abst z_t_maxbed_gab_abst z_gefabstbed_lau_abst m_max_em_has_fkt m_min_em_has_fkt m_k0_mod_has_fkt m_soll_em_has_fkt m_soll_k0_has_fkt n_soll_em_has_fkt st_ablauf_fkt status_ablauf_has_fkt z_k0_has_fkt z_m_soll_em_has_fkt z_n_soll_em_has_fkt z_n_soll_vm_has_fkt z_zuendfreigabe_vm_has_fkt z_p_hys_k0_has_fkt n_soll_vm_has_fkt z_ablauf_has_stg z_ablaufvariante_has_stg n_em_in status_k0_in m_k0_in n_vm_in m_vm_in z_ablauf_has_hst_in m_soll_vm_hst_in status_kraftfluss_egs_in m_mot_in c_getriebe_egs_in m_em_in istgang_egs_in sollgang_egs_in nd_k0_in status_schaltung_egs_in ng_vm_in status_schaltart_svh_has_sbe m_soll_vm_l_hst_in status_sa_vm_in m_min_vm_in c_vm_in n_min_em_has_sbe z_lls_fktaktiv_has_sbe z_svh_has_sbe /end LOC_MEASUREMENT
/end FUNCTION
/begin FUNCTION SFOp_ABST207_Var_2 "" /begin DEF_CHARACTERISTIC MO_K0OEFFNENBED_LAU_ABST MS_K0OEFFNENBED_LAU_ABST /end DEF_CHARACTERISTIC
 /begin LOC_MEASUREMENT m_soll_vm_has_abst m_soll_vm_l_has_abst z_m_soll_vm_has_abst z_init z_t_maxbed_koe_abst z_t_maxbed_ast_abst z_t_k0oeffnenbed_lau_abst z_t_maxbed_lau_abst z_svh_reset_zustand_abst z_t_maxbed_ksa_abst z_t_maxbed_sak_abst status_k0sreg_lau_abst z_t_maxbed_gab_abst z_gefabstbed_lau_abst m_max_em_has_fkt m_min_em_has_fkt m_k0_mod_has_fkt m_soll_em_has_fkt m_soll_k0_has_fkt n_soll_em_has_fkt st_ablauf_fkt status_ablauf_has_fkt z_k0_has_fkt z_m_soll_em_has_fkt z_n_soll_em_has_fkt z_n_soll_vm_has_fkt z_zuendfreigabe_vm_has_fkt z_p_hys_k0_has_fkt n_soll_vm_has_fkt z_ablauf_has_stg z_ablaufvariante_has_stg n_em_in status_k0_in m_k0_in n_vm_in m_vm_in z_ablauf_has_hst_in m_soll_vm_hst_in status_kraftfluss_egs_in m_mot_in c_getriebe_egs_in m_em_in istgang_egs_in sollgang_egs_in nd_k0_in status_schaltung_egs_in ng_vm_in status_schaltart_svh_has_sbe m_soll_vm_l_hst_in status_sa_vm_in m_min_vm_in c_vm_in n_min_em_has_sbe z_lls_fktaktiv_has_sbe z_svh_has_sbe /end LOC_MEASUREMENT
/end FUNCTION
/begin FUNCTION SFOp_ABST21_st_gef_abstellen_abst ""
 /begin DEF_CHARACTERISTIC KL_MSOLLK0ZIEL_GAB_ABST_Y KL_MSOLLK0ZIEL_GAB_ABST_X MG_SOLLK0NEG_GAB_ABST MG_SOLLK0POS_GAB_ABST MO_K0REGELN_GAB_ABST SWI_ZK0REGELN_LAU_ABST STATUS_ABL_GAB_ABST T_MAX_GAB_ABST /end DEF_CHARACTERISTIC
 /begin LOC_MEASUREMENT m_soll_vm_has_abst m_soll_vm_l_has_abst z_m_soll_vm_has_abst z_init z_t_maxbed_koe_abst z_t_maxbed_ast_abst z_t_k0oeffnenbed_lau_abst z_t_maxbed_lau_abst z_svh_reset_zustand_abst z_t_maxbed_ksa_abst z_t_maxbed_sak_abst status_k0sreg_lau_abst z_t_maxbed_gab_abst z_gefabstbed_lau_abst t_maxbed_gab_abst m_max_em_has_fkt m_min_em_has_fkt m_k0_mod_has_fkt m_soll_em_has_fkt m_soll_k0_has_fkt n_soll_em_has_fkt st_ablauf_fkt status_ablauf_has_fkt z_k0_has_fkt z_m_soll_em_has_fkt z_n_soll_em_has_fkt z_n_soll_vm_has_fkt z_zuendfreigabe_vm_has_fkt z_p_hys_k0_has_fkt n_soll_vm_has_fkt z_ablauf_has_stg z_ablaufvariante_has_stg n_em_in status_k0_in m_k0_in n_vm_in m_vm_in z_ablauf_has_hst_in m_soll_vm_hst_in status_kraftfluss_egs_in m_mot_in c_getriebe_egs_in m_em_in istgang_egs_in sollgang_egs_in nd_k0_in status_schaltung_egs_in ng_vm_in status_schaltart_svh_has_sbe m_soll_vm_l_hst_in status_sa_vm_in m_min_vm_in c_vm_in n_min_em_has_sbe z_lls_fktaktiv_has_sbe z_svh_has_sbe /end LOC_MEASUREMENT
 /begin SUB_FUNCTION SFOp_ABST54_Initialisierung Run_SFOp_ABST58_cLimiter_Gradient_MSollK0 SFOp_ABST64_Initialisierung Run_SFOp_ABST57_abs_fl32 Run_SFOp_ABST67_abs_fl32 /end SUB_FUNCTION
/end FUNCTION
/begin FUNCTION SFOp_ABST212_Bitwise_AND_ui8_ "" /begin DEF_CHARACTERISTIC K_SVH_RESET_LAU_ABST /end DEF_CHARACTERISTIC /begin LOC_MEASUREMENT status_schaltart_svh_has_sbe /end LOC_MEASUREMENT /end FUNCTION
/begin FUNCTION SFOp_ABST22_st_k0_oeffnen_abst ""
 /begin DEF_CHARACTERISTIC SWI_ZK0REGELN_LAU_ABST MO_K0REGELN_KOE_ABST T_MAX_KOE_ABST TAB_MGSOLLK0ABLVAR_KOE_ABST /end DEF_CHARACTERISTIC
 /begin LOC_MEASUREMENT m_soll_vm_has_abst m_soll_vm_l_has_abst z_m_soll_vm_has_abst z_init z_t_maxbed_koe_abst z_t_maxbed_ast_abst z_t_k0oeffnenbed_lau_abst z_t_maxbed_lau_abst z_svh_reset_zustand_abst z_t_maxbed_ksa_abst z_t_maxbed_sak_abst status_k0sreg_lau_abst z_t_maxbed_gab_abst z_gefabstbed_lau_abst t_maxbed_koe_abst m_max_em_has_fkt m_min_em_has_fkt m_k0_mod_has_fkt m_soll_em_has_fkt m_soll_k0_has_fkt n_soll_em_has_fkt st_ablauf_fkt status_ablauf_has_fkt z_k0_has_fkt z_m_soll_em_has_fkt z_n_soll_em_has_fkt z_n_soll_vm_has_fkt z_zuendfreigabe_vm_has_fkt z_p_hys_k0_has_fkt n_soll_vm_has_fkt z_ablauf_has_stg z_ablaufvariante_has_stg n_em_in status_k0_in m_k0_in n_vm_in m_vm_in z_ablauf_has_hst_in m_soll_vm_hst_in status_kraftfluss_egs_in m_mot_in c_getriebe_egs_in m_em_in istgang_egs_in sollgang_egs_in nd_k0_in status_schaltung_egs_in ng_vm_in status_schaltart_svh_has_sbe m_soll_vm_l_hst_in status_sa_vm_in m_min_vm_in c_vm_in n_min_em_has_sbe z_lls_fktaktiv_has_sbe z_svh_has_sbe /end LOC_MEASUREMENT
 /begin SUB_FUNCTION SFOp_ABST83_Initialisierung SFOp_ABST76_Initialisierung Run_SFOp_ABST79_cLimiter_Gradient_MSollK0 /end SUB_FUNCTION
/end FUNCTION
/begin FUNCTION SFOp_ABST23_st_k0_schliessen_abbruch_abst "" /begin DEF_CHARACTERISTIC T_MAX_KSA_ABST /end DEF_CHARACTERISTIC
 /begin LOC_MEASUREMENT m_soll_vm_has_abst m_soll_vm_l_has_abst z_m_soll_vm_has_abst z_init z_t_maxbed_koe_abst z_t_maxbed_ast_abst z_t_k0oeffnenbed_lau_abst z_t_maxbed_lau_abst z_svh_reset_zustand_abst z_t_maxbed_ksa_abst z_t_maxbed_sak_abst status_k0sreg_lau_abst z_t_maxbed_gab_abst z_gefabstbed_lau_abst t_maxbed_ksa_abst m_max_em_has_fkt m_min_em_has_fkt m_k0_mod_has_fkt m_soll_em_has_fkt m_soll_k0_has_fkt n_soll_em_has_fkt st_ablauf_fkt status_ablauf_has_fkt z_k0_has_fkt z_m_soll_em_has_fkt z_n_soll_em_has_fkt z_n_soll_vm_has_fkt z_zuendfreigabe_vm_has_fkt z_p_hys_k0_has_fkt n_soll_vm_has_fkt /end LOC_MEASUREMENT
 /begin SUB_FUNCTION SFOp_ABST92_Initialisierung SFOp_ABST93_Initialisierung /end SUB_FUNCTION
/end FUNCTION
/begin FUNCTION SFOp_ABST24_st_last_uebernahme_abst "" /begin DEF_CHARACTERISTIC T_MAX_LAU_ABST /end DEF_CHARACTERISTIC
 /begin LOC_MEASUREMENT m_soll_vm_has_abst m_soll_vm_l_has_abst z_m_soll_vm_has_abst z_init z_t_maxbed_koe_abst z_t_maxbed_ast_abst z_t_k0oeffnenbed_lau_abst z_t_maxbed_lau_abst z_svh_reset_zustand_abst z_t_maxbed_ksa_abst z_t_maxbed_sak_abst status_k0sreg_lau_abst z_t_maxbed_gab_abst z_gefabstbed_lau_abst status_sa_vm_lau_abst t_maxbed_lau_abst m_max_em_has_fkt m_min_em_has_fkt m_k0_mod_has_fkt m_soll_em_has_fkt m_soll_k0_has_fkt n_soll_em_has_fkt st_ablauf_fkt status_ablauf_has_fkt z_k0_has_fkt z_m_soll_em_has_fkt z_n_soll_em_has_fkt z_n_soll_vm_has_fkt z_zuendfreigabe_vm_has_fkt z_p_hys_k0_has_fkt n_soll_vm_has_fkt z_ablauf_has_stg z_ablaufvariante_has_stg n_em_in status_k0_in m_k0_in n_vm_in m_vm_in z_ablauf_has_hst_in m_soll_vm_hst_in status_kraftfluss_egs_in m_mot_in c_getriebe_egs_in m_em_in istgang_egs_in sollgang_egs_in nd_k0_in status_schaltung_egs_in ng_vm_in status_schaltart_svh_has_sbe m_soll_vm_l_hst_in status_sa_vm_in m_min_vm_in c_vm_in n_min_em_has_sbe z_lls_fktaktiv_has_sbe z_svh_has_sbe /end LOC_MEASUREMENT
 /begin SUB_FUNCTION SFOp_ABST105_Initialisierung SFOp_ABST104_Ansteuervariante_2 SFOp_ABST134_Initialisierung SFOp_ABST103_Ansteuervariante_1 SFOp_ABST133_Initialisierung SFOp_ABST129_Initialisierung /end SUB_FUNCTION
/end FUNCTION
/begin FUNCTION SFOp_ABST25_st_schaltung_aktiv_abst "" /begin DEF_CHARACTERISTIC M_K0MODMIN_SAK_ABST T_MAX_SAK_ABST K_SVH_RESET_SAK_ABST /end DEF_CHARACTERISTIC
 /begin LOC_MEASUREMENT m_soll_vm_has_abst m_soll_vm_l_has_abst z_m_soll_vm_has_abst z_init z_t_maxbed_koe_abst z_t_maxbed_ast_abst z_t_k0oeffnenbed_lau_abst z_t_maxbed_lau_abst z_svh_reset_zustand_abst z_t_maxbed_ksa_abst z_t_maxbed_sak_abst status_k0sreg_lau_abst z_t_maxbed_gab_abst z_gefabstbed_lau_abst t_maxbed_sak_abst m_max_em_has_fkt m_min_em_has_fkt m_k0_mod_has_fkt m_soll_em_has_fkt m_soll_k0_has_fkt n_soll_em_has_fkt st_ablauf_fkt status_ablauf_has_fkt z_k0_has_fkt z_m_soll_em_has_fkt z_n_soll_em_has_fkt z_n_soll_vm_has_fkt z_zuendfreigabe_vm_has_fkt z_p_hys_k0_has_fkt n_soll_vm_has_fkt z_ablauf_has_stg z_ablaufvariante_has_stg n_em_in status_k0_in m_k0_in n_vm_in m_vm_in z_ablauf_has_hst_in m_soll_vm_hst_in status_kraftfluss_egs_in m_mot_in c_getriebe_egs_in m_em_in istgang_egs_in sollgang_egs_in nd_k0_in status_schaltung_egs_in ng_vm_in status_schaltart_svh_has_sbe m_soll_vm_l_hst_in status_sa_vm_in m_min_vm_in c_vm_in n_min_em_has_sbe z_lls_fktaktiv_has_sbe z_svh_has_sbe /end LOC_MEASUREMENT
 /begin SUB_FUNCTION SFOp_ABST141_Initialisierung /end SUB_FUNCTION
/end FUNCTION
/begin FUNCTION SFOp_ABST26_st_start ""
 /begin LOC_MEASUREMENT m_soll_vm_has_abst m_soll_vm_l_has_abst z_m_soll_vm_has_abst z_init z_t_maxbed_koe_abst z_t_maxbed_ast_abst z_t_k0oeffnenbed_lau_abst z_t_maxbed_lau_abst z_svh_reset_zustand_abst z_t_maxbed_ksa_abst z_t_maxbed_sak_abst status_k0sreg_lau_abst z_t_maxbed_gab_abst z_gefabstbed_lau_abst m_max_em_has_fkt m_min_em_has_fkt m_k0_mod_has_fkt m_soll_em_has_fkt m_soll_k0_has_fkt n_soll_em_has_fkt st_ablauf_fkt status_ablauf_has_fkt z_k0_has_fkt z_m_soll_em_has_fkt z_n_soll_em_has_fkt z_n_soll_vm_has_fkt z_zuendfreigabe_vm_has_fkt z_p_hys_k0_has_fkt n_soll_vm_has_fkt z_ablauf_has_stg z_ablaufvariante_has_stg n_em_in status_k0_in m_k0_in n_vm_in m_vm_in z_ablauf_has_hst_in m_soll_vm_hst_in status_kraftfluss_egs_in m_mot_in c_getriebe_egs_in m_em_in istgang_egs_in sollgang_egs_in nd_k0_in status_schaltung_egs_in ng_vm_in status_schaltart_svh_has_sbe m_soll_vm_l_hst_in status_sa_vm_in m_min_vm_in c_vm_in n_min_em_has_sbe z_lls_fktaktiv_has_sbe z_svh_has_sbe /end LOC_MEASUREMENT
 /begin SUB_FUNCTION SFOp_ABST156_Initialisierung SFOp_ABST154_Initialisierung SFOp_ABST155_Initialisierung SFOp_ABST152_Initialisierung SFOp_ABST153_Initialisierung /end SUB_FUNCTION
/end FUNCTION
/begin FUNCTION SFOp_ABST27_st_uebergabe ""
 /begin LOC_MEASUREMENT m_soll_vm_has_abst m_soll_vm_l_has_abst z_m_soll_vm_has_abst z_init z_t_maxbed_koe_abst z_t_maxbed_ast_abst z_t_k0oeffnenbed_lau_abst z_t_maxbed_lau_abst z_svh_reset_zustand_abst z_t_maxbed_ksa_abst z_t_maxbed_sak_abst status_k0sreg_lau_abst z_t_maxbed_gab_abst z_gefabstbed_lau_abst m_max_em_has_fkt m_min_em_has_fkt m_k0_mod_has_fkt m_soll_em_has_fkt m_soll_k0_has_fkt n_soll_em_has_fkt st_ablauf_fkt status_ablauf_has_fkt z_k0_has_fkt z_m_soll_em_has_fkt z_n_soll_em_has_fkt z_n_soll_vm_has_fkt z_zuendfreigabe_vm_has_fkt z_p_hys_k0_has_fkt n_soll_vm_has_fkt /end LOC_MEASUREMENT
 /begin SUB_FUNCTION SFOp_ABST166_Initialisierung SFOp_ABST163_Initialisierung SFOp_ABST164_Initialisierung SFOp_ABST165_Initialisierung /end SUB_FUNCTION
/end FUNCTION
/begin FUNCTION SFOp_ABST28_st_uebergabe_abbruch_abst ""
 /begin LOC_MEASUREMENT m_soll_vm_has_abst m_soll_vm_l_has_abst z_m_soll_vm_has_abst z_init z_t_maxbed_koe_abst z_t_maxbed_ast_abst z_t_k0oeffnenbed_lau_abst z_t_maxbed_lau_abst z_svh_reset_zustand_abst z_t_maxbed_ksa_abst z_t_maxbed_sak_abst status_k0sreg_lau_abst z_t_maxbed_gab_abst z_gefabstbed_lau_abst m_max_em_has_fkt m_min_em_has_fkt m_k0_mod_has_fkt m_soll_em_has_fkt m_soll_k0_has_fkt n_soll_em_has_fkt st_ablauf_fkt status_ablauf_has_fkt z_k0_has_fkt z_m_soll_em_has_fkt z_n_soll_em_has_fkt z_n_soll_vm_has_fkt z_zuendfreigabe_vm_has_fkt z_p_hys_k0_has_fkt n_soll_vm_has_fkt /end LOC_MEASUREMENT
 /begin SUB_FUNCTION SFOp_ABST174_Initialisierung SFOp_ABST173_Initialisierung /end SUB_FUNCTION
/end FUNCTION
/begin FUNCTION SFOp_ABST36_Initialisierung "" /begin DEF_CHARACTERISTIC SWI_K0ANSTEUERUNG_AST_ABST /end DEF_CHARACTERISTIC
 /begin LOC_MEASUREMENT st_ablauf_fkt_alt_abst z_k0_has_fkt_alt_abst m_k0_mod_has_fkt m_soll_k0_has_fkt z_p_hys_k0_has_fkt z_ablauf_has_stg z_ablaufvariante_has_stg n_em_in status_k0_in m_k0_in n_vm_in m_vm_in z_ablauf_has_hst_in m_soll_vm_hst_in status_kraftfluss_egs_in m_mot_in c_getriebe_egs_in m_em_in istgang_egs_in sollgang_egs_in nd_k0_in status_schaltung_egs_in ng_vm_in status_schaltart_svh_has_sbe m_soll_vm_l_hst_in status_sa_vm_in m_min_vm_in c_vm_in n_min_em_has_sbe z_lls_fktaktiv_has_sbe z_svh_has_sbe /end LOC_MEASUREMENT
/end FUNCTION
/begin FUNCTION SFOp_ABST4_CalcFcn ""
 /begin LOC_MEASUREMENT m_soll_vm_has_abst m_soll_vm_l_has_abst z_m_soll_vm_has_abst z_init z_t_maxbed_koe_abst z_t_maxbed_ast_abst z_t_k0oeffnenbed_lau_abst z_t_maxbed_lau_abst z_svh_reset_zustand_abst z_t_maxbed_ksa_abst z_t_maxbed_sak_abst status_k0sreg_lau_abst z_t_maxbed_gab_abst z_gefabstbed_lau_abst st_ablauf_fkt_alt_abst z_k0_has_fkt_alt_abst m_max_em_has_fkt m_min_em_has_fkt m_k0_mod_has_fkt m_soll_em_has_fkt m_soll_k0_has_fkt n_soll_em_has_fkt st_ablauf_fkt status_ablauf_has_fkt z_k0_has_fkt z_m_soll_em_has_fkt z_n_soll_em_has_fkt z_n_soll_vm_has_fkt z_zuendfreigabe_vm_has_fkt z_p_hys_k0_has_fkt n_soll_vm_has_fkt z_ablauf_has_stg z_ablaufvariante_has_stg n_em_in status_k0_in m_k0_in n_vm_in m_vm_in z_ablauf_has_hst_in m_soll_vm_hst_in status_kraftfluss_egs_in m_mot_in c_getriebe_egs_in m_em_in istgang_egs_in sollgang_egs_in nd_k0_in status_schaltung_egs_in ng_vm_in status_schaltart_svh_has_sbe m_soll_vm_l_hst_in status_sa_vm_in m_min_vm_in c_vm_in n_min_em_has_sbe z_lls_fktaktiv_has_sbe z_svh_has_sbe /end LOC_MEASUREMENT
 /begin SUB_FUNCTION SFOp_ABST24_st_last_uebernahme_abst SFOp_ABST21_st_gef_abstellen_abst SFOp_ABST20_st_abstellen_abst SFOp_ABST22_st_k0_oeffnen_abst SFOp_ABST23_st_k0_schliessen_abbruch_abst SFOp_ABST25_st_schaltung_aktiv_abst SFOp_ABST26_st_start SFOp_ABST27_st_uebergabe SFOp_ABST28_st_uebergabe_abbruch_abst /end SUB_FUNCTION
/end FUNCTION
/begin FUNCTION SFOp_ABST43_Initialisierung ""
 /begin DEF_CHARACTERISTIC STATUS_ABL_AST_ABST STATUS_ABL_GEFABST_AST_ABST T_MAX_AST_ABST T_MAX_GEFABST_AST_ABST /end DEF_CHARACTERISTIC
 /begin LOC_MEASUREMENT m_soll_vm_has_abst m_soll_vm_l_has_abst z_m_soll_vm_has_abst z_init z_t_maxbed_koe_abst z_t_maxbed_ast_abst z_t_k0oeffnenbed_lau_abst z_t_maxbed_lau_abst z_svh_reset_zustand_abst z_t_maxbed_ksa_abst z_t_maxbed_sak_abst status_k0sreg_lau_abst z_t_maxbed_gab_abst z_gefabstbed_lau_abst m_max_em_has_fkt m_min_em_has_fkt m_k0_mod_has_fkt m_soll_em_has_fkt m_soll_k0_has_fkt n_soll_em_has_fkt st_ablauf_fkt status_ablauf_has_fkt z_k0_has_fkt z_m_soll_em_has_fkt z_n_soll_em_has_fkt z_n_soll_vm_has_fkt z_zuendfreigabe_vm_has_fkt z_p_hys_k0_has_fkt n_soll_vm_has_fkt /end LOC_MEASUREMENT
/end FUNCTION
/begin FUNCTION SFOp_ABST48_Initialisierung "" /begin DEF_CHARACTERISTIC KL_KSVHRESET_AST_ABST_Y KL_KSVHRESET_AST_ABST_X /end DEF_CHARACTERISTIC /begin LOC_MEASUREMENT z_svh_reset_zustand_abst istgang_egs_in /end LOC_MEASUREMENT /end FUNCTION
/begin FUNCTION SFOp_ABST49_Initialisierung "" /begin LOC_MEASUREMENT z_zuendfreigabe_vm_has_fkt /end LOC_MEASUREMENT /end FUNCTION
/begin FUNCTION SFOp_ABST54_Initialisierung "" /begin DEF_CHARACTERISTIC M_K0MODHAS_ZIEL_LAU_ABST /end DEF_CHARACTERISTIC /begin LOC_MEASUREMENT m_k0_mod_has_fkt z_k0_has_fkt z_p_hys_k0_has_fkt /end LOC_MEASUREMENT /end FUNCTION
/begin FUNCTION SFOp_ABST6_Input ""
 /begin LOC_MEASUREMENT m_soll_vm_has_abst m_soll_vm_l_has_abst z_m_soll_vm_has_abst z_init z_t_maxbed_koe_abst z_t_maxbed_ast_abst z_t_k0oeffnenbed_lau_abst z_t_maxbed_lau_abst z_svh_reset_zustand_abst z_t_maxbed_ksa_abst z_t_maxbed_sak_abst status_k0sreg_lau_abst z_t_maxbed_gab_abst z_gefabstbed_lau_abst st_ablauf_fkt_alt_abst z_k0_has_fkt_alt_abst m_max_em_has_fkt m_min_em_has_fkt m_k0_mod_has_fkt m_soll_em_has_fkt m_soll_k0_has_fkt n_soll_em_has_fkt st_ablauf_fkt status_ablauf_has_fkt z_k0_has_fkt z_m_soll_em_has_fkt z_n_soll_em_has_fkt z_n_soll_vm_has_fkt z_zuendfreigabe_vm_has_fkt z_p_hys_k0_has_fkt z_ponr_fkt z_ablauf_svh_reset_has_fkt m_max_iae_has_fkt m_soll_res_em_has_fkt mg_soll_k0_has_fkt n_soll_vm_has_fkt nd_min_saf_has_fkt nd_soll_iae_fkt z_ablaufvariante_kalt_zus z_emaktiv_fuw_zus_fkt z_fehler15_eh_fkt z_k0_befuellopt_has_fkt z_m_max_iae_has_fkt z_respschlepp_sas_fkt z_saf_has_fkt z_sbe_has_fkt z_zuendfreigabe_vm_fkt z_hybfkt_stg st_ziel_bz_has_stg st_ist_bz_has_stg st_ist_hcomd_has_stg z_ablauf_has_stg z_ablaufvariante_has_stg n_em_in status_k0_in m_k0_in n_vm_in m_vm_in z_ablauf_has_hst_in m_soll_vm_hst_in status_kraftfluss_egs_in m_mot_in c_getriebe_egs_in m_em_in istgang_egs_in sollgang_egs_in z_modus_em_hst_in m_iae_in m_max_dyn_em_in m_soll_em_hst_in m_vm_start_in m_wunsch_fpw_in n_ab_egs_in n_soll_ll_vm_in n_t_egs_in osmode_next_in p_bremse_fzg_in status_fehler_iep_in status_iae_in status_iep_in pos_egs_in z_ablaufvariante_has_hst_in zielgang_egs_in z_k0_fst_in status_iae_adap_in z_diag_ersfkt_has_in z_diag_ersfkt_hi_has_in z_diag_notgang_has_in status_k0_adap_in status_waschstr_in z_n_min_em_parksp_has_in n_mot_soll_iae_in status_alaengs_adaoff_in gangwechsel_egs_in z_nllsoll_iae_in status_nem_in status_nvm_in kolbenpos_k0_in z_kps_stada_in t_betrieb_pvu_has_ee_in status_ll_vm_in z_msa_fst_in m_min_dyn_em_in phi_neigung_in v_f_in drehrichtung_nem_in fpw_in drehrichtung_nab_in schalt_mode_egs_in m_ziel_k0_hst_in status_kraftfluss_lev2_egs_in i_gang_lev2_egs_in status_c_k0_in bremspedal_in status_autohold_in status_hillhold_in status_vf_in v_f_ref_in status_vfref_in z_diag_ersfkt_hi_96_has_in status_k0_adap_zaehler_in status_k0_befuellung_in z_oea_hst_in z_iep_in z_nllsoll_iep_in nd_k0_in status_schaltung_egs_in ng_vm_in status_schaltart_svh_has_sbe i_istgang_egs i_zielgang_egs m_wunsch_fpw_hst_fil mg_wunsch_fpw_in mg_wunsch_fpw_hst_in n_sec_iae ndg_k0_in n_min_em_psys_lp3_has_sbe status_psys_has_sbe vg_f_sbe v_f_sbe status_sync_schaltung_sbe z_pvu_has_sbe z_freigabe_pvu_has_sbe t_betrieb_pvu_has_sbe mg_mot_in status_radschlupf_rse_has_sbe m_soll_vm_l_hst_in status_sa_vm_in m_min_vm_in c_vm_in n_soll_em_hst_in abstellpos_vm_in abstellpos_vm_status_in status_nreg_em_hst_in z_msa_stada_in m_wunsch_fpw_hst_in status_getrbereit_in status_betriebsbereit_hst_in z_ba_has_vm_hst_in z_ba_has_k0_hst_in status_abs_in status_asr_in modus_e_fahren_hst_in status_kl15_in status_posvueb_in soc_in status_soc_in c_umgebung_in status_cumgebung_in n_min_em_has_sbe z_lls_fktaktiv_has_sbe z_svh_has_sbe m_motmax_has_sbe z_k0_has_sbe m_soll_res_em_has_sbe m_soll_res_em_bas_sbe z_modus_iae_has_sbe z_sas_has_sbe z_modus_iep_has_sbe z_msa_has_sbe status_efahren_has_sbe z_msa_avh_moni_has_sbe z_msa_eaf_moni_has_sbe z_start_modus_has_sbe m_k0_mber_has_sbe z_status_psys_mps_sbe m_k0_has_sbe m_soll_k0_has_sbe analyse_has_sbe z_nminemmodus_has_sbe /end LOC_MEASUREMENT
/end FUNCTION
/begin FUNCTION SFOp_ABST64_Initialisierung "" /begin LOC_MEASUREMENT st_ablauf_fkt /end LOC_MEASUREMENT /end FUNCTION
/begin FUNCTION SFOp_ABST7_Output ""
 /begin LOC_MEASUREMENT m_soll_vm_has_abst m_soll_vm_l_has_abst z_m_soll_vm_has_abst z_init z_t_maxbed_koe_abst z_t_maxbed_ast_abst z_t_k0oeffnenbed_lau_abst z_t_maxbed_lau_abst z_svh_reset_zustand_abst z_t_maxbed_ksa_abst z_t_maxbed_sak_abst status_k0sreg_lau_abst z_t_maxbed_gab_abst z_gefabstbed_lau_abst m_max_em_has_fkt m_min_em_has_fkt m_k0_mod_has_fkt m_soll_em_has_fkt m_soll_k0_has_fkt n_soll_em_has_fkt st_ablauf_fkt status_ablauf_has_fkt z_k0_has_fkt z_m_soll_em_has_fkt z_n_soll_em_has_fkt z_n_soll_vm_has_fkt z_zuendfreigabe_vm_has_fkt z_p_hys_k0_has_fkt z_ponr_fkt z_ablauf_svh_reset_has_fkt n_soll_vm_has_fkt z_ablauf_has_stg z_ablaufvariante_has_stg n_em_in status_k0_in m_k0_in n_vm_in m_vm_in z_ablauf_has_hst_in m_soll_vm_hst_in status_kraftfluss_egs_in m_mot_in c_getriebe_egs_in m_em_in istgang_egs_in sollgang_egs_in nd_k0_in status_schaltung_egs_in ng_vm_in status_schaltart_svh_has_sbe m_soll_vm_l_hst_in status_sa_vm_in m_min_vm_in c_vm_in n_min_em_has_sbe z_lls_fktaktiv_has_sbe z_svh_has_sbe /end LOC_MEASUREMENT
 /begin SUB_FUNCTION SFOp_ABST180_Schaltungsbeeinflussung /end SUB_FUNCTION
/end FUNCTION
/begin FUNCTION SFOp_ABST76_Initialisierung "" /begin DEF_CHARACTERISTIC M_K0MODHAS_ZIEL_LAU_ABST /end DEF_CHARACTERISTIC /begin LOC_MEASUREMENT m_k0_mod_has_fkt z_k0_has_fkt z_p_hys_k0_has_fkt /end LOC_MEASUREMENT /end FUNCTION
/begin FUNCTION SFOp_ABST8_PhaseControl ""
 /begin DEF_CHARACTERISTIC KF_NSEMBED_GAB_ABST_W KF_NSEMBED_GAB_ABST_X KF_NSEMBED_GAB_ABST_Y BM_LLSGABBED_LAU_ABST NS_MINEMGABBED_LAU_ABST Z_ABLAUFVARIANTE_GEFABST_ABST K_SVH_RESET_LAU_ABST SWI_ABBRUCH_AKTIV_ABST MS_K0VMABSTBED_KOE_ABST NDS_K0VMABSTBED_KOE_ABST NS_EMMINBED_KOE_ABST MO_VMK0ZUBED_KSA_ABST Z_ABLAUFVARIANTE_K0SOEF_ABST NS_EMMINBED_LAU_ABST NS_EMMINBED_SAK_ABST MS_K0BED_AST_ABST NS_VMAUSBED_AST_ABST /end DEF_CHARACTERISTIC
 /begin LOC_MEASUREMENT m_soll_vm_has_abst m_soll_vm_l_has_abst z_m_soll_vm_has_abst z_init z_t_maxbed_koe_abst z_t_maxbed_ast_abst z_t_k0oeffnenbed_lau_abst z_t_maxbed_lau_abst z_svh_reset_zustand_abst z_t_maxbed_ksa_abst z_t_maxbed_sak_abst status_k0sreg_lau_abst z_t_maxbed_gab_abst z_gefabstbed_lau_abst m_max_em_has_fkt m_min_em_has_fkt m_k0_mod_has_fkt m_soll_em_has_fkt m_soll_k0_has_fkt n_soll_em_has_fkt st_ablauf_fkt status_ablauf_has_fkt z_k0_has_fkt z_m_soll_em_has_fkt z_n_soll_em_has_fkt z_n_soll_vm_has_fkt z_zuendfreigabe_vm_has_fkt z_p_hys_k0_has_fkt n_soll_vm_has_fkt z_ablauf_has_stg z_ablaufvariante_has_stg n_em_in status_k0_in m_k0_in n_vm_in m_vm_in z_ablauf_has_hst_in m_soll_vm_hst_in status_kraftfluss_egs_in m_mot_in c_getriebe_egs_in m_em_in istgang_egs_in sollgang_egs_in nd_k0_in status_schaltung_egs_in ng_vm_in status_schaltart_svh_has_sbe m_soll_vm_l_hst_in status_sa_vm_in m_min_vm_in c_vm_in n_min_em_has_sbe z_lls_fktaktiv_has_sbe z_svh_has_sbe /end LOC_MEASUREMENT
 /begin SUB_FUNCTION SFOp_ABST203_Var_2 SFOp_ABST206_Var_1 SFOp_ABST207_Var_2 Run_SFOp_ABST199_abs_fl32 SFOp_ABST212_Bitwise_AND_ui8_ SFOp_ABST196_Bitwise_AND_ui32_ /end SUB_FUNCTION
/end FUNCTION
/begin FUNCTION SFOp_ABST83_Initialisierung "" /begin DEF_CHARACTERISTIC STATUS_ABL_AST_ABST STATUS_ABL_KOE_ABST /end DEF_CHARACTERISTIC
 /begin LOC_MEASUREMENT m_soll_vm_has_abst m_soll_vm_l_has_abst z_m_soll_vm_has_abst z_init z_t_maxbed_koe_abst z_t_maxbed_ast_abst z_t_k0oeffnenbed_lau_abst z_t_maxbed_lau_abst z_svh_reset_zustand_abst z_t_maxbed_ksa_abst z_t_maxbed_sak_abst status_k0sreg_lau_abst z_t_maxbed_gab_abst z_gefabstbed_lau_abst m_max_em_has_fkt m_min_em_has_fkt m_k0_mod_has_fkt m_soll_em_has_fkt m_soll_k0_has_fkt n_soll_em_has_fkt st_ablauf_fkt status_ablauf_has_fkt z_k0_has_fkt z_m_soll_em_has_fkt z_n_soll_em_has_fkt z_n_soll_vm_has_fkt z_zuendfreigabe_vm_has_fkt z_p_hys_k0_has_fkt n_soll_vm_has_fkt /end LOC_MEASUREMENT
/end FUNCTION
/begin FUNCTION SFOp_ABST92_Initialisierung "" /begin DEF_CHARACTERISTIC SWI_ZPHYSK0_KSA_ABST /end DEF_CHARACTERISTIC /begin LOC_MEASUREMENT m_soll_k0_has_fkt z_k0_has_fkt z_p_hys_k0_has_fkt /end LOC_MEASUREMENT /end FUNCTION
/begin FUNCTION SFOp_ABST93_Initialisierung "" /begin LOC_MEASUREMENT st_ablauf_fkt status_ablauf_has_fkt /end LOC_MEASUREMENT /end FUNCTION
/begin FUNCTION SFOp_NOS109_Conditions ""
 /begin DEF_CHARACTERISTIC NS_EMMINBED_SCL_NOS SWI_ABBRUCH_AKTIV_NOS MS_K0_ABB_NOS NS_EMMINBED_NST_NOS /end DEF_CHARACTERISTIC
 /begin LOC_MEASUREMENT z_t_ndsk0_nst_nos z_t_max_nst_nos z_t_max_scl_nos z_init_nos z_t_max_abb_nos st_ablauf_fkt status_ablauf_has_fkt z_p_hys_k0_has_fkt z_k0_has_fkt m_soll_k0_has_fkt m_k0_mod_has_fkt z_zuendfreigabe_vm_has_fkt z_ablauf_has_stg status_k0_in m_k0_in n_vm_in n_em_in status_psys_has_sbe nd_k0_in /end LOC_MEASUREMENT
/end FUNCTION
/begin FUNCTION SFOp_NOS18_st_k0schliessen_nos "" /begin DEF_CHARACTERISTIC T_MAX_SCL_NOS /end DEF_CHARACTERISTIC
 /begin LOC_MEASUREMENT z_t_ndsk0_nst_nos z_t_max_nst_nos z_t_max_scl_nos z_init_nos z_t_max_abb_nos t_max_scl_nos st_ablauf_fkt status_ablauf_has_fkt z_p_hys_k0_has_fkt z_k0_has_fkt m_soll_k0_has_fkt m_k0_mod_has_fkt z_zuendfreigabe_vm_has_fkt z_ablauf_has_stg status_k0_in m_k0_in n_vm_in n_em_in status_psys_has_sbe nd_k0_in /end LOC_MEASUREMENT
 /begin SUB_FUNCTION SFOp_NOS32_Initialisierung SFOp_NOS30_Initialisierung SFOp_NOS29_VM_Ansteuerung /end SUB_FUNCTION
/end FUNCTION
/begin FUNCTION SFOp_NOS19_st_konditionieren_nos ""
 /begin LOC_MEASUREMENT z_t_ndsk0_nst_nos z_t_max_nst_nos z_t_max_scl_nos z_init_nos z_t_max_abb_nos st_ablauf_fkt status_ablauf_has_fkt z_p_hys_k0_has_fkt z_k0_has_fkt m_soll_k0_has_fkt m_k0_mod_has_fkt z_zuendfreigabe_vm_has_fkt z_ablauf_has_stg status_k0_in m_k0_in n_vm_in n_em_in status_psys_has_sbe nd_k0_in /end LOC_MEASUREMENT
 /begin SUB_FUNCTION SFOp_NOS39_Phasenablaufsteuerung SFOp_NOS41_Initialisierung SFOp_NOS40_VM_Ansteuerung /end SUB_FUNCTION
/end FUNCTION
/begin FUNCTION SFOp_NOS20_st_notstart_abbruch_nos "" /begin DEF_CHARACTERISTIC MG_SOLLK0_ABB_NOS T_MAX_ABB_NOS /end DEF_CHARACTERISTIC
 /begin LOC_MEASUREMENT z_t_ndsk0_nst_nos z_t_max_nst_nos z_t_max_scl_nos z_init_nos z_t_max_abb_nos t_max_abb_nos st_ablauf_fkt status_ablauf_has_fkt z_p_hys_k0_has_fkt z_k0_has_fkt m_soll_k0_has_fkt m_k0_mod_has_fkt z_zuendfreigabe_vm_has_fkt z_ablauf_has_stg status_k0_in m_k0_in n_vm_in n_em_in status_psys_has_sbe nd_k0_in /end LOC_MEASUREMENT
 /begin SUB_FUNCTION SFOp_NOS54_Initialisierung SFOp_NOS48_Initialisierung Run_SFOp_NOS50_cLimiter_Gradient_MSollK0 /end SUB_FUNCTION
/end FUNCTION
/begin FUNCTION SFOp_NOS21_st_notstarten_nos ""
 /begin DEF_CHARACTERISTIC MG_K0SOLL1_NST_NOS MG_K0SOLL2_NST_NOS M_SOLLK0INI_NST_NOS M_SOLLK0ZIEL1_NOS M_SOLLK0ZIEL2_NOS NDS_K0_NST_NOS NS_VM_UMS_NST_NOS T_NDSK0_NST_NOS T_UMS_NST_NOS T_MAX_NST_NOS /end DEF_CHARACTERISTIC
 /begin LOC_MEASUREMENT z_t_ndsk0_nst_nos z_t_max_nst_nos z_t_max_scl_nos z_init_nos z_t_max_abb_nos m_soll_k0_ziel_nos t_ndsk0_nst_nos t_ums_nst_nos t_max_nst_nos st_ablauf_fkt status_ablauf_has_fkt z_p_hys_k0_has_fkt z_k0_has_fkt m_soll_k0_has_fkt m_k0_mod_has_fkt z_zuendfreigabe_vm_has_fkt z_ablauf_has_stg status_k0_in m_k0_in n_vm_in n_em_in status_psys_has_sbe nd_k0_in /end LOC_MEASUREMENT
 /begin SUB_FUNCTION SFOp_NOS78_Initialisierung SFOp_NOS63_Initialisierung Run_SFOp_NOS67_cLimiter_m_soll_k0_has SFOp_NOS62_VM_Ansteuerung Run_SFOp_NOS66_abs_fl32 /end SUB_FUNCTION
/end FUNCTION
/begin FUNCTION SFOp_NOS22_st_start_nos ""
 /begin LOC_MEASUREMENT z_t_ndsk0_nst_nos z_t_max_nst_nos z_t_max_scl_nos z_init_nos z_t_max_abb_nos st_ablauf_fkt status_ablauf_has_fkt z_p_hys_k0_has_fkt z_k0_has_fkt m_soll_k0_has_fkt m_k0_mod_has_fkt z_zuendfreigabe_vm_has_fkt /end LOC_MEASUREMENT
 /begin SUB_FUNCTION SFOp_NOS83_st_start /end SUB_FUNCTION
/end FUNCTION
/begin FUNCTION SFOp_NOS23_st_uebergabe_nos ""
 /begin LOC_MEASUREMENT z_t_ndsk0_nst_nos z_t_max_nst_nos z_t_max_scl_nos z_init_nos z_t_max_abb_nos st_ablauf_fkt status_ablauf_has_fkt z_p_hys_k0_has_fkt z_k0_has_fkt m_soll_k0_has_fkt m_k0_mod_has_fkt z_zuendfreigabe_vm_has_fkt z_ablauf_has_stg status_k0_in m_k0_in n_vm_in n_em_in status_psys_has_sbe nd_k0_in /end LOC_MEASUREMENT
 /begin SUB_FUNCTION SFOp_NOS87_Phasenablaufsteuerung SFOp_NOS89_Initialisierung SFOp_NOS88_VM_Ansteuerung /end SUB_FUNCTION
/end FUNCTION
/begin FUNCTION SFOp_NOS24_st_uebergabe_notstart_abbruch_nos ""
 /begin LOC_MEASUREMENT z_t_ndsk0_nst_nos z_t_max_nst_nos z_t_max_scl_nos z_init_nos z_t_max_abb_nos st_ablauf_fkt status_ablauf_has_fkt z_p_hys_k0_has_fkt z_k0_has_fkt m_soll_k0_has_fkt m_k0_mod_has_fkt z_zuendfreigabe_vm_has_fkt z_ablauf_has_stg status_k0_in m_k0_in n_vm_in n_em_in status_psys_has_sbe nd_k0_in /end LOC_MEASUREMENT
 /begin SUB_FUNCTION SFOp_NOS94_Phasenablaufsteuerung SFOp_NOS95_Initialisierung /end SUB_FUNCTION
/end FUNCTION
/begin FUNCTION SFOp_NOS29_VM_Ansteuerung "" /begin LOC_MEASUREMENT z_zuendfreigabe_vm_has_fkt /end LOC_MEASUREMENT /end FUNCTION
/begin FUNCTION SFOp_NOS30_Initialisierung "" /begin DEF_CHARACTERISTIC SWI_ZPHYSK0_SCL_NOS /end DEF_CHARACTERISTIC /begin LOC_MEASUREMENT z_p_hys_k0_has_fkt m_soll_k0_has_fkt /end LOC_MEASUREMENT /end FUNCTION
/begin FUNCTION SFOp_NOS32_Initialisierung "" /begin DEF_CHARACTERISTIC STATUS_ABL_SCL_NOS /end DEF_CHARACTERISTIC /begin LOC_MEASUREMENT st_ablauf_fkt status_ablauf_has_fkt /end LOC_MEASUREMENT /end FUNCTION
/begin FUNCTION SFOp_NOS39_Phasenablaufsteuerung "" /begin DEF_CHARACTERISTIC STATUS_ABL_KON_NOS /end DEF_CHARACTERISTIC /begin LOC_MEASUREMENT st_ablauf_fkt status_ablauf_has_fkt /end LOC_MEASUREMENT /end FUNCTION
/begin FUNCTION SFOp_NOS4_CalcFcn ""
 /begin LOC_MEASUREMENT z_t_ndsk0_nst_nos z_t_max_nst_nos z_t_max_scl_nos z_init_nos z_t_max_abb_nos st_ablauf_fkt status_ablauf_has_fkt z_p_hys_k0_has_fkt z_k0_has_fkt m_soll_k0_has_fkt m_k0_mod_has_fkt z_zuendfreigabe_vm_has_fkt z_ablauf_has_stg status_k0_in m_k0_in n_vm_in n_em_in status_psys_has_sbe nd_k0_in /end LOC_MEASUREMENT
 /begin SUB_FUNCTION SFOp_NOS18_st_k0schliessen_nos SFOp_NOS19_st_konditionieren_nos SFOp_NOS20_st_notstart_abbruch_nos SFOp_NOS21_st_notstarten_nos SFOp_NOS22_st_start_nos SFOp_NOS23_st_uebergabe_nos SFOp_NOS24_st_uebergabe_notstart_abbruch_nos /end SUB_FUNCTION
/end FUNCTION
/begin FUNCTION SFOp_NOS40_VM_Ansteuerung "" /begin LOC_MEASUREMENT z_zuendfreigabe_vm_has_fkt /end LOC_MEASUREMENT /end FUNCTION
/begin FUNCTION SFOp_NOS41_Initialisierung "" /begin DEF_CHARACTERISTIC SWI_ZPHYSK0_KON_NOS /end DEF_CHARACTERISTIC /begin LOC_MEASUREMENT z_p_hys_k0_has_fkt /end LOC_MEASUREMENT /end FUNCTION
/begin FUNCTION SFOp_NOS48_Initialisierung "" /begin DEF_CHARACTERISTIC SWI_ZPHYSK0_ABB_NOS /end DEF_CHARACTERISTIC /begin LOC_MEASUREMENT z_p_hys_k0_has_fkt /end LOC_MEASUREMENT /end FUNCTION
/begin FUNCTION SFOp_NOS54_Initialisierung "" /begin LOC_MEASUREMENT st_ablauf_fkt status_ablauf_has_fkt /end LOC_MEASUREMENT /end FUNCTION
/begin FUNCTION SFOp_NOS6_Input ""
 /begin LOC_MEASUREMENT z_t_ndsk0_nst_nos z_t_max_nst_nos z_t_max_scl_nos z_init_nos z_t_max_abb_nos st_ablauf_fkt status_ablauf_has_fkt z_p_hys_k0_has_fkt z_k0_has_fkt m_soll_k0_has_fkt m_k0_mod_has_fkt z_zuendfreigabe_vm_has_fkt z_hybfkt_stg st_ziel_bz_has_stg st_ist_bz_has_stg st_ist_hcomd_has_stg z_ablauf_has_stg z_ablaufvariante_has_stg status_k0_in m_k0_in n_vm_in n_em_in z_modus_em_hst_in c_getriebe_egs_in istgang_egs_in m_em_in m_iae_in m_max_dyn_em_in m_soll_em_hst_in m_soll_vm_hst_in m_vm_in m_vm_start_in m_wunsch_fpw_in n_ab_egs_in n_soll_ll_vm_in n_t_egs_in osmode_next_in p_bremse_fzg_in sollgang_egs_in status_fehler_iep_in status_iae_in status_iep_in pos_egs_in z_ablauf_has_hst_in z_ablaufvariante_has_hst_in zielgang_egs_in z_k0_fst_in m_mot_in status_iae_adap_in z_diag_ersfkt_has_in z_diag_ersfkt_hi_has_in z_diag_notgang_has_in status_k0_adap_in status_waschstr_in status_kraftfluss_egs_in z_n_min_em_parksp_has_in n_mot_soll_iae_in status_alaengs_adaoff_in gangwechsel_egs_in z_nllsoll_iae_in status_nem_in status_nvm_in kolbenpos_k0_in z_kps_stada_in t_betrieb_pvu_has_ee_in status_ll_vm_in z_msa_fst_in m_min_dyn_em_in phi_neigung_in v_f_in drehrichtung_nem_in fpw_in drehrichtung_nab_in schalt_mode_egs_in m_ziel_k0_hst_in status_kraftfluss_lev2_egs_in i_gang_lev2_egs_in status_c_k0_in bremspedal_in status_autohold_in status_hillhold_in status_vf_in v_f_ref_in status_vfref_in z_diag_ersfkt_hi_96_has_in status_k0_adap_zaehler_in status_k0_befuellung_in z_oea_hst_in z_iep_in z_nllsoll_iep_in status_psys_has_sbe nd_k0_in i_istgang_egs i_zielgang_egs m_wunsch_fpw_hst_fil mg_wunsch_fpw_in mg_wunsch_fpw_hst_in n_sec_iae ndg_k0_in ng_vm_in status_schaltung_egs_in n_min_em_psys_lp3_has_sbe vg_f_sbe v_f_sbe status_sync_schaltung_sbe z_pvu_has_sbe z_freigabe_pvu_has_sbe t_betrieb_pvu_has_sbe mg_mot_in status_radschlupf_rse_has_sbe status_schaltart_svh_has_sbe c_vm_in n_soll_em_hst_in abstellpos_vm_in abstellpos_vm_status_in status_nreg_em_hst_in m_min_vm_in m_soll_vm_l_hst_in z_msa_stada_in m_wunsch_fpw_hst_in status_getrbereit_in /end LOC_MEASUREMENT
/end FUNCTION
/begin FUNCTION SFOp_NOS62_VM_Ansteuerung "" /begin LOC_MEASUREMENT z_zuendfreigabe_vm_has_fkt /end LOC_MEASUREMENT /end FUNCTION
/begin FUNCTION SFOp_NOS63_Initialisierung "" /begin DEF_CHARACTERISTIC SWI_ZPHYSK0_NST_NOS /end DEF_CHARACTERISTIC /begin LOC_MEASUREMENT z_p_hys_k0_has_fkt z_k0_has_fkt /end LOC_MEASUREMENT /end FUNCTION
/begin FUNCTION SFOp_NOS7_Output ""
 /begin LOC_MEASUREMENT z_t_ndsk0_nst_nos z_t_max_nst_nos z_t_max_scl_nos z_init_nos z_t_max_abb_nos st_ablauf_fkt status_ablauf_has_fkt z_p_hys_k0_has_fkt z_zuendfreigabe_vm_fkt z_k0_has_fkt m_soll_k0_has_fkt m_k0_mod_has_fkt z_zuendfreigabe_vm_has_fkt /end LOC_MEASUREMENT
/end FUNCTION
/begin FUNCTION SFOp_NOS78_Initialisierung "" /begin DEF_CHARACTERISTIC STATUS_ABL_NST_NOS /end DEF_CHARACTERISTIC /begin LOC_MEASUREMENT st_ablauf_fkt status_ablauf_has_fkt /end LOC_MEASUREMENT /end FUNCTION
/begin FUNCTION SFOp_NOS8_PhaseControl ""
 /begin LOC_MEASUREMENT z_t_ndsk0_nst_nos z_t_max_nst_nos z_t_max_scl_nos z_init_nos z_t_max_abb_nos st_ablauf_fkt status_ablauf_has_fkt z_p_hys_k0_has_fkt z_k0_has_fkt m_soll_k0_has_fkt m_k0_mod_has_fkt z_zuendfreigabe_vm_has_fkt z_ablauf_has_stg status_k0_in m_k0_in n_vm_in n_em_in status_psys_has_sbe nd_k0_in /end LOC_MEASUREMENT
 /begin SUB_FUNCTION SFOp_NOS109_Conditions /end SUB_FUNCTION
/end FUNCTION
/begin FUNCTION SFOp_NOS83_st_start "" /begin DEF_CHARACTERISTIC STATUS_ABL_SRT_NOS SWI_ZPHYSK0_SRT_NOS /end DEF_CHARACTERISTIC
 /begin LOC_MEASUREMENT z_init_nos st_ablauf_fkt status_ablauf_has_fkt z_p_hys_k0_has_fkt z_k0_has_fkt m_soll_k0_has_fkt m_k0_mod_has_fkt z_zuendfreigabe_vm_has_fkt /end LOC_MEASUREMENT
/end FUNCTION
/begin FUNCTION SFOp_NOS87_Phasenablaufsteuerung "" /begin LOC_MEASUREMENT st_ablauf_fkt status_ablauf_has_fkt /end LOC_MEASUREMENT /end FUNCTION
/begin FUNCTION SFOp_NOS88_VM_Ansteuerung "" /begin LOC_MEASUREMENT z_zuendfreigabe_vm_has_fkt /end LOC_MEASUREMENT /end FUNCTION
/begin FUNCTION SFOp_NOS89_Initialisierung "" /begin DEF_CHARACTERISTIC SWI_ZPHYSK0_UEB_NOS /end DEF_CHARACTERISTIC /begin LOC_MEASUREMENT z_p_hys_k0_has_fkt z_k0_has_fkt m_soll_k0_has_fkt /end LOC_MEASUREMENT /end FUNCTION
/begin FUNCTION SFOp_NOS94_Phasenablaufsteuerung "" /begin LOC_MEASUREMENT st_ablauf_fkt status_ablauf_has_fkt /end LOC_MEASUREMENT /end FUNCTION
/begin FUNCTION SFOp_NOS95_Initialisierung "" /begin DEF_CHARACTERISTIC SWI_ZPHYSK0_UEA_NOS /end DEF_CHARACTERISTIC /begin LOC_MEASUREMENT z_p_hys_k0_has_fkt z_k0_has_fkt m_soll_k0_has_fkt /end LOC_MEASUREMENT /end FUNCTION
/begin FUNCTION SFOp_OhneAb3_CalcFcn "" /begin LOC_MEASUREMENT status_ablauf_has_fkt /end LOC_MEASUREMENT /end FUNCTION
/begin FUNCTION SFOp_OhneAb5_Input ""
 /begin LOC_MEASUREMENT z_modus_em_hst_in c_getriebe_egs_in istgang_egs_in m_em_in m_iae_in m_k0_in m_max_dyn_em_in m_soll_em_hst_in m_soll_vm_hst_in m_vm_in m_vm_start_in m_wunsch_fpw_in n_ab_egs_in n_em_in n_soll_ll_vm_in n_t_egs_in n_vm_in osmode_next_in p_bremse_fzg_in sollgang_egs_in status_fehler_iep_in status_iae_in status_iep_in status_k0_in pos_egs_in z_ablauf_has_hst_in z_ablaufvariante_has_hst_in zielgang_egs_in z_k0_fst_in m_mot_in status_iae_adap_in z_diag_ersfkt_has_in z_diag_ersfkt_hi_has_in z_diag_notgang_has_in status_k0_adap_in status_waschstr_in status_kraftfluss_egs_in z_n_min_em_parksp_has_in n_mot_soll_iae_in status_alaengs_adaoff_in gangwechsel_egs_in z_nllsoll_iae_in status_nem_in status_nvm_in kolbenpos_k0_in z_kps_stada_in t_betrieb_pvu_has_ee_in status_ll_vm_in z_msa_fst_in m_min_dyn_em_in phi_neigung_in v_f_in drehrichtung_nem_in fpw_in drehrichtung_nab_in schalt_mode_egs_in m_ziel_k0_hst_in status_kraftfluss_lev2_egs_in i_gang_lev2_egs_in status_c_k0_in bremspedal_in status_autohold_in status_hillhold_in status_vf_in v_f_ref_in status_vfref_in z_diag_ersfkt_hi_96_has_in status_k0_adap_zaehler_in status_k0_befuellung_in z_oea_hst_in z_iep_in z_nllsoll_iep_in c_vm_in n_soll_em_hst_in abstellpos_vm_in abstellpos_vm_status_in status_nreg_em_hst_in m_min_vm_in m_soll_vm_l_hst_in z_msa_stada_in m_wunsch_fpw_hst_in status_getrbereit_in /end LOC_MEASUREMENT
/end FUNCTION
/begin FUNCTION SFOp_OhneAb6_Output "" /begin LOC_MEASUREMENT status_ablauf_has_fkt /end LOC_MEASUREMENT /end FUNCTION
/begin FUNCTION SFOp_Passiv17_Signale_im_Abbruchfall "" /begin DEF_CHARACTERISTIC M_SOLLK0MAXABBRUCH_PASSIV_HAS /end DEF_CHARACTERISTIC /begin LOC_MEASUREMENT m_soll_k0_has_fkt z_k0_has_fkt /end LOC_MEASUREMENT /end FUNCTION
/begin FUNCTION SFOp_Passiv2_FOp_Passiv "" /begin DEF_CHARACTERISTIC T_VK0FIXABBRUCH_PASSIV_HAS TAB_ZPHYSK0_PASSIV_HAS /end DEF_CHARACTERISTIC
 /begin LOC_MEASUREMENT t_k0fixabbruch_passiv_has m_soll_em_has_fkt n_soll_em_has_fkt m_max_em_has_fkt m_min_em_has_fkt z_m_soll_em_has_fkt z_n_soll_em_has_fkt n_soll_vm_has_fkt z_n_soll_vm_has_fkt z_zuendfreigabe_vm_has_fkt m_soll_k0_has_fkt mg_soll_k0_has_fkt z_k0_has_fkt z_p_hys_k0_has_fkt z_m_max_iae_has_fkt m_max_iae_has_fkt st_ablauf_fkt status_ablauf_has_fkt m_k0_mod_has_fkt z_ablauf_svh_reset_has_fkt z_fehler15_eh_fkt z_ponr_fkt z_emaktiv_fuw_zus_fkt m_soll_res_em_has_fkt nd_min_saf_has_fkt nd_soll_iae_fkt z_ablaufvariante_kalt_zus z_k0_befuellopt_has_fkt z_respschlepp_sas_fkt z_saf_has_fkt z_sbe_has_fkt z_zuendfreigabe_vm_fkt z_hybfkt_stg st_ziel_bz_has_stg st_ist_bz_has_stg st_ist_hcomd_has_stg z_ablauf_has_stg z_ablaufvariante_has_stg z_modus_em_hst_in c_getriebe_egs_in istgang_egs_in m_em_in m_iae_in m_k0_in m_max_dyn_em_in m_soll_em_hst_in m_soll_vm_hst_in m_vm_in m_vm_start_in m_wunsch_fpw_in n_ab_egs_in n_em_in n_soll_ll_vm_in n_t_egs_in n_vm_in osmode_next_in p_bremse_fzg_in sollgang_egs_in status_fehler_iep_in status_iae_in status_iep_in status_k0_in pos_egs_in z_ablauf_has_hst_in z_ablaufvariante_has_hst_in zielgang_egs_in z_k0_fst_in m_mot_in status_iae_adap_in z_diag_ersfkt_has_in z_diag_ersfkt_hi_has_in z_diag_notgang_has_in status_k0_adap_in status_waschstr_in status_kraftfluss_egs_in z_n_min_em_parksp_has_in n_mot_soll_iae_in status_alaengs_adaoff_in gangwechsel_egs_in z_nllsoll_iae_in status_nem_in status_nvm_in kolbenpos_k0_in z_kps_stada_in t_betrieb_pvu_has_ee_in status_ll_vm_in z_msa_fst_in m_min_dyn_em_in phi_neigung_in v_f_in drehrichtung_nem_in fpw_in drehrichtung_nab_in schalt_mode_egs_in m_ziel_k0_hst_in status_kraftfluss_lev2_egs_in i_gang_lev2_egs_in status_c_k0_in bremspedal_in status_autohold_in status_hillhold_in status_vf_in v_f_ref_in status_vfref_in z_diag_ersfkt_hi_96_has_in status_k0_adap_zaehler_in status_k0_befuellung_in z_oea_hst_in z_iep_in z_nllsoll_iep_in c_vm_in n_soll_em_hst_in abstellpos_vm_in abstellpos_vm_status_in status_nreg_em_hst_in m_min_vm_in m_soll_vm_l_hst_in z_msa_stada_in m_wunsch_fpw_hst_in status_getrbereit_in /end LOC_MEASUREMENT
 /begin SUB_FUNCTION SFOp_Passiv17_Signale_im_Abbruchfall /end SUB_FUNCTION
/end FUNCTION
/begin FUNCTION SFOp_SLST128_Integral "" /begin LOC_MEASUREMENT m_k0integral_ans m_k0_in /end LOC_MEASUREMENT /end FUNCTION
/begin FUNCTION SFOp_SLST129_Begrenzung_m_soll_em_has ""
 /begin DEF_CHARACTERISTIC KL_MSSOLLEMAKTIVSTKRAFTFL_ANS_Y KL_MSSOLLEMAKTIVSTKRAFTFL_ANS_X KL_MSSOLLEMAKTIV_ANS_Y KL_MSSOLLEMAKTIV_ANS_X T_MSOLLEMAKTIVMAX_ANS /end DEF_CHARACTERISTIC
 /begin LOC_MEASUREMENT nd_iae_ans z_k0entkaktiv_ans z_m_max_iae_has_in z_m_max_stiae_has z_nsollvmaktiv_ans z_iae_entkoppelt_ans m_ziel_vm_has_ans n_sec_iae_ist_ans t_msollemaktiv_ans z_t_msollemaktiv_ans z_ablauf_has_stg i_istgang_egs i_zielgang_egs m_wunsch_fpw_hst_fil mg_wunsch_fpw_hst_in n_sec_iae nd_k0_in ndg_k0_in ng_vm_in status_schaltung_egs_in status_psys_has_sbe status_sync_schaltung_sbe mg_mot_in status_schaltart_svh_has_sbe z_svh_has_sbe n_min_em_has_sbe z_modus_em_hst_in c_getriebe_egs_in m_em_in m_iae_in m_k0_in m_max_dyn_em_in m_soll_em_hst_in m_soll_vm_hst_in m_vm_in m_vm_start_in m_wunsch_fpw_in n_ab_egs_in n_em_in n_soll_ll_vm_in n_vm_in sollgang_egs_in status_iae_in status_k0_in z_ablauf_has_hst_in zielgang_egs_in z_k0_fst_in m_mot_in n_mot_soll_iae_in gangwechsel_egs_in kolbenpos_k0_in status_ll_vm_in m_min_dyn_em_in schalt_mode_egs_in status_k0_befuellung_in c_vm_in abstellpos_vm_in abstellpos_vm_status_in status_nreg_em_hst_in m_min_vm_in m_soll_vm_l_hst_in m_wunsch_fpw_hst_in /end LOC_MEASUREMENT
/end FUNCTION
/begin FUNCTION SFOp_SLST130_Modifikation_Schaltverhinderung "" /begin DEF_CHARACTERISTIC KL_SVHSTKRAFTFLUSS_ANS_Y KL_SVHSTKRAFTFLUSS_ANS_X /end DEF_CHARACTERISTIC
 /begin LOC_MEASUREMENT nd_iae_ans z_k0entkaktiv_ans z_m_max_iae_has_in z_m_max_stiae_has z_nsollvmaktiv_ans z_iae_entkoppelt_ans m_ziel_vm_has_ans n_sec_iae_ist_ans z_ablauf_has_stg i_istgang_egs i_zielgang_egs m_wunsch_fpw_hst_fil mg_wunsch_fpw_hst_in n_sec_iae nd_k0_in ndg_k0_in ng_vm_in status_schaltung_egs_in status_psys_has_sbe status_sync_schaltung_sbe mg_mot_in status_schaltart_svh_has_sbe z_svh_has_sbe n_min_em_has_sbe z_modus_em_hst_in c_getriebe_egs_in istgang_egs_in m_em_in m_iae_in m_k0_in m_max_dyn_em_in m_soll_em_hst_in m_soll_vm_hst_in m_vm_in m_vm_start_in m_wunsch_fpw_in n_ab_egs_in n_em_in n_soll_ll_vm_in n_vm_in sollgang_egs_in status_iae_in status_k0_in z_ablauf_has_hst_in zielgang_egs_in z_k0_fst_in m_mot_in n_mot_soll_iae_in gangwechsel_egs_in kolbenpos_k0_in status_ll_vm_in m_min_dyn_em_in schalt_mode_egs_in status_k0_befuellung_in c_vm_in abstellpos_vm_in abstellpos_vm_status_in status_nreg_em_hst_in m_min_vm_in m_soll_vm_l_hst_in m_wunsch_fpw_hst_in /end LOC_MEASUREMENT
/end FUNCTION
/begin FUNCTION SFOp_SLST158_St_Anschleppen_Ans ""
 /begin LOC_MEASUREMENT nd_iae_ans z_nsollvmaktiv_ans m_ziel_vm_has_ans n_sec_iae_ist_ans z_ablauf_has_stg i_istgang_egs i_zielgang_egs m_wunsch_fpw_hst_fil mg_wunsch_fpw_hst_in n_sec_iae nd_k0_in ndg_k0_in status_schaltung_egs_in status_sync_schaltung_sbe mg_mot_in status_schaltart_svh_has_sbe z_svh_has_sbe n_min_em_has_sbe z_modus_em_hst_in m_iae_in m_soll_em_hst_in m_soll_vm_hst_in m_vm_in n_ab_egs_in sollgang_egs_in status_iae_in zielgang_egs_in z_k0_fst_in n_mot_soll_iae_in gangwechsel_egs_in kolbenpos_k0_in status_ll_vm_in schalt_mode_egs_in status_k0_befuellung_in m_min_vm_in m_soll_vm_l_hst_in m_wunsch_fpw_hst_in /end LOC_MEASUREMENT
 /begin SUB_FUNCTION SFOp_SLST227_st_anschleppen_ans /end SUB_FUNCTION
/end FUNCTION
/begin FUNCTION SFOp_SLST159_St_K0_Schliessen_Ans "" /begin DEF_CHARACTERISTIC MS_MMAXIAEINAKTIV_ANS STATUS_ABL_SCL_ANS /end DEF_CHARACTERISTIC
 /begin LOC_MEASUREMENT nd_iae_ans z_k0entkaktiv_ans z_m_max_iae_has_in z_m_max_stiae_has z_nsollvmaktiv_ans z_iae_entkoppelt_ans m_ziel_vm_has_ans n_sec_iae_ist_ans z_ablauf_has_stg i_istgang_egs i_zielgang_egs m_wunsch_fpw_hst_fil mg_wunsch_fpw_hst_in n_sec_iae nd_k0_in ndg_k0_in ng_vm_in status_schaltung_egs_in status_psys_has_sbe status_sync_schaltung_sbe mg_mot_in status_schaltart_svh_has_sbe z_svh_has_sbe n_min_em_has_sbe z_modus_em_hst_in c_getriebe_egs_in m_em_in m_iae_in m_k0_in m_soll_em_hst_in m_soll_vm_hst_in m_vm_start_in m_wunsch_fpw_in n_ab_egs_in n_em_in n_soll_ll_vm_in n_vm_in sollgang_egs_in status_iae_in status_k0_in z_ablauf_has_hst_in zielgang_egs_in z_k0_fst_in status_kraftfluss_egs_in n_mot_soll_iae_in gangwechsel_egs_in kolbenpos_k0_in status_ll_vm_in schalt_mode_egs_in status_k0_befuellung_in c_vm_in abstellpos_vm_in abstellpos_vm_status_in status_nreg_em_hst_in m_min_vm_in m_soll_vm_l_hst_in m_wunsch_fpw_hst_in /end LOC_MEASUREMENT
 /begin SUB_FUNCTION SFOp_SLST305_st_k0_schliessen_ans /end SUB_FUNCTION
/end FUNCTION
/begin FUNCTION SFOp_SLST160_St_K0_Synchronisieren_Ans "" /begin DEF_CHARACTERISTIC STATUS_ABL_SYN_ANS /end DEF_CHARACTERISTIC
 /begin LOC_MEASUREMENT nd_iae_ans z_nsollvmaktiv_ans ng_em_ans m_ziel_vm_has_ans n_sec_iae_ist_ans z_ablauf_has_stg i_istgang_egs i_zielgang_egs m_wunsch_fpw_hst_fil n_sec_iae ng_vm_in status_sync_schaltung_sbe mg_mot_in z_svh_has_sbe n_min_em_has_sbe z_modus_em_hst_in c_getriebe_egs_in m_iae_in m_soll_em_hst_in m_soll_vm_hst_in m_vm_in m_vm_start_in n_ab_egs_in sollgang_egs_in z_ablauf_has_hst_in zielgang_egs_in n_mot_soll_iae_in gangwechsel_egs_in kolbenpos_k0_in status_ll_vm_in schalt_mode_egs_in status_k0_befuellung_in c_vm_in abstellpos_vm_in abstellpos_vm_status_in m_min_vm_in m_soll_vm_l_hst_in /end LOC_MEASUREMENT
 /begin SUB_FUNCTION SFOp_SLST334_st_k0_synchronisieren_ans /end SUB_FUNCTION
/end FUNCTION
/begin FUNCTION SFOp_SLST161_St_Konditionieren_Ans ""
 /begin LOC_MEASUREMENT nd_iae_ans z_k0entkaktiv_ans z_nsollvmaktiv_ans m_ziel_vm_has_ans n_sec_iae_ist_ans z_ablauf_has_stg i_istgang_egs i_zielgang_egs m_wunsch_fpw_hst_fil mg_wunsch_fpw_hst_in n_sec_iae ndg_k0_in status_schaltung_egs_in status_sync_schaltung_sbe mg_mot_in status_schaltart_svh_has_sbe z_svh_has_sbe n_min_em_has_sbe z_modus_em_hst_in m_iae_in m_soll_vm_hst_in m_vm_in m_vm_start_in n_ab_egs_in sollgang_egs_in zielgang_egs_in z_k0_fst_in n_mot_soll_iae_in status_ll_vm_in schalt_mode_egs_in c_vm_in abstellpos_vm_status_in status_nreg_em_hst_in m_min_vm_in m_soll_vm_l_hst_in /end LOC_MEASUREMENT
 /begin SUB_FUNCTION SFOp_SLST457_st_konditionieren_ans /end SUB_FUNCTION
/end FUNCTION
/begin FUNCTION SFOp_SLST162_St_SLST_Abbruch_Ans "" /begin DEF_CHARACTERISTIC MS_MMAXIAEINAKTIV_ANS /end DEF_CHARACTERISTIC
 /begin LOC_MEASUREMENT nd_iae_ans z_k0entkaktiv_ans z_m_max_iae_has_in z_m_max_stiae_has z_nsollvmaktiv_ans z_iae_entkoppelt_ans m_ziel_vm_has_ans n_sec_iae_ist_ans z_ablauf_has_stg i_istgang_egs i_zielgang_egs m_wunsch_fpw_hst_fil mg_wunsch_fpw_hst_in n_sec_iae nd_k0_in ndg_k0_in ng_vm_in status_schaltung_egs_in status_sync_schaltung_sbe mg_mot_in status_schaltart_svh_has_sbe z_svh_has_sbe n_min_em_has_sbe z_modus_em_hst_in c_getriebe_egs_in istgang_egs_in m_em_in m_iae_in m_soll_em_hst_in m_soll_vm_hst_in m_vm_in m_vm_start_in m_wunsch_fpw_in n_ab_egs_in n_em_in n_soll_ll_vm_in n_vm_in sollgang_egs_in status_iae_in z_ablauf_has_hst_in zielgang_egs_in z_k0_fst_in m_mot_in status_kraftfluss_egs_in n_mot_soll_iae_in gangwechsel_egs_in kolbenpos_k0_in status_ll_vm_in schalt_mode_egs_in status_k0_befuellung_in c_vm_in abstellpos_vm_in abstellpos_vm_status_in status_nreg_em_hst_in m_min_vm_in m_soll_vm_l_hst_in m_wunsch_fpw_hst_in /end LOC_MEASUREMENT
 /begin SUB_FUNCTION SFOp_SLST567_st_slst_abbruch_ans /end SUB_FUNCTION
/end FUNCTION
/begin FUNCTION SFOp_SLST163_St_Schaltung_aktiv "" /begin DEF_CHARACTERISTIC STATUS_ABL_SAK_ANS /end DEF_CHARACTERISTIC
 /begin LOC_MEASUREMENT nd_iae_ans z_k0entkaktiv_ans z_m_max_iae_has_in z_m_max_stiae_has z_nsollvmaktiv_ans z_iae_entkoppelt_ans m_ziel_vm_has_ans n_sec_iae_ist_ans z_ablauf_has_stg i_istgang_egs i_zielgang_egs m_wunsch_fpw_hst_fil mg_wunsch_fpw_hst_in n_sec_iae ng_vm_in status_schaltung_egs_in status_psys_has_sbe status_sync_schaltung_sbe mg_mot_in z_svh_has_sbe n_min_em_has_sbe z_modus_em_hst_in c_getriebe_egs_in m_em_in m_iae_in m_k0_in m_soll_em_hst_in m_soll_vm_hst_in m_vm_start_in n_ab_egs_in sollgang_egs_in status_iae_in status_k0_in z_ablauf_has_hst_in z_k0_fst_in m_mot_in n_mot_soll_iae_in kolbenpos_k0_in status_ll_vm_in m_min_dyn_em_in status_k0_befuellung_in c_vm_in abstellpos_vm_in abstellpos_vm_status_in status_nreg_em_hst_in m_min_vm_in m_soll_vm_l_hst_in m_wunsch_fpw_hst_in /end LOC_MEASUREMENT
 /begin SUB_FUNCTION SFOp_SLST595_st_schaltung_aktiv /end SUB_FUNCTION
/end FUNCTION
/begin RECORD_LAYOUT FLOAT32_IEEE_COL_DIRECT_M_S7_S3 FNC_VALUES 1 FLOAT32_IEEE COLUMN_DIR DIRECT /end RECORD_LAYOUT
/begin RECORD_LAYOUT FLOAT32_IEEE_X_INCR_DIRECT_M_S7_S3 AXIS_PTS_X 1 FLOAT32_IEEE INDEX_INCR DIRECT /end RECORD_LAYOUT
/begin RECORD_LAYOUT SBYTE_X_INCR_DIRECT_M_S7_S3 AXIS_PTS_X 1 SBYTE INDEX_INCR DIRECT /end RECORD_LAYOUT
/begin RECORD_LAYOUT UBYTE_COL_DIRECT_M_S7_S3 FNC_VALUES 1 UBYTE COLUMN_DIR DIRECT /end RECORD_LAYOUT
/begin RECORD_LAYOUT UBYTE_X_INCR_DIRECT_M_S7_S3 AXIS_PTS_X 1 UBYTE INDEX_INCR DIRECT /end RECORD_LAYOUT
/begin RECORD_LAYOUT ULONG_COL_DIRECT_M_S7_S3 FNC_VALUES 1 ULONG COLUMN_DIR DIRECT /end RECORD_LAYOUT
/begin RECORD_LAYOUT ULONG_X_INCR_DIRECT_M_S7_S3 AXIS_PTS_X 1 ULONG INDEX_INCR DIRECT /end RECORD_LAYOUT
/begin RECORD_LAYOUT UWORD_COL_DIRECT_M_S7_S3 FNC_VALUES 1 UWORD COLUMN_DIR DIRECT /end RECORD_LAYOUT
/begin RECORD_LAYOUT UWORD_X_INCR_DIRECT_M_S7_S3 AXIS_PTS_X 1 UWORD INDEX_INCR DIRECT /end RECORD_LAYOUT
/end MODULE
/end PROJECT
