ASAP2_VERSION 1 51
/begin PROJECT _929_929 "Gen2_BMW_System_Supplier_Lib"
/begin HEADER "" VERSION "C_03_03" PROJECT_NO _929_929 /end HEADER
/begin MODULE DIM ""
/begin MOD_COMMON "" BYTE_ORDER MSB_FIRST ALIGNMENT_BYTE 1 ALIGNMENT_WORD 2 ALIGNMENT_LONG 4 ALIGNMENT_FLOAT32_IEEE 4 /end MOD_COMMON
/begin MEASUREMENT Sonstige.Test.StartEE "EepromStd[4 ... 5]: Markierung 12345 am Anfang des Kanals EepromStd [(x=1/UMR___1_1_0)]" UWORD UMR___1_1_0_S6_S3 1 100 0 65535 ECU_ADDRESS 0xFFF81054 /end MEASUREMENT
/begin MEASUREMENT Sonstige.InfoSpeicher.Eintrag "EepromStd[6 ... 185]: Atsys Infospeicher Eintraege [(x=18/UMR___1_1_0),(y=10/UMR___1_1_0)]" UBYTE UMR___1_1_0_S6_S3 1 100 0 255 ECU_ADDRESS 0xFFF81056 MATRIX_DIM 180 1 1 /end MEASUREMENT
/begin MEASUREMENT Sonstige.InfoSpeicher.Zaehler "EepromStd[186 ... 187]: Atsys Infospeicher: Anzahl der Eintraege [(x=1/UMR___1_1_0)]" UWORD UMR___1_1_0_S6_S3 1 100 0 65535 ECU_ADDRESS 0xFFF8110A /end MEASUREMENT
/begin MEASUREMENT Sonstige.InfoSpeicher.Init "EepromStd[188 ... 189]: Atsys Infospeicher: derzeit noch dummy-Groesse fuer Initialisierung [(x=1/UMR___1_1_0)]" UWORD UMR___1_1_0_S6_S3 1 100 0 65535 ECU_ADDRESS 0xFFF8110C /end MEASUREMENT
/begin MEASUREMENT Sonstige.Itf.AbstellTemperatur "EepromStd[190]: Getriebe Abstelltemperatur [(x=1/UMR___1_1_0)]" UBYTE UMR_GRADC__1_1_M40_S6_S3 1 100 -40 215 ECU_ADDRESS 0xFFF8110E /end MEASUREMENT
/begin MEASUREMENT Sonstige.Itf.Dummy "EepromStd[191]: Dummy Speicher [(x=1/UMR___1_1_0)]" UBYTE UMR___1_1_0_S6_S3 1 100 0 255 ECU_ADDRESS 0xFFF8110F /end MEASUREMENT
/begin MEASUREMENT Sonstige.PosVUew.Zaehler "EepromStd[192 ... 195]: PosV Ueberwachung Zaehler ueber Zuendung/Motor AUS [(x=1/UMR___1_1_0)]" ULONG UMR___1_1_0_S6_S3 1 100 0 2147483647 ECU_ADDRESS 0xFFF81110 /end MEASUREMENT
/begin MEASUREMENT PulsAda.Daten.ZwSpPf "EepromStd[200 ... 211]: Pulsadaption: Zwischenspeicher Fuelldruck [(x=6/UMR___1_1_0)]" SWORD UMR_MBAR__1_1_0_S6_S3 1 100 -32768 32767 ECU_ADDRESS 0xFFF81118 MATRIX_DIM 6 1 1 /end MEASUREMENT
/begin MEASUREMENT PulsAda.Daten.ZwSpTsf "EepromStd[212 ... 223]: Pulsadaption: Zwischenspeicher Schnellfuellzeit [(x=6/UMR___1_1_0)]" SWORD UMR_MSEC__1_1_0_S6_S3 1 100 -32768 32767 ECU_ADDRESS 0xFFF81124 MATRIX_DIM 6 1 1 /end MEASUREMENT
/begin MEASUREMENT PulsAda.Daten.Prueftyp "EepromStd[224 ... 229]: Pulsadaption: Prueftyp (TSF oder PF) [(x=6/UMR___1_1_0)]" UBYTE UMR___1_1_0_S6_S3 1 100 0 255 ECU_ADDRESS 0xFFF81130 MATRIX_DIM 6 1 1 /end MEASUREMENT
/begin MEASUREMENT PulsAda.Daten.Pulsid "EepromStd[230 ... 235]: Pulsadaption: Puls ID (Nummer Pruefpuls laut Diagrammm in PH) [(x=6/UMR___1_1_0)]" UBYTE UMR___1_1_0_S6_S3 1 100 0 255 ECU_ADDRESS 0xFFF81136 MATRIX_DIM 6 1 1 /end MEASUREMENT
/begin MEASUREMENT PulsAda.Daten.NPruefzyklen "EepromStd[236 ... 241]: Pulsadaption: Anzahl der abgeschlossenen Pruefzyklen fuer Increment Befuell-Pruefzaehler [(x=6/UMR___1_1_0)]" UBYTE UMR___1_1_0_S6_S3 1 100 0 255 ECU_ADDRESS 0xFFF8113C MATRIX_DIM 6 1 1 /end MEASUREMENT
/begin MEASUREMENT PulsAda.Daten.NPulsgrenz "EepromStd[242 ... 247]: Pulsadaption: Anzahl der Pulse in diesem Pruefzyklus [(x=6/UMR___1_1_0)]" UBYTE UMR___1_1_0_S6_S3 1 100 0 255 ECU_ADDRESS 0xFFF81142 MATRIX_DIM 6 1 1 /end MEASUREMENT
/begin MEASUREMENT PulsAda.Daten.NPruefschleife "EepromStd[248 ... 253]: Pulsadaption: Zaehler Pruefschleife bei Puls 3 (laut Diagramm in PH) [(x=6/UMR___1_1_0)]" UBYTE UMR___1_1_0_S6_S3 1 100 0 255 ECU_ADDRESS 0xFFF81148 MATRIX_DIM 6 1 1 /end MEASUREMENT
/begin MEASUREMENT AdaKup.PF.SchaltCtr "EepromStd[258 ... 267]: Kup-Fuelldruck-Adaption: Schaltungszaehler [(x=5/UMR___1_1_0)]" UWORD UMR___1_1_0_S6_S3 1 100 0 65535 ECU_ADDRESS 0xFFF81152 MATRIX_DIM 5 1 1 /end MEASUREMENT
/begin MEASUREMENT AdaKup.PF.PruefCtr "EepromStd[268 ... 277]: Kup-Fuelldruck-Adaption: Pruefzaehler [(x=5/UMR___1_1_0)]" UWORD UMR___1_1_0_S6_S3 1 100 0 65535 ECU_ADDRESS 0xFFF8115C MATRIX_DIM 5 1 1 /end MEASUREMENT
/begin MEASUREMENT AdaKup.PF.PruefStartCtr "EepromStd[278 ... 287]: Kup-Fuelldruck-Adaption: Pruefzaehler [(x=5/UMR___1_1_0)]" UWORD UMR___1_1_0_S6_S3 1 100 0 65535 ECU_ADDRESS 0xFFF81166 MATRIX_DIM 5 1 1 /end MEASUREMENT
/begin MEASUREMENT AdaKup.PF.Speicher "EepromStd[288 ... 297]: Kup-Fuelldruck-Adaptionswert [(x=5/UMR___1_1_0)]" SWORD UMR_MBAR__1_1_0_S6_S3 1 100 -32768 32767 ECU_ADDRESS 0xFFF81170 MATRIX_DIM 5 1 1 /end MEASUREMENT
/begin MEASUREMENT AdaKup.TSF.SchaltCtr "EepromStd[298 ... 307]: Kup-Schnellfuellzeit-Adaption Schaltungszaehler [(x=5/UMR___1_1_0)]" UWORD UMR___1_1_0_S6_S3 1 100 0 65535 ECU_ADDRESS 0xFFF8117A MATRIX_DIM 5 1 1 /end MEASUREMENT
/begin MEASUREMENT AdaKup.TSF.PruefCtr "EepromStd[308 ... 317]: Kup-Schnellfuellzeit-Adaption Pruefzaehler [(x=5/UMR___1_1_0)]" UWORD UMR___1_1_0_S6_S3 1 100 0 65535 ECU_ADDRESS 0xFFF81184 MATRIX_DIM 5 1 1 /end MEASUREMENT
/begin MEASUREMENT AdaKup.TSF.Speicher "EepromStd[318 ... 327]: Kup-Schnellfuellzeit-Adaptionswert [(x=5/UMR___1_1_0)]" SWORD UMR_MSEC__1_1_0_S6_S3 1 100 -32768 32767 ECU_ADDRESS 0xFFF8118E MATRIX_DIM 5 1 1 /end MEASUREMENT
/begin MEASUREMENT AdaKup.AdaBE.GlsKf1 "EepromStd[328 ... 389]: Beeinflussungsadaption alle Schaltungen Kennfeld 1 [(x=31/UMR___1_1_0)]" SWORD UMR_MBAR__1_1_0_S6_S3 1 100 -32768 32767 ECU_ADDRESS 0xFFF81198 MATRIX_DIM 31 1 1 /end MEASUREMENT
/begin MEASUREMENT AdaKup.AdaBE.GlsKf2 "EepromStd[390 ... 451]: Beeinflussungsadaption alle Schaltungen Kennfeld 2 [(x=31/UMR___1_1_0)]" SWORD UMR_MBAR__1_1_0_S6_S3 1 100 -32768 32767 ECU_ADDRESS 0xFFF811D6 MATRIX_DIM 31 1 1 /end MEASUREMENT
/begin MEASUREMENT AdaKup.AdaBE.GlsKf3 "EepromStd[452 ... 465]: Beeinflussungsadaption Kennfeld 3 nur 1 [(x=7/UMR___1_1_0)]" SWORD UMR_MBAR__1_1_0_S6_S3 1 100 -32768 32767 ECU_ADDRESS 0xFFF81214 MATRIX_DIM 7 1 1 /end MEASUREMENT
/begin MEASUREMENT AdaGlsEHS.KF1.Speicher "EepromStd[470 ... 917]: GLS Adaption Einzel-Hoch-Schaltungen Kennfeld 1 [(x=8/UMR_NM__1_1_0),(y=8/UMR_U_MIN_1_1_0),(z=7/UMR___1_1_0)]" SBYTE UMR_MBAR__10_1_0_S6_S3 1 100 -1280 1270 ECU_ADDRESS 0xFFF81226 MATRIX_DIM 448 1 1 /end MEASUREMENT
/begin MEASUREMENT AdaGlsEHS.KF1.BewSchaltCtr "EepromStd[918 ... 931]: GLS Adaption Bewertungszaehler Einzel-Hoch-Schaltungen Kennfeld 1 [(x=7/UMR___1_1_0)]" UWORD UMR___1_1_0_S6_S3 1 100 0 65535 ECU_ADDRESS 0xFFF813E6 MATRIX_DIM 7 1 1 /end MEASUREMENT
/begin MEASUREMENT AdaGlsEHS.KF2.Speicher "EepromStd[932 ... 1379]: GLS Adaption Einzel-Hoch-Schaltungen Kennfeld 2 [(x=8/UMR_NM__1_1_0),(y=8/UMR_U_MIN_1_1_0),(z=7/UMR___1_1_0)]" SBYTE UMR_MBAR__10_1_0_S6_S3 1 100 -1280 1270 ECU_ADDRESS 0xFFF813F4 MATRIX_DIM 448 1 1 /end MEASUREMENT
/begin MEASUREMENT AdaGlsEHS.KF2.BewSchaltCtr "EepromStd[1380 ... 1393]: GLS Adaption Bewertungszaehler Einzel-Hoch-Schaltungen Kennfeld 2 [(x=7/UMR___1_1_0)]" UWORD UMR___1_1_0_S6_S3 1 100 0 65535 ECU_ADDRESS 0xFFF815B4 MATRIX_DIM 7 1 1 /end MEASUREMENT
/begin MEASUREMENT AdaGlsEHS.KaltKF1.Speicher "EepromStd[1394 ... 1841]: GLS Adaption Einzel-Hoch-Schaltungen Kennfeld 1 Kalt [(x=8/UMR_NM__1_1_0),(y=8/UMR_U_MIN_1_1_0),(z=7/UMR___1_1_0)]" SBYTE UMR_MBAR__10_1_0_S6_S3 1 100 -1280 1270 ECU_ADDRESS 0xFFF815C2 MATRIX_DIM 448 1 1 /end MEASUREMENT
/begin MEASUREMENT AdaGlsEHS.KaltKF1.BewSchaltCtr "EepromStd[1842 ... 1855]: GLS Adaption Bewertungszaehler Einzel-Hoch-Schaltungen Kennfeld 1 Kalt [(x=7/UMR___1_1_0)]" UWORD UMR___1_1_0_S6_S3 1 100 0 65535 ECU_ADDRESS 0xFFF81782 MATRIX_DIM 7 1 1 /end MEASUREMENT
/begin MEASUREMENT AdaGlsEHS.KaltKF2.Speicher "EepromStd[1856 ... 2303]: GLS Adaption Einzel-Hoch-Schaltungen Kennfeld 2 Kalt [(x=8/UMR_NM__1_1_0),(y=8/UMR_U_MIN_1_1_0),(z=7/UMR___1_1_0)]" SBYTE UMR_MBAR__10_1_0_S6_S3 1 100 -1280 1270 ECU_ADDRESS 0xFFF81790 MATRIX_DIM 448 1 1 /end MEASUREMENT
/begin MEASUREMENT AdaGlsEHS.KaltKF2.BewSchaltCtr "EepromStd[2304 ... 2317]: GLS Adaption Bewertungszaehler Einzel-Hoch-Schaltungen Kennfeld 2 Kalt [(x=7/UMR___1_1_0)]" UWORD UMR___1_1_0_S6_S3 1 100 0 65535 ECU_ADDRESS 0xFFF81950 MATRIX_DIM 7 1 1 /end MEASUREMENT
/begin MEASUREMENT AdaGlsEHS.KF3.Speicher "EepromStd[2318 ... 2429]: GLS Adaption Einzel-Hoch-Schaltungen Kennfeld 3 [(x=4/UMR_NM__1_1_0),(y=4/UMR_U_MIN_1_1_0),(z=7/UMR___1_1_0)]" SBYTE UMR_MBAR__10_1_0_S6_S3 1 100 -1280 1270 ECU_ADDRESS 0xFFF8195E MATRIX_DIM 112 1 1 /end MEASUREMENT
/begin MEASUREMENT AdaGlsEHS.KF3.BewSchaltCtr "EepromStd[2430 ... 2443]: GLS Adaption Bewertungszaehler Einzel-Hoch-Schaltungen Kennfeld 3 [(x=7/UMR___1_1_0)]" UWORD UMR___1_1_0_S6_S3 1 100 0 65535 ECU_ADDRESS 0xFFF819CE MATRIX_DIM 7 1 1 /end MEASUREMENT
/begin MEASUREMENT AdaGlsEHS.KaltKF3.Speicher "EepromStd[2444 ... 2555]: GLS Adaption Einzel-Hoch-Schaltungen Kennfeld 3 Kalt [(x=4/UMR_NM__1_1_0),(y=4/UMR_U_MIN_1_1_0),(z=7/UMR___1_1_0)]" SBYTE UMR_MBAR__10_1_0_S6_S3 1 100 -1280 1270 ECU_ADDRESS 0xFFF819DC MATRIX_DIM 112 1 1 /end MEASUREMENT
/begin MEASUREMENT AdaGlsEHS.KaltKF3.BewSchaltCtr "EepromStd[2556 ... 2569]: GLS Adaption Bewertungszaehler Einzel-Hoch-Schaltungen Kennfeld 3 Kalt [(x=7/UMR___1_1_0)]" UWORD UMR___1_1_0_S6_S3 1 100 0 65535 ECU_ADDRESS 0xFFF81A4C MATRIX_DIM 7 1 1 /end MEASUREMENT
/begin MEASUREMENT AdaGlsDHS.KF1.Speicher "EepromStd[2574 ... 2717]: GLS Adaption Doppel-Hoch-Schaltungen Kennfeld 1 [(x=4/UMR_NM__1_1_0),(y=6/UMR_U_MIN_1_1_0),(z=6/UMR___1_1_0)]" SBYTE UMR_MBAR__10_1_0_S6_S3 1 100 -1280 1270 ECU_ADDRESS 0xFFF81A5E MATRIX_DIM 144 1 1 /end MEASUREMENT
/begin MEASUREMENT AdaGlsDHS.KF1.BewSchaltCtr "EepromStd[2718 ... 2729]: GLS Adaption Bewertungszaehler Doppel-Hoch-Schaltungen Kennfeld 1 [(x=6/UMR___1_1_0)]" UWORD UMR___1_1_0_S6_S3 1 100 0 65535 ECU_ADDRESS 0xFFF81AEE MATRIX_DIM 6 1 1 /end MEASUREMENT
/begin MEASUREMENT AdaGlsDHS.KaltKF1.Speicher "EepromStd[2730 ... 2873]: GLS Adaption Doppel-Hoch-Schaltungen Kennfeld 1 Kalt [(x=4/UMR_NM__1_1_0),(y=6/UMR_U_MIN_1_1_0),(z=6/UMR___1_1_0)]" SBYTE UMR_MBAR__10_1_0_S6_S3 1 100 -1280 1270 ECU_ADDRESS 0xFFF81AFA MATRIX_DIM 144 1 1 /end MEASUREMENT
/begin MEASUREMENT AdaGlsDHS.KaltKF1.BewSchaltCtr "EepromStd[2874 ... 2885]: GLS Adaption Bewertungszaehler Doppel-Hoch-Schaltungen Kennfeld 1 Kalt [(x=6/UMR___1_1_0)]" UWORD UMR___1_1_0_S6_S3 1 100 0 65535 ECU_ADDRESS 0xFFF81B8A MATRIX_DIM 6 1 1 /end MEASUREMENT
/begin MEASUREMENT AdaGlsERS.KF1.Speicher "EepromStd[2890 ... 3337]: GLS Adaption Einzel-Rueck-Schaltungen Kennfeld 1 [(x=8/UMR_NM__1_1_0),(y=8/UMR_U_MIN_1_1_0),(z=7/UMR___1_1_0)]" SBYTE UMR_MBAR__10_1_0_S6_S3 1 100 -1280 1270 ECU_ADDRESS 0xFFF81B9A MATRIX_DIM 448 1 1 /end MEASUREMENT
/begin MEASUREMENT AdaGlsERS.KF1.BewSchaltCtr "EepromStd[3338 ... 3351]: GLS Adaption Bewertungszaehler Einzel-Rueck-Schaltungen Kennfeld 1 [(x=7/UMR___1_1_0)]" UWORD UMR___1_1_0_S6_S3 1 100 0 65535 ECU_ADDRESS 0xFFF81D5A MATRIX_DIM 7 1 1 /end MEASUREMENT
/begin MEASUREMENT AdaGlsERS.KF2.Speicher "EepromStd[3352 ... 3799]: GLS Adaption Einzel-Rueck-Schaltungen Kennfeld 2 [(x=8/UMR_NM__1_1_0),(y=8/UMR_U_MIN_1_1_0),(z=7/UMR___1_1_0)]" SBYTE UMR_MBAR__10_1_0_S6_S3 1 100 -1280 1270 ECU_ADDRESS 0xFFF81D68 MATRIX_DIM 448 1 1 /end MEASUREMENT
/begin MEASUREMENT AdaGlsERS.KF2.BewSchaltCtr "EepromStd[3800 ... 3813]: GLS Adaption Bewertungszaehler Einzel-Rueck-Schaltungen Kennfeld 2 [(x=7/UMR___1_1_0)]" UWORD UMR___1_1_0_S6_S3 1 100 0 65535 ECU_ADDRESS 0xFFF81F28 MATRIX_DIM 7 1 1 /end MEASUREMENT
/begin MEASUREMENT AdaGlsDRS.KF1.Speicher "EepromStd[3818 ... 4201]: GLS Adaption Doppel-Rueck-Schaltungen Kennfeld 1 [(x=8/UMR_NM__1_1_0),(y=8/UMR_U_MIN_1_1_0),(z=6/UMR___1_1_0)]" SBYTE UMR_MBAR__10_1_0_S6_S3 1 100 -1280 1270 ECU_ADDRESS 0xFFF81F3A MATRIX_DIM 384 1 1 /end MEASUREMENT
/begin MEASUREMENT AdaGlsDRS.KF1.BewSchaltCtr "EepromStd[4202 ... 4213]: GLS Adaption Bewertungszaehler Doppel-Rueck-Schaltungen Kennfeld 1 [(x=6/UMR___1_1_0)]" UWORD UMR___1_1_0_S6_S3 1 100 0 65535 ECU_ADDRESS 0xFFF820BA MATRIX_DIM 6 1 1 /end MEASUREMENT
/begin MEASUREMENT AdaGlsNFRS.KF1.Speicher "EepromStd[4218 ... 4337]: GLS Adaption N-Fach-Rueck-Schaltungen Kennfeld 1 [(x=6/UMR_NM__1_1_0),(y=4/UMR_U_MIN_1_1_0),(z=5/UMR___1_1_0)]" SBYTE UMR_MBAR__10_1_0_S6_S3 1 100 -1280 1270 ECU_ADDRESS 0xFFF820CA MATRIX_DIM 120 1 1 /end MEASUREMENT
/begin MEASUREMENT AdaGlsNFRS.KF1.BewSchaltCtr "EepromStd[4338 ... 4347]: GLS Adaption Bewertungszaehler N-Fach-Rueck-Schaltungen Kennfeld 1 [(x=5/UMR___1_1_0)]" UWORD UMR___1_1_0_S6_S3 1 100 0 65535 ECU_ADDRESS 0xFFF82142 MATRIX_DIM 5 1 1 /end MEASUREMENT
/begin MEASUREMENT AdaIae.Daten.Speicher "EepromStd[4352 ... 4353]: IAE Anlegepunkt Adaptions-Speicher [(x=1/UMR___1_1_0)]" SWORD UMR_MBAR__1_1_0_S6_S3 1 100 -32768 32767 ECU_ADDRESS 0xFFF82150 /end MEASUREMENT
/begin MEASUREMENT AdaIae.Daten.BewCtr "EepromStd[4354 ... 4355]: IAE Anlegepunkt Adaption: Bewertungszaehler [(x=1/UMR___1_1_0)]" UWORD UMR___1_1_0_S6_S3 1 100 0 65535 ECU_ADDRESS 0xFFF82152 /end MEASUREMENT
/begin MEASUREMENT AdaIae.Daten.IepSpeicher "EepromStd[4356 ... 4363]: IAE Anlegepunkt Adaptions-Speicher [(x=4/UMR___1_1_0)]" SWORD UMR_MBAR__1_1_0_S6_S3 1 100 -32768 32767 ECU_ADDRESS 0xFFF82154 MATRIX_DIM 4 1 1 /end MEASUREMENT
/begin MEASUREMENT AdaIae.Daten.BewCtrIep "EepromStd[4364 ... 4371]: IAE IEP Anlegepunkt Adaption: Bewertungszaehler [(x=4/UMR___1_1_0)]" UWORD UMR___1_1_0_S6_S3 1 100 0 65535 ECU_ADDRESS 0xFFF8215C MATRIX_DIM 4 1 1 /end MEASUREMENT
/begin MEASUREMENT AdaIae.Daten.IepBetrCtr "EepromStd[4372 ... 4379]: IEP-Betriebszeit seit letzter Adaption [(x=4/UMR_SEC__1_1_0)]" UWORD UMR_SEC__1_1_0_S6_S3 1 100 0 65535 ECU_ADDRESS 0xFFF82164 MATRIX_DIM 4 1 1 /end MEASUREMENT
/begin MEASUREMENT AdaIae.Iae.AnfahrCtr "EepromStd[4380 ... 4381]: IAE Anlegepunkt Adaption: Anfahrzaehler IAE [(x=1/UMR___1_1_0)]" UWORD UMR___1_1_0_S6_S3 1 100 0 65535 ECU_ADDRESS 0xFFF8216C /end MEASUREMENT
/begin MEASUREMENT AdaIae.Kup.SchaltCtr "EepromStd[4382 ... 4383]: IAE Anlegepunkt Adaption: Schaltungszaehler der Iae-Kup [(x=1/UMR___1_1_0)]" UWORD UMR___1_1_0_S6_S3 1 100 0 65535 ECU_ADDRESS 0xFFF8216E /end MEASUREMENT
/begin MEASUREMENT AdaIaeuf.Daten.Speicher "EepromStd[4388 ... 4423]: IAE Uebertragungsfaehigkeits Adaptions-Speicher [(x=6/UMR_U_MIN_1_1_0),(y=6/UMR_NM__1_1_0)]" SBYTE UMR_NM_BAR_1_1_0_S6_S3 1 100 -128 127 ECU_ADDRESS 0xFFF82174 MATRIX_DIM 36 1 1 /end MEASUREMENT
/begin MEASUREMENT AdaK0.PF.SchaltCtr "EepromStd[4428 ... 4429]: K0-Fuelldruck-Adaption: Schaltungszaehler [(x=1/UMR___1_1_0)]" UWORD UMR___1_1_0_S6_S3 1 100 0 65535 ECU_ADDRESS 0xFFF8219C /end MEASUREMENT
/begin MEASUREMENT AdaK0.PF.PruefCtr "EepromStd[4430 ... 4431]: K0-Fuelldruck-Adaption: Pruefzaehler [(x=1/UMR___1_1_0)]" UWORD UMR___1_1_0_S6_S3 1 100 0 65535 ECU_ADDRESS 0xFFF8219E /end MEASUREMENT
/begin MEASUREMENT AdaK0.PF.PruefStartCtr "EepromStd[4432 ... 4433]: K0-Fuelldruck-Adaption: Pruefzaehler [(x=1/UMR___1_1_0)]" UWORD UMR___1_1_0_S6_S3 1 100 0 65535 ECU_ADDRESS 0xFFF821A0 /end MEASUREMENT
/begin MEASUREMENT AdaK0.PF.Speicher "EepromStd[4434 ... 4435]: K0-Fuelldruck-Adaptionswert [(x=1/UMR___1_1_0)]" SWORD UMR_MBAR__1_1_0_S6_S3 1 100 -32768 32767 ECU_ADDRESS 0xFFF821A2 /end MEASUREMENT
/begin MEASUREMENT AdaK0.TSF.SchaltCtr "EepromStd[4436 ... 4437]: K0-Schnellfuellzeit-Adaption Schaltungszaehler [(x=1/UMR___1_1_0)]" UWORD UMR___1_1_0_S6_S3 1 100 0 65535 ECU_ADDRESS 0xFFF821A4 /end MEASUREMENT
/begin MEASUREMENT AdaK0.TSF.PruefCtr "EepromStd[4438 ... 4439]: K0-Schnellfuellzeit-Adaption Pruefzaehler [(x=1/UMR___1_1_0)]" UWORD UMR___1_1_0_S6_S3 1 100 0 65535 ECU_ADDRESS 0xFFF821A6 /end MEASUREMENT
/begin MEASUREMENT AdaK0.TSF.Speicher "EepromStd[4440 ... 4441]: K0-Schnellfuellzeit-Adaptionswert [(x=1/UMR___1_1_0)]" SWORD UMR_MSEC__1_1_0_S6_S3 1 100 -32768 32767 ECU_ADDRESS 0xFFF821A8 /end MEASUREMENT
/begin MEASUREMENT AdaK0.Timer.Lock "EepromStd[4442 ... 4443]: Timer um K0-Puls-Ada wegen Urluft zu sperren [(x=1/UMR___1_1_0)]" UWORD UMR_SEC__1_1_0_S6_S3 1 100 0 65535 ECU_ADDRESS 0xFFF821AA /end MEASUREMENT
/begin MEASUREMENT AdaK0.Timer.Maxlock "EepromStd[4444 ... 4445]: Maxzeit-Timer K0-Puls-Ada wegen Urluft sperren [(x=1/UMR___1_1_0)]" UWORD UMR_SEC__1_1_0_S6_S3 1 100 0 65535 ECU_ADDRESS 0xFFF821AC /end MEASUREMENT
/begin MEASUREMENT Ueberwachungen.Parksperrenmagnet.TmaxPmueb "EepromStd[4452 ... 4455]: Zeitdauer nach der eine Ueberpruefung des Parksperrenmagnet erfolgen soll [(x=1/UMR___1_1_0)]" ULONG UMR_MSEC__10_1_0_S6_S3 1 100 0 42949672950 ECU_ADDRESS 0xFFF821B4 /end MEASUREMENT
/begin MEASUREMENT IAE.Std.CIaeAbstell "EepromStd[4460 ... 4461]: Abstelltemperatur der IAE [(x=1/UMR___1_1_0)]" UWORD UMR_GRADC__1_1_M40_S6_S3 1 100 -40 65495 ECU_ADDRESS 0xFFF821BC /end MEASUREMENT
/begin MEASUREMENT Nvr.Verwaltung.Versionierung "EepromStd[4466 ... 4523]: Versionierung von EEPROM-Daten um diese separat Loeschen zu koennen [(x=58/UMR___1_1_0)]" UBYTE UMR___1_1_0_S6_S3 1 100 0 255 ECU_ADDRESS 0xFFF821C2 MATRIX_DIM 58 1 1 /end MEASUREMENT
/begin MEASUREMENT Temp.Stada.preadaption_finish_counter "EepromStd[4528 ... 4529]: Haeufigkeit und Art des Abschliessens von STADA-Vorgeangen [(x=1/UMR___1_1_0)]" UWORD UMR___1_1_0_S6_S3 1 100 0 65535 ECU_ADDRESS 0xFFF82200 /end MEASUREMENT
/begin MEASUREMENT AdaKupKalt.PF.SchaltCtr "EepromStd[4534 ... 4543]: Kup-Fuelldruck-Adaption: Schaltungszaehler [(x=5/UMR___1_1_0)]" UWORD UMR___1_1_0_S6_S3 1 100 0 65535 ECU_ADDRESS 0xFFF82206 MATRIX_DIM 5 1 1 /end MEASUREMENT
/begin MEASUREMENT AdaKupKalt.PF.PruefCtr "EepromStd[4544 ... 4553]: Kup-Fuelldruck-Adaption: Pruefzeahler Adaptionsklasse kalt [(x=5/UMR___1_1_0)]" UWORD UMR___1_1_0_S6_S3 1 100 0 65535 ECU_ADDRESS 0xFFF82210 MATRIX_DIM 5 1 1 /end MEASUREMENT
/begin MEASUREMENT AdaKupKalt.PF.Speicher "EepromStd[4554 ... 4563]: Kup-Fuelldruck-Adaptionswert [(x=5/UMR___1_1_0)]" SWORD UMR_MBAR__1_1_0_S6_S3 1 100 -32768 32767 ECU_ADDRESS 0xFFF8221A MATRIX_DIM 5 1 1 /end MEASUREMENT
/begin MEASUREMENT AdaKupKalt.AdaBE.GlsKf1 "EepromStd[4564 ... 4625]: Beeinflussungsadaption alle Schaltungen Kennfeld 1 PF kalt [(x=31/UMR___1_1_0)]" SWORD UMR_MBAR__1_1_0_S6_S3 1 100 -32768 32767 ECU_ADDRESS 0xFFF82224 MATRIX_DIM 31 1 1 /end MEASUREMENT
/begin MEASUREMENT AdaKupKalt.AdaBE.GlsKf2 "EepromStd[4626 ... 4687]: Beeinflussungsadaption alle Schaltungen Kennfeld 2 PF kalt [(x=31/UMR___1_1_0)]" SWORD UMR_MBAR__1_1_0_S6_S3 1 100 -32768 32767 ECU_ADDRESS 0xFFF82262 MATRIX_DIM 31 1 1 /end MEASUREMENT
/begin MEASUREMENT AdaKupKalt.AdaBE.GlsKf3 "EepromStd[4688 ... 4701]: Beeinflussungsadaption Kennfeld 3 nur 1 PF kalt [(x=7/UMR___1_1_0)]" SWORD UMR_MBAR__1_1_0_S6_S3 1 100 -32768 32767 ECU_ADDRESS 0xFFF822A0 MATRIX_DIM 7 1 1 /end MEASUREMENT
/begin MEASUREMENT AdaK0Kalt.PF.SchaltCtr "EepromStd[4706 ... 4707]: K0-Fuelldruck-Adaption: Schaltungszaehler kalt [(x=1/UMR___1_1_0)]" UWORD UMR___1_1_0_S6_S3 1 100 0 65535 ECU_ADDRESS 0xFFF822B2 /end MEASUREMENT
/begin MEASUREMENT AdaK0Kalt.PF.PruefCtr "EepromStd[4708 ... 4709]: K0-Fuelldruck-Adaption: Pruefzaehler kalt [(x=1/UMR___1_1_0)]" UWORD UMR___1_1_0_S6_S3 1 100 0 65535 ECU_ADDRESS 0xFFF822B4 /end MEASUREMENT
/begin MEASUREMENT AdaK0Kalt.PF.Speicher "EepromStd[4710 ... 4711]: K0-Fuelldruck-Adaptionswert kalt [(x=1/UMR___1_1_0)]" SWORD UMR_MBAR__1_1_0_S6_S3 1 100 -32768 32767 ECU_ADDRESS 0xFFF822B6 /end MEASUREMENT
/begin MEASUREMENT PulsAdaKalt.Daten.ZwSpPf "EepromStd[4716 ... 4727]: Pulsadaption Kalt: Zwischenspeicher Fuelldruck [(x=6/UMR___1_1_0)]" SWORD UMR_MBAR__1_1_0_S6_S3 1 100 -32768 32767 ECU_ADDRESS 0xFFF822BC MATRIX_DIM 6 1 1 /end MEASUREMENT
/begin MEASUREMENT PulsAdaKalt.Daten.ZwSpTsf "EepromStd[4728 ... 4739]: Pulsadaption Kalt: Zwischenspeicher Schnellfuellzeit [(x=6/UMR___1_1_0)]" SWORD UMR_MSEC__1_1_0_S6_S3 1 100 -32768 32767 ECU_ADDRESS 0xFFF822C8 MATRIX_DIM 6 1 1 /end MEASUREMENT
/begin MEASUREMENT PulsAdaKalt.Daten.Prueftyp "EepromStd[4740 ... 4745]: Pulsadaption Kalt: Prueftyp (TSF oder PF) [(x=6/UMR___1_1_0)]" UBYTE UMR___1_1_0_S6_S3 1 100 0 255 ECU_ADDRESS 0xFFF822D4 MATRIX_DIM 6 1 1 /end MEASUREMENT
/begin MEASUREMENT PulsAdaKalt.Daten.Pulsid "EepromStd[4746 ... 4751]: Pulsadaption Kalt: Puls ID (Nummer Pruefpuls laut Diagrammm in PH) [(x=6/UMR___1_1_0)]" UBYTE UMR___1_1_0_S6_S3 1 100 0 255 ECU_ADDRESS 0xFFF822DA MATRIX_DIM 6 1 1 /end MEASUREMENT
/begin MEASUREMENT PulsAdaKalt.Daten.NPruefzyklen "EepromStd[4752 ... 4757]: Pulsadaption Kalt: Anzahl der abgeschlossenen Pruefzyklen fuer Increment Befuell-Pruefzaehler [(x=6/UMR___1_1_0)]" UBYTE UMR___1_1_0_S6_S3 1 100 0 255 ECU_ADDRESS 0xFFF822E0 MATRIX_DIM 6 1 1 /end MEASUREMENT
/begin MEASUREMENT PulsAdaKalt.Daten.NPulsgrenz "EepromStd[4758 ... 4763]: Pulsadaption Kalt: Anzahl der Pulse in diesem Pruefzyklus [(x=6/UMR___1_1_0)]" UBYTE UMR___1_1_0_S6_S3 1 100 0 255 ECU_ADDRESS 0xFFF822E6 MATRIX_DIM 6 1 1 /end MEASUREMENT
/begin MEASUREMENT PulsAdaKalt.Daten.NPruefschleife "EepromStd[4764 ... 4769]: Pulsadaption Kalt: Zaehler Pruefschleife bei Puls 3 (laut Diagramm in PH) [(x=6/UMR___1_1_0)]" UBYTE UMR___1_1_0_S6_S3 1 100 0 255 ECU_ADDRESS 0xFFF822EC MATRIX_DIM 6 1 1 /end MEASUREMENT
/begin MEASUREMENT StadaKup.Daten.TSF "EepromStd[4774 ... 4778]: Kupplungsspezifischer Status der TSF Adaption der STADA [(x=5/UMR___1_1_0)]" UBYTE UMR___1_1_0_S6_S3 1 100 0 255 ECU_ADDRESS 0xFFF822F6 MATRIX_DIM 5 1 1 /end MEASUREMENT
/begin MEASUREMENT StadaKup.Daten.PF "EepromStd[4779 ... 4783]: Kupplungsspezifischer Status der PF Adaption der STADA [(x=5/UMR___1_1_0)]" UBYTE UMR___1_1_0_S6_S3 1 100 0 255 ECU_ADDRESS 0xFFF822FB MATRIX_DIM 5 1 1 /end MEASUREMENT
/begin MEASUREMENT StadaK0.Daten.TSF "EepromStd[4788]: Status der TSF Adaption der K0 durch die STADA [(x=1/UMR___1_1_0)]" UBYTE UMR___1_1_0_S6_S3 1 100 0 255 ECU_ADDRESS 0xFFF82304 /end MEASUREMENT
/begin MEASUREMENT StadaK0.Daten.PF "EepromStd[4789]: Status der PF Adaption der K0 durch die STADA [(x=1/UMR___1_1_0)]" UBYTE UMR___1_1_0_S6_S3 1 100 0 255 ECU_ADDRESS 0xFFF82305 /end MEASUREMENT
/begin MEASUREMENT Kanal.Test.EndeEE "EepromStd[4794 ... 4795]: Ende-Marker des Kanals EEPROM_STD Wert: 54321 [(x=1/UMR___1_1_0)]" UWORD UMR___1_1_0_S6_S3 1 100 0 65535 ECU_ADDRESS 0xFFF8230A /end MEASUREMENT
/begin MEASUREMENT NoIni.MOBEF.MESchlupfCounter "Statistics[4 ... 5]: Motor Eingriff Schlupf-Zaehler [(x=1/UMR___1_1_0)]" UWORD UMR___1_1_0_S6_S3 1 100 0 65535 ECU_ADDRESS 0xFFF9A00C /end MEASUREMENT
/begin MEASUREMENT NoIni.MvG.Version "Statistics[6 ... 7]: MvG Versions-Nummer [(x=1/UMR___1_1_0)]" UWORD UMR___1_1_0_S6_S3 1 100 0 65535 ECU_ADDRESS 0xFFF9A00E /end MEASUREMENT
/begin MEASUREMENT MvG.Betriebspunkt.Ctr "Statistics[58 ... 1353]: MvG Betriebspunkt [(z=9/UMR___1_1_0),(x=6/UMR_U_MIN_1_1_0),(y=8/UMR_NM__1_1_0)]" UBYTE UMR___1_1_0_S6_S3 1 100 0 255 ECU_ADDRESS 0xFFF9A042 MATRIX_DIM 1296 1 1 /end MEASUREMENT
/begin MEASUREMENT MvG.GetrTemp.Ctr "Statistics[1354 ... 1377]: MvG Getriebe Temperatur [(x=8/UMR_GRADC__1_1_M40)]" UBYTE UMR___1_1_0_S6_S3 1 100 0 255 ECU_ADDRESS 0xFFF9A552 MATRIX_DIM 24 1 1 /end MEASUREMENT
/begin MEASUREMENT MvG.HisSpeicherLoesen.Ctr "Statistics[1378 ... 1401]: MvG HIS Speicher Loesen Temperatur [(x=8/UMR_GRADC__1_1_M40)]" UBYTE UMR___1_1_0_S6_S3 1 100 0 255 ECU_ADDRESS 0xFFF9A56A MATRIX_DIM 24 1 1 /end MEASUREMENT
/begin MEASUREMENT MvG.MotorStartTemp.Ctr "Statistics[1402 ... 1425]: MvG Motor Start Temperatur [(x=8/UMR_GRADC__1_1_M40)]" UBYTE UMR___1_1_0_S6_S3 1 100 0 255 ECU_ADDRESS 0xFFF9A582 MATRIX_DIM 24 1 1 /end MEASUREMENT
/begin MEASUREMENT MvG.IaeTemp.Ctr "Statistics[1426 ... 1449]: MvG Iae Temperatur [(x=8/UMR_GRADC__1_1_M40)]" UBYTE UMR___1_1_0_S6_S3 1 100 0 255 ECU_ADDRESS 0xFFF9A59A MATRIX_DIM 24 1 1 /end MEASUREMENT
/begin MEASUREMENT MvG.K0BelagTemp.Ctr "Statistics[1450 ... 1473]: MvG K0 Belag Temperatur [(x=8/UMR_GRADC__1_1_M40)]" UBYTE UMR___1_1_0_S6_S3 1 100 0 255 ECU_ADDRESS 0xFFF9A5B2 MATRIX_DIM 24 1 1 /end MEASUREMENT
/begin MEASUREMENT MvG.IaeZustand.Ctr "Statistics[1474 ... 1482]: MvG Iae Zustand [(x=3/UMR___1_1_0)]" UBYTE UMR___1_1_0_S6_S3 1 100 0 255 ECU_ADDRESS 0xFFF9A5CA MATRIX_DIM 9 1 1 /end MEASUREMENT
/begin MEASUREMENT MvG.IaeBelastung.Ctr "Statistics[1483 ... 1674]: MvG IAE Belastung [(x=8/UMR_U_MIN_1_1_0),(y=8/UMR_NM__1_1_0)]" UBYTE UMR___1_1_0_S6_S3 1 100 0 255 ECU_ADDRESS 0xFFF9A5D3 MATRIX_DIM 192 1 1 /end MEASUREMENT
/begin MEASUREMENT MvG.K0Zustand.Ctr "Statistics[1675 ... 1686]: MvG K0 Zustand [(x=4/UMR___1_1_0)]" UBYTE UMR___1_1_0_S6_S3 1 100 0 255 ECU_ADDRESS 0xFFF9A693 MATRIX_DIM 12 1 1 /end MEASUREMENT
/begin MEASUREMENT MvG.K0Belastung.Ctr "Statistics[1687 ... 1878]: MvG K0 Belastung [(x=8/UMR_U_MIN_1_1_0),(y=8/UMR_NM__1_1_0)]" UBYTE UMR___1_1_0_S6_S3 1 100 0 255 ECU_ADDRESS 0xFFF9A69F MATRIX_DIM 192 1 1 /end MEASUREMENT
/begin MEASUREMENT MvG.KupTemp.Ctr "Statistics[1879 ... 1998]: MvG Temperatur der Kupplungen [(y=5/UMR___1_1_0),(x=8/UMR_GRADC__1_1_0)]" UBYTE UMR___1_1_0_S6_S3 1 100 0 255 ECU_ADDRESS 0xFFF9A75F MATRIX_DIM 120 1 1 /end MEASUREMENT
/begin MEASUREMENT MvG.AnzSchleppstart.Ctr "Statistics[1999 ... 2022]: MvG Anzahl der Schleppstarts [(x=8/UMR___1_1_0)]" UBYTE UMR___1_1_0_S6_S3 1 100 0 255 ECU_ADDRESS 0xFFF9A7D7 MATRIX_DIM 24 1 1 /end MEASUREMENT
/begin MEASUREMENT MvG.IepBetriebsstunden.Ctr "Statistics[2023 ... 2034]: MvG Iep Betriebsstunden [(x=4/UMR___1_1_0)]" UBYTE UMR___1_1_0_S6_S3 1 100 0 255 ECU_ADDRESS 0xFFF9A7EF MATRIX_DIM 12 1 1 /end MEASUREMENT
/begin MEASUREMENT MvG.Schaltungen.Ctr "Statistics[2035 ... 2127]: MvG Schaltungen [(x=31/UMR___1_1_0)]" UBYTE UMR___1_1_0_S6_S3 1 100 0 255 ECU_ADDRESS 0xFFF9A7FB MATRIX_DIM 93 1 1 /end MEASUREMENT
/begin MEASUREMENT MvG.KflWechsel.Ctr "Statistics[2128 ... 2178]: MvG Kfl Wechsel [(x=17/UMR___1_1_0)]" UBYTE UMR___1_1_0_S6_S3 1 100 0 255 ECU_ADDRESS 0xFFF9A858 MATRIX_DIM 51 1 1 /end MEASUREMENT
/begin MEASUREMENT BPDaten.SchlafMV.ResetErkennungPosVUeb "BPRam[4 ... 5]: Batterie gepuferte Daten: Reset Erkennung PosV Ueberwachung [(x=1/UMR___1_1_0)]" UWORD UMR___1_1_0_S6_S3 1 100 0 65535 ECU_ADDRESS 0xFFF83B14 /end MEASUREMENT
/begin MEASUREMENT AdaIaeufRead.Daten.Speicher "BPRam[10 ... 45]: IAE Uebertragungsfaehigkeits Adaptions-Speicher [(x=6/UMR_U_MIN_1_1_0),(y=6/UMR_NM__1_1_0)]" SBYTE UMR_NM_BAR_1_1_0_S6_S3 1 100 -128 127 ECU_ADDRESS 0xFFF83B1A MATRIX_DIM 36 1 1 /end MEASUREMENT
/begin MEASUREMENT iAdaPfusf.n_f_alt.n_f "letzter Wert" SLONG UMR___1_1_0_S6_S3 1 100 -2147483648 2147483647 DISPLAY_IDENTIFIER n_f.n_f_alt.iAdaPfusf ECU_ADDRESS 0xFFF8C014 /end MEASUREMENT
/begin MEASUREMENT iAdaPfusf.n_f_alt.letzter_ms_timer "letzter Timerwert" UWORD UMR___1_1_0_S6_S3 1 100 0 65535 DISPLAY_IDENTIFIER letzter_ms_timer.n_f_alt.iAdaPfusf ECU_ADDRESS 0xFFF8C018 /end MEASUREMENT
/begin MEASUREMENT iAdaPfusf.z_adapfn_status "Status der neuen Fuelldruckadaption" UBYTE Conv.cAdaPfusf._.z_adapfn_status_S6_S3 1 100 0 15 DISPLAY_IDENTIFIER z_adapfn_status.iAdaPfusf ECU_ADDRESS 0xFFF8BFE0 /end MEASUREMENT
/begin MEASUREMENT iAdaPfusf.adapfn_status "Status der neuen Fuelldruckadaption" UBYTE Conv.cAdaPfusf._.adapfn_status_S6_S3 1 100 0 15 DISPLAY_IDENTIFIER adapfn_status.iAdaPfusf ECU_ADDRESS 0xFFF8BFE1 /end MEASUREMENT
/begin MEASUREMENT iAdaPfusf.adkl_pfad "Adaptionsklasse der Fuelldruckadaption" UBYTE Conv.cAdaPfusf._.adkl_pfad_S6_S3 1 100 0 5 DISPLAY_IDENTIFIER adkl_pfad.iAdaPfusf ECU_ADDRESS 0xFFF8BFE2 /end MEASUREMENT
/begin MEASUREMENT iAdaPfusf.ng_ab_pfad "Abtriebsdrehzahlgradient neue Fuelldruck-Ada" SWORD UMR_U_MINSEC_1_1_0_S6_S3 1 100 -1000 1000 DISPLAY_IDENTIFIER ng_ab_pfad.iAdaPfusf ECU_ADDRESS 0xFFF8BFE4 /end MEASUREMENT
/begin MEASUREMENT iAdaPfusf.ada_wert_pfad "Adaptionswert (nur delta) neue Fuelldruckada." SWORD UMR_BAR__1_1000_0_S6_S3 1 100 -1.024 1.024 DISPLAY_IDENTIFIER ada_wert_pfad.iAdaPfusf ECU_ADDRESS 0xFFF8BFE6 /end MEASUREMENT
/begin MEASUREMENT iAdaPfusf.schaltart_pfad "Schaltart neue Fuelldruckadaption 0=KS, 1=HS, 2=RS" UBYTE Conv.cAdaPfusf._.schaltart_pfad_S6_S3 1 100 0 2 DISPLAY_IDENTIFIER schaltart_pfad.iAdaPfusf ECU_ADDRESS 0xFFF8BFE8 /end MEASUREMENT
/begin MEASUREMENT iAdaPfusf.schaltcode_pfad "Schaltcode neue Fuelldruckadaption (Maximalausbau: bei 8-Gang Projekten, die Schaltungen in 9. Gang ignorieren)" UBYTE Conv.cAdaPfusf._.schaltcode_pfad_S6_S3 1 100 0 17 DISPLAY_IDENTIFIER schaltcode_pfad.iAdaPfusf ECU_ADDRESS 0xFFF8BFE9 /end MEASUREMENT
/begin MEASUREMENT iAdaPfusf.f_mt_krit_aktiv_pfad "Flag: Turbinenmoment Kriterium bei RS PFAD verwenden" UBYTE Conv.cAdaPfusf._.f_mt_krit_aktiv_pfad_S6_S3 1 100 0 1 BIT_MASK 0x1 DISPLAY_IDENTIFIER f_mt_krit_aktiv_pfad.iAdaPfusf ECU_ADDRESS 0xFFF8BFEA /end MEASUREMENT
/begin MEASUREMENT iAdaPfusf.timer_pfad "Timer f. Neue Fuelldruckadaption" UWORD UMR_MSEC__10_1_0_S6_S3 1 100 0 5000 DISPLAY_IDENTIFIER timer_pfad.iAdaPfusf ECU_ADDRESS 0xFFF8BFEC /end MEASUREMENT
/begin MEASUREMENT iAdaPfusf.td_pfad "Differenzzeit fuer PF bei HS - ADAPFN" SWORD UMR_MSEC__10_1_0_S6_S3 1 100 -3000 3000 DISPLAY_IDENTIFIER td_pfad.iAdaPfusf ECU_ADDRESS 0xFFF8BFEE /end MEASUREMENT
/begin MEASUREMENT iAdaPfusf.td_pfadtsyn "Differenzzeit fuer PF bei RS - ADAPFN" SWORD UMR_MSEC__10_1_0_S6_S3 1 100 -300 300 DISPLAY_IDENTIFIER td_pfadtsyn.iAdaPfusf ECU_ADDRESS 0xFFF8BFF0 /end MEASUREMENT
/begin MEASUREMENT iAdaPfusf.nd_syn_istgang_pfad "Differenzdrehzahl n_t zu synchron PFN-Adaption" SWORD UMR_U_MIN_1_1_0_S6_S3 1 100 -32768 32767 DISPLAY_IDENTIFIER nd_syn_istgang_pfad.iAdaPfusf ECU_ADDRESS 0xFFF8BFF2 /end MEASUREMENT
/begin MEASUREMENT iAdaPfusf.f_max_flare_erreicht_hs_pfad "Flag: nd_synistgang groesser Schwelle - waehrend Beoabachtungszeitraum bei HS PFAD verwenden" UBYTE Conv.cAdaPfusf._.f_max_flare_erreicht_hs_pfad_S6_S3 1 100 0 1 BIT_MASK 0x1 DISPLAY_IDENTIFIER f_max_flare_erreicht_hs_pfad.iAdaPfusf ECU_ADDRESS 0xFFF8BFF4 /end MEASUREMENT
/begin MEASUREMENT iAdaPfusf.nd_syn_istgang_min_pfad "Minimale Differenzdrehzahl n_t zu synchron PFN-Adaption" SWORD UMR_U_MIN_1_1_0_S6_S3 1 100 -32768 32767 DISPLAY_IDENTIFIER nd_syn_istgang_min_pfad.iAdaPfusf ECU_ADDRESS 0xFFF8BFF6 /end MEASUREMENT
/begin MEASUREMENT iAdaPfusf.pm_gls_pfad "mittlere Regeleingriff PFAD" SWORD UMR_BAR__1_100_0_S6_S3 1 100 -1.25 1.24 DISPLAY_IDENTIFIER pm_gls_pfad.iAdaPfusf ECU_ADDRESS 0xFFF8BFF8 /end MEASUREMENT
/begin MEASUREMENT iAdaPfusf.m_t_pfad "Moment zum Zeitpunkt der Bewertung" SWORD UMR_NM__1_1_0_S6_S3 1 100 -400 1640 DISPLAY_IDENTIFIER m_t_pfad.iAdaPfusf ECU_ADDRESS 0xFFF8BFFA /end MEASUREMENT
/begin MEASUREMENT iAdaPfusf.t_bezug_pfad "Bezugspunkt: Ende Rampe1 Anm: -99990 steht f. unbestimmt" SWORD UMR_MSEC__10_1_0_S6_S3 1 100 0 3000 DISPLAY_IDENTIFIER t_bezug_pfad.iAdaPfusf ECU_ADDRESS 0xFFF8BFFC /end MEASUREMENT
/begin MEASUREMENT iAdaPfusf.t_mess_pfad "Messpunkt: Verlassen Synchron Anm: -99990 steht f. unbestimmt" SWORD UMR_MSEC__10_1_0_S6_S3 1 100 0 3000 DISPLAY_IDENTIFIER t_mess_pfad.iAdaPfusf ECU_ADDRESS 0xFFF8BFFE /end MEASUREMENT
/begin MEASUREMENT iAdaPfusf.n_tsync_pfad "Synchrondrehzahl alter Gang + ND_PFADRSxy bzw. -ND_PFADHS" UWORD UMR_U_MIN_1_1_0_S6_S3 1 100 0 8160 DISPLAY_IDENTIFIER n_tsync_pfad.iAdaPfusf ECU_ADDRESS 0xFFF8C000 /end MEASUREMENT
/begin MEASUREMENT iAdaPfusf.dki_pfad "DKI zu Schaltungsbeginn bei HS - neue Fuelldruckada" UBYTE UMR_PROZENT__20_51_0_S6_S3 1 100 0 100 DISPLAY_IDENTIFIER dki_pfad.iAdaPfusf ECU_ADDRESS 0xFFF8C002 /end MEASUREMENT
/begin MEASUREMENT iAdaPfusf.f_adapfn_status "Freigabe für Status aktualisierung" UBYTE Conv.cAdaPfusf._.f_adapfn_status_S6_S3 1 100 0 1 BIT_MASK 0x1 DISPLAY_IDENTIFIER f_adapfn_status.iAdaPfusf ECU_ADDRESS 0xFFF8C003 /end MEASUREMENT
/begin MEASUREMENT iAdaPfusf.bew_fuer_adkl_pfad "-" UBYTE UMR___1_1_0_S6_S3 1 100 0 255 DISPLAY_IDENTIFIER bew_fuer_adkl_pfad.iAdaPfusf ECU_ADDRESS 0xFFF8C004 /end MEASUREMENT
/begin MEASUREMENT iAdaPfusf.pgls_speicher_pfad "Regelflaeche von p_kzu" SLONG UMR___1_1_0_S6_S3 1 100 -2147483648 2147483647 DISPLAY_IDENTIFIER pgls_speicher_pfad.iAdaPfusf ECU_ADDRESS 0xFFF8C008 /end MEASUREMENT
/begin MEASUREMENT iAdaPfusf.cycle_count_pfad "Zaehler fuer Takte" UWORD UMR___1_1_0_S6_S3 1 100 0 65535 DISPLAY_IDENTIFIER cycle_count_pfad.iAdaPfusf ECU_ADDRESS 0xFFF8C00C /end MEASUREMENT
/begin MEASUREMENT iAdaPfusf.hsad_verbotqsx "reine Anzeigegroesse: Spontanitaets-Beeinflussung durch PFAD" UBYTE Conv.cAdaPfusf._.hsad_verbotqsx_S6_S3 1 100 0 1 BIT_MASK 0x1 DISPLAY_IDENTIFIER hsad_verbotqsx.iAdaPfusf ECU_ADDRESS 0xFFF8C00E /end MEASUREMENT
/begin MEASUREMENT iAdaPfusf.pm_gls_status "eigener Zustandsgraph" UBYTE Conv.cAdaPfusf._.pm_gls_status_S6_S3 1 100 0 255 DISPLAY_IDENTIFIER pm_gls_status.iAdaPfusf ECU_ADDRESS 0xFFF8C00F /end MEASUREMENT
/begin MEASUREMENT iAdaPfusf.ada_starttyp_pf "ID Aktiever Adaptionstyp" UBYTE Conv.cAdaPfusf._.ada_starttyp_pf_S6_S3 1 100 0 4 DISPLAY_IDENTIFIER ada_starttyp_pf.iAdaPfusf ECU_ADDRESS 0xFFF8C010 /end MEASUREMENT
/begin MEASUREMENT iAdaPfusf.freigabe_e_h "Signal zu abfrage ob Ada Abaluf für E oder H Fahren freigegeben ist" UBYTE Conv.cAdaPfusf._.freigabe_e_h_S6_S3 1 100 0 2 DISPLAY_IDENTIFIER freigabe_e_h.iAdaPfusf ECU_ADDRESS 0xFFF8C011 /end MEASUREMENT
/begin MEASUREMENT iAdaPfusf.kup_pfad "betrachtete Kupplung der PF-Adaption" UBYTE UMR___1_1_0_S6_S3 1 100 0 5 DISPLAY_IDENTIFIER kup_pfad.iAdaPfusf ECU_ADDRESS 0xFFF8C012 /end MEASUREMENT
/begin MEASUREMENT iAdaPfusf.z_pfad_cgt_adkl_kup_pfad "Temperaturabheangige Adaptionsklasse der zu peruefenden Kupplung bei Adaptionsinitialisierung." UBYTE Conv.cAdaPfusf._.z_pfad_cgt_adkl_kup_pfad_S6_S3 1 100 0 6 DISPLAY_IDENTIFIER z_pfad_cgt_adkl_kup_pfad.iAdaPfusf ECU_ADDRESS 0xFFF8C013 /end MEASUREMENT
/begin MEASUREMENT iAdaPstSysNmot.timer_nmotleersoll_aktiv_stada.timer "Der aktuelle Timerwert" UWORD UMR_MSEC__10_1_0_S6_S3 1 100 0 655350 DISPLAY_IDENTIFIER timer_nmotleersoll_aktiv_stada.iAdaPstSysNmot ECU_ADDRESS 0xFFF8A066 /end MEASUREMENT
/begin MEASUREMENT iAdaPstSysNmot.akt_ada "ID der Momentan aktiven Adaption" UBYTE Conv.cAdaPstSysNmot._.akt_ada_S6_S3 1 100 0 3 DISPLAY_IDENTIFIER akt_ada.iAdaPstSysNmot ECU_ADDRESS 0xFFF8A062 /end MEASUREMENT
/begin MEASUREMENT iAdaPstSysNmot.z_systemkondit_nmot "Zustand der Testeradaption" UBYTE Conv.cAdaPstSysNmot._.z_systemkondit_nmot_S6_S3 1 100 0 8 DISPLAY_IDENTIFIER z_systemkondit_nmot.iAdaPstSysNmot ECU_ADDRESS 0xFFF8A063 /end MEASUREMENT
/begin MEASUREMENT iAdaPstSysNmot.f_nmotsoll_stada_em "anforderung E- Maschienenmindestdrehzahl durch Adaption" UBYTE Conv.cAdaPstSysNmot._.f_nmotsoll_stada_em_S6_S3 1 100 0 1 BIT_MASK 0x1 DISPLAY_IDENTIFIER f_nmotsoll_stada_em.iAdaPstSysNmot ECU_ADDRESS 0xFFF8A064 /end MEASUREMENT
/begin MEASUREMENT iAdaPstSysZzs.akt_ada "ID der Momentan aktiven Adaption" UBYTE Conv.cAdaPstSysZzs._.akt_ada_S6_S3 1 100 0 3 DISPLAY_IDENTIFIER akt_ada.iAdaPstSysZzs ECU_ADDRESS 0xFFF8A38E /end MEASUREMENT
/begin MEASUREMENT iAdaPstSysZzs.z_systemkondit_zzs "Zustand der Testeradaption" UBYTE Conv.cAdaPstSysZzs._.z_systemkondit_zzs_S6_S3 1 100 0 11 DISPLAY_IDENTIFIER z_systemkondit_zzs.iAdaPstSysZzs ECU_ADDRESS 0xFFF8A38F /end MEASUREMENT
/begin MEASUREMENT iAdaPstSysZzs.gang_zzs_stada "Gang der eingelegt werden soll um eine Pulspruefung zu starten" SBYTE Conv.cAdaPstSysZzs._.gang_zzs_stada_S6_S3 1 100 -1 8 DISPLAY_IDENTIFIER gang_zzs_stada.iAdaPstSysZzs ECU_ADDRESS 0xFFF8A390 /end MEASUREMENT
/begin MEASUREMENT iAdaPstSysPsys.akt_ada "ID der Momentan aktiven Adaption" UBYTE Conv.cAdaPstSysPsys._.akt_ada_S6_S3 1 100 0 3 DISPLAY_IDENTIFIER akt_ada.iAdaPstSysPsys ECU_ADDRESS 0xFFF8A68B /end MEASUREMENT
/begin MEASUREMENT iAdaPstSysPsys.z_systemkondit_psys "Zustand der Testeradaption" UBYTE Conv.cAdaPstSysPsys._.z_systemkondit_psys_S6_S3 1 100 0 6 DISPLAY_IDENTIFIER z_systemkondit_psys.iAdaPstSysPsys ECU_ADDRESS 0xFFF8A68C /end MEASUREMENT
/begin MEASUREMENT iAdaPstSysPsys.f_psys_anforderung_stada "Singalisiert das Systemdruckanhebung angeforder ist" UBYTE Conv.cAdaPstSysPsys._.f_psys_anforderung_stada_S6_S3 1 100 0 1 BIT_MASK 0x1 DISPLAY_IDENTIFIER f_psys_anforderung_stada.iAdaPstSysPsys ECU_ADDRESS 0xFFF8A68D /end MEASUREMENT
/begin MEASUREMENT iAdaPstSysFunkdeakt.akt_ada "ID der Momentan aktiven Adaption" UBYTE Conv.cAdaPstSysFunkdeakt._.akt_ada_S6_S3 1 100 0 3 DISPLAY_IDENTIFIER akt_ada.iAdaPstSysFunkdeakt ECU_ADDRESS 0xFFF8A252 /end MEASUREMENT
/begin MEASUREMENT iAdaPstSysFunkdeakt.z_systemkondit_funkdeakt "Zustand der Funktionsdeaktivierung" UBYTE Conv.cAdaPstSysFunkdeakt._.z_systemkondit_funkdeakt_S6_S3 1 100 0 8 DISPLAY_IDENTIFIER z_systemkondit_funkdeakt.iAdaPstSysFunkdeakt ECU_ADDRESS 0xFFF8A253 /end MEASUREMENT
/begin MEASUREMENT iAdaPstSysAgl.akt_ada "ID der Momentan aktiven Adaption" UBYTE Conv.cAdaPstSysAgl._.akt_ada_S6_S3 1 100 0 3 DISPLAY_IDENTIFIER akt_ada.iAdaPstSysAgl ECU_ADDRESS 0xFFF8A250 /end MEASUREMENT
/begin MEASUREMENT iAdaPstSysAgl.z_systemkondit_agl "Zustand der Testeradaption" UBYTE Conv.cAdaPstSysAgl._.z_systemkondit_agl_S6_S3 1 100 0 4 DISPLAY_IDENTIFIER z_systemkondit_agl.iAdaPstSysAgl ECU_ADDRESS 0xFFF8A251 /end MEASUREMENT
/begin MEASUREMENT iAdaPstSysK0.akt_ada "ID der Momentan aktiven Adaption" UBYTE Conv.cAdaPstSysK0._.akt_ada_S6_S3 1 100 0 3 DISPLAY_IDENTIFIER akt_ada.iAdaPstSysK0 ECU_ADDRESS 0xFFF8A38D /end MEASUREMENT
/begin MEASUREMENT iAdaPstSysKup.akt_ada "ID der Momentan aktiven Adaption" UBYTE Conv.cAdaPstSysKup._.akt_ada_S6_S3 1 100 0 3 DISPLAY_IDENTIFIER akt_ada.iAdaPstSysKup ECU_ADDRESS 0xFFF8C7F8 /end MEASUREMENT
/begin MEASUREMENT iAdaPstSysKup.sal_eng_start_req "Startanforderung an den Verbrennungsmotor" UBYTE Conv.cAdaPstSysKup._.sal_eng_start_req_S6_S3 1 100 0 1 BIT_MASK 0x1 DISPLAY_IDENTIFIER sal_eng_start_req.iAdaPstSysKup ECU_ADDRESS 0xFFF8C7F9 /end MEASUREMENT
/begin MEASUREMENT iAdaPstSysKup.sal_eng_stop_disable "Verhinderung Motor-Stopp wird hierueber angefordert" UBYTE Conv.cAdaPstSysKup._.sal_eng_stop_disable_S6_S3 1 100 0 1 BIT_MASK 0x1 DISPLAY_IDENTIFIER sal_eng_stop_disable.iAdaPstSysKup ECU_ADDRESS 0xFFF8C7FA /end MEASUREMENT
/begin MEASUREMENT iAdaPstSysKup.z_k0_stada "Sollvorgabe für die Trennkupplung K0 durch die Stillstandsadaption" UBYTE Conv.cAdaPstSysKup._.z_k0_stada_S6_S3 1 100 0 1 DISPLAY_IDENTIFIER z_k0_stada.iAdaPstSysKup ECU_ADDRESS 0xFFF8C7FB /end MEASUREMENT
/begin MEASUREMENT iAdaPstzs.iBew.iFensterNeg.iTimerStarten.timer "Der aktuelle Timerwert" UBYTE UMR_MSEC__10_1_0_S6_S3 1 100 0 2550 DISPLAY_IDENTIFIER iTimerStarten.iFensterNeg.iBew.iAdaPstzs ECU_ADDRESS 0xFFF8C020 /end MEASUREMENT
/begin MEASUREMENT iAdaPstzs.iBew.iFensterNeg.iTimerBeenden.timer "Der aktuelle Timerwert" UBYTE UMR_MSEC__10_1_0_S6_S3 1 100 0 2550 DISPLAY_IDENTIFIER iTimerBeenden.iFensterNeg.iBew.iAdaPstzs ECU_ADDRESS 0xFFF8C021 /end MEASUREMENT
/begin MEASUREMENT iAdaPstzs.iBew.iFensterNeg.f_aktiv_stada "Zustand des Fensters" UBYTE Conv.cAdaPstbwFenster._.f_aktiv_stada_S6_S3 1 100 0 1 BIT_MASK 0x1 DISPLAY_IDENTIFIER f_aktiv_Neg_stada ECU_ADDRESS 0xFFF8C022 /end MEASUREMENT
/begin MEASUREMENT iAdaPstzs.iBew.iFensterNeg.f_starten_stada "Fenster soll aktiviert werden" UBYTE Conv.cAdaPstbwFenster._.f_starten_stada_S6_S3 1 100 0 1 BIT_MASK 0x1 DISPLAY_IDENTIFIER f_starten_Neg_stada ECU_ADDRESS 0xFFF8C023 /end MEASUREMENT
/begin MEASUREMENT iAdaPstzs.iBew.iFensterNeg.f_beenden_stada "Fenster soll beendet werden" UBYTE Conv.cAdaPstbwFenster._.f_beenden_stada_S6_S3 1 100 0 1 BIT_MASK 0x1 DISPLAY_IDENTIFIER f_beenden_Neg_stada ECU_ADDRESS 0xFFF8C024 /end MEASUREMENT
/begin MEASUREMENT iAdaPstzs.iBew.iFensterPos.iTimerStarten.timer "Der aktuelle Timerwert" UBYTE UMR_MSEC__10_1_0_S6_S3 1 100 0 2550 DISPLAY_IDENTIFIER iTimerStarten.iFensterPos.iBew.iAdaPstzs ECU_ADDRESS 0xFFF8C025 /end MEASUREMENT
/begin MEASUREMENT iAdaPstzs.iBew.iFensterPos.iTimerBeenden.timer "Der aktuelle Timerwert" UBYTE UMR_MSEC__10_1_0_S6_S3 1 100 0 2550 DISPLAY_IDENTIFIER iTimerBeenden.iFensterPos.iBew.iAdaPstzs ECU_ADDRESS 0xFFF8C026 /end MEASUREMENT
/begin MEASUREMENT iAdaPstzs.iBew.iFensterPos.f_aktiv_stada "Zustand des Fensters" UBYTE Conv.cAdaPstbwFenster._.f_aktiv_stada_S6_S3 1 100 0 1 BIT_MASK 0x1 DISPLAY_IDENTIFIER f_aktiv_Pos_stada ECU_ADDRESS 0xFFF8C027 /end MEASUREMENT
/begin MEASUREMENT iAdaPstzs.iBew.iFensterPos.f_starten_stada "Fenster soll aktiviert werden" UBYTE Conv.cAdaPstbwFenster._.f_starten_stada_S6_S3 1 100 0 1 BIT_MASK 0x1 DISPLAY_IDENTIFIER f_starten_Pos_stada ECU_ADDRESS 0xFFF8C028 /end MEASUREMENT
/begin MEASUREMENT iAdaPstzs.iBew.iFensterPos.f_beenden_stada "Fenster soll beendet werden" UBYTE Conv.cAdaPstbwFenster._.f_beenden_stada_S6_S3 1 100 0 1 BIT_MASK 0x1 DISPLAY_IDENTIFIER f_beenden_Pos_stada ECU_ADDRESS 0xFFF8C029 /end MEASUREMENT
/begin MEASUREMENT iAdaPstzs.iBew.iTimerAmp.timer "Der aktuelle Timerwert" UBYTE UMR_MSEC__10_1_0_S6_S3 1 100 0 2550 DISPLAY_IDENTIFIER iTimerAmp.iBew.iAdaPstzs ECU_ADDRESS 0xFFF8C02A /end MEASUREMENT
/begin MEASUREMENT iAdaPstzs.iBew.zustand_stada "Zustand Bewertung des Bewertungsablaufes" UBYTE Conv.cAdaPstbw._.zustand_stada_S6_S3 1 100 0 4 DISPLAY_IDENTIFIER zustand_stada.iBew.iAdaPstzs ECU_ADDRESS 0xFFF8C02B /end MEASUREMENT
/begin MEASUREMENT iAdaPstzs.iBew.testresultat_stada "Testresultat Befuellpruefung" UBYTE Conv.cAdaPstbw._.testresultat_stada_S6_S3 1 100 0 4 DISPLAY_IDENTIFIER testresultat_stada.iBew.iAdaPstzs ECU_ADDRESS 0xFFF8C02C /end MEASUREMENT
/begin MEASUREMENT iAdaPstzs.iBew.nd_pulszwneg_stada "Schwelle TAB_ND_PULSZWNEG..." SWORD UMR_U_MIN_1_1_0_S6_S3 1 100 0 1000 DISPLAY_IDENTIFIER nd_pulszwneg_stada.iBew.iAdaPstzs ECU_ADDRESS 0xFFF8C02E /end MEASUREMENT
/begin MEASUREMENT iAdaPstzs.iBew.nd_pulszwpos_stada "Schwelle TAB_ND_PULSZWPOS..." SWORD UMR_U_MIN_1_1_0_S6_S3 1 100 0 1000 DISPLAY_IDENTIFIER nd_pulszwpos_stada.iBew.iAdaPstzs ECU_ADDRESS 0xFFF8C030 /end MEASUREMENT
/begin MEASUREMENT iAdaPstzs.iBew.nd_pulsamp_stada "Schwelle TAB_ND_PULSAMP..." SWORD UMR_U_MIN_1_1_0_S6_S3 1 100 0 1000 DISPLAY_IDENTIFIER nd_pulsamp_stada.iBew.iAdaPstzs ECU_ADDRESS 0xFFF8C032 /end MEASUREMENT
/begin MEASUREMENT iAdaPstzs.iBew.nd_pulsneg_stada "Schwelle TAB_ND_PULSNEG..." SWORD UMR_U_MIN_1_1_0_S6_S3 1 100 0 1000 DISPLAY_IDENTIFIER nd_pulsneg_stada.iBew.iAdaPstzs ECU_ADDRESS 0xFFF8C034 /end MEASUREMENT
/begin MEASUREMENT iAdaPstzs.iBew.nd_pulspos_stada "Schwelle TAB_ND_PULSPOS..." SWORD UMR_U_MIN_1_1_0_S6_S3 1 100 0 1000 DISPLAY_IDENTIFIER nd_pulspos_stada.iBew.iAdaPstzs ECU_ADDRESS 0xFFF8C036 /end MEASUREMENT
/begin MEASUREMENT iAdaPstzs.iBew.neg_rea_stada "ND-Reaktion auf PF- oder SF-Puls" UBYTE Conv.cAdaPstbw._.neg_rea_stada_S6_S3 1 100 0 2 DISPLAY_IDENTIFIER neg_rea_stada.iBew.iAdaPstzs ECU_ADDRESS 0xFFF8C038 /end MEASUREMENT
/begin MEASUREMENT iAdaPstzs.iBew.pos_rea_stada "ND-Reaktion nach PF- oder SF-Puls" UBYTE Conv.cAdaPstbw._.pos_rea_stada_S6_S3 1 100 0 2 DISPLAY_IDENTIFIER pos_rea_stada.iBew.iAdaPstzs ECU_ADDRESS 0xFFF8C039 /end MEASUREMENT
/begin MEASUREMENT iAdaPstzs.iBew.rea_amplitude_stada "ND-Reaktion nach Puls als Amplitude spitze-spitze" UBYTE Conv.cAdaPstbw._.rea_amplitude_stada_S6_S3 1 100 0 1 DISPLAY_IDENTIFIER rea_amplitude_stada.iBew.iAdaPstzs ECU_ADDRESS 0xFFF8C03A /end MEASUREMENT
/begin MEASUREMENT iAdaPstzs.iBew.n_guete_min_stada "Minimum der Drehzahlsignalguete f. Amplitudenbest." SWORD UMR_U_MIN_1_1_0_S6_S3 1 100 -2048 2048 DISPLAY_IDENTIFIER n_guete_min_stada.iBew.iAdaPstzs ECU_ADDRESS 0xFFF8C03C /end MEASUREMENT
/begin MEASUREMENT iAdaPstzs.iBew.amplitude_ss_stada "Drehzahlwert f.Amplitude spitze-spitze" SWORD UMR_U_MIN_1_1_0_S6_S3 1 100 -100 100 DISPLAY_IDENTIFIER amplitude_ss_stada.iBew.iAdaPstzs ECU_ADDRESS 0xFFF8C03E /end MEASUREMENT
/begin MEASUREMENT iAdaPstzs.iBew.max_adawert_stada "Der Maximale Adaptionswert" SWORD UMR___1_1_0_S6_S3 1 100 -32768 32767 DISPLAY_IDENTIFIER max_adawert_stada.iBew.iAdaPstzs ECU_ADDRESS 0xFFF8C044 /end MEASUREMENT
/begin MEASUREMENT iAdaPstzs.iBew.zeit_erk_amp_stada "Die Zeit für die Erkennung der Amplitude" UBYTE UMR_MSEC__10_1_0_S6_S3 1 100 0 2500 DISPLAY_IDENTIFIER zeit_erk_amp_stada.iBew.iAdaPstzs ECU_ADDRESS 0xFFF8C046 /end MEASUREMENT
/begin MEASUREMENT iAdaPstzs.iTSf.zustand_stada "Zustand Schnellfuellpruefung" UBYTE Conv.cAdaPstsf._.zustand_stada_S6_S3 1 100 0 6 DISPLAY_IDENTIFIER zustand_stada.iTSf.iAdaPstzs ECU_ADDRESS 0xFFF8C050 /end MEASUREMENT
/begin MEASUREMENT iAdaPstzs.iTSf.kup_puls_stada "Kupplung die aktuell geprueft werden soll" UBYTE Conv.cAdaPstsf._.kup_puls_stada_S6_S3 1 100 0 6 DISPLAY_IDENTIFIER kup_puls_stada.iTSf.iAdaPstzs ECU_ADDRESS 0xFFF8C051 /end MEASUREMENT
/begin MEASUREMENT iAdaPstzs.iPf.iZustandstimerStada.timer "Der aktuelle Timerwert" UWORD UMR_MSEC__10_1_0_S6_S3 1 100 0 655350 DISPLAY_IDENTIFIER iZustandstimerStada.iPf.iAdaPstzs ECU_ADDRESS 0xFFF8C05C /end MEASUREMENT
/begin MEASUREMENT iAdaPstzs.iPf.zustand_stada "Zustand Fuelldruckpruefung" UBYTE Conv.cAdaPstpf._.zustand_stada_S6_S3 1 100 0 7 DISPLAY_IDENTIFIER zustand_stada.iPf.iAdaPstzs ECU_ADDRESS 0xFFF8C05E /end MEASUREMENT
/begin MEASUREMENT iAdaPstzs.iPf.t_fenster_nach_sf_stada "Verbotszeit fuer die Abfrage ND_ADABBR nach SF" UWORD UMR_MSEC__10_1_0_S6_S3 1 100 0 2500 DISPLAY_IDENTIFIER t_fenster_nach_sf_stada.iPf.iAdaPstzs ECU_ADDRESS 0xFFF8C060 /end MEASUREMENT
/begin MEASUREMENT iAdaPstzs.iPf.fenster_nach_sf_stada "Flag fuer Verbot auf Abfrage ND_ADABBR nach SF" UBYTE Conv.cAdaPstpf._.fenster_nach_sf_stada_S6_S3 1 100 0 1 BIT_MASK 0x1 DISPLAY_IDENTIFIER fenster_nach_sf_stada.iPf.iAdaPstzs ECU_ADDRESS 0xFFF8C062 /end MEASUREMENT
/begin MEASUREMENT iAdaPstzs.iPf.t_fenster_sf_stada "Verbotszeit fuer die Abfrage ND_ADABBR waehrnd SF" UWORD UMR_MSEC__10_1_0_S6_S3 1 100 0 2500 DISPLAY_IDENTIFIER t_fenster_sf_stada.iPf.iAdaPstzs ECU_ADDRESS 0xFFF8C064 /end MEASUREMENT
/begin MEASUREMENT iAdaPstzs.iPf.fenster_sf_stada "Flag fuer Verbot auf Abfrage ND_ADABBR waehrnd SF" UBYTE Conv.cAdaPstpf._.fenster_sf_stada_S6_S3 1 100 0 1 BIT_MASK 0x1 DISPLAY_IDENTIFIER fenster_sf_stada.iPf.iAdaPstzs ECU_ADDRESS 0xFFF8C066 /end MEASUREMENT
/begin MEASUREMENT iAdaPstzs.iPf.kup_puls_stada "Kupplung die aktuell geprueft werden soll" UBYTE Conv.cAdaPstpf._.kup_puls_stada_S6_S3 1 100 0 6 DISPLAY_IDENTIFIER kup_puls_stada.iPf.iAdaPstzs ECU_ADDRESS 0xFFF8C067 /end MEASUREMENT
/begin MEASUREMENT iAdaPstzs.iPf.f_deakt_dither_stada "Bitcodirtes Signal zur Deaktivierung der Dither Funktion Bit0:nicht belegt Bit1:KupA Bit2:KupB ..." UBYTE UMR___1_1_0_S6_S3 1 100 0 255 DISPLAY_IDENTIFIER f_deakt_dither_stada.iPf.iAdaPstzs ECU_ADDRESS 0xFFF8C068 /end MEASUREMENT
/begin MEASUREMENT iAdaPstzs.iPre.iZustandstimerStada.timer "Der aktuelle Timerwert" UWORD UMR_MSEC__10_1_0_S6_S3 1 100 0 655350 DISPLAY_IDENTIFIER iZustandstimerStada.iPre.iAdaPstzs ECU_ADDRESS 0xFFF8C074 /end MEASUREMENT
/begin MEASUREMENT iAdaPstzs.iPre.iRampeAb.letzter_wert "Speichert den letzten Eingangswert" SLONG UMR___1_1_0_S6_S3 1 100 -2147483648 2147483647 DISPLAY_IDENTIFIER letzter_wert.iRampeAb.iPre.iAdaPstzs ECU_ADDRESS 0xFFF8C078 /end MEASUREMENT
/begin MEASUREMENT iAdaPstzs.iPre.iRampeAb.letzter_timer "Speichert den letzten BS-Timer" UWORD UMR_SEC__1_1_0_S6_S3 1 100 0 255 DISPLAY_IDENTIFIER letzter_timer.iRampeAb.iPre.iAdaPstzs ECU_ADDRESS 0xFFF8C07C /end MEASUREMENT
/begin MEASUREMENT iAdaPstzs.iPre.iRampeAuf.letzter_wert "Speichert den letzten Eingangswert" FLOAT32_IEEE UMR___1_1_0_S6_S3 1 100 -1E+037 1E+037 FORMAT "%4.2" DISPLAY_IDENTIFIER letzter_wert.iRampeAuf.iPre.iAdaPstzs ECU_ADDRESS 0xFFF8C080 /end MEASUREMENT
/begin MEASUREMENT iAdaPstzs.iPre.iRampeAuf.letzter_ms_timer "Speichert den letzten BS-Timer" UWORD UMR_MSEC__1_1_0_S6_S3 1 100 0 65535 DISPLAY_IDENTIFIER letzter_ms_timer.iRampeAuf.iPre.iAdaPstzs ECU_ADDRESS 0xFFF8C084 /end MEASUREMENT
/begin MEASUREMENT iAdaPstzs.iPre.iRampeAuf.minimum "Minimum Begrenzung" FLOAT32_IEEE UMR___1_1_0_S6_S3 1 100 -1E+037 1E+037 FORMAT "%4.2" DISPLAY_IDENTIFIER minimum.iRampeAuf.iPre.iAdaPstzs ECU_ADDRESS 0xFFF8C088 /end MEASUREMENT
/begin MEASUREMENT iAdaPstzs.iPre.iRampeAuf.maximum "Maximum Begrenzung" FLOAT32_IEEE UMR___1_1_0_S6_S3 1 100 -1E+037 1E+037 FORMAT "%4.2" DISPLAY_IDENTIFIER maximum.iRampeAuf.iPre.iAdaPstzs ECU_ADDRESS 0xFFF8C08C /end MEASUREMENT
/begin MEASUREMENT iAdaPstzs.iPre.zustand_stada "Zustand Fuelldruckpruefung" UBYTE Conv.cAdaPstPrepuls._.zustand_stada_S6_S3 1 100 0 7 DISPLAY_IDENTIFIER zustand_stada.iPre.iAdaPstzs ECU_ADDRESS 0xFFF8C094 /end MEASUREMENT
/begin MEASUREMENT iAdaPstzs.iPre.p_pre_puls_stada "Druck Pruefpuls (Offset auf minimalen FD)" SWORD UMR_BAR__1_1000_0_S6_S3 1 100 -3 3 DISPLAY_IDENTIFIER p_pre_puls_stada.iPre.iAdaPstzs ECU_ADDRESS 0xFFF8C096 /end MEASUREMENT
/begin MEASUREMENT iAdaPstzs.iPre.t_ra_vorstada_ab "Applizierte Abramzeit für Prepuls" UWORD UMR_MSEC__10_1_0_S6_S3 1 100 0 1000 DISPLAY_IDENTIFIER t_ra_vorstada_ab.iPre.iAdaPstzs ECU_ADDRESS 0xFFF8C098 /end MEASUREMENT
/begin MEASUREMENT iAdaPstzs.iPre.t_ra_vorstada_auf "Applizierte Auframpzeit für Prepuls" UWORD UMR_MSEC__10_1_0_S6_S3 1 100 0 1000 DISPLAY_IDENTIFIER t_ra_vorstada_auf.iPre.iAdaPstzs ECU_ADDRESS 0xFFF8C09A /end MEASUREMENT
/begin MEASUREMENT iAdaPstzs.iPre.kup_puls_stada "Kupplung die aktuell geprueft werden soll" UBYTE Conv.cAdaPstPrepuls._.kup_puls_stada_S6_S3 1 100 0 5 DISPLAY_IDENTIFIER kup_puls_stada.iPre.iAdaPstzs ECU_ADDRESS 0xFFF8C09C /end MEASUREMENT
/begin MEASUREMENT iAdaPstzs.iZustandstimerStada.timer "Der aktuelle Timerwert" UWORD UMR_MSEC__10_1_0_S6_S3 1 100 0 655350 DISPLAY_IDENTIFIER iZustandstimerStada.iAdaPstzs ECU_ADDRESS 0xFFF8C0A8 /end MEASUREMENT
/begin MEASUREMENT iAdaPstzs.iTMaxInitStada.timer "Der aktuelle Timerwert" ULONG UMR_MSEC__10_1_0_S6_S3 1 100 0 42949672950 DISPLAY_IDENTIFIER iTMaxInitStada.iAdaPstzs ECU_ADDRESS 0xFFF8C0AC /end MEASUREMENT
/begin MEASUREMENT iAdaPstzs.iVerbotRedBef_stada.puls_verb_redbef "Reduzierte Bef. verbietet Adaption Bitcodiert: xxxxxxx1x = Kup A wurde Verboten xxxxxx1xx = Kup B wurde Verboten xxxxx1xxx = Kup C wurde Verboten ..." UBYTE UMR___1_1_0_S6_S3 1 100 0 255 DISPLAY_IDENTIFIER puls_verb_redbef_stada ECU_ADDRESS 0xFFF8C0B0 /end MEASUREMENT
/begin MEASUREMENT iAdaPstzs.zustand_stada "Zustand des Pruefpulsablaufes" UBYTE Conv.cAdaPstzs._.zustand_stada_S6_S3 1 100 0 8 DISPLAY_IDENTIFIER zustand_stada.iAdaPstzs ECU_ADDRESS 0xFFF8C0B1 /end MEASUREMENT
/begin MEASUREMENT iAdaPstzs.testfall_prueftyp_stada "aktiver Prueftyp der Pulsadaption" UBYTE Conv.cAdaPstzs._.testfall_prueftyp_stada_S6_S3 1 100 0 2 DISPLAY_IDENTIFIER testfall_prueftyp_stada.iAdaPstzs ECU_ADDRESS 0xFFF8C0B2 /end MEASUREMENT
/begin MEASUREMENT iAdaPstzs.pulsid_stada "Der aktuelle Pruefpuls (Nummer)" UBYTE Conv.cAdaPstzs._.pulsid_stada_S6_S3 1 100 0 4 DISPLAY_IDENTIFIER pulsid_stada.iAdaPstzs ECU_ADDRESS 0xFFF8C0B3 /end MEASUREMENT
/begin MEASUREMENT iAdaPstzs.n_pulsgrenz_stada "Zaehler f. Anzahl Pulse einer Kupplung" UBYTE UMR___1_1_0_S6_S3 1 100 0 255 DISPLAY_IDENTIFIER n_pulsgrenz_stada.iAdaPstzs ECU_ADDRESS 0xFFF8C0B4 /end MEASUREMENT
/begin MEASUREMENT iAdaPstzs.n_pruefschleife_stada "Zaehler f. erkannte Drehzahlreaktion bei Puls3/Puls4" UBYTE UMR___1_1_0_S6_S3 1 100 0 2 DISPLAY_IDENTIFIER n_pruefschleife_stada.iAdaPstzs ECU_ADDRESS 0xFFF8C0B5 /end MEASUREMENT
/begin MEASUREMENT iAdaPstzs.zwsp_tsf_stada "Zwischenspeicherwert SF-Zeit kupplungsbez. Adaption" SWORD UMR_MSEC__1_1_0_S6_S3 1 100 -2000 2000 DISPLAY_IDENTIFIER zwsp_tsf_stada.iAdaPstzs ECU_ADDRESS 0xFFF8C0B6 /end MEASUREMENT
/begin MEASUREMENT iAdaPstzs.zwsp_pf_stada "Zwischenspeicherwert PF-Druck KPAD" SWORD UMR_BAR__1_1000_0_S6_S3 1 100 -5 5 DISPLAY_IDENTIFIER zwsp_pf_stada.iAdaPstzs ECU_ADDRESS 0xFFF8C0B8 /end MEASUREMENT
/begin MEASUREMENT iAdaPstzs.kup_puls_stada "Kupplung die aktuell geprueft werden soll" UBYTE Conv.cAdaPstzs._.kup_puls_stada_S6_S3 1 100 0 6 DISPLAY_IDENTIFIER kup_puls_stada.iAdaPstzs ECU_ADDRESS 0xFFF8C0BA /end MEASUREMENT
/begin MEASUREMENT iAdaPstzs.kup_pruefpuls_ausgabe_stada "Kupplung die aktuell geprueft wird" UBYTE Conv.cAdaPstzs._.kup_pruefpuls_ausgabe_stada_S6_S3 1 100 0 6 DISPLAY_IDENTIFIER kup_pruefpuls_ausgabe_stada.iAdaPstzs ECU_ADDRESS 0xFFF8C0BB /end MEASUREMENT
/begin MEASUREMENT iAdaPstzs.zeit_sf_1ms_stada "Die Schnellfuellzeit der Pulsadaption in 1ms" UWORD UMR_MSEC__1_1_0_S6_S3 1 100 0 1000 DISPLAY_IDENTIFIER zeit_sf_1ms_stada.iAdaPstzs ECU_ADDRESS 0xFFF8C0BC /end MEASUREMENT
/begin MEASUREMENT iAdaPstzs.zeit_sf_10ms_stada "Die Schnellfuellzeit der Pulsadaption in 10ms" UWORD UMR_MSEC__10_1_0_S6_S3 1 100 0 1000 DISPLAY_IDENTIFIER zeit_sf_10ms_stada.iAdaPstzs ECU_ADDRESS 0xFFF8C0BE /end MEASUREMENT
/begin MEASUREMENT iAdaPstzs.p_pulsausgabe_stada "Druck Pruefpuls (Offset auf minimalen FD)" SWORD UMR_BAR__1_1000_0_S6_S3 1 100 -3 3 DISPLAY_IDENTIFIER p_pulsausgabe_stada.iAdaPstzs ECU_ADDRESS 0xFFF8C0C0 /end MEASUREMENT
/begin MEASUREMENT iAdaPstzs.n_mot_start "n_mot-Wert zu Beginn des Pulses" UWORD UMR_U_MIN_1_1_0_S6_S3 1 100 0 65535 DISPLAY_IDENTIFIER n_mot_start.iAdaPstzs ECU_ADDRESS 0xFFF8C0C2 /end MEASUREMENT
/begin MEASUREMENT iAdaPstzs.schnellfuellung_aktiv_stada "Flag Schnellfuellung aktiv" UBYTE Conv.cAdaPstzs._.schnellfuellung_aktiv_stada_S6_S3 1 100 0 1 BIT_MASK 0x1 DISPLAY_IDENTIFIER schnellfuellung_aktiv_stada.iAdaPstzs ECU_ADDRESS 0xFFF8C0C4 /end MEASUREMENT
/begin MEASUREMENT iAdaPstzs.druck_statisch_stada "Flag für statische Druckausgabe" UBYTE Conv.cAdaPstzs._.druck_statisch_stada_S6_S3 1 100 0 1 BIT_MASK 0x1 DISPLAY_IDENTIFIER druck_statisch_stada.iAdaPstzs ECU_ADDRESS 0xFFF8C0C5 /end MEASUREMENT
/begin MEASUREMENT iAdaPstzs.pulszyklus_beenden_stada "Flag, ob Pulszyklus beendet werden soll" UBYTE Conv.cAdaPstzs._.pulszyklus_beenden_stada_S6_S3 1 100 0 3 DISPLAY_IDENTIFIER pulszyklus_beenden_stada.iAdaPstzs ECU_ADDRESS 0xFFF8C0C6 /end MEASUREMENT
/begin MEASUREMENT iAdaPstzs.f_red_bef_kup "Flag aktiviert verwendung der Prarmetern der red. Bef. bei Puls" UBYTE Conv.cAdaPstzs._.f_red_bef_kup_S6_S3 1 100 0 1 BIT_MASK 0x1 DISPLAY_IDENTIFIER f_red_bef_kup.iAdaPstzs ECU_ADDRESS 0xFFF8C0C7 /end MEASUREMENT
/begin MEASUREMENT iAdaPstzs.testfall_gang_stada "Gang der eingelegt werden soll um eine Pulspruefung zu starten" SBYTE Conv.cAdaPstzs._.testfall_gang_stada_S6_S3 1 100 -1 8 DISPLAY_IDENTIFIER testfall_gang_stada.iAdaPstzs ECU_ADDRESS 0xFFF8C0C8 /end MEASUREMENT
/begin MEASUREMENT iAdaPstzs.pre_ada_zustand_stada "Zustand der Testeradaption" UBYTE Conv.cAdaPstzs._.pre_ada_zustand_stada_S6_S3 1 100 0 17 DISPLAY_IDENTIFIER pre_ada_zustand_stada.iAdaPstzs ECU_ADDRESS 0xFFF8C0C9 /end MEASUREMENT
/begin MEASUREMENT iAdaPstzs.akt_ada "ID der Momentan aktiven Adaption" UBYTE Conv.cAdaPstzs._.akt_ada_S6_S3 1 100 0 3 DISPLAY_IDENTIFIER akt_ada.iAdaPstzs ECU_ADDRESS 0xFFF8C0CA /end MEASUREMENT
/begin MEASUREMENT iAdaPstzs.f_deaktivierung_erkannt "Singalisiert das ein Laufendes STADA Ablauf Abgebrochen wurde" UBYTE Conv.cAdaPstzs._.f_deaktivierung_erkannt_S6_S3 1 100 0 1 BIT_MASK 0x1 DISPLAY_IDENTIFIER f_deaktivierung_erkannt.iAdaPstzs ECU_ADDRESS 0xFFF8C0CB /end MEASUREMENT
/begin MEASUREMENT iAdaPstzs.anz_kup_puls_stada "Kupplung deren Werte angezeigt werden" UBYTE Conv.cAdaPstzs._.anz_kup_puls_stada_S6_S3 1 100 0 6 DISPLAY_IDENTIFIER anz_kup_puls_stada.iAdaPstzs ECU_ADDRESS 0xFFF8C0D8 /end MEASUREMENT
/begin MEASUREMENT iAdaPstzs.anz_prueftyp_stada "Momentaner Adaptionstyp der Pulsadaption von kup_puls" UBYTE Conv.cAdaPstzs._.anz_prueftyp_stada_S6_S3 1 100 0 2 DISPLAY_IDENTIFIER anz_prueftyp_stada.iAdaPstzs ECU_ADDRESS 0xFFF8C0D9 /end MEASUREMENT
/begin MEASUREMENT iAdaPstzs.anz_pulsid_stada "Momentan ausgefuehrter Puls von TSF/PF-Pruefung von kup_puls" UBYTE Conv.cAdaPstzs._.anz_pulsid_stada_S6_S3 1 100 0 4 DISPLAY_IDENTIFIER anz_pulsid_stada.iAdaPstzs ECU_ADDRESS 0xFFF8C0DA /end MEASUREMENT
/begin MEASUREMENT iAdaPstzs.anz_n_pulsgrenz_stada "Anzahl Pulse auf Kupplung in diesem Pruefzyklus von kup_puls" UBYTE UMR___1_1_0_S6_S3 1 100 0 255 DISPLAY_IDENTIFIER anz_n_pulsgrenz_stada.iAdaPstzs ECU_ADDRESS 0xFFF8C0DB /end MEASUREMENT
/begin MEASUREMENT iAdaPstzs.anz_n_pruefschleife_stada "Anzahl der Schleifendurchlaeufe bei Puls 3 von kup_puls" UBYTE UMR___1_1_0_S6_S3 1 100 0 10 DISPLAY_IDENTIFIER anz_n_pruefschleife_stada.iAdaPstzs ECU_ADDRESS 0xFFF8C0DC /end MEASUREMENT
/begin MEASUREMENT iAdaPstzs.anz_zwsp_tsf_stada "TSF-Zwischenspeicherwert Pulsada von kup_puls" SWORD UMR_MSEC__1_1_0_S6_S3 1 100 -2000 2000 DISPLAY_IDENTIFIER anz_zwsp_tsf_stada.iAdaPstzs ECU_ADDRESS 0xFFF8C0DE /end MEASUREMENT
/begin MEASUREMENT iAdaPstzs.anz_zwsp_pf_stada "PF-Zwischenspeicherwert Pulsada von kup_puls" SWORD UMR_BAR__1_1000_0_S6_S3 1 100 -5 5 DISPLAY_IDENTIFIER anz_zwsp_pf_stada.iAdaPstzs ECU_ADDRESS 0xFFF8C0E0 /end MEASUREMENT
/begin MEASUREMENT iAdaPstzs.anz_tsf_adawert_stada "Adaptionswert kupplungsbez. TSF-Adaption von kup_puls" SWORD UMR_MSEC__1_1_0_S6_S3 1 100 -2000 2000 DISPLAY_IDENTIFIER anz_tsf_adawert_stada.iAdaPstzs ECU_ADDRESS 0xFFF8C0E2 /end MEASUREMENT
/begin MEASUREMENT iAdaPstzs.anz_pf_adawert_stada "Adaptionswert kupplungsbez. PF-Adaption von kup_puls" SWORD UMR_BAR__1_1000_0_S6_S3 1 100 -5 5 DISPLAY_IDENTIFIER anz_pf_adawert_stada.iAdaPstzs ECU_ADDRESS 0xFFF8C0E4 /end MEASUREMENT
/begin MEASUREMENT iAdaPstzs.anz_durchgefuehrt_stada "Adaptonszustand anz_kup_puls" UBYTE Conv.cAdaPstzs._.anz_durchgefuehrt_stada_S6_S3 1 100 0 2 DISPLAY_IDENTIFIER anz_durchgefuehrt_stada.iAdaPstzs ECU_ADDRESS 0xFFF8C0E6 /end MEASUREMENT
/begin MEASUREMENT iAdaPstzs.anz_tsf_counter_stada "Adaptionsdurchläufe TSF Stada" UBYTE UMR___1_1_0_S6_S3 1 100 0 255 DISPLAY_IDENTIFIER anz_tsf_counter_stada.iAdaPstzs ECU_ADDRESS 0xFFF8C0E7 /end MEASUREMENT
/begin MEASUREMENT iAdaPstzs.anz_pf_counter_stada "Adaptionsdurchläufe PF Stada" UBYTE UMR___1_1_0_S6_S3 1 100 0 255 DISPLAY_IDENTIFIER anz_pf_counter_stada.iAdaPstzs ECU_ADDRESS 0xFFF8C0E8 /end MEASUREMENT
/begin MEASUREMENT iAdaPstzs.fzg_stillstand_stada "True wenn das Fahrzeug steht und festgebremst ist" UBYTE Conv.cAdaPstzs._.fzg_stillstand_stada_S6_S3 1 100 0 1 BIT_MASK 0x1 DISPLAY_IDENTIFIER fzg_stillstand_stada.iAdaPstzs ECU_ADDRESS 0xFFF8C0E9 /end MEASUREMENT
/begin MEASUREMENT iAdaPstzs.grundbedingung_erfuellt_zyklisch_stada "True wenn ein die STADA generel durchgefuehrt werden darf z.B. Testeranforderung muss aktiv sein" UBYTE Conv.cAdaPstzs._.grundbedingung_erfuellt_zyklisch_stada_S6_S3 1 100 0 1 BIT_MASK 0x1 DISPLAY_IDENTIFIER grundbedingung_erfuellt_zyklisch_stada.iAdaPstzs ECU_ADDRESS 0xFFF8C0EA /end MEASUREMENT
/begin MEASUREMENT iAdaPstzs.grundbedingung_erfuellt_einmalig_stada "Dedektiert ob die Adaption gestartet werden kann. Wenn die STADA gestartet ist ist der Wert nicht relevant" UBYTE Conv.cAdaPstzs._.grundbedingung_erfuellt_einmalig_stada_S6_S3 1 100 0 1 BIT_MASK 0x1 DISPLAY_IDENTIFIER grundbedingung_erfuellt_einmalig_stada.iAdaPstzs ECU_ADDRESS 0xFFF8C0EB /end MEASUREMENT
/begin MEASUREMENT iAdaPstzs.fzg_stillstand_k0_stada "True wenn das Fahrzeug steht und festgebremst ist" UBYTE Conv.cAdaPstzs._.fzg_stillstand_k0_stada_S6_S3 1 100 0 1 BIT_MASK 0x1 DISPLAY_IDENTIFIER fzg_stillstand_k0_stada.iAdaPstzs ECU_ADDRESS 0xFFF8C0EC /end MEASUREMENT
/begin MEASUREMENT iAdaPstzs.grundbedingung_erfuellt_zyklisch_k0_stada "True wenn ein die STADA generel durchgefuehrt werden darf z.B. Testeranforderung muss aktiv sein" UBYTE Conv.cAdaPstzs._.grundbedingung_erfuellt_zyklisch_k0_stada_S6_S3 1 100 0 1 BIT_MASK 0x1 DISPLAY_IDENTIFIER grundbedingung_erfuellt_zyklisch_k0_stada.iAdaPstzs ECU_ADDRESS 0xFFF8C0ED /end MEASUREMENT
/begin MEASUREMENT iAdaPstzs.grundbedingung_erfuellt_einmalig_k0_stada "Dedektiert ob die Adaption gestartet werden kann. Wenn die STADA gestartet ist ist der Wert nicht relevant" UBYTE Conv.cAdaPstzs._.grundbedingung_erfuellt_einmalig_k0_stada_S6_S3 1 100 0 1 BIT_MASK 0x1 DISPLAY_IDENTIFIER grundbedingung_erfuellt_einmalig_k0_stada.iAdaPstzs ECU_ADDRESS 0xFFF8C0EE /end MEASUREMENT
/begin MEASUREMENT iAdaPstCondition.preadaption_condition_stada_int "Status Einstiegsbedingungen nur Intern wird bei Update auf Schnittstelle kopiert" UBYTE Conv.cAdaPstCondition._.preadaption_condition_stada_int_S6_S3 1 100 0 255 DISPLAY_IDENTIFIER preadaption_condition_stada_int.iAdaPstCondition ECU_ADDRESS 0xFFF8A090 /end MEASUREMENT
/begin MEASUREMENT iAdaPstCondition.preadaption_condition_stada "Status Einstiegsbedingungen wird auf Schnittstelle ausgegeben" UBYTE Conv.cAdaPstCondition._.preadaption_condition_stada_S6_S3 1 100 0 255 DISPLAY_IDENTIFIER preadaption_condition_stada.iAdaPstCondition ECU_ADDRESS 0xFFF8A091 /end MEASUREMENT
/begin MEASUREMENT iAdaPstState.preadaption_state_stada "Zustand der Stillstandsadaption" UBYTE Conv.cAdaPstState._.preadaption_state_stada_S6_S3 1 100 0 4 DISPLAY_IDENTIFIER preadaption_state_stada.iAdaPstState ECU_ADDRESS 0xFFF8A38B /end MEASUREMENT
/begin MEASUREMENT iAdaPstUserinfo.preadaption_userinfo_stada "Benutzerinformationen" UBYTE Conv.cAdaPstUserinfo._.preadaption_userinfo_stada_S6_S3 1 100 0 255 DISPLAY_IDENTIFIER preadaption_userinfo_stada.iAdaPstUserinfo ECU_ADDRESS 0xFFF8A38C /end MEASUREMENT
/begin MEASUREMENT iAdaUrlufterkSchaltungAnz.kup_schaltung_url "Kupplung die aktuell geprueft wird" UBYTE Conv.cAdaUrlufterkSchaltungAnz._.kup_schaltung_url_S6_S3 1 100 0 5 DISPLAY_IDENTIFIER kup_schaltung_url.iAdaUrlufterkSchaltungAnz ECU_ADDRESS 0xFFF8A098 /end MEASUREMENT
/begin MEASUREMENT iAdaUrlufterkSchaltungAnz.m_motist_start_schaltung_url "Kurbelwellenistmoment" SWORD UMR_NM__1_1_0_S6_S3 1 100 -400 1640 DISPLAY_IDENTIFIER m_motist_start_schaltung_url.iAdaUrlufterkSchaltungAnz ECU_ADDRESS 0xFFF8A09A /end MEASUREMENT
/begin MEASUREMENT iAdaUrlufterkSchaltungAnz.t_zeitfenster_schaltung_url "Die Schnellfuellzeit der Pulsadaption in 1ms" UWORD UMR_MSEC__10_1_0_S6_S3 1 100 0 10000 DISPLAY_IDENTIFIER t_zeitfenster_schaltung_url.iAdaUrlufterkSchaltungAnz ECU_ADDRESS 0xFFF8A09C /end MEASUREMENT
/begin MEASUREMENT iAdaUrlufterkSchaltungAnz.ng_schaltung_url "PT1- Gefilterter Gradient" SWORD UMR_U_MINSEC_10_1_0_S6_S3 1 100 -327680 327670 DISPLAY_IDENTIFIER ng_schaltung_url.iAdaUrlufterkSchaltungAnz ECU_ADDRESS 0xFFF8A09E /end MEASUREMENT
/begin MEASUREMENT iAdaUrlufterkSchaltungAnz.f_loeschen_schalung_url "Fehler wurde erkannt und der TSF Ada Speicher geloescht" UBYTE Conv.cAdaUrlufterkSchaltungAnz._.f_loeschen_schalung_url_S6_S3 1 100 0 1 BIT_MASK 0x1 DISPLAY_IDENTIFIER f_loeschen_schalung_url.iAdaUrlufterkSchaltungAnz ECU_ADDRESS 0xFFF8A0A0 /end MEASUREMENT
/begin MEASUREMENT iAdaUrlufterkSchaltung.iSignal.iPt1.x "Filterwert" SLONG UMR___1_300_0_S6_S3 1 100 -7158278.82667 7158278.82333 DISPLAY_IDENTIFIER iPt1.iSignal.iAdaUrlufterkSchaltung ECU_ADDRESS 0xFFF8C840 /end MEASUREMENT
/begin MEASUREMENT iAdaUrlufterkSchaltung.iSignal.f_signal_ungueltig "Status der Singalberechung" UBYTE Conv.cAdaUrlufterkSchaltungSignal._.f_signal_ungueltig_S6_S3 1 100 0 1 BIT_MASK 0x1 DISPLAY_IDENTIFIER f_signal_ungueltig.iSignal.iAdaUrlufterkSchaltung ECU_ADDRESS 0xFFF8C82C /end MEASUREMENT
/begin MEASUREMENT iAdaUrlufterkSchaltung.iSignal.signal_quelle "ausgewählte Signalquelle" UBYTE Conv.cAdaUrlufterkSchaltungSignal._.signal_quelle_S6_S3 1 100 0 1 DISPLAY_IDENTIFIER signal_quelle.iSignal.iAdaUrlufterkSchaltung ECU_ADDRESS 0xFFF8C82D /end MEASUREMENT
/begin MEASUREMENT iAdaUrlufterkSchaltung.iSignal.signal_quelle_alt "ausgewählte Signalquelle aus letztr Berechung" UBYTE Conv.cAdaUrlufterkSchaltungSignal._.signal_quelle_alt_S6_S3 1 100 0 1 DISPLAY_IDENTIFIER signal_quelle_alt.iSignal.iAdaUrlufterkSchaltung ECU_ADDRESS 0xFFF8C82E /end MEASUREMENT
/begin MEASUREMENT iAdaUrlufterkSchaltung.iSignal.rowert_signal "Signalwert der ausgewaehlten Quelle" SWORD UMR_U_MIN_1_1_0_S6_S3 1 100 -32768 32767 DISPLAY_IDENTIFIER rowert_signal.iSignal.iAdaUrlufterkSchaltung ECU_ADDRESS 0xFFF8C830 /end MEASUREMENT
/begin MEASUREMENT iAdaUrlufterkSchaltung.iSignal.f_pt1_inti "Anforderung an den PT1 Filter sich beim naechsten Aufruf zu Initialisieren" UBYTE Conv.cAdaUrlufterkSchaltungSignal._.f_pt1_inti_S6_S3 1 100 0 1 BIT_MASK 0x1 DISPLAY_IDENTIFIER f_pt1_inti.iSignal.iAdaUrlufterkSchaltung ECU_ADDRESS 0xFFF8C832 /end MEASUREMENT
/begin MEASUREMENT iAdaUrlufterkSchaltung.iSignal.f_grad_inti "Anforderung an die Gradientenberechung sich beim naechsten Aufruf zu Initialisieren" UBYTE Conv.cAdaUrlufterkSchaltungSignal._.f_grad_inti_S6_S3 1 100 0 1 BIT_MASK 0x1 DISPLAY_IDENTIFIER f_grad_inti.iSignal.iAdaUrlufterkSchaltung ECU_ADDRESS 0xFFF8C833 /end MEASUREMENT
/begin MEASUREMENT iAdaUrlufterkSchaltung.iSignal.sig_grad "Eingangssignal in Gradientenberechung" SWORD UMR_U_MIN_1_1_0_S6_S3 1 100 -32768 32767 DISPLAY_IDENTIFIER sig_grad.iSignal.iAdaUrlufterkSchaltung ECU_ADDRESS 0xFFF8C834 /end MEASUREMENT
/begin MEASUREMENT iAdaUrlufterkSchaltung.iSignal.sig_grad_alt "Eingangssignal in Gradientenberechung aus letztem Zyklus" SWORD UMR_U_MIN_1_1_0_S6_S3 1 100 -32768 32767 DISPLAY_IDENTIFIER sig_grad_alt.iSignal.iAdaUrlufterkSchaltung ECU_ADDRESS 0xFFF8C836 /end MEASUREMENT
/begin MEASUREMENT iAdaUrlufterkSchaltung.iSignal.sig_grad_diff "Aenderung des Eingangssignals" SLONG UMR_U_MIN_1_1_0_S6_S3 1 100 -2147483648 2147483647 DISPLAY_IDENTIFIER sig_grad_diff.iSignal.iAdaUrlufterkSchaltung ECU_ADDRESS 0xFFF8C838 /end MEASUREMENT
/begin MEASUREMENT iAdaUrlufterkSchaltung.iSignal.rowert_gradient "Gradient von rowert_signal" SWORD UMR_U_MINSEC_10_1_0_S6_S3 1 100 -327680 327670 DISPLAY_IDENTIFIER rowert_gradient.iSignal.iAdaUrlufterkSchaltung ECU_ADDRESS 0xFFF8C83C /end MEASUREMENT
/begin MEASUREMENT iAdaUrlufterkSchaltung.iSignal.filt_gradient "PT1- Gefilterter Gradient" SWORD UMR_U_MINSEC_10_1_0_S6_S3 1 100 -327680 327670 DISPLAY_IDENTIFIER filt_gradient.iSignal.iAdaUrlufterkSchaltung ECU_ADDRESS 0xFFF8C83E /end MEASUREMENT
/begin MEASUREMENT iAdaUrlufterkSchaltung.iZeitfenster.timer "Der aktuelle Timerwert" UBYTE UMR_MSEC__10_1_0_S6_S3 1 100 0 2550 DISPLAY_IDENTIFIER iZeitfenster.iAdaUrlufterkSchaltung ECU_ADDRESS 0xFFF8C844 /end MEASUREMENT
/begin MEASUREMENT iAdaUrlufterkSchaltung.zustand "" UBYTE Conv.cAdaUrlufterkSchaltung._.zustand_S6_S3 1 100 0 1 DISPLAY_IDENTIFIER zustand.iAdaUrlufterkSchaltung ECU_ADDRESS 0xFFF8C828 /end MEASUREMENT
/begin MEASUREMENT iAdaUrlufterkSchaltung.kup "Kupplung die aktuell geprueft wird" UBYTE Conv.cAdaUrlufterkSchaltung._.kup_S6_S3 1 100 0 5 DISPLAY_IDENTIFIER kup.iAdaUrlufterkSchaltung ECU_ADDRESS 0xFFF8C829 /end MEASUREMENT
/begin MEASUREMENT iAdaUrlufterkSchaltung.m_motist_start "Kurbelwellenistmoment" SWORD UMR_NM__1_1_0_S6_S3 1 100 -400 1640 DISPLAY_IDENTIFIER m_motist_start.iAdaUrlufterkSchaltung ECU_ADDRESS 0xFFF8C82A /end MEASUREMENT
/begin MEASUREMENT iAdaUrlufterkPulsAnz.kup_puls_url "Kupplung die aktuell geprueft wird" UBYTE Conv.cAdaUrlufterkPulsAnz._.kup_puls_url_S6_S3 1 100 0 6 DISPLAY_IDENTIFIER kup_puls_url.iAdaUrlufterkPulsAnz ECU_ADDRESS 0xFFF8C820 /end MEASUREMENT
/begin MEASUREMENT iAdaUrlufterkPulsAnz.t_zeitfenster_puls_url "Ueberwachungszeitraum der Urlufterkennung" UWORD UMR_MSEC__10_1_0_S6_S3 1 100 0 10000 DISPLAY_IDENTIFIER t_zeitfenster_puls_url.iAdaUrlufterkPulsAnz ECU_ADDRESS 0xFFF8C822 /end MEASUREMENT
/begin MEASUREMENT iAdaUrlufterkPulsAnz.n_guete_puls_url "Guete des Bewerteten Signals." SWORD UMR_U_MIN_1_1_0_S6_S3 1 100 -32768 32767 DISPLAY_IDENTIFIER n_guete_puls_url.iAdaUrlufterkPulsAnz ECU_ADDRESS 0xFFF8C824 /end MEASUREMENT
/begin MEASUREMENT iAdaUrlufterkPulsAnz.f_loeschen_puls_url "Fehler wurde erkannt und der TSF Ada Speicher geloescht" UBYTE Conv.cAdaUrlufterkPulsAnz._.f_loeschen_puls_url_S6_S3 1 100 0 1 BIT_MASK 0x1 DISPLAY_IDENTIFIER f_loeschen_puls_url.iAdaUrlufterkPulsAnz ECU_ADDRESS 0xFFF8C826 /end MEASUREMENT
/begin MEASUREMENT iAdaUrlufterkPuls.iZeitfenster.timer "Der aktuelle Timerwert" UBYTE UMR_MSEC__10_1_0_S6_S3 1 100 0 2550 DISPLAY_IDENTIFIER iZeitfenster.iAdaUrlufterkPuls ECU_ADDRESS 0xFFF8A097 /end MEASUREMENT
/begin MEASUREMENT iAdaUrlufterkPuls.zustand "Zustände in der sich die Urluferkennung befinden kann" UBYTE Conv.cAdaUrlufterkPuls._.zustand_S6_S3 1 100 0 1 DISPLAY_IDENTIFIER zustand.iAdaUrlufterkPuls ECU_ADDRESS 0xFFF8A092 /end MEASUREMENT
/begin MEASUREMENT iAdaUrlufterkPuls.kup "Kupplung die aktuell geprueft wird" UBYTE Conv.cAdaUrlufterkPuls._.kup_S6_S3 1 100 0 6 DISPLAY_IDENTIFIER kup.iAdaUrlufterkPuls ECU_ADDRESS 0xFFF8A093 /end MEASUREMENT
/begin MEASUREMENT iAdaUrlufterkPuls.kfl_ist_start "kfl_ist" UBYTE Conv.cAdaUrlufterkPuls._.kfl_ist_start_S6_S3 1 100 0 2 DISPLAY_IDENTIFIER kfl_ist_start.iAdaUrlufterkPuls ECU_ADDRESS 0xFFF8A094 /end MEASUREMENT
/begin MEASUREMENT iAdaUrlufterkPuls.istgang_start "Ist-Gang" SBYTE Conv.cAdaUrlufterkPuls._.istgang_start_S6_S3 1 100 -1 8 DISPLAY_IDENTIFIER istgang_start.iAdaUrlufterkPuls ECU_ADDRESS 0xFFF8A095 /end MEASUREMENT
/begin MEASUREMENT iAdaUrlufterkPuls.prueftyp "aktiver Prueftyp der Pulsadaption" UBYTE Conv.cAdaUrlufterkPuls._.prueftyp_S6_S3 1 100 0 10 DISPLAY_IDENTIFIER prueftyp.iAdaUrlufterkPuls ECU_ADDRESS 0xFFF8A096 /end MEASUREMENT
/begin MEASUREMENT iAdaGlast.ps_adadruck "Ausgegebener Adaptionsschaltdruck" SWORD UMR_BAR__1_1000_0_S6_S3 1 100 -1.25 1.25 DISPLAY_IDENTIFIER ps_adadruck.iAdaGlast ECU_ADDRESS 0xFFF8BEF8 /end MEASUREMENT
/begin MEASUREMENT iAdaGlast.bfl_adadruck "Anteil Adaptionsschaltdruck durch Beeinflussung" SWORD UMR_BAR__1_1000_0_S6_S3 1 100 -1.25 1.25 DISPLAY_IDENTIFIER bfl_adadruck.iAdaGlast ECU_ADDRESS 0xFFF8BEFA /end MEASUREMENT
/begin MEASUREMENT iAdaGlast.ps_adadruck_kalt "Ausgegebener Adaptionsschaltdruck" SWORD UMR_BAR__1_1000_0_S6_S3 1 100 -1.25 1.25 DISPLAY_IDENTIFIER ps_adadruck_kalt.iAdaGlast ECU_ADDRESS 0xFFF8BEFC /end MEASUREMENT
/begin MEASUREMENT iAdaGlast.ps_adadruck_warm "Ausgegebener Adaptionsschaltdruck" SWORD UMR_BAR__1_1000_0_S6_S3 1 100 -1.25 1.25 DISPLAY_IDENTIFIER ps_adadruck_warm.iAdaGlast ECU_ADDRESS 0xFFF8BEFE /end MEASUREMENT
/begin MEASUREMENT iAdaGlast.gls_flag_abbruch_wg_adapfn "Flag fuer Abbruch GLS-Ada wegen PF-HS-Ada" UBYTE Conv.cAdaGlast._.gls_flag_abbruch_wg_adapfn_S6_S3 1 100 0 1 BIT_MASK 0x1 DISPLAY_IDENTIFIER gls_flag_abbruch_wg_adapfn.iAdaGlast ECU_ADDRESS 0xFFF8BF00 /end MEASUREMENT
/begin MEASUREMENT iAdaGlast.gls_adbr "Adaptionsbereich der GLS-Adaption" SWORD UMR___1_1_0_S6_S3 1 100 0 1170 DISPLAY_IDENTIFIER gls_adbr.iAdaGlast ECU_ADDRESS 0xFFF8BF02 /end MEASUREMENT
/begin MEASUREMENT iAdaGlast.adaps_status "Anzeigegroesse Ablauf Schaltdruckadaption" UWORD Conv.cAdaGlast._.adaps_status_S6_S3 1 100 400 499 DISPLAY_IDENTIFIER adaps_status.iAdaGlast ECU_ADDRESS 0xFFF8BF04 /end MEASUREMENT
/begin MEASUREMENT iAdaGlast.pm_gls "mittlere Regeleingriff" SWORD UMR_BAR__1_100_0_S6_S3 1 100 -1.25 1.25 DISPLAY_IDENTIFIER pm_gls.iAdaGlast ECU_ADDRESS 0xFFF8BF06 /end MEASUREMENT
/begin MEASUREMENT iAdaGlast.pm_gls_korr "mittlere Regeleingriff korrigiert" SWORD UMR_BAR__1_100_0_S6_S3 1 100 -1.25 1.25 DISPLAY_IDENTIFIER pm_gls_korr.iAdaGlast ECU_ADDRESS 0xFFF8BF08 /end MEASUREMENT
/begin MEASUREMENT iAdaGlast.bew_kup "Kupplung die beobachtet/bewertet wird" UBYTE Conv.cAdaGlast._.bew_kup_S6_S3 1 100 0 5 DISPLAY_IDENTIFIER bew_kup.iAdaGlast ECU_ADDRESS 0xFFF8BF0A /end MEASUREMENT
/begin MEASUREMENT iAdaGlast.bew_schaltcode "Schaltcode innerhalb des aktuellen Schalttyps fuer GLS-Adaption" UBYTE UMR___1_1_0_S6_S3 1 100 0 7 DISPLAY_IDENTIFIER bew_schaltcode.iAdaGlast ECU_ADDRESS 0xFFF8BF0B /end MEASUREMENT
/begin MEASUREMENT iAdaGlast.bew_schaltcode_lesen "Schaltcode innerhalb des aktuellen Schalttyps fuer GLS-Adaption beim Lesen" UBYTE UMR___1_1_0_S6_S3 1 100 0 7 DISPLAY_IDENTIFIER bew_schaltcode_lesen.iAdaGlast ECU_ADDRESS 0xFFF8BF0C /end MEASUREMENT
/begin MEASUREMENT iAdaGlast.bew_kennfeld "welches Kennfeld wird von GLS-ADA beschrieben" UBYTE Conv.cAdaGlast._.bew_kennfeld_S6_S3 1 100 0 3 DISPLAY_IDENTIFIER bew_kennfeld.iAdaGlast ECU_ADDRESS 0xFFF8BF0D /end MEASUREMENT
/begin MEASUREMENT iAdaGlast.bew_kennfeld_lesen "aus welchem Kennfeld wird von GLS-ADA gelesen" UBYTE Conv.cAdaGlast._.bew_kennfeld_lesen_S6_S3 1 100 0 3 DISPLAY_IDENTIFIER bew_kennfeld_lesen.iAdaGlast ECU_ADDRESS 0xFFF8BF0E /end MEASUREMENT
/begin MEASUREMENT iAdaGlast.warm_kalt_kennfeld_lesen "welches Kennfeld warm oder kalt soll von GLS-ADA verwendet werden" UBYTE Conv.cAdaGlast._.warm_kalt_kennfeld_lesen_S6_S3 1 100 0 4 DISPLAY_IDENTIFIER warm_kalt_kennfeld_lesen.iAdaGlast ECU_ADDRESS 0xFFF8BF0F /end MEASUREMENT
/begin MEASUREMENT iAdaGlast.warm_kalt_kennfeld_schreiben "welches Kennfeld warm oder kalt soll von GLS-ADA verwendet werden" UBYTE Conv.cAdaGlast._.warm_kalt_kennfeld_schreiben_S6_S3 1 100 0 4 DISPLAY_IDENTIFIER warm_kalt_kennfeld_schreiben.iAdaGlast ECU_ADDRESS 0xFFF8BF10 /end MEASUREMENT
/begin MEASUREMENT iAdaGlast.bew_schalttyp "Typ der Schaltung aus Sicht GLS-Ada" UBYTE Conv.cAdaGlast._.bew_schalttyp_S6_S3 1 100 0 4 DISPLAY_IDENTIFIER bew_schalttyp.iAdaGlast ECU_ADDRESS 0xFFF8BF11 /end MEASUREMENT
/begin MEASUREMENT iAdaGlast.bew_index "Vorgabe Schaltung mit SP/SPORT-Parametern" UBYTE Conv.cAdaGlast._.bew_index_S6_S3 1 100 0 3 DISPLAY_IDENTIFIER bew_index.iAdaGlast ECU_ADDRESS 0xFFF8BF12 /end MEASUREMENT
/begin MEASUREMENT iAdaGlast.bew_schalttyp_lesen "Typ der Schaltung aus Sicht GLS-Ada beim Lesezugriff" UBYTE Conv.cAdaGlast._.bew_schalttyp_lesen_S6_S3 1 100 0 4 DISPLAY_IDENTIFIER bew_schalttyp_lesen.iAdaGlast ECU_ADDRESS 0xFFF8BF13 /end MEASUREMENT
/begin MEASUREMENT iAdaGlast.status_ausgabe_verzoegern "status_ausgabe_verzoegern" UBYTE Conv.cAdaGlast._.status_ausgabe_verzoegern_S6_S3 1 100 0 1 BIT_MASK 0x1 DISPLAY_IDENTIFIER status_ausgabe_verzoegern.iAdaGlast ECU_ADDRESS 0xFFF8BF14 /end MEASUREMENT
/begin MEASUREMENT iAdaGlast.dki_abbrschwelle "DKI-Schwelle Adaptionsabbruch" UBYTE UMR_PROZENT__20_51_0_S6_S3 1 100 0 100 DISPLAY_IDENTIFIER dki_abbrschwelle.iAdaGlast ECU_ADDRESS 0xFFF8BF15 /end MEASUREMENT
/begin MEASUREMENT iAdaGlast.pgls_speicher "Regelflaeche der GLS" SLONG UMR___1_1_0_S6_S3 1 100 -2147483648 2147483647 DISPLAY_IDENTIFIER pgls_speicher.iAdaGlast ECU_ADDRESS 0xFFF8BF18 /end MEASUREMENT
/begin MEASUREMENT iAdaGlast.con_cycle_count "Zaehler fuer GLS-Reglertakte" UWORD UMR___1_1_0_S6_S3 1 100 0 65535 DISPLAY_IDENTIFIER con_cycle_count.iAdaGlast ECU_ADDRESS 0xFFF8BF1C /end MEASUREMENT
/begin MEASUREMENT iAdaGlast.glsbew_fuer_adbr "Merker f. zu bewertende Adbr" SWORD UMR___1_1_0_S6_S3 1 100 -32768 32767 DISPLAY_IDENTIFIER glsbew_fuer_adbr.iAdaGlast ECU_ADDRESS 0xFFF8BF1E /end MEASUREMENT
/begin MEASUREMENT iAdaGlast.gls_dki_schaltbeginn "DKI zu Schaltbeginn" UBYTE UMR_PROZENT__20_51_0_S6_S3 1 100 0 100 DISPLAY_IDENTIFIER gls_dki_schaltbeginn.iAdaGlast ECU_ADDRESS 0xFFF8BF20 /end MEASUREMENT
/begin MEASUREMENT iAdaGlast.f_e_fahren_aktiv_schaltbeginn "Flag e_fahren_aktiv zu Schaltbeginn" UBYTE UMR___1_1_0_S6_S3 1 100 0 1 DISPLAY_IDENTIFIER f_e_fahren_aktiv_schaltbeginn.iAdaGlast ECU_ADDRESS 0xFFF8BF21 /end MEASUREMENT
/begin MEASUREMENT iAdaGlast.gls_trimm_verbot_versch_rs "Verbot von verschachtelten RS durch GLS Trimm Funktion" UBYTE Conv.cAdaGlast._.gls_trimm_verbot_versch_rs_S6_S3 1 100 0 1 BIT_MASK 0x1 DISPLAY_IDENTIFIER gls_trimm_verbot_versch_rs.iAdaGlast ECU_ADDRESS 0xFFF8BF22 /end MEASUREMENT
/begin MEASUREMENT iAdaGlast.gls_trimm_spont_beeinflussung "Beeinflussung der Spontanitaet durch GLS Trimm Funktion" UBYTE Conv.cAdaGlast._.gls_trimm_spont_beeinflussung_S6_S3 1 100 0 1 BIT_MASK 0x1 DISPLAY_IDENTIFIER gls_trimm_spont_beeinflussung.iAdaGlast ECU_ADDRESS 0xFFF8BF23 /end MEASUREMENT
/begin MEASUREMENT iAdaGlast.f_gls_trimm_kup_schwelle "Kup Pruef Zaehler Schwelle, aktuelle Schaltung, unterschritten - unabhaengig von SWI_TRIMMUNDODER_KPLBP" UBYTE Conv.cAdaGlast._.f_gls_trimm_kup_schwelle_S6_S3 1 100 0 1 BIT_MASK 0x1 DISPLAY_IDENTIFIER f_gls_trimm_kup_schwelle.iAdaGlast ECU_ADDRESS 0xFFF8BF24 /end MEASUREMENT
/begin MEASUREMENT iAdaGlast.f_gls_trimm_gls_schwelle_kf1 "Gls Kennfeld 1 Schwelle, aktuelle Schaltung, unterschritten - unabhaengig von SWI_TRIMMUNDODER_KPLBP" UBYTE Conv.cAdaGlast._.f_gls_trimm_gls_schwelle_kf1_S6_S3 1 100 0 1 BIT_MASK 0x1 DISPLAY_IDENTIFIER f_gls_trimm_gls_schwelle_kf1.iAdaGlast ECU_ADDRESS 0xFFF8BF25 /end MEASUREMENT
/begin MEASUREMENT iAdaGlast.f_gls_trimm_gls_schwelle_kf2 "Gls Kennfeld 2 Schwelle, aktuelle Schaltung, unterschritten - unabhaengig von SWI_TRIMMUNDODER_KPLBP" UBYTE Conv.cAdaGlast._.f_gls_trimm_gls_schwelle_kf2_S6_S3 1 100 0 1 BIT_MASK 0x1 DISPLAY_IDENTIFIER f_gls_trimm_gls_schwelle_kf2.iAdaGlast ECU_ADDRESS 0xFFF8BF26 /end MEASUREMENT
/begin MEASUREMENT iAdaGlast.gls_ada_state "gls_ada_state" UBYTE Conv.cAdaGlast._.gls_ada_state_S6_S3 1 100 1 8 DISPLAY_IDENTIFIER gls_ada_state.iAdaGlast ECU_ADDRESS 0xFFF8BF27 /end MEASUREMENT
/begin MEASUREMENT iAdaGlast.nt_adbr "Turbinendrehzahl aus der der gls_adbr bestimmt wurde" UWORD UMR_U_MIN_1_1_0_S6_S3 1 100 0 8160 DISPLAY_IDENTIFIER nt_adbr.iAdaGlast ECU_ADDRESS 0xFFF8BF28 /end MEASUREMENT
/begin MEASUREMENT iAdaGlast.mt_adbr "Turbinenmoment aus der der gls_adbr bestimmt wurde" SWORD UMR_NM__1_1_0_S6_S3 1 100 -400 1640 DISPLAY_IDENTIFIER mt_adbr.iAdaGlast ECU_ADDRESS 0xFFF8BF2A /end MEASUREMENT
/begin MEASUREMENT iAdaGlast.bew_erl_schaltinfo "erweiterte Freigabe GLS Adaption" UBYTE Conv.cAdaGlast._.bew_erl_schaltinfo_S6_S3 1 100 0 1 BIT_MASK 0x1 DISPLAY_IDENTIFIER bew_erl_schaltinfo.iAdaGlast ECU_ADDRESS 0xFFF8BF2C /end MEASUREMENT
/begin MEASUREMENT iAdaGlosc.FiAxRefAdaOff.x "Filterwert" SLONG UMR___1_300_0_S6_S3 1 100 -7158278.82667 7158278.82333 DISPLAY_IDENTIFIER FiAxRefAdaOff.iAdaGlosc ECU_ADDRESS 0xFFF8BF98 /end MEASUREMENT
/begin MEASUREMENT iAdaGlosc.adaption_counter "Allgemeiner Adaptionszaehler" UWORD UMR___1_1_0_S6_S3 1 100 0 65535 DISPLAY_IDENTIFIER adaption_counter.iAdaGlosc ECU_ADDRESS 0xFFF8BF6C /end MEASUREMENT
/begin MEASUREMENT iAdaGlosc.f_aenderung_adaram_daten "Wird nach Aufruf der ADA-Bewertungsfunktionen gesetzt" UBYTE Conv.cAdaGlosc._.f_aenderung_adaram_daten_S6_S3 1 100 0 1 BIT_MASK 0x1 DISPLAY_IDENTIFIER f_aenderung_adaram_daten.iAdaGlosc ECU_ADDRESS 0xFFF8BF6E /end MEASUREMENT
/begin MEASUREMENT iAdaGlosc.adabew_verbot_sas "Flag: Bewertungsverbot durch Schaltablauf" UBYTE UMR___1_1_0_S6_S3 1 100 0 1 BIT_MASK 0x1 DISPLAY_IDENTIFIER adabew_verbot_sas.iAdaGlosc ECU_ADDRESS 0xFFF8BF6F /end MEASUREMENT
/begin MEASUREMENT iAdaGlosc.ada_synchron "FLAG: Synchronpunkt erreicht" UBYTE Conv.cAdaGlosc._.ada_synchron_S6_S3 1 100 0 1 BIT_MASK 0x1 DISPLAY_IDENTIFIER ada_synchron.iAdaGlosc ECU_ADDRESS 0xFFF8BF70 /end MEASUREMENT
/begin MEASUREMENT iAdaGlosc.ada_schaltung_kzu "Flag: Schaltung ueber KZU" UBYTE Conv.cAdaGlosc._.ada_schaltung_kzu_S6_S3 1 100 0 1 BIT_MASK 0x1 DISPLAY_IDENTIFIER ada_schaltung_kzu.iAdaGlosc ECU_ADDRESS 0xFFF8BF71 /end MEASUREMENT
/begin MEASUREMENT iAdaGlosc.init_mit_azg "Init. der Adaptionssp. mit AZG" UBYTE Conv.cAdaGlosc._.init_mit_azg_S6_S3 1 100 0 255 DISPLAY_IDENTIFIER init_mit_azg.iAdaGlosc ECU_ADDRESS 0xFFF8BF72 /end MEASUREMENT
/begin MEASUREMENT iAdaGlosc.ada_zielgang "Zielgang fuer Adaptionsfunktionen" UBYTE Conv.cAdaGlosc._.ada_zielgang_S6_S3 1 100 0 8 DISPLAY_IDENTIFIER ada_zielgang.iAdaGlosc ECU_ADDRESS 0xFFF8BF73 /end MEASUREMENT
/begin MEASUREMENT iAdaGlosc.ada_istgang "Istgang fuer Adaptionsfunktionen" UBYTE Conv.cAdaGlosc._.ada_istgang_S6_S3 1 100 0 8 DISPLAY_IDENTIFIER ada_istgang.iAdaGlosc ECU_ADDRESS 0xFFF8BF74 /end MEASUREMENT
/begin MEASUREMENT iAdaGlosc.ada_version "" UBYTE Conv.cAdaGlosc._.ada_version_S6_S3 1 100 0 57 DISPLAY_IDENTIFIER ada_version.iAdaGlosc ECU_ADDRESS 0xFFF8BF75 /end MEASUREMENT
/begin MEASUREMENT iAdaGlosc.ada_p_gls_kzu_1mbar "Druck GLS Regelung der KZU in 1 mbar Quantisierung" SLONG UMR_MBAR__1_1_0_S6_S3 1 100 -320000 320000 DISPLAY_IDENTIFIER ada_p_gls_kzu_1mbar.iAdaGlosc ECU_ADDRESS 0xFFF8BF78 /end MEASUREMENT
/begin MEASUREMENT iAdaGlosc.ada_p_gls_kab_1mbar "Druck GLS Regelung der KAB in 1 mbar Quantisierung" SLONG UMR_MBAR__1_1_0_S6_S3 1 100 -2147483648 2147483647 DISPLAY_IDENTIFIER ada_p_gls_kab_1mbar.iAdaGlosc ECU_ADDRESS 0xFFF8BF7C /end MEASUREMENT
/begin MEASUREMENT iAdaGlosc.ada_p_gls_kzu "Druck GLS Regelung der KZU" SLONG UMR_MBAR__10_1_0_S6_S3 1 100 -320000 320000 DISPLAY_IDENTIFIER ada_p_gls_kzu.iAdaGlosc ECU_ADDRESS 0xFFF8BF80 /end MEASUREMENT
/begin MEASUREMENT iAdaGlosc.ada_p_gls_kab "Druck GLS Regelung der KAB" SLONG UMR_MBAR__10_1_0_S6_S3 1 100 -21474836480 21474836470 DISPLAY_IDENTIFIER ada_p_gls_kab.iAdaGlosc ECU_ADDRESS 0xFFF8BF84 /end MEASUREMENT
/begin MEASUREMENT iAdaGlosc.ada_k_zu "zuschaltende Kupplung, die von der PF-Adaption beobachtet wird" UBYTE Conv.cAdaGlosc._.ada_k_zu_S6_S3 1 100 0 5 DISPLAY_IDENTIFIER ada_k_zu.iAdaGlosc ECU_ADDRESS 0xFFF8BF88 /end MEASUREMENT
/begin MEASUREMENT iAdaGlosc.ada_schaltart "Variable zur Klassifizierung der aktuellen Schaltung aus ADA Sicht" UBYTE Conv.cAdaGlosc._.ada_schaltart_S6_S3 1 100 0 2 DISPLAY_IDENTIFIER ada_schaltart.iAdaGlosc ECU_ADDRESS 0xFFF8BF89 /end MEASUREMENT
/begin MEASUREMENT iAdaGlosc.ada_schaltinfo "Laufende Schaltung ist EHS, MHS, MRS, MRS oder keine Schaltung" UBYTE Conv.cAdaGlosc._.ada_schaltinfo_S6_S3 1 100 0 4 DISPLAY_IDENTIFIER ada_schaltinfo.iAdaGlosc ECU_ADDRESS 0xFFF8BF8A /end MEASUREMENT
/begin MEASUREMENT iAdaGlosc.ada_iae_info "Variable zur Klassifizierung der aktuell aktiven IAE Adaption" UBYTE Conv.cAdaGlosc._.ada_iae_info_S6_S3 1 100 0 2 DISPLAY_IDENTIFIER ada_iae_info.iAdaGlosc ECU_ADDRESS 0xFFF8BF8B /end MEASUREMENT
/begin MEASUREMENT iAdaGlosc.z_ada_schaltung "Klassifizierung der aktuellen Schaltung aus ADA Sicht" UBYTE Conv.cAdaGlosc._.z_ada_schaltung_S6_S3 1 100 0 2 DISPLAY_IDENTIFIER z_ada_schaltung.iAdaGlosc ECU_ADDRESS 0xFFF8BF8C /end MEASUREMENT
/begin MEASUREMENT iAdaGlosc.ada_schaltungs_index "Klassifizierung aktuellen Schaltung (normal, spontan, sportlich, amax) aus ADA Sicht" UBYTE Conv.cAdaGlosc._.ada_schaltungs_index_S6_S3 1 100 0 4 DISPLAY_IDENTIFIER ada_schaltungs_index.iAdaGlosc ECU_ADDRESS 0xFFF8BF8D /end MEASUREMENT
/begin MEASUREMENT iAdaGlosc.f_ada_bew_verboten "Ein globales Ada-Abbruch-Kriterium hat zugeschlagen" UBYTE Conv.cAdaGlosc._.f_ada_bew_verboten_S6_S3 1 100 0 1 BIT_MASK 0x1 DISPLAY_IDENTIFIER f_ada_bew_verboten.iAdaGlosc ECU_ADDRESS 0xFFF8BF8E /end MEASUREMENT
/begin MEASUREMENT iAdaGlosc.f_letzte_schaltung_rs "letzte Schaltung war eine RS (auch kein GE/GA)" UBYTE Conv.cAdaGlosc._.f_letzte_schaltung_rs_S6_S3 1 100 0 1 BIT_MASK 0x1 DISPLAY_IDENTIFIER f_letzte_schaltung_rs.iAdaGlosc ECU_ADDRESS 0xFFF8BF8F /end MEASUREMENT
/begin MEASUREMENT iAdaGlosc.flag_alaengs_adaoff "Abbruch von Adaptionen aufgrund von Längbeschleunigung" UBYTE Conv.cAdaGlosc._.flag_alaengs_adaoff_S6_S3 1 100 0 1 BIT_MASK 0x1 DISPLAY_IDENTIFIER flag_alaengs_adaoff.iAdaGlosc ECU_ADDRESS 0xFFF8BF90 /end MEASUREMENT
/begin MEASUREMENT iAdaGlosc.bew_verbot_laengs_beschl "Zustandsgroesse ob Adas wegen Laengsbeschleunigung verboten sind" UBYTE Conv.cAdaGlosc._.bew_verbot_laengs_beschl_S6_S3 1 100 0 2 DISPLAY_IDENTIFIER bew_verbot_laengs_beschl.iAdaGlosc ECU_ADDRESS 0xFFF8BF91 /end MEASUREMENT
/begin MEASUREMENT iAdaGlosc.ax_ref_gef_ada "Laengsbeschleunigung gefiltert fuer Adaptionen" SWORD UMR_M_SEC2_1_32_0_S6_S3 1 100 -1024 1023.96875 DISPLAY_IDENTIFIER ax_ref_gef_ada.iAdaGlosc ECU_ADDRESS 0xFFF8BF92 /end MEASUREMENT
/begin MEASUREMENT iAdaGlosc.flag_allada_del "interne Groesse zum Loeschen von Adaptionsdaten" UBYTE Conv.cAdaGlosc._.flag_allada_del_S6_S3 1 100 0 1 BIT_MASK 0x1 DISPLAY_IDENTIFIER flag_allada_del.iAdaGlosc ECU_ADDRESS 0xFFF8BF94 /end MEASUREMENT
/begin MEASUREMENT iAdaIaeApKorr.TimerAdaIaeApKorr.time "Zeit des Timers" UWORD UMR_SEC__1_100_0_S6_S3 1 100 0 655.35 DISPLAY_IDENTIFIER TimerAdaIaeApKorr.iAdaIaeApKorr ECU_ADDRESS 0xFFF8C7D2 /end MEASUREMENT
/begin MEASUREMENT iAdaIaeApKorr.TimerMaxWartenAdaIaeApKorr.time "Zeit des Timers" UWORD UMR_SEC__1_100_0_S6_S3 1 100 0 655.35 DISPLAY_IDENTIFIER TimerMaxWartenAdaIaeApKorr.iAdaIaeApKorr ECU_ADDRESS 0xFFF8C7D4 /end MEASUREMENT
/begin MEASUREMENT iAdaIaeApKorr.FiNMotAdaIae.x "Filterwert" SLONG UMR___1_300_0_S6_S3 1 100 -7158278.82667 7158278.82333 DISPLAY_IDENTIFIER FiNMotAdaIae.iAdaIaeApKorr ECU_ADDRESS 0xFFF8C7D8 /end MEASUREMENT
/begin MEASUREMENT iAdaIaeApKorr.FiMMotIstAdaIae.x "Filterwert" SLONG UMR___1_300_0_S6_S3 1 100 -7158278.82667 7158278.82333 DISPLAY_IDENTIFIER FiMMotIstAdaIae.iAdaIaeApKorr ECU_ADDRESS 0xFFF8C7DC /end MEASUREMENT
/begin MEASUREMENT iAdaIaeApKorr.FiNMotAdaIaeFloat.x "Filterwert" FLOAT32_IEEE UMR___1_1_0_S6_S3 1 100 -1000000000 1000000000 FORMAT "%4.2" DISPLAY_IDENTIFIER FiNMotAdaIaeFloat.iAdaIaeApKorr ECU_ADDRESS 0xFFF8C7E0 /end MEASUREMENT
/begin MEASUREMENT iAdaIaeApKorr.FiMMotIstAdaIaeFloat.x "Filterwert" FLOAT32_IEEE UMR___1_1_0_S6_S3 1 100 -1000000000 1000000000 FORMAT "%4.2" DISPLAY_IDENTIFIER FiMMotIstAdaIaeFloat.iAdaIaeApKorr ECU_ADDRESS 0xFFF8C7E4 /end MEASUREMENT
/begin MEASUREMENT iAdaIaeApKorr.FiNGMotAdaIae.x "Filterwert" FLOAT32_IEEE UMR___1_1_0_S6_S3 1 100 -2147483648 2147483647 FORMAT "%4.2" DISPLAY_IDENTIFIER x.FiNGMotAdaIae.iAdaIaeApKorr ECU_ADDRESS 0xFFF8C7E8 /end MEASUREMENT
/begin MEASUREMENT iAdaIaeApKorr.FiNGMotAdaIae.xp "Ableitung vom Eingangswert" FLOAT32_IEEE UMR__SEC_1_1_0_S6_S3 1 100 -2147483648 2147483647 FORMAT "%4.2" DISPLAY_IDENTIFIER xp.FiNGMotAdaIae.iAdaIaeApKorr ECU_ADDRESS 0xFFF8C7EC /end MEASUREMENT
/begin MEASUREMENT iAdaIaeApKorr.FiMGMotIstAdaIae.x "Filterwert" FLOAT32_IEEE UMR___1_1_0_S6_S3 1 100 -2147483648 2147483647 FORMAT "%4.2" DISPLAY_IDENTIFIER x.FiMGMotIstAdaIae.iAdaIaeApKorr ECU_ADDRESS 0xFFF8C7F0 /end MEASUREMENT
/begin MEASUREMENT iAdaIaeApKorr.FiMGMotIstAdaIae.xp "Ableitung vom Eingangswert" FLOAT32_IEEE UMR__SEC_1_1_0_S6_S3 1 100 -2147483648 2147483647 FORMAT "%4.2" DISPLAY_IDENTIFIER xp.FiMGMotIstAdaIae.iAdaIaeApKorr ECU_ADDRESS 0xFFF8C7F4 /end MEASUREMENT
/begin MEASUREMENT iAdaIaeApKorr.z_apada_korr "Zustand des IAE Anlegepunkt-Adaption Koordinators" UBYTE Conv.cAdaIaeApKorr._.z_apada_korr_S6_S3 1 100 0 5 DISPLAY_IDENTIFIER z_apada_korr.iAdaIaeApKorr ECU_ADDRESS 0xFFF8C7A0 /end MEASUREMENT
/begin MEASUREMENT iAdaIaeApKorr.abbruch_bit_ada_iae "Info zu globalen Abbruchkriterien und Abbruch aus Warten Sperrzeit" ULONG Conv.cAdaIaeApKorr._.abbruch_bit_ada_iae_S6_S3 1 100 0 536870912 DISPLAY_IDENTIFIER abbruch_bit_ada_iae.iAdaIaeApKorr ECU_ADDRESS 0xFFF8C7A4 /end MEASUREMENT
/begin MEASUREMENT iAdaIaeApKorr.apada_iae_aktive_adaption "Vom Koordinator ausgewähle Adaption" UBYTE Conv.cAdaIaeApKorr._.apada_iae_aktive_adaption_S6_S3 1 100 0 2 DISPLAY_IDENTIFIER apada_iae_aktive_adaption.iAdaIaeApKorr ECU_ADDRESS 0xFFF8C7A8 /end MEASUREMENT
/begin MEASUREMENT iAdaIaeApKorr.req_n_mot_llsoll_iae "Anforderung einer Leerlaufdrehzahl durch Iae" UBYTE Conv.cAdaIaeApKorr._.req_n_mot_llsoll_iae_S6_S3 1 100 0 3 DISPLAY_IDENTIFIER req_n_mot_llsoll_iae.iAdaIaeApKorr ECU_ADDRESS 0xFFF8C7A9 /end MEASUREMENT
/begin MEASUREMENT iAdaIaeApKorr.n_mot_ada_iae "Interner gefilteter Wert der IAE-Adaption" UWORD UMR_U_MIN_1_1_0_S6_S3 1 100 0 8160 DISPLAY_IDENTIFIER n_mot_ada_iae.iAdaIaeApKorr ECU_ADDRESS 0xFFF8C7AA /end MEASUREMENT
/begin MEASUREMENT iAdaIaeApKorr.n_mot_ff_ada_iae "Interner gefilteter Wert der IAE-Adaption (Floatfilter)" FLOAT32_IEEE UMR_U_MIN_1_1_0_S6_S3 1 100 0 8160 DISPLAY_IDENTIFIER n_mot_ff_ada_iae.iAdaIaeApKorr ECU_ADDRESS 0xFFF8C7AC /end MEASUREMENT
/begin MEASUREMENT iAdaIaeApKorr.ng_mot_ada_iae "Interner gefilteter Wert der IAE-Adaption" SWORD UMR_U_MINSEC_1_1_0_S6_S3 1 100 -10000 10000 DISPLAY_IDENTIFIER ng_mot_ada_iae.iAdaIaeApKorr ECU_ADDRESS 0xFFF8C7B0 /end MEASUREMENT
/begin MEASUREMENT iAdaIaeApKorr.m_motist_ada_iae "Interner gefilteter Wert der IAE-Adaption" SWORD UMR_NM__1_1_0_S6_S3 1 100 -400 1640 DISPLAY_IDENTIFIER m_motist_ada_iae.iAdaIaeApKorr ECU_ADDRESS 0xFFF8C7B2 /end MEASUREMENT
/begin MEASUREMENT iAdaIaeApKorr.m_motist_ff_ada_iae "Interner gefilteter Wert der IAE-Adaption (Floatfilter)" FLOAT32_IEEE UMR_NM__1_1_0_S6_S3 1 100 -400 1640 DISPLAY_IDENTIFIER m_motist_ff_ada_iae.iAdaIaeApKorr ECU_ADDRESS 0xFFF8C7B4 /end MEASUREMENT
/begin MEASUREMENT iAdaIaeApKorr.mg_motist_ada_iae "Interner gefilteter Wert der IAE-Adaption" SWORD UMR_NM_SEC_1_1_0_S6_S3 1 100 -10000 10000 DISPLAY_IDENTIFIER mg_motist_ada_iae.iAdaIaeApKorr ECU_ADDRESS 0xFFF8C7B8 /end MEASUREMENT
/begin MEASUREMENT iAdaIaeApKorr.n_mot_soll_ada_iae "n_mot_soll abhaengig von z_modus_iae" UWORD UMR_U_MIN_1_1_0_S6_S3 1 100 0 8200 DISPLAY_IDENTIFIER n_mot_soll_ada_iae.iAdaIaeApKorr ECU_ADDRESS 0xFFF8C7BA /end MEASUREMENT
/begin MEASUREMENT iAdaIaeApKorr.n_mot_soll_leer_start "n_mot_soll_leer waehrend Uebergang nach -Warten auf Stat Bedingungen-" UWORD UMR_U_MIN_1_1_0_S6_S3 1 100 0 8200 DISPLAY_IDENTIFIER n_mot_soll_leer_start.iAdaIaeApKorr ECU_ADDRESS 0xFFF8C7BC /end MEASUREMENT
/begin MEASUREMENT iAdaIaeApKorr.m_stell_start_ada_iae "m_stell_iae waehrend Uebergang nach -Warten auf Stat Bedingungen-" SLONG UMR_NM__1_1_0_S6_S3 1 100 -400 1640 DISPLAY_IDENTIFIER m_stell_start_ada_iae.iAdaIaeApKorr ECU_ADDRESS 0xFFF8C7C0 /end MEASUREMENT
/begin MEASUREMENT iAdaIaeApKorr.summe_m_motist_ada_iae "Summe ueber m_motist_ada_iae waehrend WARTEN_STAT_BED" SLONG UMR_NM__1_1_0_S6_S3 1 100 -2147483648 2147483647 DISPLAY_IDENTIFIER summe_m_motist_ada_iae.iAdaIaeApKorr ECU_ADDRESS 0xFFF8C7C4 /end MEASUREMENT
/begin MEASUREMENT iAdaIaeApKorr.m_mw_motist_aperk_iae "reine Anzeigegroesse nur fuer die Erprobung benoetigt" SWORD UMR_NM__1_1_0_S6_S3 1 100 -400 1640 DISPLAY_IDENTIFIER m_mw_motist_aperk_iae.iAdaIaeApKorr ECU_ADDRESS 0xFFF8C7C8 /end MEASUREMENT
/begin MEASUREMENT iAdaIaeApKorr.m_schlepp_ada_iae "Schleppmomente des Getriebes zur Korrekturrechnung für die IAE-Adaption während IEP-Betrieb" SWORD UMR_NM__1_1_0_S6_S3 1 100 0 50 DISPLAY_IDENTIFIER m_schlepp_ada_iae.iAdaIaeApKorr ECU_ADDRESS 0xFFF8C7CA /end MEASUREMENT
/begin MEASUREMENT iAdaIaeApKorr.ada_wert_ap_iae "aktueller Adaptionswert der IAE-Ada" SWORD UMR_BAR__1_1000_0_S6_S3 1 100 -1 12.75 DISPLAY_IDENTIFIER ada_wert_ap_iae.iAdaIaeApKorr ECU_ADDRESS 0xFFF8C7CC /end MEASUREMENT
/begin MEASUREMENT iAdaIaeApKorr.ada_wert_ap_iep_iae "aktueller Adaptionswert der IEP-Ada" SWORD UMR_BAR__1_1000_0_S6_S3 1 100 -1 12.75 DISPLAY_IDENTIFIER ada_wert_ap_iep_iae.iAdaIaeApKorr ECU_ADDRESS 0xFFF8C7CE /end MEASUREMENT
/begin MEASUREMENT iAdaIaeApKorr.po_ada_iae "aktueller Adaptionswert der IAE und IEP Adaption" SWORD UMR_BAR__1_1000_0_S6_S3 1 100 -2 25.5 DISPLAY_IDENTIFIER po_ada_iae.iAdaIaeApKorr ECU_ADDRESS 0xFFF8C7D0 /end MEASUREMENT
/begin MEASUREMENT iAdaIaeApIae.TimerMaxWartenAdaIae.time "Zeit des Timers" UWORD UMR_SEC__1_100_0_S6_S3 1 100 0 655.35 DISPLAY_IDENTIFIER TimerMaxWartenAdaIae.iAdaIaeApIae ECU_ADDRESS 0xFFF8BFC6 /end MEASUREMENT
/begin MEASUREMENT iAdaIaeApIae.TimerAdaIae.time "Zeit des Timers" UWORD UMR_SEC__1_100_0_S6_S3 1 100 0 655.35 DISPLAY_IDENTIFIER TimerAdaIae.iAdaIaeApIae ECU_ADDRESS 0xFFF8BFC8 /end MEASUREMENT
/begin MEASUREMENT iAdaIaeApIae.TimerKriterienAdaIae.time "Zeit des Timers" UWORD UMR_SEC__1_100_0_S6_S3 1 100 0 655.35 DISPLAY_IDENTIFIER TimerKriterienAdaIae.iAdaIaeApIae ECU_ADDRESS 0xFFF8BFCA /end MEASUREMENT
/begin MEASUREMENT iAdaIaeApIae.RampeAdaIae.letzter_wert "Speichert den letzten Eingangswert" FLOAT32_IEEE UMR___1_1_0_S6_S3 1 100 -1E+037 1E+037 FORMAT "%4.2" DISPLAY_IDENTIFIER letzter_wert.RampeAdaIae.iAdaIaeApIae ECU_ADDRESS 0xFFF8BFCC /end MEASUREMENT
/begin MEASUREMENT iAdaIaeApIae.RampeAdaIae.letzter_ms_timer "Speichert den letzten BS-Timer" UWORD UMR_MSEC__1_1_0_S6_S3 1 100 0 65535 DISPLAY_IDENTIFIER letzter_ms_timer.RampeAdaIae.iAdaIaeApIae ECU_ADDRESS 0xFFF8BFD0 /end MEASUREMENT
/begin MEASUREMENT iAdaIaeApIae.RampeAdaIae.minimum "Minimum Begrenzung" FLOAT32_IEEE UMR___1_1_0_S6_S3 1 100 -1E+037 1E+037 FORMAT "%4.2" DISPLAY_IDENTIFIER minimum.RampeAdaIae.iAdaIaeApIae ECU_ADDRESS 0xFFF8BFD4 /end MEASUREMENT
/begin MEASUREMENT iAdaIaeApIae.RampeAdaIae.maximum "Maximum Begrenzung" FLOAT32_IEEE UMR___1_1_0_S6_S3 1 100 -1E+037 1E+037 FORMAT "%4.2" DISPLAY_IDENTIFIER maximum.RampeAdaIae.iAdaIaeApIae ECU_ADDRESS 0xFFF8BFD8 /end MEASUREMENT
/begin MEASUREMENT iAdaIaeApIae.z_apada_iae "Zustand der IAE Anlegepunkt-Adaption" UBYTE Conv.cAdaIaeApIae._.z_apada_iae_S6_S3 1 100 0 14 DISPLAY_IDENTIFIER z_apada_iae.iAdaIaeApIae ECU_ADDRESS 0xFFF8BFA0 /end MEASUREMENT
/begin MEASUREMENT iAdaIaeApIae.f_req_ada_iae "Adaption Notwendig und Grundbedingugnen erfuellt." UBYTE Conv.cAdaIaeApIae._.f_req_ada_iae_S6_S3 1 100 0 1 BIT_MASK 0x1 DISPLAY_IDENTIFIER f_req_ada_iae.iAdaIaeApIae ECU_ADDRESS 0xFFF8BFA1 /end MEASUREMENT
/begin MEASUREMENT iAdaIaeApIae.f_angelegt_mmot_iae "IAE-ADA Momenten-Kriterium erkannt" UBYTE Conv.cAdaIaeApIae._.f_angelegt_mmot_iae_S6_S3 1 100 0 1 BIT_MASK 0x1 DISPLAY_IDENTIFIER f_angelegt_mmot_iae.iAdaIaeApIae ECU_ADDRESS 0xFFF8BFA2 /end MEASUREMENT
/begin MEASUREMENT iAdaIaeApIae.f_rampinit_iae "IAE-ADA Initphase der Prueframpe erkannt" UBYTE Conv.cAdaIaeApIae._.f_rampinit_iae_S6_S3 1 100 0 1 BIT_MASK 0x1 DISPLAY_IDENTIFIER f_rampinit_iae.iAdaIaeApIae ECU_ADDRESS 0xFFF8BFA3 /end MEASUREMENT
/begin MEASUREMENT iAdaIaeApIae.f_bew_verboten_iae "Adaptions-Bewertung durch globale Ada-Abbruch kriterien verboten" UBYTE Conv.cAdaIaeApIae._.f_bew_verboten_iae_S6_S3 1 100 0 1 BIT_MASK 0x1 DISPLAY_IDENTIFIER f_bew_verboten_iae.iAdaIaeApIae ECU_ADDRESS 0xFFF8BFA4 /end MEASUREMENT
/begin MEASUREMENT iAdaIaeApIae.f_abbruch_global_iae "Globales Abbruch-Kriterium ist eingetreten - in Zustand Hys-Schleife wird nicht sofort abgebrochen" UBYTE Conv.cAdaIaeApIae._.f_abbruch_global_iae_S6_S3 1 100 0 1 BIT_MASK 0x1 DISPLAY_IDENTIFIER f_abbruch_global_iae.iAdaIaeApIae ECU_ADDRESS 0xFFF8BFA5 /end MEASUREMENT
/begin MEASUREMENT iAdaIaeApIae.req_n_mot_llsoll_iae "Anforderung einer Leerlaufdrehzahl durch Iae" UBYTE Conv.cAdaIaeApIae._.req_n_mot_llsoll_iae_S6_S3 1 100 0 1 DISPLAY_IDENTIFIER req_n_mot_llsoll_iae.iAdaIaeApIae ECU_ADDRESS 0xFFF8BFA6 /end MEASUREMENT
/begin MEASUREMENT iAdaIaeApIae.c_getr_ref_iae "Temperatur bei Beginn Prueframpe (zum Festhalten des Ada-Wertes)" UBYTE UMR_GRADC__1_1_M40_S6_S3 1 100 -40 215 DISPLAY_IDENTIFIER c_getr_ref_iae.iAdaIaeApIae ECU_ADDRESS 0xFFF8BFA7 /end MEASUREMENT
/begin MEASUREMENT iAdaIaeApIae.po_stell_ada_iae "Druck-Offset der ansteuernden IAE-Adaption" SWORD UMR_BAR__1_1000_0_S6_S3 1 100 -1 12.75 DISPLAY_IDENTIFIER po_stell_ada_iae.iAdaIaeApIae ECU_ADDRESS 0xFFF8BFA8 /end MEASUREMENT
/begin MEASUREMENT iAdaIaeApIae.ada_wert_iae "aktueller Adaptionswert der IAE-Ada" SWORD UMR_BAR__1_1000_0_S6_S3 1 100 -1 12.75 DISPLAY_IDENTIFIER ada_wert_iae.iAdaIaeApIae ECU_ADDRESS 0xFFF8BFAA /end MEASUREMENT
/begin MEASUREMENT iAdaIaeApIae.po_n_ada_iae "aktueller Adaptionswert der IAE-Ada fuer Druckansteuerung in N" SWORD UMR_BAR__1_1000_0_S6_S3 1 100 -1 12.75 DISPLAY_IDENTIFIER po_n_ada_iae.iAdaIaeApIae ECU_ADDRESS 0xFFF8BFAC /end MEASUREMENT
/begin MEASUREMENT iAdaIaeApIae.po_rampen_init "Startwert der Prueframpe" SWORD UMR_BAR__1_1000_0_S6_S3 1 100 -1 12.75 DISPLAY_IDENTIFIER po_rampen_init.iAdaIaeApIae ECU_ADDRESS 0xFFF8BFAE /end MEASUREMENT
/begin MEASUREMENT iAdaIaeApIae.po_uef_start "Startwert der Ueberfuehrungs-Fkt." SWORD UMR_BAR__1_1000_0_S6_S3 1 100 -1 12.75 DISPLAY_IDENTIFIER po_uef_start.iAdaIaeApIae ECU_ADDRESS 0xFFF8BFB0 /end MEASUREMENT
/begin MEASUREMENT iAdaIaeApIae.po_uef_ziel "Zielwert der Ueberfuehrungs-Fkt." SWORD UMR_BAR__1_1000_0_S6_S3 1 100 -1 12.75 DISPLAY_IDENTIFIER po_uef_ziel.iAdaIaeApIae ECU_ADDRESS 0xFFF8BFB2 /end MEASUREMENT
/begin MEASUREMENT iAdaIaeApIae.delta_anlege_druck_iae "Aenderung des Anlege-Drucks als Eingang in Ada-Speicher Aenderung - Hinweis: PO_APERK_IAE wurde schon abgezogen" SWORD UMR_BAR__1_1000_0_S6_S3 1 100 -1 12.75 DISPLAY_IDENTIFIER delta_anlege_druck_iae.iAdaIaeApIae ECU_ADDRESS 0xFFF8BFB4 /end MEASUREMENT
/begin MEASUREMENT iAdaIaeApIae.pg_rampe_ada_iae "Rampendruckgradient (Aussnahme Prueframpe) der der IAE-Anlegepunktadaption" SWORD UMR_BAR_SEC_1_10_0_S6_S3 1 100 -100 100 DISPLAY_IDENTIFIER pg_rampe_ada_iae.iAdaIaeApIae ECU_ADDRESS 0xFFF8BFB6 /end MEASUREMENT
/begin MEASUREMENT iAdaIaeApIae.m_mot_ref_ada_iae "Referenzmotormoment der IAE-Adaption" SLONG UMR_NM__1_100_0_S6_S3 1 100 -1200 1200 DISPLAY_IDENTIFIER m_mot_ref_ada_iae.iAdaIaeApIae ECU_ADDRESS 0xFFF8BFB8 /end MEASUREMENT
/begin MEASUREMENT iAdaIaeApIae.md_mot_ada_iae "Differnez m_mot zum Refernezwert waehrend Prueframpe" SWORD UMR_NM__1_1_0_S6_S3 1 100 -400 1640 DISPLAY_IDENTIFIER md_mot_ada_iae.iAdaIaeApIae ECU_ADDRESS 0xFFF8BFBC /end MEASUREMENT
/begin MEASUREMENT iAdaIaeApIae.summe_m_motist_ada_iae "Summe ueber m_motist_ada_iae waehrend WARTEN_STAT_BED" SLONG UMR_NM__1_1_0_S6_S3 1 100 -2147483648 2147483647 DISPLAY_IDENTIFIER summe_m_motist_ada_iae.iAdaIaeApIae ECU_ADDRESS 0xFFF8BFC0 /end MEASUREMENT
/begin MEASUREMENT iAdaIaeApIae.ada_starttyp_pf "ID Aktiever Adaptionstyp" UBYTE Conv.cAdaIaeApIae._.ada_starttyp_pf_S6_S3 1 100 0 4 DISPLAY_IDENTIFIER ada_starttyp_pf.iAdaIaeApIae ECU_ADDRESS 0xFFF8BFC4 /end MEASUREMENT
/begin MEASUREMENT iAdaIaeApIep.TimerAdaIaeApIep.time "Zeit des Timers" UWORD UMR_SEC__1_100_0_S6_S3 1 100 0 655.35 DISPLAY_IDENTIFIER TimerAdaIaeApIep.iAdaIaeApIep ECU_ADDRESS 0xFFF8C79A /end MEASUREMENT
/begin MEASUREMENT iAdaIaeApIep.TimerAdaIaeApIepMaxAbsenken.time "Zeit des Timers" UWORD UMR_SEC__1_100_0_S6_S3 1 100 0 655.35 DISPLAY_IDENTIFIER TimerAdaIaeApIepMaxAbsenken.iAdaIaeApIep ECU_ADDRESS 0xFFF8C79C /end MEASUREMENT
/begin MEASUREMENT iAdaIaeApIep.z_apada_iep "Zustand der IAE Anlegepunkt-Adaption IEP" UBYTE Conv.cAdaIaeApIep._.z_apada_iep_S6_S3 1 100 0 14 DISPLAY_IDENTIFIER z_apada_iep.iAdaIaeApIep ECU_ADDRESS 0xFFF8C784 /end MEASUREMENT
/begin MEASUREMENT iAdaIaeApIep.f_req_ada_iep_iae "Adaption Notwendig und Grundbedingugnen erfuellt." UBYTE Conv.cAdaIaeApIep._.f_req_ada_iep_iae_S6_S3 1 100 0 1 BIT_MASK 0x1 DISPLAY_IDENTIFIER f_req_ada_iep_iae.iAdaIaeApIep ECU_ADDRESS 0xFFF8C785 /end MEASUREMENT
/begin MEASUREMENT iAdaIaeApIep.f_abbruch_global_iae "Globales Abbruch-Kriterium ist eingetreten - in Zustand Hys-Schleife wird nicht sofort abgebrochen" UBYTE Conv.cAdaIaeApIep._.f_abbruch_global_iae_S6_S3 1 100 0 1 BIT_MASK 0x1 DISPLAY_IDENTIFIER f_abbruch_global_iae.iAdaIaeApIep ECU_ADDRESS 0xFFF8C786 /end MEASUREMENT
/begin MEASUREMENT iAdaIaeApIep.cs_1_aperk_iae "Grenze zwischen ADKL 1 und 2." UBYTE UMR_GRADC__1_1_M40_S6_S3 1 100 -40 205 DISPLAY_IDENTIFIER cs_1_aperk_iae.iAdaIaeApIep ECU_ADDRESS 0xFFF8C787 /end MEASUREMENT
/begin MEASUREMENT iAdaIaeApIep.cs_2_aperk_iae "Grenze zwischen ADKL 2 und 3." UBYTE UMR_GRADC__1_1_M40_S6_S3 1 100 -40 205 DISPLAY_IDENTIFIER cs_2_aperk_iae.iAdaIaeApIep ECU_ADDRESS 0xFFF8C788 /end MEASUREMENT
/begin MEASUREMENT iAdaIaeApIep.cs_3_aperk_iae "Grenze zwischen ADKL 3 und 4." UBYTE UMR_GRADC__1_1_M40_S6_S3 1 100 -40 205 DISPLAY_IDENTIFIER cs_3_aperk_iae.iAdaIaeApIep ECU_ADDRESS 0xFFF8C789 /end MEASUREMENT
/begin MEASUREMENT iAdaIaeApIep.adkl_iep "Aktuelle Adaptionsklasse der IEA AP IEA Adaption." UBYTE Conv.cAdaIaeApIep._.adkl_iep_S6_S3 1 100 1 4 DISPLAY_IDENTIFIER adkl_iep.iAdaIaeApIep ECU_ADDRESS 0xFFF8C78A /end MEASUREMENT
/begin MEASUREMENT iAdaIaeApIep.m_mot_ref_aperk_iep_iae "Referenz Motormoment" SWORD UMR_NM__1_1_0_S6_S3 1 100 -400 1640 DISPLAY_IDENTIFIER m_mot_ref_aperk_iep_iae.iAdaIaeApIep ECU_ADDRESS 0xFFF8C78C /end MEASUREMENT
/begin MEASUREMENT iAdaIaeApIep.m_mot_iep_aperk_iep_iae "Mittelwert Motormoment weahrend M_MOT_IEP" SWORD UMR_NM__1_1_0_S6_S3 1 100 -400 1640 DISPLAY_IDENTIFIER m_mot_iep_aperk_iep_iae.iAdaIaeApIep ECU_ADDRESS 0xFFF8C78E /end MEASUREMENT
/begin MEASUREMENT iAdaIaeApIep.summe_m_mot_aperk_iep_iae "Speicher zur Bildung des Referenz-Motormoments" SLONG UMR_NM__1_1_0_S6_S3 1 100 -2147483648 2147483647 DISPLAY_IDENTIFIER summe_m_mot_aperk_iep_iae.iAdaIaeApIep ECU_ADDRESS 0xFFF8C790 /end MEASUREMENT
/begin MEASUREMENT iAdaIaeApIep.counter_m_mot_aperk_iep_iae "Zeahler zur Bildung des Referenz-Motormoments" UWORD UMR___1_1_0_S6_S3 1 100 0 65535 DISPLAY_IDENTIFIER counter_m_mot_aperk_iep_iae.iAdaIaeApIep ECU_ADDRESS 0xFFF8C794 /end MEASUREMENT
/begin MEASUREMENT iAdaIaeApIep.md_mot_aperk_iep_iae "Differenz Motormoment" SWORD UMR_NM__1_1_0_S6_S3 1 100 -2040 2040 DISPLAY_IDENTIFIER md_mot_aperk_iep_iae.iAdaIaeApIep ECU_ADDRESS 0xFFF8C796 /end MEASUREMENT
/begin MEASUREMENT iAdaIaeApIep.req_n_mot_llsoll_iae "Anforderung einer Leerlaufdrehzahl durch Iae" UBYTE Conv.cAdaIaeApIep._.req_n_mot_llsoll_iae_S6_S3 1 100 0 3 DISPLAY_IDENTIFIER req_n_mot_llsoll_iae.iAdaIaeApIep ECU_ADDRESS 0xFFF8C798 /end MEASUREMENT
/begin MEASUREMENT iAdaIaeuf.f_read_kf_gueltig "Kopie der Adaptionsdaten ist gueltig und kann verwendet werden" UBYTE Conv.cAdaIaeuf._.f_read_kf_gueltig_S6_S3 1 100 0 1 BIT_MASK 0x1 DISPLAY_IDENTIFIER f_read_kf_gueltig.iAdaIaeuf ECU_ADDRESS 0xFFF8C75C /end MEASUREMENT
/begin MEASUREMENT iAdaIaeuf.f_ada_sperren_werteuebername "Flag zur Freigabe der Adaption. Damit wird die Adaption solange verboten bis die neu Adaptierten Werte auch von der IAE verwendet werden" UBYTE Conv.cAdaIaeuf._.f_ada_sperren_werteuebername_S6_S3 1 100 0 1 BIT_MASK 0x1 DISPLAY_IDENTIFIER f_ada_sperren_werteuebername.iAdaIaeuf ECU_ADDRESS 0xFFF8C75D /end MEASUREMENT
/begin MEASUREMENT iAdaIaeuf.adbr_lesen "Index des Berichs zwichen den Stuezstellen" UBYTE UMR___1_1_0_S6_S3 1 100 0 49 DISPLAY_IDENTIFIER adbr_lesen.iAdaIaeuf ECU_ADDRESS 0xFFF8C75E /end MEASUREMENT
/begin MEASUREMENT iAdaIaeuf.adbr_schreiben "Index des Berichs zwichen den Stuezstellen" UBYTE UMR___1_1_0_S6_S3 1 100 0 49 DISPLAY_IDENTIFIER adbr_schreiben.iAdaIaeuf ECU_ADDRESS 0xFFF8C75F /end MEASUREMENT
/begin MEASUREMENT iNvrKoordinator.ee_management_status "Status EE-Management" UBYTE Conv.cNvrKoordinator._.ee_management_status_S6_S3 1 100 1 8 DISPLAY_IDENTIFIER ee_management_status.iNvrKoordinator ECU_ADDRESS 0xFFF8A63D /end MEASUREMENT
/begin MEASUREMENT iNvrKoordinator.ee_anzeige_block_history "Status EE-Management" UBYTE Conv.cNvrKoordinator._.ee_anzeige_block_history_S6_S3 1 100 0 10 DISPLAY_IDENTIFIER ee_anzeige_block_history.iNvrKoordinator ECU_ADDRESS 0xFFF8A63E /end MEASUREMENT
/begin MEASUREMENT iNvrKoordinator.ee_systemstart_ueber_reset "Wurde System ueber Reset gestartet" UBYTE Conv.cNvrKoordinator._.ee_systemstart_ueber_reset_S6_S3 1 100 0 2 DISPLAY_IDENTIFIER ee_systemstart_ueber_reset.iNvrKoordinator ECU_ADDRESS 0xFFF8A63F /end MEASUREMENT
/begin MEASUREMENT iNvrInSWP.ee_urstart_info_eeprom "Kopie des Uebergabe-Parameters des SW-Partners bei Urstart/Prog-Wechsel erkannt" UBYTE UMR___1_1_0_S6_S3 1 100 0 255 DISPLAY_IDENTIFIER ee_urstart_info_eeprom.iNvrInSWP ECU_ADDRESS 0xFFF8A32E /end MEASUREMENT
/begin MEASUREMENT iNvrInSWP.n_aufruf_eeprom_valid "Zaehler, der anzeigt, wie haeufig die Check-Ram-Spiegel-Funktion von SWP aufgerufen wurde" UBYTE UMR___1_1_0_S6_S3 1 100 0 255 DISPLAY_IDENTIFIER n_aufruf_eeprom_valid.iNvrInSWP ECU_ADDRESS 0xFFF8A32F /end MEASUREMENT
/begin MEASUREMENT iNvrInSWP.n_aufruf_eeprom_default "Zaehler, der anzeigt, wie haeufig die Urstart-Funktion von SWP aufgerufen wurde" UBYTE UMR___1_1_0_S6_S3 1 100 0 255 DISPLAY_IDENTIFIER n_aufruf_eeprom_default.iNvrInSWP ECU_ADDRESS 0xFFF8A330 /end MEASUREMENT
/begin MEASUREMENT iNvrInSWP.n_aufruf_eeprom_update "Zaehler, der anzeigt, wie haeufig die Update-Funktion von SWP aufgerufen wurde" UBYTE UMR___1_1_0_S6_S3 1 100 0 255 DISPLAY_IDENTIFIER n_aufruf_eeprom_update.iNvrInSWP ECU_ADDRESS 0xFFF8A331 /end MEASUREMENT
/begin MEASUREMENT iNvrInSWP.n_aufruf_statistics_valid "Zaehler, der anzeigt, wie haeufig die Check-Ram-Spiegel-Funktion von SWP aufgerufen wurde" UBYTE UMR___1_1_0_S6_S3 1 100 0 255 DISPLAY_IDENTIFIER n_aufruf_statistics_valid.iNvrInSWP ECU_ADDRESS 0xFFF8A332 /end MEASUREMENT
/begin MEASUREMENT iNvrInSWP.n_aufruf_statistics_update "Zaehler, der anzeigt, wie haeufig die Update-Funktion von SWP aufgerufen wurde" UBYTE UMR___1_1_0_S6_S3 1 100 0 255 DISPLAY_IDENTIFIER n_aufruf_statistics_update.iNvrInSWP ECU_ADDRESS 0xFFF8A333 /end MEASUREMENT
/begin MEASUREMENT iNvrInSWP.f_externer_loesch_auftrag "Flag, TRUE, wenn CALL_ADA_LOESCHEN vom SWP aufgerufen wurde" UBYTE UMR___1_1_0_S6_S3 1 100 0 1 BIT_MASK 0x1 DISPLAY_IDENTIFIER f_externer_loesch_auftrag.iNvrInSWP ECU_ADDRESS 0xFFF8A334 /end MEASUREMENT
/begin COMPU_METHOD SBW_PROZENT_S1_S3 "int = ((phys * 1) / 1) - (0) %" RAT_FUNC "%2.0" "%" COEFFS 0 1 -0 0 0 1 /end COMPU_METHOD
/begin COMPU_METHOD UMR___1_300_0_S6_S3 "int = ((phys * 300) / 1) - (0) [-]" RAT_FUNC "%7.5" "[-]" COEFFS 0 300 -0 0 0 1 /end COMPU_METHOD
/begin COMPU_METHOD UMR___1_1_0_S6_S3 "int = ((phys * 1) / 1) - (0) [-]" RAT_FUNC "%2.0" "[-]" COEFFS 0 1 -0 0 0 1 /end COMPU_METHOD
/begin COMPU_METHOD UMR_NM__1_100_0_S6_S3 "int = ((phys * 100) / 1) - (0) [Nm]" RAT_FUNC "%4.2" "[Nm]" COEFFS 0 100 -0 0 0 1 /end COMPU_METHOD
/begin COMPU_METHOD UMR_NM__1_1_0_S6_S3 "int = ((phys * 1) / 1) - (0) [Nm]" RAT_FUNC "%2.0" "[Nm]" COEFFS 0 1 -0 0 0 1 /end COMPU_METHOD
/begin COMPU_METHOD UMR_NM_SEC_1_1_0_S6_S3 "int = ((phys * 1) / 1) - (0) [Nm/s]" RAT_FUNC "%2.0" "[Nm/s]" COEFFS 0 1 -0 0 0 1 /end COMPU_METHOD
/begin COMPU_METHOD UMR_NM_BAR_1_1_0_S6_S3 "int = ((phys * 1) / 1) - (0) [Nm/bar]" RAT_FUNC "%2.0" "[Nm/bar]" COEFFS 0 1 -0 0 0 1 /end COMPU_METHOD
/begin COMPU_METHOD UMR_MBAR__1_1_0_S6_S3 "int = ((phys * 1) / 1) - (0) [mbar]" RAT_FUNC "%2.0" "[mbar]" COEFFS 0 1 -0 0 0 1 /end COMPU_METHOD
/begin COMPU_METHOD UMR_MBAR__10_1_0_S6_S3 "int = ((phys * 1) / 10) - (0) [mbar]" RAT_FUNC "%2.0" "[mbar]" COEFFS 0 1 -0 0 0 10 /end COMPU_METHOD
/begin COMPU_METHOD UMR_BAR__1_1000_0_S6_S3 "int = ((phys * 1000) / 1) - (0) [bar]" RAT_FUNC "%5.3" "[bar]" COEFFS 0 1000 -0 0 0 1 /end COMPU_METHOD
/begin COMPU_METHOD UMR_BAR__1_100_0_S6_S3 "int = ((phys * 100) / 1) - (0) [bar]" RAT_FUNC "%4.2" "[bar]" COEFFS 0 100 -0 0 0 1 /end COMPU_METHOD
/begin COMPU_METHOD UMR_BAR_SEC_1_10_0_S6_S3 "int = ((phys * 10) / 1) - (0) [bar/s]" RAT_FUNC "%3.1" "[bar/s]" COEFFS 0 10 -0 0 0 1 /end COMPU_METHOD
/begin COMPU_METHOD UMR_U_MIN_1_1_0_S6_S3 "int = ((phys * 1) / 1) - (0) [U/min]" RAT_FUNC "%2.0" "[U/min]" COEFFS 0 1 -0 0 0 1 /end COMPU_METHOD
/begin COMPU_METHOD UMR_U_MINSEC_1_1_0_S6_S3 "int = ((phys * 1) / 1) - (0) [U/(min*s)]" RAT_FUNC "%2.0" "[U/(min*s)]" COEFFS 0 1 -0 0 0 1 /end COMPU_METHOD
/begin COMPU_METHOD UMR_U_MINSEC_10_1_0_S6_S3 "int = ((phys * 1) / 10) - (0) [U/(min*s)]" RAT_FUNC "%2.0" "[U/(min*s)]" COEFFS 0 1 -0 0 0 10 /end COMPU_METHOD
/begin COMPU_METHOD UMR_MSEC__1_1_0_S6_S3 "int = ((phys * 1) / 1) - (0) [ms]" RAT_FUNC "%2.0" "[ms]" COEFFS 0 1 -0 0 0 1 /end COMPU_METHOD
/begin COMPU_METHOD UMR_MSEC__10_1_0_S6_S3 "int = ((phys * 1) / 10) - (0) [ms]" RAT_FUNC "%2.0" "[ms]" COEFFS 0 1 -0 0 0 10 /end COMPU_METHOD
/begin COMPU_METHOD UMR_SEC__1_100_0_S6_S3 "int = ((phys * 100) / 1) - (0) [s]" RAT_FUNC "%4.2" "[s]" COEFFS 0 100 -0 0 0 1 /end COMPU_METHOD
/begin COMPU_METHOD UMR_SEC__1_1_0_S6_S3 "int = ((phys * 1) / 1) - (0) [s]" RAT_FUNC "%2.0" "[s]" COEFFS 0 1 -0 0 0 1 /end COMPU_METHOD
/begin COMPU_METHOD UMR__SEC_1_1_0_S6_S3 "int = ((phys * 1) / 1) - (0) [1/s]" RAT_FUNC "%2.0" "[1/s]" COEFFS 0 1 -0 0 0 1 /end COMPU_METHOD
/begin COMPU_METHOD UMR_GRADC__1_1_M40_S6_S3 "int = ((phys * 1) / 1) - (-40) [°C]" RAT_FUNC "%2.0" "[°C]" COEFFS 0 1 40 0 0 1 /end COMPU_METHOD
/begin COMPU_METHOD UMR_PROZENT__20_51_0_S6_S3 "int = ((phys * 51) / 20) - (0) [%]" RAT_FUNC "%6.4" "[%]" COEFFS 0 51 -0 0 0 20 /end COMPU_METHOD
/begin COMPU_METHOD UMR_M_SEC2_1_32_0_S6_S3 "int = ((phys * 32) / 1) - (0) [m/s^2]" RAT_FUNC "%4.2" "[m/s^2]" COEFFS 0 32 -0 0 0 1 /end COMPU_METHOD
/begin COMPU_METHOD Conv.cAdaPfusf._.z_adapfn_status_S6_S3 "Umrechnung fuer Messgroesse cAdaPfusf::z_adapfn_status" TAB_VERB "%4.0" "" COMPU_TAB_REF Conv.cAdaPfusf._.z_adapfn_status_S6_S3 /end COMPU_METHOD
/begin COMPU_METHOD Conv.cAdaPfusf._.adapfn_status_S6_S3 "Umrechnung fuer Messgroesse cAdaPfusf::adapfn_status" TAB_VERB "%4.0" "" COMPU_TAB_REF Conv.cAdaPfusf._.adapfn_status_S6_S3 /end COMPU_METHOD
/begin COMPU_METHOD Conv.cAdaPfusf._.adkl_pfad_S6_S3 "Umrechnung fuer Messgroesse cAdaPfusf::adkl_pfad" TAB_VERB "%4.0" "" COMPU_TAB_REF Conv.cAdaPfusf._.adkl_pfad_S6_S3 /end COMPU_METHOD
/begin COMPU_METHOD Conv.cAdaPfusf._.schaltart_pfad_S6_S3 "Umrechnung fuer Messgroesse cAdaPfusf::schaltart_pfad" TAB_VERB "%4.0" "" COMPU_TAB_REF Conv.cAdaPfusf._.schaltart_pfad_S6_S3 /end COMPU_METHOD
/begin COMPU_METHOD Conv.cAdaPfusf._.schaltcode_pfad_S6_S3 "Umrechnung fuer Messgroesse cAdaPfusf::schaltcode_pfad" TAB_VERB "%4.0" "" COMPU_TAB_REF Conv.cAdaPfusf._.schaltcode_pfad_S6_S3 /end COMPU_METHOD
/begin COMPU_METHOD Conv.cAdaPfusf._.f_mt_krit_aktiv_pfad_S6_S3 "Umrechnung fuer Messgroesse cAdaPfusf::f_mt_krit_aktiv_pfad" TAB_VERB "%4.0" "" COMPU_TAB_REF Conv.cAdaPfusf._.f_mt_krit_aktiv_pfad_S6_S3 /end COMPU_METHOD
/begin COMPU_METHOD Conv.cAdaPfusf._.f_max_flare_erreicht_hs_pfad_S6_S3 "Umrechnung fuer Messgroesse cAdaPfusf::f_max_flare_erreicht_hs_pfad" TAB_VERB "%4.0" "" COMPU_TAB_REF Conv.cAdaPfusf._.f_max_flare_erreicht_hs_pfad_S6_S3 /end COMPU_METHOD
/begin COMPU_METHOD Conv.cAdaPfusf._.f_adapfn_status_S6_S3 "Umrechnung fuer Messgroesse cAdaPfusf::f_adapfn_status" TAB_VERB "%4.0" "" COMPU_TAB_REF Conv.cAdaPfusf._.f_adapfn_status_S6_S3 /end COMPU_METHOD
/begin COMPU_METHOD Conv.cAdaPfusf._.hsad_verbotqsx_S6_S3 "Umrechnung fuer Messgroesse cAdaPfusf::hsad_verbotqsx" TAB_VERB "%4.0" "" COMPU_TAB_REF Conv.cAdaPfusf._.hsad_verbotqsx_S6_S3 /end COMPU_METHOD
/begin COMPU_METHOD Conv.cAdaPfusf._.pm_gls_status_S6_S3 "Umrechnung fuer Messgroesse cAdaPfusf::pm_gls_status" TAB_VERB "%4.0" "" COMPU_TAB_REF Conv.cAdaPfusf._.pm_gls_status_S6_S3 /end COMPU_METHOD
/begin COMPU_METHOD Conv.cAdaPfusf._.ada_starttyp_pf_S6_S3 "Umrechnung fuer Messgroesse cAdaPfusf::ada_starttyp_pf" TAB_VERB "%4.0" "" COMPU_TAB_REF Conv.cAdaPfusf._.ada_starttyp_pf_S6_S3 /end COMPU_METHOD
/begin COMPU_METHOD Conv.cAdaPfusf._.freigabe_e_h_S6_S3 "Umrechnung fuer Messgroesse cAdaPfusf::freigabe_e_h" TAB_VERB "%4.0" "" COMPU_TAB_REF Conv.cAdaPfusf._.freigabe_e_h_S6_S3 /end COMPU_METHOD
/begin COMPU_METHOD Conv.cAdaPfusf._.z_pfad_cgt_adkl_kup_pfad_S6_S3 "Umrechnung fuer Messgroesse cAdaPfusf::z_pfad_cgt_adkl_kup_pfad" TAB_VERB "%4.0" "" COMPU_TAB_REF Conv.cAdaPfusf._.z_pfad_cgt_adkl_kup_pfad_S6_S3 /end COMPU_METHOD
/begin COMPU_METHOD Conv.cAdaPstbwFenster._.f_aktiv_stada_S6_S3 "Umrechnung fuer Messgroesse cAdaPstbwFenster::f_aktiv_stada" TAB_VERB "%4.0" "" COMPU_TAB_REF Conv.cAdaPstbwFenster._.f_aktiv_stada_S6_S3 /end COMPU_METHOD
/begin COMPU_METHOD Conv.cAdaPstbwFenster._.f_starten_stada_S6_S3 "Umrechnung fuer Messgroesse cAdaPstbwFenster::f_starten_stada" TAB_VERB "%4.0" "" COMPU_TAB_REF Conv.cAdaPstbwFenster._.f_starten_stada_S6_S3 /end COMPU_METHOD
/begin COMPU_METHOD Conv.cAdaPstbwFenster._.f_beenden_stada_S6_S3 "Umrechnung fuer Messgroesse cAdaPstbwFenster::f_beenden_stada" TAB_VERB "%4.0" "" COMPU_TAB_REF Conv.cAdaPstbwFenster._.f_beenden_stada_S6_S3 /end COMPU_METHOD
/begin COMPU_METHOD Conv.cAdaPstbw._.zustand_stada_S6_S3 "Umrechnung fuer Messgroesse cAdaPstbw::zustand_stada" TAB_VERB "%4.0" "" COMPU_TAB_REF Conv.cAdaPstbw._.zustand_stada_S6_S3 /end COMPU_METHOD
/begin COMPU_METHOD Conv.cAdaPstbw._.testresultat_stada_S6_S3 "Umrechnung fuer Messgroesse cAdaPstbw::testresultat_stada" TAB_VERB "%4.0" "" COMPU_TAB_REF Conv.cAdaPstbw._.testresultat_stada_S6_S3 /end COMPU_METHOD
/begin COMPU_METHOD Conv.cAdaPstbw._.neg_rea_stada_S6_S3 "Umrechnung fuer Messgroesse cAdaPstbw::neg_rea_stada" TAB_VERB "%4.0" "" COMPU_TAB_REF Conv.cAdaPstbw._.neg_rea_stada_S6_S3 /end COMPU_METHOD
/begin COMPU_METHOD Conv.cAdaPstbw._.pos_rea_stada_S6_S3 "Umrechnung fuer Messgroesse cAdaPstbw::pos_rea_stada" TAB_VERB "%4.0" "" COMPU_TAB_REF Conv.cAdaPstbw._.pos_rea_stada_S6_S3 /end COMPU_METHOD
/begin COMPU_METHOD Conv.cAdaPstbw._.rea_amplitude_stada_S6_S3 "Umrechnung fuer Messgroesse cAdaPstbw::rea_amplitude_stada" TAB_VERB "%4.0" "" COMPU_TAB_REF Conv.cAdaPstbw._.rea_amplitude_stada_S6_S3 /end COMPU_METHOD
/begin COMPU_METHOD Conv.cAdaPstpf._.zustand_stada_S6_S3 "Umrechnung fuer Messgroesse cAdaPstpf::zustand_stada" TAB_VERB "%4.0" "" COMPU_TAB_REF Conv.cAdaPstpf._.zustand_stada_S6_S3 /end COMPU_METHOD
/begin COMPU_METHOD Conv.cAdaPstpf._.fenster_nach_sf_stada_S6_S3 "Umrechnung fuer Messgroesse cAdaPstpf::fenster_nach_sf_stada" TAB_VERB "%4.0" "" COMPU_TAB_REF Conv.cAdaPstpf._.fenster_nach_sf_stada_S6_S3 /end COMPU_METHOD
/begin COMPU_METHOD Conv.cAdaPstpf._.fenster_sf_stada_S6_S3 "Umrechnung fuer Messgroesse cAdaPstpf::fenster_sf_stada" TAB_VERB "%4.0" "" COMPU_TAB_REF Conv.cAdaPstpf._.fenster_sf_stada_S6_S3 /end COMPU_METHOD
/begin COMPU_METHOD Conv.cAdaPstpf._.kup_puls_stada_S6_S3 "Umrechnung fuer Messgroesse cAdaPstpf::kup_puls_stada" TAB_VERB "%4.0" "" COMPU_TAB_REF Conv.cAdaPstpf._.kup_puls_stada_S6_S3 /end COMPU_METHOD
/begin COMPU_METHOD Conv.cAdaPstsf._.zustand_stada_S6_S3 "Umrechnung fuer Messgroesse cAdaPstsf::zustand_stada" TAB_VERB "%4.0" "" COMPU_TAB_REF Conv.cAdaPstsf._.zustand_stada_S6_S3 /end COMPU_METHOD
/begin COMPU_METHOD Conv.cAdaPstsf._.kup_puls_stada_S6_S3 "Umrechnung fuer Messgroesse cAdaPstsf::kup_puls_stada" TAB_VERB "%4.0" "" COMPU_TAB_REF Conv.cAdaPstsf._.kup_puls_stada_S6_S3 /end COMPU_METHOD
/begin COMPU_METHOD Conv.cAdaPstPrepuls._.zustand_stada_S6_S3 "Umrechnung fuer Messgroesse cAdaPstPrepuls::zustand_stada" TAB_VERB "%4.0" "" COMPU_TAB_REF Conv.cAdaPstPrepuls._.zustand_stada_S6_S3 /end COMPU_METHOD
/begin COMPU_METHOD Conv.cAdaPstPrepuls._.kup_puls_stada_S6_S3 "Umrechnung fuer Messgroesse cAdaPstPrepuls::kup_puls_stada" TAB_VERB "%4.0" "" COMPU_TAB_REF Conv.cAdaPstPrepuls._.kup_puls_stada_S6_S3 /end COMPU_METHOD
/begin COMPU_METHOD Conv.cAdaPstSysNmot._.akt_ada_S6_S3 "Umrechnung fuer Messgroesse cAdaPstSysNmot::akt_ada" TAB_VERB "%4.0" "" COMPU_TAB_REF Conv.cAdaPstSysNmot._.akt_ada_S6_S3 /end COMPU_METHOD
/begin COMPU_METHOD Conv.cAdaPstSysNmot._.z_systemkondit_nmot_S6_S3 "Umrechnung fuer Messgroesse cAdaPstSysNmot::z_systemkondit_nmot" TAB_VERB "%4.0" "" COMPU_TAB_REF Conv.cAdaPstSysNmot._.z_systemkondit_nmot_S6_S3 /end COMPU_METHOD
/begin COMPU_METHOD Conv.cAdaPstSysNmot._.f_nmotsoll_stada_em_S6_S3 "Umrechnung fuer Messgroesse cAdaPstSysNmot::f_nmotsoll_stada_em" TAB_VERB "%4.0" "" COMPU_TAB_REF Conv.cAdaPstSysNmot._.f_nmotsoll_stada_em_S6_S3 /end COMPU_METHOD
/begin COMPU_METHOD Conv.cAdaPstSysZzs._.akt_ada_S6_S3 "Umrechnung fuer Messgroesse cAdaPstSysZzs::akt_ada" TAB_VERB "%4.0" "" COMPU_TAB_REF Conv.cAdaPstSysZzs._.akt_ada_S6_S3 /end COMPU_METHOD
/begin COMPU_METHOD Conv.cAdaPstSysZzs._.z_systemkondit_zzs_S6_S3 "Umrechnung fuer Messgroesse cAdaPstSysZzs::z_systemkondit_zzs" TAB_VERB "%4.0" "" COMPU_TAB_REF Conv.cAdaPstSysZzs._.z_systemkondit_zzs_S6_S3 /end COMPU_METHOD
/begin COMPU_METHOD Conv.cAdaPstSysZzs._.gang_zzs_stada_S6_S3 "Umrechnung fuer Messgroesse cAdaPstSysZzs::gang_zzs_stada" TAB_VERB "%4.0" "" COMPU_TAB_REF Conv.cAdaPstSysZzs._.gang_zzs_stada_S6_S3 /end COMPU_METHOD
/begin COMPU_METHOD Conv.cAdaPstSysPsys._.akt_ada_S6_S3 "Umrechnung fuer Messgroesse cAdaPstSysPsys::akt_ada" TAB_VERB "%4.0" "" COMPU_TAB_REF Conv.cAdaPstSysPsys._.akt_ada_S6_S3 /end COMPU_METHOD
/begin COMPU_METHOD Conv.cAdaPstSysPsys._.z_systemkondit_psys_S6_S3 "Umrechnung fuer Messgroesse cAdaPstSysPsys::z_systemkondit_psys" TAB_VERB "%4.0" "" COMPU_TAB_REF Conv.cAdaPstSysPsys._.z_systemkondit_psys_S6_S3 /end COMPU_METHOD
/begin COMPU_METHOD Conv.cAdaPstSysPsys._.f_psys_anforderung_stada_S6_S3 "Umrechnung fuer Messgroesse cAdaPstSysPsys::f_psys_anforderung_stada" TAB_VERB "%4.0" "" COMPU_TAB_REF Conv.cAdaPstSysPsys._.f_psys_anforderung_stada_S6_S3 /end COMPU_METHOD
/begin COMPU_METHOD Conv.cAdaPstSysFunkdeakt._.akt_ada_S6_S3 "Umrechnung fuer Messgroesse cAdaPstSysFunkdeakt::akt_ada" TAB_VERB "%4.0" "" COMPU_TAB_REF Conv.cAdaPstSysFunkdeakt._.akt_ada_S6_S3 /end COMPU_METHOD
/begin COMPU_METHOD Conv.cAdaPstSysFunkdeakt._.z_systemkondit_funkdeakt_S6_S3 "Umrechnung fuer Messgroesse cAdaPstSysFunkdeakt::z_systemkondit_funkdeakt" TAB_VERB "%4.0" "" COMPU_TAB_REF Conv.cAdaPstSysFunkdeakt._.z_systemkondit_funkdeakt_S6_S3 /end COMPU_METHOD
/begin COMPU_METHOD Conv.cAdaPstSysAgl._.akt_ada_S6_S3 "Umrechnung fuer Messgroesse cAdaPstSysAgl::akt_ada" TAB_VERB "%4.0" "" COMPU_TAB_REF Conv.cAdaPstSysAgl._.akt_ada_S6_S3 /end COMPU_METHOD
/begin COMPU_METHOD Conv.cAdaPstSysAgl._.z_systemkondit_agl_S6_S3 "Umrechnung fuer Messgroesse cAdaPstSysAgl::z_systemkondit_agl" TAB_VERB "%4.0" "" COMPU_TAB_REF Conv.cAdaPstSysAgl._.z_systemkondit_agl_S6_S3 /end COMPU_METHOD
/begin COMPU_METHOD Conv.cAdaPstSysK0._.akt_ada_S6_S3 "Umrechnung fuer Messgroesse cAdaPstSysK0::akt_ada" TAB_VERB "%4.0" "" COMPU_TAB_REF Conv.cAdaPstSysK0._.akt_ada_S6_S3 /end COMPU_METHOD
/begin COMPU_METHOD Conv.cAdaPstSysKup._.akt_ada_S6_S3 "Umrechnung fuer Messgroesse cAdaPstSysKup::akt_ada" TAB_VERB "%4.0" "" COMPU_TAB_REF Conv.cAdaPstSysKup._.akt_ada_S6_S3 /end COMPU_METHOD
/begin COMPU_METHOD Conv.cAdaPstSysKup._.sal_eng_start_req_S6_S3 "Umrechnung fuer Messgroesse cAdaPstSysKup::sal_eng_start_req" TAB_VERB "%4.0" "" COMPU_TAB_REF Conv.cAdaPstSysKup._.sal_eng_start_req_S6_S3 /end COMPU_METHOD
/begin COMPU_METHOD Conv.cAdaPstSysKup._.sal_eng_stop_disable_S6_S3 "Umrechnung fuer Messgroesse cAdaPstSysKup::sal_eng_stop_disable" TAB_VERB "%4.0" "" COMPU_TAB_REF Conv.cAdaPstSysKup._.sal_eng_stop_disable_S6_S3 /end COMPU_METHOD
/begin COMPU_METHOD Conv.cAdaPstSysKup._.z_k0_stada_S6_S3 "Umrechnung fuer Messgroesse cAdaPstSysKup::z_k0_stada" TAB_VERB "%4.0" "" COMPU_TAB_REF Conv.cAdaPstSysKup._.z_k0_stada_S6_S3 /end COMPU_METHOD
/begin COMPU_METHOD Conv.cAdaPstzs._.zustand_stada_S6_S3 "Umrechnung fuer Messgroesse cAdaPstzs::zustand_stada" TAB_VERB "%4.0" "" COMPU_TAB_REF Conv.cAdaPstzs._.zustand_stada_S6_S3 /end COMPU_METHOD
/begin COMPU_METHOD Conv.cAdaPstzs._.testfall_prueftyp_stada_S6_S3 "Umrechnung fuer Messgroesse cAdaPstzs::testfall_prueftyp_stada" TAB_VERB "%4.0" "" COMPU_TAB_REF Conv.cAdaPstzs._.testfall_prueftyp_stada_S6_S3 /end COMPU_METHOD
/begin COMPU_METHOD Conv.cAdaPstzs._.pulsid_stada_S6_S3 "Umrechnung fuer Messgroesse cAdaPstzs::pulsid_stada" TAB_VERB "%4.0" "" COMPU_TAB_REF Conv.cAdaPstzs._.pulsid_stada_S6_S3 /end COMPU_METHOD
/begin COMPU_METHOD Conv.cAdaPstzs._.kup_puls_stada_S6_S3 "Umrechnung fuer Messgroesse cAdaPstzs::kup_puls_stada" TAB_VERB "%4.0" "" COMPU_TAB_REF Conv.cAdaPstzs._.kup_puls_stada_S6_S3 /end COMPU_METHOD
/begin COMPU_METHOD Conv.cAdaPstzs._.kup_pruefpuls_ausgabe_stada_S6_S3 "Umrechnung fuer Messgroesse cAdaPstzs::kup_pruefpuls_ausgabe_stada" TAB_VERB "%4.0" "" COMPU_TAB_REF Conv.cAdaPstzs._.kup_pruefpuls_ausgabe_stada_S6_S3 /end COMPU_METHOD
/begin COMPU_METHOD Conv.cAdaPstzs._.schnellfuellung_aktiv_stada_S6_S3 "Umrechnung fuer Messgroesse cAdaPstzs::schnellfuellung_aktiv_stada" TAB_VERB "%4.0" "" COMPU_TAB_REF Conv.cAdaPstzs._.schnellfuellung_aktiv_stada_S6_S3 /end COMPU_METHOD
/begin COMPU_METHOD Conv.cAdaPstzs._.druck_statisch_stada_S6_S3 "Umrechnung fuer Messgroesse cAdaPstzs::druck_statisch_stada" TAB_VERB "%4.0" "" COMPU_TAB_REF Conv.cAdaPstzs._.druck_statisch_stada_S6_S3 /end COMPU_METHOD
/begin COMPU_METHOD Conv.cAdaPstzs._.pulszyklus_beenden_stada_S6_S3 "Umrechnung fuer Messgroesse cAdaPstzs::pulszyklus_beenden_stada" TAB_VERB "%4.0" "" COMPU_TAB_REF Conv.cAdaPstzs._.pulszyklus_beenden_stada_S6_S3 /end COMPU_METHOD
/begin COMPU_METHOD Conv.cAdaPstzs._.f_red_bef_kup_S6_S3 "Umrechnung fuer Messgroesse cAdaPstzs::f_red_bef_kup" TAB_VERB "%4.0" "" COMPU_TAB_REF Conv.cAdaPstzs._.f_red_bef_kup_S6_S3 /end COMPU_METHOD
/begin COMPU_METHOD Conv.cAdaPstzs._.testfall_gang_stada_S6_S3 "Umrechnung fuer Messgroesse cAdaPstzs::testfall_gang_stada" TAB_VERB "%4.0" "" COMPU_TAB_REF Conv.cAdaPstzs._.testfall_gang_stada_S6_S3 /end COMPU_METHOD
/begin COMPU_METHOD Conv.cAdaPstzs._.pre_ada_zustand_stada_S6_S3 "Umrechnung fuer Messgroesse cAdaPstzs::pre_ada_zustand_stada" TAB_VERB "%4.0" "" COMPU_TAB_REF Conv.cAdaPstzs._.pre_ada_zustand_stada_S6_S3 /end COMPU_METHOD
/begin COMPU_METHOD Conv.cAdaPstzs._.akt_ada_S6_S3 "Umrechnung fuer Messgroesse cAdaPstzs::akt_ada" TAB_VERB "%4.0" "" COMPU_TAB_REF Conv.cAdaPstzs._.akt_ada_S6_S3 /end COMPU_METHOD
/begin COMPU_METHOD Conv.cAdaPstzs._.f_deaktivierung_erkannt_S6_S3 "Umrechnung fuer Messgroesse cAdaPstzs::f_deaktivierung_erkannt" TAB_VERB "%4.0" "" COMPU_TAB_REF Conv.cAdaPstzs._.f_deaktivierung_erkannt_S6_S3 /end COMPU_METHOD
/begin COMPU_METHOD Conv.cAdaPstzs._.anz_kup_puls_stada_S6_S3 "Umrechnung fuer Messgroesse cAdaPstzs::anz_kup_puls_stada" TAB_VERB "%4.0" "" COMPU_TAB_REF Conv.cAdaPstzs._.anz_kup_puls_stada_S6_S3 /end COMPU_METHOD
/begin COMPU_METHOD Conv.cAdaPstzs._.anz_prueftyp_stada_S6_S3 "Umrechnung fuer Messgroesse cAdaPstzs::anz_prueftyp_stada" TAB_VERB "%4.0" "" COMPU_TAB_REF Conv.cAdaPstzs._.anz_prueftyp_stada_S6_S3 /end COMPU_METHOD
/begin COMPU_METHOD Conv.cAdaPstzs._.anz_pulsid_stada_S6_S3 "Umrechnung fuer Messgroesse cAdaPstzs::anz_pulsid_stada" TAB_VERB "%4.0" "" COMPU_TAB_REF Conv.cAdaPstzs._.anz_pulsid_stada_S6_S3 /end COMPU_METHOD
/begin COMPU_METHOD Conv.cAdaPstzs._.anz_durchgefuehrt_stada_S6_S3 "Umrechnung fuer Messgroesse cAdaPstzs::anz_durchgefuehrt_stada" TAB_VERB "%4.0" "" COMPU_TAB_REF Conv.cAdaPstzs._.anz_durchgefuehrt_stada_S6_S3 /end COMPU_METHOD
/begin COMPU_METHOD Conv.cAdaPstzs._.fzg_stillstand_stada_S6_S3 "Umrechnung fuer Messgroesse cAdaPstzs::fzg_stillstand_stada" TAB_VERB "%4.0" "" COMPU_TAB_REF Conv.cAdaPstzs._.fzg_stillstand_stada_S6_S3 /end COMPU_METHOD
/begin COMPU_METHOD Conv.cAdaPstzs._.grundbedingung_erfuellt_zyklisch_stada_S6_S3 "Umrechnung fuer Messgroesse cAdaPstzs::grundbedingung_erfuellt_zyklisch_stada" TAB_VERB "%4.0" "" COMPU_TAB_REF Conv.cAdaPstzs._.grundbedingung_erfuellt_zyklisch_stada_S6_S3 /end COMPU_METHOD
/begin COMPU_METHOD Conv.cAdaPstzs._.grundbedingung_erfuellt_einmalig_stada_S6_S3 "Umrechnung fuer Messgroesse cAdaPstzs::grundbedingung_erfuellt_einmalig_stada" TAB_VERB "%4.0" "" COMPU_TAB_REF Conv.cAdaPstzs._.grundbedingung_erfuellt_einmalig_stada_S6_S3 /end COMPU_METHOD
/begin COMPU_METHOD Conv.cAdaPstzs._.fzg_stillstand_k0_stada_S6_S3 "Umrechnung fuer Messgroesse cAdaPstzs::fzg_stillstand_k0_stada" TAB_VERB "%4.0" "" COMPU_TAB_REF Conv.cAdaPstzs._.fzg_stillstand_k0_stada_S6_S3 /end COMPU_METHOD
/begin COMPU_METHOD Conv.cAdaPstzs._.grundbedingung_erfuellt_zyklisch_k0_stada_S6_S3 "Umrechnung fuer Messgroesse cAdaPstzs::grundbedingung_erfuellt_zyklisch_k0_stada" TAB_VERB "%4.0" "" COMPU_TAB_REF Conv.cAdaPstzs._.grundbedingung_erfuellt_zyklisch_k0_stada_S6_S3 /end COMPU_METHOD
/begin COMPU_METHOD Conv.cAdaPstzs._.grundbedingung_erfuellt_einmalig_k0_stada_S6_S3 "Umrechnung fuer Messgroesse cAdaPstzs::grundbedingung_erfuellt_einmalig_k0_stada" TAB_VERB "%4.0" "" COMPU_TAB_REF Conv.cAdaPstzs._.grundbedingung_erfuellt_einmalig_k0_stada_S6_S3 /end COMPU_METHOD
/begin COMPU_METHOD Conv.cAdaPstCondition._.preadaption_condition_stada_int_S6_S3 "Umrechnung fuer Messgroesse cAdaPstCondition::preadaption_condition_stada_int" TAB_VERB "%4.0" "" COMPU_TAB_REF Conv.cAdaPstCondition._.preadaption_condition_stada_int_S6_S3 /end COMPU_METHOD
/begin COMPU_METHOD Conv.cAdaPstCondition._.preadaption_condition_stada_S6_S3 "Umrechnung fuer Messgroesse cAdaPstCondition::preadaption_condition_stada" TAB_VERB "%4.0" "" COMPU_TAB_REF Conv.cAdaPstCondition._.preadaption_condition_stada_S6_S3 /end COMPU_METHOD
/begin COMPU_METHOD Conv.cAdaPstState._.preadaption_state_stada_S6_S3 "Umrechnung fuer Messgroesse cAdaPstState::preadaption_state_stada" TAB_VERB "%4.0" "" COMPU_TAB_REF Conv.cAdaPstState._.preadaption_state_stada_S6_S3 /end COMPU_METHOD
/begin COMPU_METHOD Conv.cAdaPstUserinfo._.preadaption_userinfo_stada_S6_S3 "Umrechnung fuer Messgroesse cAdaPstUserinfo::preadaption_userinfo_stada" TAB_VERB "%4.0" "" COMPU_TAB_REF Conv.cAdaPstUserinfo._.preadaption_userinfo_stada_S6_S3 /end COMPU_METHOD
/begin COMPU_METHOD Conv.cAdaUrlufterkSchaltungSignal._.f_signal_ungueltig_S6_S3 "Umrechnung fuer Messgroesse cAdaUrlufterkSchaltungSignal::f_signal_ungueltig" TAB_VERB "%4.0" "" COMPU_TAB_REF Conv.cAdaUrlufterkSchaltungSignal._.f_signal_ungueltig_S6_S3 /end COMPU_METHOD
/begin COMPU_METHOD Conv.cAdaUrlufterkSchaltungSignal._.signal_quelle_S6_S3 "Umrechnung fuer Messgroesse cAdaUrlufterkSchaltungSignal::signal_quelle" TAB_VERB "%4.0" "" COMPU_TAB_REF Conv.cAdaUrlufterkSchaltungSignal._.signal_quelle_S6_S3 /end COMPU_METHOD
/begin COMPU_METHOD Conv.cAdaUrlufterkSchaltungSignal._.signal_quelle_alt_S6_S3 "Umrechnung fuer Messgroesse cAdaUrlufterkSchaltungSignal::signal_quelle_alt" TAB_VERB "%4.0" "" COMPU_TAB_REF Conv.cAdaUrlufterkSchaltungSignal._.signal_quelle_alt_S6_S3 /end COMPU_METHOD
/begin COMPU_METHOD Conv.cAdaUrlufterkSchaltungSignal._.f_pt1_inti_S6_S3 "Umrechnung fuer Messgroesse cAdaUrlufterkSchaltungSignal::f_pt1_inti" TAB_VERB "%4.0" "" COMPU_TAB_REF Conv.cAdaUrlufterkSchaltungSignal._.f_pt1_inti_S6_S3 /end COMPU_METHOD
/begin COMPU_METHOD Conv.cAdaUrlufterkSchaltungSignal._.f_grad_inti_S6_S3 "Umrechnung fuer Messgroesse cAdaUrlufterkSchaltungSignal::f_grad_inti" TAB_VERB "%4.0" "" COMPU_TAB_REF Conv.cAdaUrlufterkSchaltungSignal._.f_grad_inti_S6_S3 /end COMPU_METHOD
/begin COMPU_METHOD Conv.cAdaUrlufterkSchaltungAnz._.kup_schaltung_url_S6_S3 "Umrechnung fuer Messgroesse cAdaUrlufterkSchaltungAnz::kup_schaltung_url" TAB_VERB "%4.0" "" COMPU_TAB_REF Conv.cAdaUrlufterkSchaltungAnz._.kup_schaltung_url_S6_S3 /end COMPU_METHOD
/begin COMPU_METHOD Conv.cAdaUrlufterkSchaltungAnz._.f_loeschen_schalung_url_S6_S3 "Umrechnung fuer Messgroesse cAdaUrlufterkSchaltungAnz::f_loeschen_schalung_url" TAB_VERB "%4.0" "" COMPU_TAB_REF Conv.cAdaUrlufterkSchaltungAnz._.f_loeschen_schalung_url_S6_S3 /end COMPU_METHOD
/begin COMPU_METHOD Conv.cAdaUrlufterkSchaltung._.zustand_S6_S3 "Umrechnung fuer Messgroesse cAdaUrlufterkSchaltung::zustand" TAB_VERB "%4.0" "" COMPU_TAB_REF Conv.cAdaUrlufterkSchaltung._.zustand_S6_S3 /end COMPU_METHOD
/begin COMPU_METHOD Conv.cAdaUrlufterkSchaltung._.kup_S6_S3 "Umrechnung fuer Messgroesse cAdaUrlufterkSchaltung::kup" TAB_VERB "%4.0" "" COMPU_TAB_REF Conv.cAdaUrlufterkSchaltung._.kup_S6_S3 /end COMPU_METHOD
/begin COMPU_METHOD Conv.cAdaUrlufterkPulsAnz._.kup_puls_url_S6_S3 "Umrechnung fuer Messgroesse cAdaUrlufterkPulsAnz::kup_puls_url" TAB_VERB "%4.0" "" COMPU_TAB_REF Conv.cAdaUrlufterkPulsAnz._.kup_puls_url_S6_S3 /end COMPU_METHOD
/begin COMPU_METHOD Conv.cAdaUrlufterkPulsAnz._.f_loeschen_puls_url_S6_S3 "Umrechnung fuer Messgroesse cAdaUrlufterkPulsAnz::f_loeschen_puls_url" TAB_VERB "%4.0" "" COMPU_TAB_REF Conv.cAdaUrlufterkPulsAnz._.f_loeschen_puls_url_S6_S3 /end COMPU_METHOD
/begin COMPU_METHOD Conv.cAdaUrlufterkPuls._.zustand_S6_S3 "Umrechnung fuer Messgroesse cAdaUrlufterkPuls::zustand" TAB_VERB "%4.0" "" COMPU_TAB_REF Conv.cAdaUrlufterkPuls._.zustand_S6_S3 /end COMPU_METHOD
/begin COMPU_METHOD Conv.cAdaUrlufterkPuls._.kup_S6_S3 "Umrechnung fuer Messgroesse cAdaUrlufterkPuls::kup" TAB_VERB "%4.0" "" COMPU_TAB_REF Conv.cAdaUrlufterkPuls._.kup_S6_S3 /end COMPU_METHOD
/begin COMPU_METHOD Conv.cAdaUrlufterkPuls._.kfl_ist_start_S6_S3 "Umrechnung fuer Messgroesse cAdaUrlufterkPuls::kfl_ist_start" TAB_VERB "%4.0" "" COMPU_TAB_REF Conv.cAdaUrlufterkPuls._.kfl_ist_start_S6_S3 /end COMPU_METHOD
/begin COMPU_METHOD Conv.cAdaUrlufterkPuls._.istgang_start_S6_S3 "Umrechnung fuer Messgroesse cAdaUrlufterkPuls::istgang_start" TAB_VERB "%4.0" "" COMPU_TAB_REF Conv.cAdaUrlufterkPuls._.istgang_start_S6_S3 /end COMPU_METHOD
/begin COMPU_METHOD Conv.cAdaUrlufterkPuls._.prueftyp_S6_S3 "Umrechnung fuer Messgroesse cAdaUrlufterkPuls::prueftyp" TAB_VERB "%4.0" "" COMPU_TAB_REF Conv.cAdaUrlufterkPuls._.prueftyp_S6_S3 /end COMPU_METHOD
/begin COMPU_METHOD Conv.cAdaGlast._.gls_flag_abbruch_wg_adapfn_S6_S3 "Umrechnung fuer Messgroesse cAdaGlast::gls_flag_abbruch_wg_adapfn" TAB_VERB "%4.0" "" COMPU_TAB_REF Conv.cAdaGlast._.gls_flag_abbruch_wg_adapfn_S6_S3 /end COMPU_METHOD
/begin COMPU_METHOD Conv.cAdaGlast._.adaps_status_S6_S3 "Umrechnung fuer Messgroesse cAdaGlast::adaps_status" TAB_VERB "%4.0" "" COMPU_TAB_REF Conv.cAdaGlast._.adaps_status_S6_S3 /end COMPU_METHOD
/begin COMPU_METHOD Conv.cAdaGlast._.bew_kup_S6_S3 "Umrechnung fuer Messgroesse cAdaGlast::bew_kup" TAB_VERB "%4.0" "" COMPU_TAB_REF Conv.cAdaGlast._.bew_kup_S6_S3 /end COMPU_METHOD
/begin COMPU_METHOD Conv.cAdaGlast._.bew_kennfeld_S6_S3 "Umrechnung fuer Messgroesse cAdaGlast::bew_kennfeld" TAB_VERB "%4.0" "" COMPU_TAB_REF Conv.cAdaGlast._.bew_kennfeld_S6_S3 /end COMPU_METHOD
/begin COMPU_METHOD Conv.cAdaGlast._.bew_kennfeld_lesen_S6_S3 "Umrechnung fuer Messgroesse cAdaGlast::bew_kennfeld_lesen" TAB_VERB "%4.0" "" COMPU_TAB_REF Conv.cAdaGlast._.bew_kennfeld_lesen_S6_S3 /end COMPU_METHOD
/begin COMPU_METHOD Conv.cAdaGlast._.warm_kalt_kennfeld_lesen_S6_S3 "Umrechnung fuer Messgroesse cAdaGlast::warm_kalt_kennfeld_lesen" TAB_VERB "%4.0" "" COMPU_TAB_REF Conv.cAdaGlast._.warm_kalt_kennfeld_lesen_S6_S3 /end COMPU_METHOD
/begin COMPU_METHOD Conv.cAdaGlast._.warm_kalt_kennfeld_schreiben_S6_S3 "Umrechnung fuer Messgroesse cAdaGlast::warm_kalt_kennfeld_schreiben" TAB_VERB "%4.0" "" COMPU_TAB_REF Conv.cAdaGlast._.warm_kalt_kennfeld_schreiben_S6_S3 /end COMPU_METHOD
/begin COMPU_METHOD Conv.cAdaGlast._.bew_schalttyp_S6_S3 "Umrechnung fuer Messgroesse cAdaGlast::bew_schalttyp" TAB_VERB "%4.0" "" COMPU_TAB_REF Conv.cAdaGlast._.bew_schalttyp_S6_S3 /end COMPU_METHOD
/begin COMPU_METHOD Conv.cAdaGlast._.bew_index_S6_S3 "Umrechnung fuer Messgroesse cAdaGlast::bew_index" TAB_VERB "%4.0" "" COMPU_TAB_REF Conv.cAdaGlast._.bew_index_S6_S3 /end COMPU_METHOD
/begin COMPU_METHOD Conv.cAdaGlast._.bew_schalttyp_lesen_S6_S3 "Umrechnung fuer Messgroesse cAdaGlast::bew_schalttyp_lesen" TAB_VERB "%4.0" "" COMPU_TAB_REF Conv.cAdaGlast._.bew_schalttyp_lesen_S6_S3 /end COMPU_METHOD
/begin COMPU_METHOD Conv.cAdaGlast._.status_ausgabe_verzoegern_S6_S3 "Umrechnung fuer Messgroesse cAdaGlast::status_ausgabe_verzoegern" TAB_VERB "%4.0" "" COMPU_TAB_REF Conv.cAdaGlast._.status_ausgabe_verzoegern_S6_S3 /end COMPU_METHOD
/begin COMPU_METHOD Conv.cAdaGlast._.gls_trimm_verbot_versch_rs_S6_S3 "Umrechnung fuer Messgroesse cAdaGlast::gls_trimm_verbot_versch_rs" TAB_VERB "%4.0" "" COMPU_TAB_REF Conv.cAdaGlast._.gls_trimm_verbot_versch_rs_S6_S3 /end COMPU_METHOD
/begin COMPU_METHOD Conv.cAdaGlast._.gls_trimm_spont_beeinflussung_S6_S3 "Umrechnung fuer Messgroesse cAdaGlast::gls_trimm_spont_beeinflussung" TAB_VERB "%4.0" "" COMPU_TAB_REF Conv.cAdaGlast._.gls_trimm_spont_beeinflussung_S6_S3 /end COMPU_METHOD
/begin COMPU_METHOD Conv.cAdaGlast._.f_gls_trimm_kup_schwelle_S6_S3 "Umrechnung fuer Messgroesse cAdaGlast::f_gls_trimm_kup_schwelle" TAB_VERB "%4.0" "" COMPU_TAB_REF Conv.cAdaGlast._.f_gls_trimm_kup_schwelle_S6_S3 /end COMPU_METHOD
/begin COMPU_METHOD Conv.cAdaGlast._.f_gls_trimm_gls_schwelle_kf1_S6_S3 "Umrechnung fuer Messgroesse cAdaGlast::f_gls_trimm_gls_schwelle_kf1" TAB_VERB "%4.0" "" COMPU_TAB_REF Conv.cAdaGlast._.f_gls_trimm_gls_schwelle_kf1_S6_S3 /end COMPU_METHOD
/begin COMPU_METHOD Conv.cAdaGlast._.f_gls_trimm_gls_schwelle_kf2_S6_S3 "Umrechnung fuer Messgroesse cAdaGlast::f_gls_trimm_gls_schwelle_kf2" TAB_VERB "%4.0" "" COMPU_TAB_REF Conv.cAdaGlast._.f_gls_trimm_gls_schwelle_kf2_S6_S3 /end COMPU_METHOD
/begin COMPU_METHOD Conv.cAdaGlast._.gls_ada_state_S6_S3 "Umrechnung fuer Messgroesse cAdaGlast::gls_ada_state" TAB_VERB "%4.0" "" COMPU_TAB_REF Conv.cAdaGlast._.gls_ada_state_S6_S3 /end COMPU_METHOD
/begin COMPU_METHOD Conv.cAdaGlast._.bew_erl_schaltinfo_S6_S3 "Umrechnung fuer Messgroesse cAdaGlast::bew_erl_schaltinfo" TAB_VERB "%4.0" "" COMPU_TAB_REF Conv.cAdaGlast._.bew_erl_schaltinfo_S6_S3 /end COMPU_METHOD
/begin COMPU_METHOD Conv.cAdaGlosc._.f_aenderung_adaram_daten_S6_S3 "Umrechnung fuer Messgroesse cAdaGlosc::f_aenderung_adaram_daten" TAB_VERB "%4.0" "" COMPU_TAB_REF Conv.cAdaGlosc._.f_aenderung_adaram_daten_S6_S3 /end COMPU_METHOD
/begin COMPU_METHOD Conv.cAdaGlosc._.ada_synchron_S6_S3 "Umrechnung fuer Messgroesse cAdaGlosc::ada_synchron" TAB_VERB "%4.0" "" COMPU_TAB_REF Conv.cAdaGlosc._.ada_synchron_S6_S3 /end COMPU_METHOD
/begin COMPU_METHOD Conv.cAdaGlosc._.ada_schaltung_kzu_S6_S3 "Umrechnung fuer Messgroesse cAdaGlosc::ada_schaltung_kzu" TAB_VERB "%4.0" "" COMPU_TAB_REF Conv.cAdaGlosc._.ada_schaltung_kzu_S6_S3 /end COMPU_METHOD
/begin COMPU_METHOD Conv.cAdaGlosc._.init_mit_azg_S6_S3 "Umrechnung fuer Messgroesse cAdaGlosc::init_mit_azg" TAB_VERB "%4.0" "" COMPU_TAB_REF Conv.cAdaGlosc._.init_mit_azg_S6_S3 /end COMPU_METHOD
/begin COMPU_METHOD Conv.cAdaGlosc._.ada_zielgang_S6_S3 "Umrechnung fuer Messgroesse cAdaGlosc::ada_zielgang" TAB_VERB "%4.0" "" COMPU_TAB_REF Conv.cAdaGlosc._.ada_zielgang_S6_S3 /end COMPU_METHOD
/begin COMPU_METHOD Conv.cAdaGlosc._.ada_istgang_S6_S3 "Umrechnung fuer Messgroesse cAdaGlosc::ada_istgang" TAB_VERB "%4.0" "" COMPU_TAB_REF Conv.cAdaGlosc._.ada_istgang_S6_S3 /end COMPU_METHOD
/begin COMPU_METHOD Conv.cAdaGlosc._.ada_version_S6_S3 "Umrechnung fuer Messgroesse cAdaGlosc::ada_version" TAB_VERB "%4.0" "" COMPU_TAB_REF Conv.cAdaGlosc._.ada_version_S6_S3 /end COMPU_METHOD
/begin COMPU_METHOD Conv.cAdaGlosc._.ada_k_zu_S6_S3 "Umrechnung fuer Messgroesse cAdaGlosc::ada_k_zu" TAB_VERB "%4.0" "" COMPU_TAB_REF Conv.cAdaGlosc._.ada_k_zu_S6_S3 /end COMPU_METHOD
/begin COMPU_METHOD Conv.cAdaGlosc._.ada_schaltart_S6_S3 "Umrechnung fuer Messgroesse cAdaGlosc::ada_schaltart" TAB_VERB "%4.0" "" COMPU_TAB_REF Conv.cAdaGlosc._.ada_schaltart_S6_S3 /end COMPU_METHOD
/begin COMPU_METHOD Conv.cAdaGlosc._.ada_schaltinfo_S6_S3 "Umrechnung fuer Messgroesse cAdaGlosc::ada_schaltinfo" TAB_VERB "%4.0" "" COMPU_TAB_REF Conv.cAdaGlosc._.ada_schaltinfo_S6_S3 /end COMPU_METHOD
/begin COMPU_METHOD Conv.cAdaGlosc._.ada_iae_info_S6_S3 "Umrechnung fuer Messgroesse cAdaGlosc::ada_iae_info" TAB_VERB "%4.0" "" COMPU_TAB_REF Conv.cAdaGlosc._.ada_iae_info_S6_S3 /end COMPU_METHOD
/begin COMPU_METHOD Conv.cAdaGlosc._.z_ada_schaltung_S6_S3 "Umrechnung fuer Messgroesse cAdaGlosc::z_ada_schaltung" TAB_VERB "%4.0" "" COMPU_TAB_REF Conv.cAdaGlosc._.z_ada_schaltung_S6_S3 /end COMPU_METHOD
/begin COMPU_METHOD Conv.cAdaGlosc._.ada_schaltungs_index_S6_S3 "Umrechnung fuer Messgroesse cAdaGlosc::ada_schaltungs_index" TAB_VERB "%4.0" "" COMPU_TAB_REF Conv.cAdaGlosc._.ada_schaltungs_index_S6_S3 /end COMPU_METHOD
/begin COMPU_METHOD Conv.cAdaGlosc._.f_ada_bew_verboten_S6_S3 "Umrechnung fuer Messgroesse cAdaGlosc::f_ada_bew_verboten" TAB_VERB "%4.0" "" COMPU_TAB_REF Conv.cAdaGlosc._.f_ada_bew_verboten_S6_S3 /end COMPU_METHOD
/begin COMPU_METHOD Conv.cAdaGlosc._.f_letzte_schaltung_rs_S6_S3 "Umrechnung fuer Messgroesse cAdaGlosc::f_letzte_schaltung_rs" TAB_VERB "%4.0" "" COMPU_TAB_REF Conv.cAdaGlosc._.f_letzte_schaltung_rs_S6_S3 /end COMPU_METHOD
/begin COMPU_METHOD Conv.cAdaGlosc._.flag_alaengs_adaoff_S6_S3 "Umrechnung fuer Messgroesse cAdaGlosc::flag_alaengs_adaoff" TAB_VERB "%4.0" "" COMPU_TAB_REF Conv.cAdaGlosc._.flag_alaengs_adaoff_S6_S3 /end COMPU_METHOD
/begin COMPU_METHOD Conv.cAdaGlosc._.bew_verbot_laengs_beschl_S6_S3 "Umrechnung fuer Messgroesse cAdaGlosc::bew_verbot_laengs_beschl" TAB_VERB "%4.0" "" COMPU_TAB_REF Conv.cAdaGlosc._.bew_verbot_laengs_beschl_S6_S3 /end COMPU_METHOD
/begin COMPU_METHOD Conv.cAdaGlosc._.flag_allada_del_S6_S3 "Umrechnung fuer Messgroesse cAdaGlosc::flag_allada_del" TAB_VERB "%4.0" "" COMPU_TAB_REF Conv.cAdaGlosc._.flag_allada_del_S6_S3 /end COMPU_METHOD
/begin COMPU_METHOD Conv.cAdaIaeApKorr._.z_apada_korr_S6_S3 "Umrechnung fuer Messgroesse cAdaIaeApKorr::z_apada_korr" TAB_VERB "%4.0" "" COMPU_TAB_REF Conv.cAdaIaeApKorr._.z_apada_korr_S6_S3 /end COMPU_METHOD
/begin COMPU_METHOD Conv.cAdaIaeApKorr._.abbruch_bit_ada_iae_S6_S3 "Umrechnung fuer Messgroesse cAdaIaeApKorr::abbruch_bit_ada_iae" TAB_VERB "%4.0" "" COMPU_TAB_REF Conv.cAdaIaeApKorr._.abbruch_bit_ada_iae_S6_S3 /end COMPU_METHOD
/begin COMPU_METHOD Conv.cAdaIaeApKorr._.apada_iae_aktive_adaption_S6_S3 "Umrechnung fuer Messgroesse cAdaIaeApKorr::apada_iae_aktive_adaption" TAB_VERB "%4.0" "" COMPU_TAB_REF Conv.cAdaIaeApKorr._.apada_iae_aktive_adaption_S6_S3 /end COMPU_METHOD
/begin COMPU_METHOD Conv.cAdaIaeApKorr._.req_n_mot_llsoll_iae_S6_S3 "Umrechnung fuer Messgroesse cAdaIaeApKorr::req_n_mot_llsoll_iae" TAB_VERB "%4.0" "" COMPU_TAB_REF Conv.cAdaIaeApKorr._.req_n_mot_llsoll_iae_S6_S3 /end COMPU_METHOD
/begin COMPU_METHOD Conv.cAdaIaeApIae._.z_apada_iae_S6_S3 "Umrechnung fuer Messgroesse cAdaIaeApIae::z_apada_iae" TAB_VERB "%4.0" "" COMPU_TAB_REF Conv.cAdaIaeApIae._.z_apada_iae_S6_S3 /end COMPU_METHOD
/begin COMPU_METHOD Conv.cAdaIaeApIae._.f_req_ada_iae_S6_S3 "Umrechnung fuer Messgroesse cAdaIaeApIae::f_req_ada_iae" TAB_VERB "%4.0" "" COMPU_TAB_REF Conv.cAdaIaeApIae._.f_req_ada_iae_S6_S3 /end COMPU_METHOD
/begin COMPU_METHOD Conv.cAdaIaeApIae._.f_angelegt_mmot_iae_S6_S3 "Umrechnung fuer Messgroesse cAdaIaeApIae::f_angelegt_mmot_iae" TAB_VERB "%4.0" "" COMPU_TAB_REF Conv.cAdaIaeApIae._.f_angelegt_mmot_iae_S6_S3 /end COMPU_METHOD
/begin COMPU_METHOD Conv.cAdaIaeApIae._.f_rampinit_iae_S6_S3 "Umrechnung fuer Messgroesse cAdaIaeApIae::f_rampinit_iae" TAB_VERB "%4.0" "" COMPU_TAB_REF Conv.cAdaIaeApIae._.f_rampinit_iae_S6_S3 /end COMPU_METHOD
/begin COMPU_METHOD Conv.cAdaIaeApIae._.f_bew_verboten_iae_S6_S3 "Umrechnung fuer Messgroesse cAdaIaeApIae::f_bew_verboten_iae" TAB_VERB "%4.0" "" COMPU_TAB_REF Conv.cAdaIaeApIae._.f_bew_verboten_iae_S6_S3 /end COMPU_METHOD
/begin COMPU_METHOD Conv.cAdaIaeApIae._.f_abbruch_global_iae_S6_S3 "Umrechnung fuer Messgroesse cAdaIaeApIae::f_abbruch_global_iae" TAB_VERB "%4.0" "" COMPU_TAB_REF Conv.cAdaIaeApIae._.f_abbruch_global_iae_S6_S3 /end COMPU_METHOD
/begin COMPU_METHOD Conv.cAdaIaeApIae._.req_n_mot_llsoll_iae_S6_S3 "Umrechnung fuer Messgroesse cAdaIaeApIae::req_n_mot_llsoll_iae" TAB_VERB "%4.0" "" COMPU_TAB_REF Conv.cAdaIaeApIae._.req_n_mot_llsoll_iae_S6_S3 /end COMPU_METHOD
/begin COMPU_METHOD Conv.cAdaIaeApIae._.ada_starttyp_pf_S6_S3 "Umrechnung fuer Messgroesse cAdaIaeApIae::ada_starttyp_pf" TAB_VERB "%4.0" "" COMPU_TAB_REF Conv.cAdaIaeApIae._.ada_starttyp_pf_S6_S3 /end COMPU_METHOD
/begin COMPU_METHOD Conv.cAdaIaeApIep._.z_apada_iep_S6_S3 "Umrechnung fuer Messgroesse cAdaIaeApIep::z_apada_iep" TAB_VERB "%4.0" "" COMPU_TAB_REF Conv.cAdaIaeApIep._.z_apada_iep_S6_S3 /end COMPU_METHOD
/begin COMPU_METHOD Conv.cAdaIaeApIep._.f_req_ada_iep_iae_S6_S3 "Umrechnung fuer Messgroesse cAdaIaeApIep::f_req_ada_iep_iae" TAB_VERB "%4.0" "" COMPU_TAB_REF Conv.cAdaIaeApIep._.f_req_ada_iep_iae_S6_S3 /end COMPU_METHOD
/begin COMPU_METHOD Conv.cAdaIaeApIep._.f_abbruch_global_iae_S6_S3 "Umrechnung fuer Messgroesse cAdaIaeApIep::f_abbruch_global_iae" TAB_VERB "%4.0" "" COMPU_TAB_REF Conv.cAdaIaeApIep._.f_abbruch_global_iae_S6_S3 /end COMPU_METHOD
/begin COMPU_METHOD Conv.cAdaIaeApIep._.adkl_iep_S6_S3 "Umrechnung fuer Messgroesse cAdaIaeApIep::adkl_iep" TAB_VERB "%4.0" "" COMPU_TAB_REF Conv.cAdaIaeApIep._.adkl_iep_S6_S3 /end COMPU_METHOD
/begin COMPU_METHOD Conv.cAdaIaeApIep._.req_n_mot_llsoll_iae_S6_S3 "Umrechnung fuer Messgroesse cAdaIaeApIep::req_n_mot_llsoll_iae" TAB_VERB "%4.0" "" COMPU_TAB_REF Conv.cAdaIaeApIep._.req_n_mot_llsoll_iae_S6_S3 /end COMPU_METHOD
/begin COMPU_METHOD Conv.cAdaIaeuf._.f_read_kf_gueltig_S6_S3 "Umrechnung fuer Messgroesse cAdaIaeuf::f_read_kf_gueltig" TAB_VERB "%4.0" "" COMPU_TAB_REF Conv.cAdaIaeuf._.f_read_kf_gueltig_S6_S3 /end COMPU_METHOD
/begin COMPU_METHOD Conv.cAdaIaeuf._.f_ada_sperren_werteuebername_S6_S3 "Umrechnung fuer Messgroesse cAdaIaeuf::f_ada_sperren_werteuebername" TAB_VERB "%4.0" "" COMPU_TAB_REF Conv.cAdaIaeuf._.f_ada_sperren_werteuebername_S6_S3 /end COMPU_METHOD
/begin COMPU_METHOD Conv.cNvrKoordinator._.ee_management_status_S6_S3 "Umrechnung fuer Messgroesse cNvrKoordinator::ee_management_status" TAB_VERB "%4.0" "" COMPU_TAB_REF Conv.cNvrKoordinator._.ee_management_status_S6_S3 /end COMPU_METHOD
/begin COMPU_METHOD Conv.cNvrKoordinator._.ee_anzeige_block_history_S6_S3 "Umrechnung fuer Messgroesse cNvrKoordinator::ee_anzeige_block_history" TAB_VERB "%4.0" "" COMPU_TAB_REF Conv.cNvrKoordinator._.ee_anzeige_block_history_S6_S3 /end COMPU_METHOD
/begin COMPU_METHOD Conv.cNvrKoordinator._.ee_systemstart_ueber_reset_S6_S3 "Umrechnung fuer Messgroesse cNvrKoordinator::ee_systemstart_ueber_reset" TAB_VERB "%4.0" "" COMPU_TAB_REF Conv.cNvrKoordinator._.ee_systemstart_ueber_reset_S6_S3 /end COMPU_METHOD
/begin COMPU_VTAB Conv.cAdaPfusf._.z_adapfn_status_S6_S3 "Umrechnung fuer Messgroesse cAdaPfusf::z_adapfn_status" TAB_VERB 15 0 "PFAD_PASSIV" 1 "PFAD_START" 2 "PFAD_WARTEN_ENDE_SCHNELL_FUELLUNG" 3 "PFAD_WARTEN_ENDE_VERZOEGERUNGS_ZEIT_HS" 4 "PFAD_BEOBACHTEN_DREHZAHL_EINZUG_HS" 5 "PFAD_BEOBACHTEN_VERLASSEN_SYNCHRON_RS" 6 "PFAD_WARTEN_SE" 8 "PFAD_BEWERTUNG_DURCHGEFUEHRT" 9 "PFAD_BEWERTUNG_VERBOTEN" 10 "PFAD_ABBRUCH_DURCH_SAS" 11 "PFAD_ABBRUCH" 12 "PFAD_ABBRUCH_DURCH_SE" 13 "PFAD_ZUSTANDSFEHLER" 14 "PFAD_WARTEN_SYNCHRON_NEUER_GANG_RS" 15 "PFAD_SCHALTUNGS_ABBRUCH" /end COMPU_VTAB
/begin COMPU_VTAB Conv.cAdaPfusf._.adapfn_status_S6_S3 "Umrechnung fuer Messgroesse cAdaPfusf::adapfn_status" TAB_VERB 15 0 "PFAD_PASSIV" 1 "PFAD_START" 2 "PFAD_WARTEN_ENDE_SCHNELL_FUELLUNG" 3 "PFAD_WARTEN_ENDE_VERZOEGERUNGS_ZEIT_HS" 4 "PFAD_BEOBACHTEN_DREHZAHL_EINZUG_HS" 5 "PFAD_BEOBACHTEN_VERLASSEN_SYNCHRON_RS" 6 "PFAD_WARTEN_SE" 8 "PFAD_BEWERTUNG_DURCHGEFUEHRT" 9 "PFAD_BEWERTUNG_VERBOTEN" 10 "PFAD_ABBRUCH_DURCH_SAS" 11 "PFAD_ABBRUCH" 12 "PFAD_ABBRUCH_DURCH_SE" 13 "PFAD_ZUSTANDSFEHLER" 14 "PFAD_WARTEN_SYNCHRON_NEUER_GANG_RS" 15 "PFAD_SCHALTUNGS_ABBRUCH" /end COMPU_VTAB
/begin COMPU_VTAB Conv.cAdaPfusf._.adkl_pfad_S6_S3 "Umrechnung fuer Messgroesse cAdaPfusf::adkl_pfad" TAB_VERB 6 0 "KEINE" 1 "K_A" 2 "K_B" 3 "K_C" 4 "K_D" 5 "K_E" /end COMPU_VTAB
/begin COMPU_VTAB Conv.cAdaPfusf._.schaltart_pfad_S6_S3 "Umrechnung fuer Messgroesse cAdaPfusf::schaltart_pfad" TAB_VERB 3 0 "KS" 1 "HS" 2 "RS" /end COMPU_VTAB
/begin COMPU_VTAB Conv.cAdaPfusf._.schaltcode_pfad_S6_S3 "Umrechnung fuer Messgroesse cAdaPfusf::schaltcode_pfad" TAB_VERB 17 0 "keine adaptionsrelevante Schaltung" 1 "Schalt-Code 12" 2 "Schalt-Code 23" 3 "Schalt-Code 34" 4 "Schalt-Code 45" 5 "Schalt-Code 56" 6 "Schalt-Code 67" 7 "Schalt-Code 78" 8 "Schalt-Code 89" 10 "Schalt-Code 21" 11 "Schalt-Code 32" 12 "Schalt-Code 43" 13 "Schalt-Code 54" 14 "Schalt-Code 65" 15 "Schalt-Code 76" 16 "Schalt-Code 87" 17 "Schalt-Code 98" /end COMPU_VTAB
/begin COMPU_VTAB Conv.cAdaPfusf._.f_mt_krit_aktiv_pfad_S6_S3 "Umrechnung fuer Messgroesse cAdaPfusf::f_mt_krit_aktiv_pfad" TAB_VERB 2 0 "nein" 1 "ja" /end COMPU_VTAB
/begin COMPU_VTAB Conv.cAdaPfusf._.f_max_flare_erreicht_hs_pfad_S6_S3 "Umrechnung fuer Messgroesse cAdaPfusf::f_max_flare_erreicht_hs_pfad" TAB_VERB 2 0 "nein" 1 "Flare erreicht" /end COMPU_VTAB
/begin COMPU_VTAB Conv.cAdaPfusf._.f_adapfn_status_S6_S3 "Umrechnung fuer Messgroesse cAdaPfusf::f_adapfn_status" TAB_VERB 2 0 "FALSE" 1 "TRUE" /end COMPU_VTAB
/begin COMPU_VTAB Conv.cAdaPfusf._.hsad_verbotqsx_S6_S3 "Umrechnung fuer Messgroesse cAdaPfusf::hsad_verbotqsx" TAB_VERB 2 0 "FALSE" 1 "TRUE" /end COMPU_VTAB
/begin COMPU_VTAB Conv.cAdaPfusf._.pm_gls_status_S6_S3 "Umrechnung fuer Messgroesse cAdaPfusf::pm_gls_status" TAB_VERB 5 10 "PASSIV_GLS_PFAD" 11 "START_GLS_PFAD" 12 "WARTEN_AUF_GLS_PFAD" 13 "AKTIV_GLS_KZU_PFAD" 14 "PM_OK_PFAD" /end COMPU_VTAB
/begin COMPU_VTAB Conv.cAdaPfusf._.ada_starttyp_pf_S6_S3 "Umrechnung fuer Messgroesse cAdaPfusf::ada_starttyp_pf" TAB_VERB 5 0 "KBPTYP_KEINE" 1 "KBPTYP_START" 2 "KBPTYP_HAUPT" 3 "KBPTYP_SCHLECHTWEGE" 4 "KBPTYP_INAKTIV" /end COMPU_VTAB
/begin COMPU_VTAB Conv.cAdaPfusf._.freigabe_e_h_S6_S3 "Umrechnung fuer Messgroesse cAdaPfusf::freigabe_e_h" TAB_VERB 3 0 "PFUSF_FREIG_KEINE" 1 "PFUSF_FREIG_H" 2 "PFUSF_FREIG_E" /end COMPU_VTAB
/begin COMPU_VTAB Conv.cAdaPfusf._.z_pfad_cgt_adkl_kup_pfad_S6_S3 "Umrechnung fuer Messgroesse cAdaPfusf::z_pfad_cgt_adkl_kup_pfad" TAB_VERB 7 0 "Z_PFAD_CGT_ADKL_INAKTIV" 1 "Z_PFAD_CGT_ADKL_UNTER_KALT" 2 "Z_PFAD_CGT_ADKL_IN_KALT" 3 "Z_PFAD_CGT_ADKL_ZWISCHEN" 4 "Z_PFAD_CGT_ADKL_IN_WARM" 5 "Z_PFAD_CGT_ADKL_UEBER_WARM" 6 "Z_PFAD_CGT_ADKL_SCHLECHTWEGE" /end COMPU_VTAB
/begin COMPU_VTAB Conv.cAdaPstbwFenster._.f_aktiv_stada_S6_S3 "Umrechnung fuer Messgroesse cAdaPstbwFenster::f_aktiv_stada" TAB_VERB 2 0 "FALSE" 1 "TRUE" /end COMPU_VTAB
/begin COMPU_VTAB Conv.cAdaPstbwFenster._.f_starten_stada_S6_S3 "Umrechnung fuer Messgroesse cAdaPstbwFenster::f_starten_stada" TAB_VERB 2 0 "FALSE" 1 "TRUE" /end COMPU_VTAB
/begin COMPU_VTAB Conv.cAdaPstbwFenster._.f_beenden_stada_S6_S3 "Umrechnung fuer Messgroesse cAdaPstbwFenster::f_beenden_stada" TAB_VERB 2 0 "FALSE" 1 "TRUE" /end COMPU_VTAB
/begin COMPU_VTAB Conv.cAdaPstbw._.zustand_stada_S6_S3 "Umrechnung fuer Messgroesse cAdaPstbw::zustand_stada" TAB_VERB 5 0 "Kein Beobachtungsablauf aktiv" 1 "Es wird die Reaktion bestimmt" 2 "Es wird bewertet" 3 "Die Bewertung ist abgeschlossen" 4 "Es ist ein Fehler aufgetreten" /end COMPU_VTAB
/begin COMPU_VTAB Conv.cAdaPstbw._.testresultat_stada_S6_S3 "Umrechnung fuer Messgroesse cAdaPstbw::testresultat_stada" TAB_VERB 5 0 "Keine Reaktion" 1 "Reaktion zu klein" 2 "Reaktion erwartet" 3 "Reaktion zu gross" 4 "Reaktion viel zu gross" /end COMPU_VTAB
/begin COMPU_VTAB Conv.cAdaPstbw._.neg_rea_stada_S6_S3 "Umrechnung fuer Messgroesse cAdaPstbw::neg_rea_stada" TAB_VERB 3 0 "Keine Reaktion erkannt" 1 "ND_TSF/PFPULSNEG erkannt" 2 "ND_TSF/PFPULSZWNEG erkannt" /end COMPU_VTAB
/begin COMPU_VTAB Conv.cAdaPstbw._.pos_rea_stada_S6_S3 "Umrechnung fuer Messgroesse cAdaPstbw::pos_rea_stada" TAB_VERB 3 0 "Keine Reaktion erkannt" 1 "ND_TSF/PFPULSPOS erkannt" 2 "ND_TSF/PFPULSZWPOS erkannt" /end COMPU_VTAB
/begin COMPU_VTAB Conv.cAdaPstbw._.rea_amplitude_stada_S6_S3 "Umrechnung fuer Messgroesse cAdaPstbw::rea_amplitude_stada" TAB_VERB 2 0 "Keine Reaktion erkannt" 1 "ND_TSF/PFPULSAMP erkannt" /end COMPU_VTAB
/begin COMPU_VTAB Conv.cAdaPstpf._.zustand_stada_S6_S3 "Umrechnung fuer Messgroesse cAdaPstpf::zustand_stada" TAB_VERB 8 0 "STDAD_PF_KEINE_PRUEFUNG" 1 "STDAD_PF_WARTEN_AUF_SF" 2 "STDAD_PF_SF_AKTIV" 3 "STDAD_PF_FD_AKTIV" 4 "STDAD_PF_FD_PULS_AKTIV" 5 "STDAD_PF_UEBERWACHUNG_AKTIV" 6 "STDAD_PF_ENDE" 7 "STDAD_PF_FEHLER_BEI_PRUEFUNG" /end COMPU_VTAB
/begin COMPU_VTAB Conv.cAdaPstpf._.fenster_nach_sf_stada_S6_S3 "Umrechnung fuer Messgroesse cAdaPstpf::fenster_nach_sf_stada" TAB_VERB 2 0 "Abfrage auf ND_ADABBR erlaubt" 1 "Abfrage auf ND_ADABBR ist verboten" /end COMPU_VTAB
/begin COMPU_VTAB Conv.cAdaPstpf._.fenster_sf_stada_S6_S3 "Umrechnung fuer Messgroesse cAdaPstpf::fenster_sf_stada" TAB_VERB 2 0 "Abfrage auf ND_ADABBR erlaubt" 1 "Abfrage auf ND_ADABBR ist verboten" /end COMPU_VTAB
/begin COMPU_VTAB Conv.cAdaPstpf._.kup_puls_stada_S6_S3 "Umrechnung fuer Messgroesse cAdaPstpf::kup_puls_stada" TAB_VERB 7 0 "KEINE_KUPPLUNG" 1 "K_A" 2 "K_B" 3 "K_C" 4 "K_D" 5 "K_E" 6 "K_K0" /end COMPU_VTAB
/begin COMPU_VTAB Conv.cAdaPstsf._.zustand_stada_S6_S3 "Umrechnung fuer Messgroesse cAdaPstsf::zustand_stada" TAB_VERB 7 0 "STDAD_TSF_KEINE_PRUEFUNG" 1 "STDAD_TSF_WARTEN_AUF_SF" 2 "STDAD_TSF_SF_AKTIV" 3 "STDAD_TSF_FD_AKTIV" 4 "STDAD_TSF_UEBERWACHUNG_AKTIV" 5 "STDAD_TSF_ENDE" 6 "STDAD_TSF_FEHLER_BEI_PRUEFUNG" /end COMPU_VTAB
/begin COMPU_VTAB Conv.cAdaPstsf._.kup_puls_stada_S6_S3 "Umrechnung fuer Messgroesse cAdaPstsf::kup_puls_stada" TAB_VERB 7 0 "KEINE_KUPPLUNG" 1 "K_A" 2 "K_B" 3 "K_C" 4 "K_D" 5 "K_E" 6 "K_K0" /end COMPU_VTAB
/begin COMPU_VTAB Conv.cAdaPstPrepuls._.zustand_stada_S6_S3 "Umrechnung fuer Messgroesse cAdaPstPrepuls::zustand_stada" TAB_VERB 8 0 "STDAD_PRE_KEINE_PRUEFUNG" 1 "STDAD_PRE_WARTEN_AUF_SF" 2 "STDAD_PRE_SF_AKTIV" 3 "STDAD_PRE_FD_AUFRA" 4 "STDAD_PRE_FD_ABRA" 5 "STDAD_PRE_FD_WARTEN" 6 "STDAD_PRE_ENDE" 7 "STDAD_PRE_FEHLER_BEI_PRUEFUNG" /end COMPU_VTAB
/begin COMPU_VTAB Conv.cAdaPstPrepuls._.kup_puls_stada_S6_S3 "Umrechnung fuer Messgroesse cAdaPstPrepuls::kup_puls_stada" TAB_VERB 6 0 "KEINE" 1 "K_A" 2 "K_B" 3 "K_C" 4 "K_D" 5 "K_E" /end COMPU_VTAB
/begin COMPU_VTAB Conv.cAdaPstSysNmot._.akt_ada_S6_S3 "Umrechnung fuer Messgroesse cAdaPstSysNmot::akt_ada" TAB_VERB 4 0 "AKT_ADA_KEINE" 1 "AKT_ADA_KUP" 2 "AKT_ADA_K0" 3 "AKT_ADA_EOL" /end COMPU_VTAB
/begin COMPU_VTAB Conv.cAdaPstSysNmot._.z_systemkondit_nmot_S6_S3 "Umrechnung fuer Messgroesse cAdaPstSysNmot::z_systemkondit_nmot" TAB_VERB 9 0 "SYSTEMKONDIT_NMOT_PASSIV" 1 "SYSTEMKONDIT_NMOT_AKTIVIEREN" 2 "SYSTEMKONDIT_NMOT_WARTEN_ZZS" 3 "SYSTEMKONDIT_NMOT_WARTEN_ZEIT" 4 "SYSTEMKONDIT_NMOT_AKTIV" 5 "SYSTEMKONDIT_NMOT_ABGESCHLOSSEN" 6 "SYSTEMKONDIT_NMOT_DEAKTIVIEREN" 7 "SYSTEMKONDIT_NMOT_DEAKTIVIEREN_ABGESCHLOSSEN" 8 "SYSTEMKONDIT_NMOT_FEHLER" /end COMPU_VTAB
/begin COMPU_VTAB Conv.cAdaPstSysNmot._.f_nmotsoll_stada_em_S6_S3 "Umrechnung fuer Messgroesse cAdaPstSysNmot::f_nmotsoll_stada_em" TAB_VERB 2 0 "FALSE" 1 "TRUE" /end COMPU_VTAB
/begin COMPU_VTAB Conv.cAdaPstSysZzs._.akt_ada_S6_S3 "Umrechnung fuer Messgroesse cAdaPstSysZzs::akt_ada" TAB_VERB 4 0 "AKT_ADA_KEINE" 1 "AKT_ADA_KUP" 2 "AKT_ADA_K0" 3 "AKT_ADA_EOL" /end COMPU_VTAB
/begin COMPU_VTAB Conv.cAdaPstSysZzs._.z_systemkondit_zzs_S6_S3 "Umrechnung fuer Messgroesse cAdaPstSysZzs::z_systemkondit_zzs" TAB_VERB 12 0 "SYSTEMKONDIT_ZZS_PASSIV" 1 "SYSTEMKONDIT_ZZS_N_AKTIVIEREN" 2 "SYSTEMKONDIT_ZZS_N_WARTEN" 3 "SYSTEMKONDIT_ZZS_N_AKTIV" 4 "SYSTEMKONDIT_ZZS_GANG_VORG" 5 "SYSTEMKONDIT_ZZS_GANG_WARTEN" 6 "SYSTEMKONDIT_ZZS_GANG_AKTIV" 7 "SYSTEMKONDIT_ZZS_ABGESCHLOSSEN" 8 "SYSTEMKONDIT_ZZS_DEAKTIVIEREN" 9 "SYSTEMKONDIT_ZZS_DEAKTIVIEREN_WARTEN" 10 "SYSTEMKONDIT_ZZS_DEAKTIVIEREN_ABGESCHLOSSEN" 11 "SYSTEMKONDIT_ZZS_FEHLER" /end COMPU_VTAB
/begin COMPU_VTAB Conv.cAdaPstSysZzs._.gang_zzs_stada_S6_S3 "Umrechnung fuer Messgroesse cAdaPstSysZzs::gang_zzs_stada" TAB_VERB 10 -1 "GR1" 0 "KEIN_GANG" 1 "G1" 2 "G2" 3 "G3" 4 "G4" 5 "G5" 6 "G6" 7 "G7" 8 "G8" /end COMPU_VTAB
/begin COMPU_VTAB Conv.cAdaPstSysPsys._.akt_ada_S6_S3 "Umrechnung fuer Messgroesse cAdaPstSysPsys::akt_ada" TAB_VERB 4 0 "AKT_ADA_KEINE" 1 "AKT_ADA_KUP" 2 "AKT_ADA_K0" 3 "AKT_ADA_EOL" /end COMPU_VTAB
/begin COMPU_VTAB Conv.cAdaPstSysPsys._.z_systemkondit_psys_S6_S3 "Umrechnung fuer Messgroesse cAdaPstSysPsys::z_systemkondit_psys" TAB_VERB 7 0 "SYSTEMKONDIT_PSYS_PASSIV" 1 "SYSTEMKONDIT_PSYS_AKTIVIEREN" 2 "SYSTEMKONDIT_PSYS_WARTEN" 3 "SYSTEMKONDIT_PSYS_ABGESCHLOSSEN" 4 "SYSTEMKONDIT_PSYS_DEAKTIVIEREN" 5 "SYSTEMKONDIT_PSYS_DEAKTIVIEREN_ABGESCHLOSSEN" 6 "SYSTEMKONDIT_PSYS_FEHLER" /end COMPU_VTAB
/begin COMPU_VTAB Conv.cAdaPstSysPsys._.f_psys_anforderung_stada_S6_S3 "Umrechnung fuer Messgroesse cAdaPstSysPsys::f_psys_anforderung_stada" TAB_VERB 2 0 "FALSE" 1 "TRUE" /end COMPU_VTAB
/begin COMPU_VTAB Conv.cAdaPstSysFunkdeakt._.akt_ada_S6_S3 "Umrechnung fuer Messgroesse cAdaPstSysFunkdeakt::akt_ada" TAB_VERB 4 0 "AKT_ADA_KEINE" 1 "AKT_ADA_KUP" 2 "AKT_ADA_K0" 3 "AKT_ADA_EOL" /end COMPU_VTAB
/begin COMPU_VTAB Conv.cAdaPstSysFunkdeakt._.z_systemkondit_funkdeakt_S6_S3 "Umrechnung fuer Messgroesse cAdaPstSysFunkdeakt::z_systemkondit_funkdeakt" TAB_VERB 9 0 "SYSTEMKONDIT_FUNKDEAKT_PASSIV" 1 "SYSTEMKONDIT_FUNKDEAKT_AKTIVIEREN" 2 "SYSTEMKONDIT_FUNKDEAKT_WARTEN" 3 "SYSTEMKONDIT_FUNKDEAKT_AKTIV" 4 "SYSTEMKONDIT_FUNKDEAKT_ABGESCHLOSSEN" 5 "SYSTEMKONDIT_FUNKDEAKT_DEAKTIVIEREN" 6 "SYSTEMKONDIT_FUNKDEAKT_DEAKTIVIEREN_WARTEN" 7 "SYSTEMKONDIT_FUNKDEAKT_DEAKTIVIEREN_ABGESCHLOSSEN" 8 "SYSTEMKONDIT_FUNKDEAKT_FEHLER" /end COMPU_VTAB
/begin COMPU_VTAB Conv.cAdaPstSysAgl._.akt_ada_S6_S3 "Umrechnung fuer Messgroesse cAdaPstSysAgl::akt_ada" TAB_VERB 4 0 "AKT_ADA_KEINE" 1 "AKT_ADA_KUP" 2 "AKT_ADA_K0" 3 "AKT_ADA_EOL" /end COMPU_VTAB
/begin COMPU_VTAB Conv.cAdaPstSysAgl._.z_systemkondit_agl_S6_S3 "Umrechnung fuer Messgroesse cAdaPstSysAgl::z_systemkondit_agl" TAB_VERB 5 0 "SYSTEMKONDIT_AGL_PASSIV" 1 "SYSTEMKONDIT_AGL_AKTIVIEREN" 2 "SYSTEMKONDIT_AGL_WARTEN" 3 "SYSTEMKONDIT_AGL_ABGESCHLOSSEN" 4 "SYSTEMKONDIT_AGL_FEHLER" /end COMPU_VTAB
/begin COMPU_VTAB Conv.cAdaPstSysK0._.akt_ada_S6_S3 "Umrechnung fuer Messgroesse cAdaPstSysK0::akt_ada" TAB_VERB 4 0 "AKT_ADA_KEINE" 1 "AKT_ADA_KUP" 2 "AKT_ADA_K0" 3 "AKT_ADA_EOL" /end COMPU_VTAB
/begin COMPU_VTAB Conv.cAdaPstSysKup._.akt_ada_S6_S3 "Umrechnung fuer Messgroesse cAdaPstSysKup::akt_ada" TAB_VERB 4 0 "AKT_ADA_KEINE" 1 "AKT_ADA_KUP" 2 "AKT_ADA_K0" 3 "AKT_ADA_EOL" /end COMPU_VTAB
/begin COMPU_VTAB Conv.cAdaPstSysKup._.sal_eng_start_req_S6_S3 "Umrechnung fuer Messgroesse cAdaPstSysKup::sal_eng_start_req" TAB_VERB 2 0 "FALSE" 1 "TRUE" /end COMPU_VTAB
/begin COMPU_VTAB Conv.cAdaPstSysKup._.sal_eng_stop_disable_S6_S3 "Umrechnung fuer Messgroesse cAdaPstSysKup::sal_eng_stop_disable" TAB_VERB 2 0 "FALSE" 1 "TRUE" /end COMPU_VTAB
/begin COMPU_VTAB Conv.cAdaPstSysKup._.z_k0_stada_S6_S3 "Umrechnung fuer Messgroesse cAdaPstSysKup::z_k0_stada" TAB_VERB 2 0 "Z_K0_STADA_KEINE" 1 "Z_K0_STADA_GESCHLOSSEN" /end COMPU_VTAB
/begin COMPU_VTAB Conv.cAdaPstzs._.zustand_stada_S6_S3 "Umrechnung fuer Messgroesse cAdaPstzs::zustand_stada" TAB_VERB 9 0 "STDAD_INAKTIV" 1 "STDAD_SPERRZEITEN_AKTIV" 2 "STDAD_PASSIV" 3 "STDAD_START" 4 "STDAD_WARTEN" 5 "STDAD_SCHNELLFUELLUNG" 6 "STDAD_FUELLDRUCK" 7 "STDAD_PULSENDE_BEWERTUNG_AKTIV" 8 "STDAD_FEHLER_BEI_PRUEFUNG" /end COMPU_VTAB
/begin COMPU_VTAB Conv.cAdaPstzs._.testfall_prueftyp_stada_S6_S3 "Umrechnung fuer Messgroesse cAdaPstzs::testfall_prueftyp_stada" TAB_VERB 3 0 "STDAD_KEINE_PRUEFUNG_AKTIV" 1 "STDAD_SF_PRUEFUNG_AKTIV" 2 "STDAD_PF_PRUEFUNG_AKTIV" /end COMPU_VTAB
/begin COMPU_VTAB Conv.cAdaPstzs._.pulsid_stada_S6_S3 "Umrechnung fuer Messgroesse cAdaPstzs::pulsid_stada" TAB_VERB 5 0 "STDAD_KEIN_PULS" 1 "STDAD_PULSID_1" 2 "STDAD_PULSID_2" 3 "STDAD_PULSID_3" 4 "STDAD_PULSID_4" /end COMPU_VTAB
/begin COMPU_VTAB Conv.cAdaPstzs._.kup_puls_stada_S6_S3 "Umrechnung fuer Messgroesse cAdaPstzs::kup_puls_stada" TAB_VERB 7 0 "KEINE_KUPPLUNG" 1 "K_A" 2 "K_B" 3 "K_C" 4 "K_D" 5 "K_E" 6 "K_K0" /end COMPU_VTAB
/begin COMPU_VTAB Conv.cAdaPstzs._.kup_pruefpuls_ausgabe_stada_S6_S3 "Umrechnung fuer Messgroesse cAdaPstzs::kup_pruefpuls_ausgabe_stada" TAB_VERB 7 0 "KEINE_KUPPLUNG" 1 "K_A" 2 "K_B" 3 "K_C" 4 "K_D" 5 "K_E" 6 "K_K0" /end COMPU_VTAB
/begin COMPU_VTAB Conv.cAdaPstzs._.schnellfuellung_aktiv_stada_S6_S3 "Umrechnung fuer Messgroesse cAdaPstzs::schnellfuellung_aktiv_stada" TAB_VERB 2 0 "FALSE" 1 "TRUE" /end COMPU_VTAB
/begin COMPU_VTAB Conv.cAdaPstzs._.druck_statisch_stada_S6_S3 "Umrechnung fuer Messgroesse cAdaPstzs::druck_statisch_stada" TAB_VERB 2 0 "FALSE" 1 "TRUE" /end COMPU_VTAB
/begin COMPU_VTAB Conv.cAdaPstzs._.pulszyklus_beenden_stada_S6_S3 "Umrechnung fuer Messgroesse cAdaPstzs::pulszyklus_beenden_stada" TAB_VERB 4 0 "STDAD_ZYKLUS_NICHT_BEENDEN" 1 "STDAD_ZYKL_BEENDEN_WG_PULS_4" 2 "STDAD_ZYKL_BEENDEN_WG_PULSGRENZ" 3 "STDAD_ZYKL_BEENDEN_WG_ZWSP" /end COMPU_VTAB
/begin COMPU_VTAB Conv.cAdaPstzs._.f_red_bef_kup_S6_S3 "Umrechnung fuer Messgroesse cAdaPstzs::f_red_bef_kup" TAB_VERB 2 0 "FALSE" 1 "TRUE" /end COMPU_VTAB
/begin COMPU_VTAB Conv.cAdaPstzs._.testfall_gang_stada_S6_S3 "Umrechnung fuer Messgroesse cAdaPstzs::testfall_gang_stada" TAB_VERB 10 -1 "GR1" 0 "KEIN_GANG" 1 "G1" 2 "G2" 3 "G3" 4 "G4" 5 "G5" 6 "G6" 7 "G7" 8 "G8" /end COMPU_VTAB
/begin COMPU_VTAB Conv.cAdaPstzs._.pre_ada_zustand_stada_S6_S3 "Umrechnung fuer Messgroesse cAdaPstzs::pre_ada_zustand_stada" TAB_VERB 18 0 "STDAD_ZUST_PASSIV_INIT" 1 "STDAD_ZUST_PASSIV" 2 "STDAD_ZUST_TESTER_AKTIV_INIT" 3 "STDAD_ZUST_TESTER_AKTIV" 4 "STDAD_ZUST_TESTFALL" 5 "STDAD_SYSTEMKONDITIONIERUNG" 6 "STDAD_ZUST_PREPULS_INIT" 7 "STDAD_ZUST_PREPULS" 8 "STDAD_ZUST_ZYKLUS_STARTEN_INIT" 9 "STDAD_ZUST_PULS_STARTEN_INIT" 10 "STDAD_ZUST_PULS_STARTEN" 11 "STDAD_ZUST_PULS_INIT" 12 "STDAD_ZUST_PULS" 13 "STDAD_ZUST_BEENDT" 14 "STDAD_ZUST_SYSTKONDIT_ABBAU_INIT" 15 "STDAD_ZUST_SYSTKONDIT_ABBAU_WARTEN" 16 "STDAD_ZUST_SYSTKONDIT_ABBAU_BEENDET" 17 "STDAD_ZUST_WART_TESTER_DEAK" /end COMPU_VTAB
/begin COMPU_VTAB Conv.cAdaPstzs._.akt_ada_S6_S3 "Umrechnung fuer Messgroesse cAdaPstzs::akt_ada" TAB_VERB 4 0 "AKT_ADA_KEINE" 1 "AKT_ADA_KUP" 2 "AKT_ADA_K0" 3 "AKT_ADA_EOL" /end COMPU_VTAB
/begin COMPU_VTAB Conv.cAdaPstzs._.f_deaktivierung_erkannt_S6_S3 "Umrechnung fuer Messgroesse cAdaPstzs::f_deaktivierung_erkannt" TAB_VERB 2 0 "FALSE" 1 "TRUE" /end COMPU_VTAB
/begin COMPU_VTAB Conv.cAdaPstzs._.anz_kup_puls_stada_S6_S3 "Umrechnung fuer Messgroesse cAdaPstzs::anz_kup_puls_stada" TAB_VERB 7 0 "KEINE_KUPPLUNG" 1 "K_A" 2 "K_B" 3 "K_C" 4 "K_D" 5 "K_E" 6 "K_K0" /end COMPU_VTAB
/begin COMPU_VTAB Conv.cAdaPstzs._.anz_prueftyp_stada_S6_S3 "Umrechnung fuer Messgroesse cAdaPstzs::anz_prueftyp_stada" TAB_VERB 3 0 "STDAD_KEINE_PRUEFUNG_AKTIV" 1 "STDAD_SF_PRUEFUNG_AKTIV" 2 "STDAD_PF_PRUEFUNG_AKTIV" /end COMPU_VTAB
/begin COMPU_VTAB Conv.cAdaPstzs._.anz_pulsid_stada_S6_S3 "Umrechnung fuer Messgroesse cAdaPstzs::anz_pulsid_stada" TAB_VERB 5 0 "STDAD_KEIN_PULS" 1 "STDAD_PULSID_1" 2 "STDAD_PULSID_2" 3 "STDAD_PULSID_3" 4 "STDAD_PULSID_4" /end COMPU_VTAB
/begin COMPU_VTAB Conv.cAdaPstzs._.anz_durchgefuehrt_stada_S6_S3 "Umrechnung fuer Messgroesse cAdaPstzs::anz_durchgefuehrt_stada" TAB_VERB 3 0 "STDAD_PRUEFUNG_INAKTIV" 1 "STDAD_PRUEFUNG_AKTIV" 2 "STDAD_PRUEFUNG_BEENDET" /end COMPU_VTAB
/begin COMPU_VTAB Conv.cAdaPstzs._.fzg_stillstand_stada_S6_S3 "Umrechnung fuer Messgroesse cAdaPstzs::fzg_stillstand_stada" TAB_VERB 2 0 "FALSE" 1 "TRUE" /end COMPU_VTAB
/begin COMPU_VTAB Conv.cAdaPstzs._.grundbedingung_erfuellt_zyklisch_stada_S6_S3 "Umrechnung fuer Messgroesse cAdaPstzs::grundbedingung_erfuellt_zyklisch_stada" TAB_VERB 2 0 "FALSE" 1 "TRUE" /end COMPU_VTAB
/begin COMPU_VTAB Conv.cAdaPstzs._.grundbedingung_erfuellt_einmalig_stada_S6_S3 "Umrechnung fuer Messgroesse cAdaPstzs::grundbedingung_erfuellt_einmalig_stada" TAB_VERB 2 0 "FALSE" 1 "TRUE" /end COMPU_VTAB
/begin COMPU_VTAB Conv.cAdaPstzs._.fzg_stillstand_k0_stada_S6_S3 "Umrechnung fuer Messgroesse cAdaPstzs::fzg_stillstand_k0_stada" TAB_VERB 2 0 "FALSE" 1 "TRUE" /end COMPU_VTAB
/begin COMPU_VTAB Conv.cAdaPstzs._.grundbedingung_erfuellt_zyklisch_k0_stada_S6_S3 "Umrechnung fuer Messgroesse cAdaPstzs::grundbedingung_erfuellt_zyklisch_k0_stada" TAB_VERB 2 0 "FALSE" 1 "TRUE" /end COMPU_VTAB
/begin COMPU_VTAB Conv.cAdaPstzs._.grundbedingung_erfuellt_einmalig_k0_stada_S6_S3 "Umrechnung fuer Messgroesse cAdaPstzs::grundbedingung_erfuellt_einmalig_k0_stada" TAB_VERB 2 0 "FALSE" 1 "TRUE" /end COMPU_VTAB
/begin COMPU_VTAB Conv.cAdaPstCondition._.preadaption_condition_stada_int_S6_S3 "Umrechnung fuer Messgroesse cAdaPstCondition::preadaption_condition_stada_int" TAB_VERB 17 0 "PREADA_COND_DEF" 1 "PREADA_COND_BED_IO" 2 "PREADA_COND_BEREITS_DURCH" 3 "PREADA_COND_CGETR_UN_NIO" 4 "PREADA_COND_CGETR_OB_NIO" 5 "PREADA_COND_PBED_NIO" 6 "PREADA_COND_POS_NIO" 7 "PREADA_COND_FP_NIO" 8 "PREADA_COND_NAB_NIO" 9 "PREADA_COND_NMOT_NIO" 10 "PREADA_COND_PBREMSE_NIO" 11 "PREADA_COND_ALGADA_NIO" 12 "PREADA_COND_FEHLE_PULS_NIO" 100 "PREADA_COND_E_FAHREN_NIO" 101 "PREADA_COND_POS_NP_NIO" 102 "PREADA_COND_K0_GESCHLOSSEN_NIO" 255 "PREADA_COND_BED_ALLG_NIO" /end COMPU_VTAB
/begin COMPU_VTAB Conv.cAdaPstCondition._.preadaption_condition_stada_S6_S3 "Umrechnung fuer Messgroesse cAdaPstCondition::preadaption_condition_stada" TAB_VERB 17 0 "PREADA_COND_DEF" 1 "PREADA_COND_BED_IO" 2 "PREADA_COND_BEREITS_DURCH" 3 "PREADA_COND_CGETR_UN_NIO" 4 "PREADA_COND_CGETR_OB_NIO" 5 "PREADA_COND_PBED_NIO" 6 "PREADA_COND_POS_NIO" 7 "PREADA_COND_FP_NIO" 8 "PREADA_COND_NAB_NIO" 9 "PREADA_COND_NMOT_NIO" 10 "PREADA_COND_PBREMSE_NIO" 11 "PREADA_COND_ALGADA_NIO" 12 "PREADA_COND_FEHLE_PULS_NIO" 100 "PREADA_COND_E_FAHREN_NIO" 101 "PREADA_COND_POS_NP_NIO" 102 "PREADA_COND_K0_GESCHLOSSEN_NIO" 255 "PREADA_COND_BED_ALLG_NIO" /end COMPU_VTAB
/begin COMPU_VTAB Conv.cAdaPstState._.preadaption_state_stada_S6_S3 "Umrechnung fuer Messgroesse cAdaPstState::preadaption_state_stada" TAB_VERB 5 0 "PREADA_STATE_NICHT_GEST" 1 "PREADA_STATE_INIT" 2 "PREADA_STATE_LAEUFT" 3 "PREADA_STATE_BEENDET" 4 "PREADA_STATE_ABGEBROCHEN" /end COMPU_VTAB
/begin COMPU_VTAB Conv.cAdaPstUserinfo._.preadaption_userinfo_stada_S6_S3 "Umrechnung fuer Messgroesse cAdaPstUserinfo::preadaption_userinfo_stada" TAB_VERB 2 0 "PREADA_USERINFO_KEINE_BED_ANW" 255 "PREADA_USERINFO_ABGEBROCHEN" /end COMPU_VTAB
/begin COMPU_VTAB Conv.cAdaUrlufterkSchaltungSignal._.f_signal_ungueltig_S6_S3 "Umrechnung fuer Messgroesse cAdaUrlufterkSchaltungSignal::f_signal_ungueltig" TAB_VERB 2 0 "FALSE" 1 "TRUE" /end COMPU_VTAB
/begin COMPU_VTAB Conv.cAdaUrlufterkSchaltungSignal._.signal_quelle_S6_S3 "Umrechnung fuer Messgroesse cAdaUrlufterkSchaltungSignal::signal_quelle" TAB_VERB 2 0 "SWI_NTNAB_URL_NT" 1 "SWI_NTNAB_URL_NAB" /end COMPU_VTAB
/begin COMPU_VTAB Conv.cAdaUrlufterkSchaltungSignal._.signal_quelle_alt_S6_S3 "Umrechnung fuer Messgroesse cAdaUrlufterkSchaltungSignal::signal_quelle_alt" TAB_VERB 2 0 "SWI_NTNAB_URL_NT" 1 "SWI_NTNAB_URL_NAB" /end COMPU_VTAB
/begin COMPU_VTAB Conv.cAdaUrlufterkSchaltungSignal._.f_pt1_inti_S6_S3 "Umrechnung fuer Messgroesse cAdaUrlufterkSchaltungSignal::f_pt1_inti" TAB_VERB 2 0 "Init notwendig" 1 "Init erfolgt" /end COMPU_VTAB
/begin COMPU_VTAB Conv.cAdaUrlufterkSchaltungSignal._.f_grad_inti_S6_S3 "Umrechnung fuer Messgroesse cAdaUrlufterkSchaltungSignal::f_grad_inti" TAB_VERB 2 0 "Init notwendig" 1 "Init erfolgt" /end COMPU_VTAB
/begin COMPU_VTAB Conv.cAdaUrlufterkSchaltungAnz._.kup_schaltung_url_S6_S3 "Umrechnung fuer Messgroesse cAdaUrlufterkSchaltungAnz::kup_schaltung_url" TAB_VERB 6 0 "KEINE" 1 "K_A" 2 "K_B" 3 "K_C" 4 "K_D" 5 "K_E" /end COMPU_VTAB
/begin COMPU_VTAB Conv.cAdaUrlufterkSchaltungAnz._.f_loeschen_schalung_url_S6_S3 "Umrechnung fuer Messgroesse cAdaUrlufterkSchaltungAnz::f_loeschen_schalung_url" TAB_VERB 2 0 "FALSE" 1 "TRUE" /end COMPU_VTAB
/begin COMPU_VTAB Conv.cAdaUrlufterkSchaltung._.zustand_S6_S3 "Umrechnung fuer Messgroesse cAdaUrlufterkSchaltung::zustand" TAB_VERB 2 0 "Z_SCHALT_URL_PASSIV" 1 "Z_SCHALT_URL_BEOBACHTUNG" /end COMPU_VTAB
/begin COMPU_VTAB Conv.cAdaUrlufterkSchaltung._.kup_S6_S3 "Umrechnung fuer Messgroesse cAdaUrlufterkSchaltung::kup" TAB_VERB 6 0 "KEINE" 1 "K_A" 2 "K_B" 3 "K_C" 4 "K_D" 5 "K_E" /end COMPU_VTAB
/begin COMPU_VTAB Conv.cAdaUrlufterkPulsAnz._.kup_puls_url_S6_S3 "Umrechnung fuer Messgroesse cAdaUrlufterkPulsAnz::kup_puls_url" TAB_VERB 7 0 "KEINE_KUPPLUNG" 1 "K_A" 2 "K_B" 3 "K_C" 4 "K_D" 5 "K_E" 6 "K_K0" /end COMPU_VTAB
/begin COMPU_VTAB Conv.cAdaUrlufterkPulsAnz._.f_loeschen_puls_url_S6_S3 "Umrechnung fuer Messgroesse cAdaUrlufterkPulsAnz::f_loeschen_puls_url" TAB_VERB 2 0 "FALSE" 1 "TRUE" /end COMPU_VTAB
/begin COMPU_VTAB Conv.cAdaUrlufterkPuls._.zustand_S6_S3 "Umrechnung fuer Messgroesse cAdaUrlufterkPuls::zustand" TAB_VERB 2 0 "Z_PULS_URL_PASSIV" 1 "Z_PULS_URL_BEOBACHTUNG" /end COMPU_VTAB
/begin COMPU_VTAB Conv.cAdaUrlufterkPuls._.kup_S6_S3 "Umrechnung fuer Messgroesse cAdaUrlufterkPuls::kup" TAB_VERB 7 0 "KEINE_KUPPLUNG" 1 "K_A" 2 "K_B" 3 "K_C" 4 "K_D" 5 "K_E" 6 "K_K0" /end COMPU_VTAB
/begin COMPU_VTAB Conv.cAdaUrlufterkPuls._.kfl_ist_start_S6_S3 "Umrechnung fuer Messgroesse cAdaUrlufterkPuls::kfl_ist_start" TAB_VERB 3 0 "KEIN_KFL" 1 "KFL_VORWAERTS" 2 "KFL_RUECKWAERTS" /end COMPU_VTAB
/begin COMPU_VTAB Conv.cAdaUrlufterkPuls._.istgang_start_S6_S3 "Umrechnung fuer Messgroesse cAdaUrlufterkPuls::istgang_start" TAB_VERB 10 -1 "GR1" 0 "KEIN_GANG" 1 "G1" 2 "G2" 3 "G3" 4 "G4" 5 "G5" 6 "G6" 7 "G7" 8 "G8" /end COMPU_VTAB
/begin COMPU_VTAB Conv.cAdaUrlufterkPuls._.prueftyp_S6_S3 "Umrechnung fuer Messgroesse cAdaUrlufterkPuls::prueftyp" TAB_VERB 3 0 "KPAD_KEINE_PRUEFUNG_AKTIV" 1 "KPAD_SF_PRUEFUNG_AKTIV" 2 "KPAD_PF_PRUEFUNG_AKTIV" /end COMPU_VTAB
/begin COMPU_VTAB Conv.cAdaGlast._.gls_flag_abbruch_wg_adapfn_S6_S3 "Umrechnung fuer Messgroesse cAdaGlast::gls_flag_abbruch_wg_adapfn" TAB_VERB 2 0 "false" 1 "true" /end COMPU_VTAB
/begin COMPU_VTAB Conv.cAdaGlast._.adaps_status_S6_S3 "Umrechnung fuer Messgroesse cAdaGlast::adaps_status" TAB_VERB 11 400 "Default" 410 "Warten auf GLS-Beginn" 415 "Beginn GLS" 420 "Warten bis GLS beendet" 425 "GLS beendet" 450 "Warten bis Schaltung beendet" 470 "Abbruchbedingung eingetreten" 477 "Zustandsfehler" 480 "Bewertung verboten wegen Diagnose" 490 "Bewertung verboten da die Schaltung nicht ueber SAS beendet wurde" 499 "4000 + x   x = Ausgabe mittlerer Regeldruck" /end COMPU_VTAB
/begin COMPU_VTAB Conv.cAdaGlast._.bew_kup_S6_S3 "Umrechnung fuer Messgroesse cAdaGlast::bew_kup" TAB_VERB 6 0 "KEINE" 1 "K_A" 2 "K_B" 3 "K_C" 4 "K_D" 5 "K_E" /end COMPU_VTAB
/begin COMPU_VTAB Conv.cAdaGlast._.bew_kennfeld_S6_S3 "Umrechnung fuer Messgroesse cAdaGlast::bew_kennfeld" TAB_VERB 4 0 "nicht definiert" 1 "ADA-GLS-Kennfeld 1" 2 "ADA-GLS-Kennfeld 2" 3 "ADA-GLS-Kennfeld 3" /end COMPU_VTAB
/begin COMPU_VTAB Conv.cAdaGlast._.bew_kennfeld_lesen_S6_S3 "Umrechnung fuer Messgroesse cAdaGlast::bew_kennfeld_lesen" TAB_VERB 4 0 "nicht definiert" 1 "ADA-GLS-Kennfeld 1" 2 "ADA-GLS-Kennfeld 2" 3 "ADA-GLS-Kennfeld 3" /end COMPU_VTAB
/begin COMPU_VTAB Conv.cAdaGlast._.warm_kalt_kennfeld_lesen_S6_S3 "Umrechnung fuer Messgroesse cAdaGlast::warm_kalt_kennfeld_lesen" TAB_VERB 5 0 "passiv" 1 "init" 2 "warm" 3 "kalt" 4 "zwischen warm und kalt" /end COMPU_VTAB
/begin COMPU_VTAB Conv.cAdaGlast._.warm_kalt_kennfeld_schreiben_S6_S3 "Umrechnung fuer Messgroesse cAdaGlast::warm_kalt_kennfeld_schreiben" TAB_VERB 5 0 "passiv" 1 "init" 2 "warm" 3 "kalt" 4 "zwischen warm und kalt" /end COMPU_VTAB
/begin COMPU_VTAB Conv.cAdaGlast._.bew_schalttyp_S6_S3 "Umrechnung fuer Messgroesse cAdaGlast::bew_schalttyp" TAB_VERB 5 0 "Einzel Hochschaltung" 1 "Einzel Rueckschaltung" 2 "Doppel Hochschaltung" 3 "Doppel Rueckschaltung" 4 "N-fach Rueckschaltung" /end COMPU_VTAB
/begin COMPU_VTAB Conv.cAdaGlast._.bew_index_S6_S3 "Umrechnung fuer Messgroesse cAdaGlast::bew_index" TAB_VERB 4 0 "NORMAL" 1 "SP" 2 "SPORT" 3 "AMAX" /end COMPU_VTAB
/begin COMPU_VTAB Conv.cAdaGlast._.bew_schalttyp_lesen_S6_S3 "Umrechnung fuer Messgroesse cAdaGlast::bew_schalttyp_lesen" TAB_VERB 5 0 "Einzel Hochschaltung" 1 "Einzel Rueckschaltung" 2 "Doppel Hochschaltung" 3 "Doppel Rueckschaltung" 4 "N-fach Rueckschaltung" /end COMPU_VTAB
/begin COMPU_VTAB Conv.cAdaGlast._.status_ausgabe_verzoegern_S6_S3 "Umrechnung fuer Messgroesse cAdaGlast::status_ausgabe_verzoegern" TAB_VERB 2 0 "FALSE" 1 "TRUE" /end COMPU_VTAB
/begin COMPU_VTAB Conv.cAdaGlast._.gls_trimm_verbot_versch_rs_S6_S3 "Umrechnung fuer Messgroesse cAdaGlast::gls_trimm_verbot_versch_rs" TAB_VERB 2 0 "PASSIV" 1 "AKTIV" /end COMPU_VTAB
/begin COMPU_VTAB Conv.cAdaGlast._.gls_trimm_spont_beeinflussung_S6_S3 "Umrechnung fuer Messgroesse cAdaGlast::gls_trimm_spont_beeinflussung" TAB_VERB 2 0 "PASSIV" 1 "AKTIV" /end COMPU_VTAB
/begin COMPU_VTAB Conv.cAdaGlast._.f_gls_trimm_kup_schwelle_S6_S3 "Umrechnung fuer Messgroesse cAdaGlast::f_gls_trimm_kup_schwelle" TAB_VERB 2 0 "PASSIV" 1 "AKTIV" /end COMPU_VTAB
/begin COMPU_VTAB Conv.cAdaGlast._.f_gls_trimm_gls_schwelle_kf1_S6_S3 "Umrechnung fuer Messgroesse cAdaGlast::f_gls_trimm_gls_schwelle_kf1" TAB_VERB 2 0 "PASSIV" 1 "AKTIV" /end COMPU_VTAB
/begin COMPU_VTAB Conv.cAdaGlast._.f_gls_trimm_gls_schwelle_kf2_S6_S3 "Umrechnung fuer Messgroesse cAdaGlast::f_gls_trimm_gls_schwelle_kf2" TAB_VERB 2 0 "PASSIV" 1 "AKTIV" /end COMPU_VTAB
/begin COMPU_VTAB Conv.cAdaGlast._.gls_ada_state_S6_S3 "Umrechnung fuer Messgroesse cAdaGlast::gls_ada_state" TAB_VERB 7 1 "PSA_PASSIV" 2 "PSA_START" 3 "WARTEN_GLS" 4 "GLS_KAB_AKTIV" 5 "GLS_KZU_AKTIV" 6 "GLS_WARTEN_SE" 8 "Z_GLS_ABBRUCH" /end COMPU_VTAB
/begin COMPU_VTAB Conv.cAdaGlast._.bew_erl_schaltinfo_S6_S3 "Umrechnung fuer Messgroesse cAdaGlast::bew_erl_schaltinfo" TAB_VERB 2 0 "FALSE" 1 "TRUE" /end COMPU_VTAB
/begin COMPU_VTAB Conv.cAdaGlosc._.f_aenderung_adaram_daten_S6_S3 "Umrechnung fuer Messgroesse cAdaGlosc::f_aenderung_adaram_daten" TAB_VERB 2 0 "keine Aenderung ADARAM-Daten" 1 "vermutlich Aenderung ADARAM-Daten" /end COMPU_VTAB
/begin COMPU_VTAB Conv.cAdaGlosc._.ada_synchron_S6_S3 "Umrechnung fuer Messgroesse cAdaGlosc::ada_synchron" TAB_VERB 2 0 "Synchronpunkt noch nicht erreicht" 1 "Synchronpunkt erreicht" /end COMPU_VTAB
/begin COMPU_VTAB Conv.cAdaGlosc._.ada_schaltung_kzu_S6_S3 "Umrechnung fuer Messgroesse cAdaGlosc::ada_schaltung_kzu" TAB_VERB 2 0 "Schaltung nicht ueber KZU" 1 "Schaltung ueber KZU" /end COMPU_VTAB
/begin COMPU_VTAB Conv.cAdaGlosc._.init_mit_azg_S6_S3 "Umrechnung fuer Messgroesse cAdaGlosc::init_mit_azg" TAB_VERB 35 0 "Initialwert" 16 "AZG-Init.-Wert fuer alle Adaptionswerte" 2 "AZG-Init.-Wert fuer K0-Ada komplett" 4 "AZG-Init.-Wert fuer GLS-Ada komplett" 8 "AZG-Init.-Wert fuer GE-Ada" 11 "AZG-Init.-Wert fuer Fusspunkt-Ada" 41 "AZG-Init.-Wert fuer CSC-Ada" 37 "AZG-Init.-Wert fuer IAE-AP Ada" 14 "AZG-Init.-Wert fuer IAE-UF Ada" 15 "AZG-Init.-Wert fuer TeachIn-Funktion" 18 "AZG-Init.-Wert fuer GLS ERS Kennfeld 1" 19 "AZG-Init.-Wert fuer GLS ERS Kennfeld 2" 20 "AZG-Init.-Wert fuer GLS DRS Kennfeld 1" 21 "AZG-Init.-Wert fuer GLS DRS Kennfeld 2" 22 "AZG-Init.-Wert fuer GLS Mehrfach RS" 23 "AZG-Init.-Wert fuer GLS EHS Kennfeld 1" 24 "AZG-Init.-Wert fuer GLS EHS Kennfeld 2" 17 "AZG-Init.-Wert fuer GLS DHS" 25 "AZG-Init.-Wert fuer Schnellfuellzeit Ada Werte" 32 "AZG-Init.-Wert fuer Fuelldruck Ada Werte" 33 "AZG-Init.-Wert fuer interne Pulsadaptionswerte" 85 "AZG-Init.-Wert fuer Info Speicher" 96 "AZG-Init.-Wert fuer Schnellfuellzeit Ada Werte K0" 97 "AZG-Init.-Wert fuer Fuelldruck Ada Werte K0" 98 "AZG-Init.-Wert fuer Schnellfuellzeit-BPZ K0" 99 "AZG-Init.-Wert fuer Fuelldruck-BPZ K0" 40 "AZG-Init.-Wert fuer Schnellfuellzeit Ada Speicher loeschen" 114 "AZG-Init.-Wert fuer Schnellfuellzeit-BPZ WK" 115 "AZG-Init.-Wert fuer interne Pulsadaptionswerte WK" 116 "AZG-Init.-Wert fuer Fuspunktadaption" 117 "AZG-Init.-Wert fuer Bewertungszaehler Fuspunktadaption" 118 "AZG-Init.-Wert fuer STADA preadaption_finish_counter" 144 "AZG-Init.-Wert fuer Gangauslegeadaption" 145 "AZG-Init.-Wert fuer Daten Gangauslegeadaption" 146 "AZG-Init.-Wert fuer Bewertungszaehler Gangauslegeadaption" /end COMPU_VTAB
/begin COMPU_VTAB Conv.cAdaGlosc._.ada_zielgang_S6_S3 "Umrechnung fuer Messgroesse cAdaGlosc::ada_zielgang" TAB_VERB 9 0 "KEIN_GANG" 1 "G1" 2 "G2" 3 "G3" 4 "G4" 5 "G5" 6 "G6" 7 "G7" 8 "G8" /end COMPU_VTAB
/begin COMPU_VTAB Conv.cAdaGlosc._.ada_istgang_S6_S3 "Umrechnung fuer Messgroesse cAdaGlosc::ada_istgang" TAB_VERB 9 0 "KEIN_GANG" 1 "G1" 2 "G2" 3 "G3" 4 "G4" 5 "G5" 6 "G6" 7 "G7" 8 "G8" /end COMPU_VTAB
/begin COMPU_VTAB Conv.cAdaGlosc._.ada_version_S6_S3 "Umrechnung fuer Messgroesse cAdaGlosc::ada_version" TAB_VERB 58 0 "Alles loeschen" 1 "EHS KF 1" 2 "Ctr EHS KF 1" 3 "EHS KF 2" 4 "Ctr EHS KF 2" 5 "EHS kalt KF 1" 6 "Ctr EHS kalt KF 1" 7 "EHS kalt KF 2" 8 "Ctr EHS kalt KF 2" 9 "ERS KF 1" 10 "Ctr ERS KF 1" 11 "ERS KF 2" 12 "Ctr ERS KF 2" 13 "DRS KF 1" 14 "Ctr DRS KF 1" 15 "NFRS KF 1" 16 "Ctr NFRS KF 1" 17 "Kup PF" 18 "Ctr Kup PF" 19 "Ctr Start Kup PF" 20 "Kup TSF" 21 "Ctr Kup TSF" 22 "Kup PF kalt" 23 "Ctr Kup PF kalt" 24 "WK Fusspunkt" 25 "Ctr WK Fusspunkt" 26 "Ada WK" 27 "Ctr Ada WK" 28 "Ada GE" 29 "Ctr Ada GE" 30 "Ada GA" 31 "Ctr Ada GA" 32 "Preadaption Finish Counter" 33 "nicht belegt 33" 34 "nicht belegt 34" 35 "nicht belegt 35" 36 "nicht belegt 36" 37 "nicht belegt 37" 38 "Ada Schlepp" 39 "EHS KF 3" 40 "Ctr EHS KF 3" 41 "EHS kalt KF 3" 42 "Ctr EHS kalt KF 3" 43 "DHS KF 1" 44 "Ctr DHS KF 1" 45 "DHS kalt KF 1" 46 "Ctr DHS kalt KF 1" 47 "Ada Iae" 48 "Ctr Ada Iae" 49 "Ada UF" 50 "Ada K0" 51 "Ctr Ada K0" 52 "nicht belegt 52" 53 "nicht belegt 53" 54 "nicht belegt 54" 55 "nicht belegt 55" 56 "nicht belegt 56" 57 "nicht belegt 57" /end COMPU_VTAB
/begin COMPU_VTAB Conv.cAdaGlosc._.ada_k_zu_S6_S3 "Umrechnung fuer Messgroesse cAdaGlosc::ada_k_zu" TAB_VERB 6 0 "KEINE" 1 "K_A" 2 "K_B" 3 "K_C" 4 "K_D" 5 "K_E" /end COMPU_VTAB
/begin COMPU_VTAB Conv.cAdaGlosc._.ada_schaltart_S6_S3 "Umrechnung fuer Messgroesse cAdaGlosc::ada_schaltart" TAB_VERB 3 0 "nicht definiert" 1 "Hochschaltung" 2 "Rueckschaltung" /end COMPU_VTAB
/begin COMPU_VTAB Conv.cAdaGlosc._.ada_schaltinfo_S6_S3 "Umrechnung fuer Messgroesse cAdaGlosc::ada_schaltinfo" TAB_VERB 5 0 "keine Schaltung" 1 "Einfach-Hochschaltung" 2 "Mehrfachhochschaltung" 3 "Einfach-Rueckschaltung" 4 "Mehrfachrueckschaltung" /end COMPU_VTAB
/begin COMPU_VTAB Conv.cAdaGlosc._.ada_iae_info_S6_S3 "Umrechnung fuer Messgroesse cAdaGlosc::ada_iae_info" TAB_VERB 3 0 "KEINE_IAE_ADAPTION_AKTIV" 1 "IAE_AP_ADA" 2 "IAE_UF_ADA" /end COMPU_VTAB
/begin COMPU_VTAB Conv.cAdaGlosc._.z_ada_schaltung_S6_S3 "Umrechnung fuer Messgroesse cAdaGlosc::z_ada_schaltung" TAB_VERB 3 0 "keine Schaltung" 1 "bewertbare Standardschaltung" 2 "Wechsel-Schaltung" /end COMPU_VTAB
/begin COMPU_VTAB Conv.cAdaGlosc._.ada_schaltungs_index_S6_S3 "Umrechnung fuer Messgroesse cAdaGlosc::ada_schaltungs_index" TAB_VERB 3 0 "IND_KURZSAS_NORMAL" 1 "IND_KURZSAS_SP" 2 "IND_KURZSAS_SPORT" /end COMPU_VTAB
/begin COMPU_VTAB Conv.cAdaGlosc._.f_ada_bew_verboten_S6_S3 "Umrechnung fuer Messgroesse cAdaGlosc::f_ada_bew_verboten" TAB_VERB 2 0 "FALSE" 1 "TRUE" /end COMPU_VTAB
/begin COMPU_VTAB Conv.cAdaGlosc._.f_letzte_schaltung_rs_S6_S3 "Umrechnung fuer Messgroesse cAdaGlosc::f_letzte_schaltung_rs" TAB_VERB 2 0 "FALSE" 1 "TRUE" /end COMPU_VTAB
/begin COMPU_VTAB Conv.cAdaGlosc._.flag_alaengs_adaoff_S6_S3 "Umrechnung fuer Messgroesse cAdaGlosc::flag_alaengs_adaoff" TAB_VERB 2 0 "FALSE" 1 "TRUE" /end COMPU_VTAB
/begin COMPU_VTAB Conv.cAdaGlosc._.bew_verbot_laengs_beschl_S6_S3 "Umrechnung fuer Messgroesse cAdaGlosc::bew_verbot_laengs_beschl" TAB_VERB 3 0 "Bewertung verboten" 1 "Bewertung erlaubt" 2 "Bewertung erlaubt und Zuendung <> EIN erkannt" /end COMPU_VTAB
/begin COMPU_VTAB Conv.cAdaGlosc._.flag_allada_del_S6_S3 "Umrechnung fuer Messgroesse cAdaGlosc::flag_allada_del" TAB_VERB 2 0 "FALSE" 1 "TRUE" /end COMPU_VTAB
/begin COMPU_VTAB Conv.cAdaIaeApKorr._.z_apada_korr_S6_S3 "Umrechnung fuer Messgroesse cAdaIaeApKorr::z_apada_korr" TAB_VERB 6 0 "Z_ADA_IAE_AP_KORR_PASSIV" 1 "Z_ADA_IAE_AP_KORR_EINSTIEG_PRUEFEN" 2 "Z_ADA_IAE_AP_KORR_WARTEN_SPERRZEIT" 3 "Z_ADA_IAE_AP_KORR_WARTEN_STAT_BED" 4 "Z_ADA_IAE_AP_KORR_APADA_LAEUFT" 5 "Z_ADA_IAE_AP_KORR_ENDE" /end COMPU_VTAB
/begin COMPU_VTAB Conv.cAdaIaeApKorr._.abbruch_bit_ada_iae_S6_S3 "Umrechnung fuer Messgroesse cAdaIaeApKorr::abbruch_bit_ada_iae" TAB_VERB 28 0 "KEIN_ABBRUCH_BIT" 1 "ABBRUCH_BIT_PASSIV_ADA_IAE_AUS" 2 "ABBRUCH_BIT_PASSIV_CTR" 4 "ABBRUCH_BIT_PASSIV_C_DELTA" 8 "ABBRUCH_BIT_PASSIV_Z_IAE_PREV" 16 "ABBRUCH_BIT_PASSIV_ALLG_ADA" 256 "ABBRUCH_BIT_WS_DKI" 512 "ABBRUCH_BIT_WS_STATUS_HAS" 1024 "ABBRUCH_BIT_WS_K0" 2048 "ABBRUCH_BIT_WS_Z_MODUS_IAE" 4096 "ABBRUCH_BIT_WS_ALLG_ADA" 8192 "ABBRUCH_BIT_GLOBAL_Z_IEA" 16384 "ABBRUCH_BIT_GLOBAL_M_MOT" 32768 "ABBRUCH_BIT_GLOBAL_MG_MOT" 65536 "ABBRUCH_BIT_GLOBAL_NG_MOT" 131072 "ABBRUCH_BIT_GLOBAL_N_AB" 262144 "ABBRUCH_BIT_GLOBAL_P_BREMS" 524288 "ABBRUCH_BIT_GLOBAL_PG_BREMS" 1048576 "ABBRUCH_BIT_GLOBAL_ISTGANG" 2097152 "ABBRUCH_BIT_GLOBAL_KFL" 4194304 "ABBRUCH_BIT_GLOBAL_N_MOT_SOLL" 8388608 "ABBRUCH_BIT_GLOBAL_STATUS_HAS" 16777216 "ABBRUCH_BIT_GLOBAL_IEP" 33554432 "ABBRUCH_BIT_GLOBAL_K0" 67108864 "ABBRUCH_BIT_GLOBAL_Z_MODUS_IAE" 134217728 "ABBRUCH_BIT_GLOBAL_M_STELL" 268435456 "ABBRUCH_BIT_GLOBAL_ALLG_ADA" 536870912 "ABBRUCH_BIT_GLOBAL_AUTO_BLS" /end COMPU_VTAB
/begin COMPU_VTAB Conv.cAdaIaeApKorr._.apada_iae_aktive_adaption_S6_S3 "Umrechnung fuer Messgroesse cAdaIaeApKorr::apada_iae_aktive_adaption" TAB_VERB 3 0 "ADA_IAE_AP_AKTIV_KEINE" 1 "ADA_IAE_AP_AKTIV_IAE" 2 "ADA_IAE_AP_AKTIV_IEP" /end COMPU_VTAB
/begin COMPU_VTAB Conv.cAdaIaeApKorr._.req_n_mot_llsoll_iae_S6_S3 "Umrechnung fuer Messgroesse cAdaIaeApKorr::req_n_mot_llsoll_iae" TAB_VERB 3 0 "" 1 "" 3 "" /end COMPU_VTAB
/begin COMPU_VTAB Conv.cAdaIaeApIae._.z_apada_iae_S6_S3 "Umrechnung fuer Messgroesse cAdaIaeApIae::z_apada_iae" TAB_VERB 12 0 "Z_ADA_IAE_PASSIV" 4 "Z_ADA_IAE_ABSENKEN_START" 5 "Z_ADA_IAE_ABSENKEN_KONST" 6 "Z_ADA_IAE_ABSENKEN_UEF" 7 "Z_ADA_IAE_PRUEFRAMPE" 8 "Z_ADA_IAE_HYS_SCHLEIFE_AB" 9 "Z_ADA_IAE_HYS_SCHLEIFE_KONST" 10 "Z_ADA_IAE_HYS_SCHLEIFE_AUF" 11 "Z_ADA_IAE_WARTEN_MMOT_PRUEFUNG" 12 "Z_ADA_IAE_MMOT_PRUEFUNG" 13 "Z_ADA_IAE_ABBRUCH_RAMPE" 14 "Z_ADA_IAE_ENDE" /end COMPU_VTAB
/begin COMPU_VTAB Conv.cAdaIaeApIae._.f_req_ada_iae_S6_S3 "Umrechnung fuer Messgroesse cAdaIaeApIae::f_req_ada_iae" TAB_VERB 2 0 "FALSE" 1 "TRUE" /end COMPU_VTAB
/begin COMPU_VTAB Conv.cAdaIaeApIae._.f_angelegt_mmot_iae_S6_S3 "Umrechnung fuer Messgroesse cAdaIaeApIae::f_angelegt_mmot_iae" TAB_VERB 2 0 "FALSE" 1 "TRUE" /end COMPU_VTAB
/begin COMPU_VTAB Conv.cAdaIaeApIae._.f_rampinit_iae_S6_S3 "Umrechnung fuer Messgroesse cAdaIaeApIae::f_rampinit_iae" TAB_VERB 2 0 "FALSE" 1 "TRUE" /end COMPU_VTAB
/begin COMPU_VTAB Conv.cAdaIaeApIae._.f_bew_verboten_iae_S6_S3 "Umrechnung fuer Messgroesse cAdaIaeApIae::f_bew_verboten_iae" TAB_VERB 2 0 "FALSE" 1 "TRUE" /end COMPU_VTAB
/begin COMPU_VTAB Conv.cAdaIaeApIae._.f_abbruch_global_iae_S6_S3 "Umrechnung fuer Messgroesse cAdaIaeApIae::f_abbruch_global_iae" TAB_VERB 2 0 "FALSE" 1 "TRUE" /end COMPU_VTAB
/begin COMPU_VTAB Conv.cAdaIaeApIae._.req_n_mot_llsoll_iae_S6_S3 "Umrechnung fuer Messgroesse cAdaIaeApIae::req_n_mot_llsoll_iae" TAB_VERB 2 0 "" 1 "" /end COMPU_VTAB
/begin COMPU_VTAB Conv.cAdaIaeApIae._.ada_starttyp_pf_S6_S3 "Umrechnung fuer Messgroesse cAdaIaeApIae::ada_starttyp_pf" TAB_VERB 5 0 "KBPTYP_KEINE" 1 "KBPTYP_START" 2 "KBPTYP_HAUPT" 3 "KBPTYP_SCHLECHTWEGE" 4 "KBPTYP_INAKTIV" /end COMPU_VTAB
/begin COMPU_VTAB Conv.cAdaIaeApIep._.z_apada_iep_S6_S3 "Umrechnung fuer Messgroesse cAdaIaeApIep::z_apada_iep" TAB_VERB 5 0 "Z_ADA_IAE_AP_IEP_PASSIV" 4 "Z_ADA_IAE_AP_IEP_M_MOT_REF" 5 "Z_ADA_IAE_AP_IEP_N_MOT_ABSENKEN" 6 "Z_ADA_IAE_AP_IEP_M_MOT_IEP" 14 "Z_ADA_IAE_AP_IEP_ENDE" /end COMPU_VTAB
/begin COMPU_VTAB Conv.cAdaIaeApIep._.f_req_ada_iep_iae_S6_S3 "Umrechnung fuer Messgroesse cAdaIaeApIep::f_req_ada_iep_iae" TAB_VERB 2 0 "FALSE" 1 "TRUE" /end COMPU_VTAB
/begin COMPU_VTAB Conv.cAdaIaeApIep._.f_abbruch_global_iae_S6_S3 "Umrechnung fuer Messgroesse cAdaIaeApIep::f_abbruch_global_iae" TAB_VERB 2 0 "FALSE" 1 "TRUE" /end COMPU_VTAB
/begin COMPU_VTAB Conv.cAdaIaeApIep._.adkl_iep_S6_S3 "Umrechnung fuer Messgroesse cAdaIaeApIep::adkl_iep" TAB_VERB 4 1 "ADA_IAE_AP_IEP_ADKL_1" 2 "ADA_IAE_AP_IEP_ADKL_2" 3 "ADA_IAE_AP_IEP_ADKL_3" 4 "ADA_IAE_AP_IEP_ADKL_4" /end COMPU_VTAB
/begin COMPU_VTAB Conv.cAdaIaeApIep._.req_n_mot_llsoll_iae_S6_S3 "Umrechnung fuer Messgroesse cAdaIaeApIep::req_n_mot_llsoll_iae" TAB_VERB 2 0 "" 3 "" /end COMPU_VTAB
/begin COMPU_VTAB Conv.cAdaIaeuf._.f_read_kf_gueltig_S6_S3 "Umrechnung fuer Messgroesse cAdaIaeuf::f_read_kf_gueltig" TAB_VERB 2 0 "FALSE" 1 "TRUE" /end COMPU_VTAB
/begin COMPU_VTAB Conv.cAdaIaeuf._.f_ada_sperren_werteuebername_S6_S3 "Umrechnung fuer Messgroesse cAdaIaeuf::f_ada_sperren_werteuebername" TAB_VERB 2 0 "FALSE" 1 "TRUE" /end COMPU_VTAB
/begin COMPU_VTAB Conv.cNvrKoordinator._.ee_management_status_S6_S3 "Umrechnung fuer Messgroesse cNvrKoordinator::ee_management_status" TAB_VERB 8 1 "Auswertung Zustand des Spiegek-Speichers" 2 "Spiegel Speicher abhaengig vom Zustand einrichten1" 3 "Spiegel Speicher abhaengig vom Zustand einrichten2" 4 "Spiegel Speicher abhaengig vom Zustand einrichten3" 5 "Normal Betrieb = zyklische Checksummenpruefung" 6 "mit SWI_EEPROM_CHECKSUMMe = 2 wird einmalig Checksumme/Pruefpattern neu berechnet" 7 "keine Schreibzugriff erlaubt" 8 "Warten auf das Abschalten der EGS" /end COMPU_VTAB
/begin COMPU_VTAB Conv.cNvrKoordinator._.ee_anzeige_block_history_S6_S3 "Umrechnung fuer Messgroesse cNvrKoordinator::ee_anzeige_block_history" TAB_VERB 11 0 "undefiniert" 1 "Block Valid i.O. - es wurden keine Daten angefordert" 2 "Block Valid i.O. trotzdem Fehler entdeckt - sollte nie vorkommen" 3 "Block Valid nicht i.O. - es wurden ungeultige Daten vom EEPROM kopiert" 4 "Block Valid nicht i.O. - es wurden gueltige Daten vom EEPROM kopiert" 5 "keine Pruefung und Init - nach Reset moeglich" 6 "keine Pruefung aber i.O. - nach Reset moeglich" 7 "Urstart erkannt und Block neu initialisiert" 8 "Block bereits freigegeben - nach Reset moeglich" 9 "Block Zustandsfehler - sollte nie auftreten" 10 "SWI_EEPROM_INIt = 2 - Block initialisieren" /end COMPU_VTAB
/begin COMPU_VTAB Conv.cNvrKoordinator._.ee_systemstart_ueber_reset_S6_S3 "Umrechnung fuer Messgroesse cNvrKoordinator::ee_systemstart_ueber_reset" TAB_VERB 3 0 "undefiniert" 1 "Systemstart ueber Reset sicher erkannt" 2 "Systemstart war sicher kein Reset" /end COMPU_VTAB
/begin FUNCTION ADA_PFUSF "In ADA_PFUSF sind die Adaptionsfunktionen zur TSF-Prüfung enthalten"
 /begin LOC_MEASUREMENT iAdaPfusf.ada_starttyp_pf iAdaPfusf.ada_wert_pfad iAdaPfusf.adapfn_status iAdaPfusf.adkl_pfad iAdaPfusf.bew_fuer_adkl_pfad iAdaPfusf.cycle_count_pfad iAdaPfusf.dki_pfad iAdaPfusf.f_adapfn_status iAdaPfusf.f_max_flare_erreicht_hs_pfad iAdaPfusf.f_mt_krit_aktiv_pfad iAdaPfusf.freigabe_e_h iAdaPfusf.hsad_verbotqsx iAdaPfusf.kup_pfad iAdaPfusf.m_t_pfad iAdaPfusf.n_f_alt.letzter_ms_timer iAdaPfusf.n_f_alt.n_f iAdaPfusf.n_tsync_pfad iAdaPfusf.nd_syn_istgang_min_pfad iAdaPfusf.nd_syn_istgang_pfad iAdaPfusf.ng_ab_pfad iAdaPfusf.pgls_speicher_pfad iAdaPfusf.pm_gls_pfad iAdaPfusf.pm_gls_status iAdaPfusf.schaltart_pfad iAdaPfusf.schaltcode_pfad iAdaPfusf.t_bezug_pfad iAdaPfusf.t_mess_pfad iAdaPfusf.td_pfad iAdaPfusf.td_pfadtsyn iAdaPfusf.timer_pfad iAdaPfusf.z_adapfn_status iAdaPfusf.z_pfad_cgt_adkl_kup_pfad /end LOC_MEASUREMENT
/end FUNCTION
/begin FUNCTION ADA_STADA "Stillstandsadaption: Pulspruefung im Stillstand aufgrund Testeranforderung." /begin SUB_FUNCTION PRUEFABLAUFE SYSTEMKONDITIONIERUNG BASISFUNKTON /end SUB_FUNCTION /end FUNCTION
/begin FUNCTION PRUEFABLAUFE "Berechung der Druckverläufe und bewertung der Systemreakton"
 /begin LOC_MEASUREMENT iAdaPstzs.iBew.amplitude_ss_stada iAdaPstzs.iBew.iFensterNeg.f_aktiv_stada iAdaPstzs.iBew.iFensterNeg.f_beenden_stada iAdaPstzs.iBew.iFensterNeg.f_starten_stada iAdaPstzs.iBew.iFensterNeg.iTimerBeenden.timer iAdaPstzs.iBew.iFensterNeg.iTimerStarten.timer iAdaPstzs.iBew.iFensterPos.f_aktiv_stada iAdaPstzs.iBew.iFensterPos.f_beenden_stada iAdaPstzs.iBew.iFensterPos.f_starten_stada iAdaPstzs.iBew.iFensterPos.iTimerBeenden.timer iAdaPstzs.iBew.iFensterPos.iTimerStarten.timer iAdaPstzs.iBew.iTimerAmp.timer iAdaPstzs.iBew.max_adawert_stada iAdaPstzs.iBew.n_guete_min_stada iAdaPstzs.iBew.nd_pulsamp_stada iAdaPstzs.iBew.nd_pulsneg_stada iAdaPstzs.iBew.nd_pulspos_stada iAdaPstzs.iBew.nd_pulszwneg_stada iAdaPstzs.iBew.nd_pulszwpos_stada iAdaPstzs.iBew.neg_rea_stada iAdaPstzs.iBew.pos_rea_stada iAdaPstzs.iBew.rea_amplitude_stada iAdaPstzs.iBew.testresultat_stada iAdaPstzs.iBew.zeit_erk_amp_stada iAdaPstzs.iBew.zustand_stada iAdaPstzs.iPf.f_deakt_dither_stada iAdaPstzs.iPf.fenster_nach_sf_stada iAdaPstzs.iPf.fenster_sf_stada iAdaPstzs.iPf.iZustandstimerStada.timer iAdaPstzs.iPf.kup_puls_stada iAdaPstzs.iPf.t_fenster_nach_sf_stada iAdaPstzs.iPf.t_fenster_sf_stada iAdaPstzs.iPf.zustand_stada iAdaPstzs.iTSf.kup_puls_stada iAdaPstzs.iTSf.zustand_stada /end LOC_MEASUREMENT
/end FUNCTION
/begin FUNCTION SYSTEMKONDITIONIERUNG "Funktionen zur vorbereitung des Getriebes auf Prüfablauf Leergelaufene Kupplungen befüllen"
 /begin LOC_MEASUREMENT iAdaPstSysAgl.akt_ada iAdaPstSysAgl.z_systemkondit_agl iAdaPstSysFunkdeakt.akt_ada iAdaPstSysFunkdeakt.z_systemkondit_funkdeakt iAdaPstSysK0.akt_ada iAdaPstSysKup.akt_ada iAdaPstSysKup.sal_eng_start_req iAdaPstSysKup.sal_eng_stop_disable iAdaPstSysKup.z_k0_stada iAdaPstSysNmot.akt_ada iAdaPstSysNmot.f_nmotsoll_stada_em iAdaPstSysNmot.timer_nmotleersoll_aktiv_stada.timer iAdaPstSysNmot.z_systemkondit_nmot iAdaPstSysPsys.akt_ada iAdaPstSysPsys.f_psys_anforderung_stada iAdaPstSysPsys.z_systemkondit_psys iAdaPstSysZzs.akt_ada iAdaPstSysZzs.gang_zzs_stada iAdaPstSysZzs.z_systemkondit_zzs iAdaPstzs.iPre.iRampeAb.letzter_timer iAdaPstzs.iPre.iRampeAb.letzter_wert iAdaPstzs.iPre.iRampeAuf.letzter_ms_timer iAdaPstzs.iPre.iRampeAuf.letzter_wert iAdaPstzs.iPre.iRampeAuf.maximum iAdaPstzs.iPre.iRampeAuf.minimum iAdaPstzs.iPre.iZustandstimerStada.timer iAdaPstzs.iPre.kup_puls_stada iAdaPstzs.iPre.p_pre_puls_stada iAdaPstzs.iPre.t_ra_vorstada_ab iAdaPstzs.iPre.t_ra_vorstada_auf iAdaPstzs.iPre.zustand_stada /end LOC_MEASUREMENT
/end FUNCTION
/begin FUNCTION BASISFUNKTON "Zentraler Abalfu der STADA und Schnittstellen zur Testerkomunikation"
 /begin LOC_MEASUREMENT iAdaPstCondition.preadaption_condition_stada iAdaPstCondition.preadaption_condition_stada_int iAdaPstState.preadaption_state_stada iAdaPstUserinfo.preadaption_userinfo_stada iAdaPstzs.akt_ada iAdaPstzs.anz_durchgefuehrt_stada iAdaPstzs.anz_kup_puls_stada iAdaPstzs.anz_n_pruefschleife_stada iAdaPstzs.anz_n_pulsgrenz_stada iAdaPstzs.anz_pf_adawert_stada iAdaPstzs.anz_pf_counter_stada iAdaPstzs.anz_prueftyp_stada iAdaPstzs.anz_pulsid_stada iAdaPstzs.anz_tsf_adawert_stada iAdaPstzs.anz_tsf_counter_stada iAdaPstzs.anz_zwsp_pf_stada iAdaPstzs.anz_zwsp_tsf_stada iAdaPstzs.druck_statisch_stada iAdaPstzs.f_deaktivierung_erkannt iAdaPstzs.f_red_bef_kup iAdaPstzs.fzg_stillstand_k0_stada iAdaPstzs.fzg_stillstand_stada iAdaPstzs.grundbedingung_erfuellt_einmalig_k0_stada iAdaPstzs.grundbedingung_erfuellt_einmalig_stada iAdaPstzs.grundbedingung_erfuellt_zyklisch_k0_stada iAdaPstzs.grundbedingung_erfuellt_zyklisch_stada iAdaPstzs.iBew.amplitude_ss_stada iAdaPstzs.iBew.iFensterNeg.f_aktiv_stada iAdaPstzs.iBew.iFensterNeg.f_beenden_stada iAdaPstzs.iBew.iFensterNeg.f_starten_stada iAdaPstzs.iBew.iFensterNeg.iTimerBeenden.timer iAdaPstzs.iBew.iFensterNeg.iTimerStarten.timer iAdaPstzs.iBew.iFensterPos.f_aktiv_stada iAdaPstzs.iBew.iFensterPos.f_beenden_stada iAdaPstzs.iBew.iFensterPos.f_starten_stada iAdaPstzs.iBew.iFensterPos.iTimerBeenden.timer iAdaPstzs.iBew.iFensterPos.iTimerStarten.timer iAdaPstzs.iBew.iTimerAmp.timer iAdaPstzs.iBew.max_adawert_stada iAdaPstzs.iBew.n_guete_min_stada iAdaPstzs.iBew.nd_pulsamp_stada iAdaPstzs.iBew.nd_pulsneg_stada iAdaPstzs.iBew.nd_pulspos_stada iAdaPstzs.iBew.nd_pulszwneg_stada iAdaPstzs.iBew.nd_pulszwpos_stada iAdaPstzs.iBew.neg_rea_stada iAdaPstzs.iBew.pos_rea_stada iAdaPstzs.iBew.rea_amplitude_stada iAdaPstzs.iBew.testresultat_stada iAdaPstzs.iBew.zeit_erk_amp_stada iAdaPstzs.iBew.zustand_stada iAdaPstzs.iPf.f_deakt_dither_stada iAdaPstzs.iPf.fenster_nach_sf_stada iAdaPstzs.iPf.fenster_sf_stada iAdaPstzs.iPf.iZustandstimerStada.timer iAdaPstzs.iPf.kup_puls_stada iAdaPstzs.iPf.t_fenster_nach_sf_stada iAdaPstzs.iPf.t_fenster_sf_stada iAdaPstzs.iPf.zustand_stada iAdaPstzs.iPre.iRampeAb.letzter_timer iAdaPstzs.iPre.iRampeAb.letzter_wert iAdaPstzs.iPre.iRampeAuf.letzter_ms_timer iAdaPstzs.iPre.iRampeAuf.letzter_wert iAdaPstzs.iPre.iRampeAuf.maximum iAdaPstzs.iPre.iRampeAuf.minimum iAdaPstzs.iPre.iZustandstimerStada.timer iAdaPstzs.iPre.kup_puls_stada iAdaPstzs.iPre.p_pre_puls_stada iAdaPstzs.iPre.t_ra_vorstada_ab iAdaPstzs.iPre.t_ra_vorstada_auf iAdaPstzs.iPre.zustand_stada iAdaPstzs.iTMaxInitStada.timer iAdaPstzs.iTSf.kup_puls_stada iAdaPstzs.iTSf.zustand_stada iAdaPstzs.iVerbotRedBef_stada.puls_verb_redbef iAdaPstzs.iZustandstimerStada.timer iAdaPstzs.kup_pruefpuls_ausgabe_stada iAdaPstzs.kup_puls_stada iAdaPstzs.n_mot_start iAdaPstzs.n_pruefschleife_stada iAdaPstzs.n_pulsgrenz_stada iAdaPstzs.p_pulsausgabe_stada iAdaPstzs.pre_ada_zustand_stada iAdaPstzs.pulsid_stada iAdaPstzs.pulszyklus_beenden_stada iAdaPstzs.schnellfuellung_aktiv_stada iAdaPstzs.testfall_gang_stada iAdaPstzs.testfall_prueftyp_stada iAdaPstzs.zeit_sf_10ms_stada iAdaPstzs.zeit_sf_1ms_stada iAdaPstzs.zustand_stada iAdaPstzs.zwsp_pf_stada iAdaPstzs.zwsp_tsf_stada /end LOC_MEASUREMENT
/end FUNCTION
/begin FUNCTION ADA_URLUFT "Urlufterkennung: Es wird während Schaltung und während einer Pulsprüfung detektiert ob aufgrund von Urluft ein falscher Schnellfüllwert adaptiert wurde."
 /begin LOC_MEASUREMENT iAdaUrlufterkPuls.iZeitfenster.timer iAdaUrlufterkPuls.istgang_start iAdaUrlufterkPuls.kfl_ist_start iAdaUrlufterkPuls.kup iAdaUrlufterkPuls.prueftyp iAdaUrlufterkPuls.zustand iAdaUrlufterkPulsAnz.f_loeschen_puls_url iAdaUrlufterkPulsAnz.kup_puls_url iAdaUrlufterkPulsAnz.n_guete_puls_url iAdaUrlufterkPulsAnz.t_zeitfenster_puls_url iAdaUrlufterkSchaltung.iSignal.f_grad_inti iAdaUrlufterkSchaltung.iSignal.f_pt1_inti iAdaUrlufterkSchaltung.iSignal.f_signal_ungueltig iAdaUrlufterkSchaltung.iSignal.filt_gradient iAdaUrlufterkSchaltung.iSignal.iPt1.x iAdaUrlufterkSchaltung.iSignal.rowert_gradient iAdaUrlufterkSchaltung.iSignal.rowert_signal iAdaUrlufterkSchaltung.iSignal.sig_grad iAdaUrlufterkSchaltung.iSignal.sig_grad_alt iAdaUrlufterkSchaltung.iSignal.sig_grad_diff iAdaUrlufterkSchaltung.iSignal.signal_quelle iAdaUrlufterkSchaltung.iSignal.signal_quelle_alt iAdaUrlufterkSchaltung.iZeitfenster.timer iAdaUrlufterkSchaltung.kup iAdaUrlufterkSchaltung.m_motist_start iAdaUrlufterkSchaltung.zustand iAdaUrlufterkSchaltungAnz.f_loeschen_schalung_url iAdaUrlufterkSchaltungAnz.kup_schaltung_url iAdaUrlufterkSchaltungAnz.m_motist_start_schaltung_url iAdaUrlufterkSchaltungAnz.ng_schaltung_url iAdaUrlufterkSchaltungAnz.t_zeitfenster_schaltung_url /end LOC_MEASUREMENT
/end FUNCTION
/begin FUNCTION ADA_SAS "In ADA_SAS sind schaltungsbezogene Adaptionsfunktionen enthalten"
 /begin LOC_MEASUREMENT iAdaGlast.adaps_status iAdaGlast.bew_erl_schaltinfo iAdaGlast.bew_index iAdaGlast.bew_kennfeld iAdaGlast.bew_kennfeld_lesen iAdaGlast.bew_kup iAdaGlast.bew_schaltcode iAdaGlast.bew_schaltcode_lesen iAdaGlast.bew_schalttyp iAdaGlast.bew_schalttyp_lesen iAdaGlast.bfl_adadruck iAdaGlast.con_cycle_count iAdaGlast.dki_abbrschwelle iAdaGlast.f_e_fahren_aktiv_schaltbeginn iAdaGlast.f_gls_trimm_gls_schwelle_kf1 iAdaGlast.f_gls_trimm_gls_schwelle_kf2 iAdaGlast.f_gls_trimm_kup_schwelle iAdaGlast.gls_ada_state iAdaGlast.gls_adbr iAdaGlast.gls_dki_schaltbeginn iAdaGlast.gls_flag_abbruch_wg_adapfn iAdaGlast.gls_trimm_spont_beeinflussung iAdaGlast.gls_trimm_verbot_versch_rs iAdaGlast.glsbew_fuer_adbr iAdaGlast.mt_adbr iAdaGlast.nt_adbr iAdaGlast.pgls_speicher iAdaGlast.pm_gls iAdaGlast.pm_gls_korr iAdaGlast.ps_adadruck iAdaGlast.ps_adadruck_kalt iAdaGlast.ps_adadruck_warm iAdaGlast.status_ausgabe_verzoegern iAdaGlast.warm_kalt_kennfeld_lesen iAdaGlast.warm_kalt_kennfeld_schreiben /end LOC_MEASUREMENT
/end FUNCTION
/begin FUNCTION ADA_GLOBAL "Adaptionsübergreifende Funktionen"
 /begin LOC_MEASUREMENT iAdaGlosc.FiAxRefAdaOff.x iAdaGlosc.ada_iae_info iAdaGlosc.ada_istgang iAdaGlosc.ada_k_zu iAdaGlosc.ada_p_gls_kab iAdaGlosc.ada_p_gls_kab_1mbar iAdaGlosc.ada_p_gls_kzu iAdaGlosc.ada_p_gls_kzu_1mbar iAdaGlosc.ada_schaltart iAdaGlosc.ada_schaltinfo iAdaGlosc.ada_schaltung_kzu iAdaGlosc.ada_schaltungs_index iAdaGlosc.ada_synchron iAdaGlosc.ada_version iAdaGlosc.ada_zielgang iAdaGlosc.adabew_verbot_sas iAdaGlosc.adaption_counter iAdaGlosc.ax_ref_gef_ada iAdaGlosc.bew_verbot_laengs_beschl iAdaGlosc.f_ada_bew_verboten iAdaGlosc.f_aenderung_adaram_daten iAdaGlosc.f_letzte_schaltung_rs iAdaGlosc.flag_alaengs_adaoff iAdaGlosc.flag_allada_del iAdaGlosc.init_mit_azg iAdaGlosc.z_ada_schaltung /end LOC_MEASUREMENT
/end FUNCTION
/begin FUNCTION ADA_IAE "In ADA_IAE sind Adaptionsfunktionen zur integrierten Anfahrelement enthalten"
 /begin LOC_MEASUREMENT iAdaIaeApIae.RampeAdaIae.letzter_ms_timer iAdaIaeApIae.RampeAdaIae.letzter_wert iAdaIaeApIae.RampeAdaIae.maximum iAdaIaeApIae.RampeAdaIae.minimum iAdaIaeApIae.TimerAdaIae.time iAdaIaeApIae.TimerKriterienAdaIae.time iAdaIaeApIae.TimerMaxWartenAdaIae.time iAdaIaeApIae.ada_starttyp_pf iAdaIaeApIae.ada_wert_iae iAdaIaeApIae.c_getr_ref_iae iAdaIaeApIae.delta_anlege_druck_iae iAdaIaeApIae.f_abbruch_global_iae iAdaIaeApIae.f_angelegt_mmot_iae iAdaIaeApIae.f_bew_verboten_iae iAdaIaeApIae.f_rampinit_iae iAdaIaeApIae.f_req_ada_iae iAdaIaeApIae.m_mot_ref_ada_iae iAdaIaeApIae.md_mot_ada_iae iAdaIaeApIae.pg_rampe_ada_iae iAdaIaeApIae.po_n_ada_iae iAdaIaeApIae.po_rampen_init iAdaIaeApIae.po_stell_ada_iae iAdaIaeApIae.po_uef_start iAdaIaeApIae.po_uef_ziel iAdaIaeApIae.req_n_mot_llsoll_iae iAdaIaeApIae.summe_m_motist_ada_iae iAdaIaeApIae.z_apada_iae iAdaIaeApIep.TimerAdaIaeApIep.time iAdaIaeApIep.TimerAdaIaeApIepMaxAbsenken.time iAdaIaeApIep.adkl_iep iAdaIaeApIep.counter_m_mot_aperk_iep_iae iAdaIaeApIep.cs_1_aperk_iae iAdaIaeApIep.cs_2_aperk_iae iAdaIaeApIep.cs_3_aperk_iae iAdaIaeApIep.f_abbruch_global_iae iAdaIaeApIep.f_req_ada_iep_iae iAdaIaeApIep.m_mot_iep_aperk_iep_iae iAdaIaeApIep.m_mot_ref_aperk_iep_iae iAdaIaeApIep.md_mot_aperk_iep_iae iAdaIaeApIep.req_n_mot_llsoll_iae iAdaIaeApIep.summe_m_mot_aperk_iep_iae iAdaIaeApIep.z_apada_iep iAdaIaeApKorr.FiMGMotIstAdaIae.x iAdaIaeApKorr.FiMGMotIstAdaIae.xp iAdaIaeApKorr.FiMMotIstAdaIae.x iAdaIaeApKorr.FiMMotIstAdaIaeFloat.x iAdaIaeApKorr.FiNGMotAdaIae.x iAdaIaeApKorr.FiNGMotAdaIae.xp iAdaIaeApKorr.FiNMotAdaIae.x iAdaIaeApKorr.FiNMotAdaIaeFloat.x iAdaIaeApKorr.TimerAdaIaeApKorr.time iAdaIaeApKorr.TimerMaxWartenAdaIaeApKorr.time iAdaIaeApKorr.abbruch_bit_ada_iae iAdaIaeApKorr.ada_wert_ap_iae iAdaIaeApKorr.ada_wert_ap_iep_iae iAdaIaeApKorr.apada_iae_aktive_adaption iAdaIaeApKorr.m_motist_ada_iae iAdaIaeApKorr.m_motist_ff_ada_iae iAdaIaeApKorr.m_mw_motist_aperk_iae iAdaIaeApKorr.m_schlepp_ada_iae iAdaIaeApKorr.m_stell_start_ada_iae iAdaIaeApKorr.mg_motist_ada_iae iAdaIaeApKorr.n_mot_ada_iae iAdaIaeApKorr.n_mot_ff_ada_iae iAdaIaeApKorr.n_mot_soll_ada_iae iAdaIaeApKorr.n_mot_soll_leer_start iAdaIaeApKorr.ng_mot_ada_iae iAdaIaeApKorr.po_ada_iae iAdaIaeApKorr.req_n_mot_llsoll_iae iAdaIaeApKorr.summe_m_motist_ada_iae iAdaIaeApKorr.z_apada_korr iAdaIaeuf.adbr_lesen iAdaIaeuf.adbr_schreiben iAdaIaeuf.f_ada_sperren_werteuebername iAdaIaeuf.f_read_kf_gueltig /end LOC_MEASUREMENT
/end FUNCTION
/begin FUNCTION NVR "Das Paket NVR enthält alle Klassen und Funktionalitäten, welche zur Ansteuerung des Non Volatile Rams (EEprom) notwendig sind."
 /begin LOC_MEASUREMENT AdaGlsDHS.KF1.BewSchaltCtr AdaGlsDHS.KF1.Speicher AdaGlsDHS.KaltKF1.BewSchaltCtr AdaGlsDHS.KaltKF1.Speicher AdaGlsDRS.KF1.BewSchaltCtr AdaGlsDRS.KF1.Speicher AdaGlsEHS.KF1.BewSchaltCtr AdaGlsEHS.KF1.Speicher AdaGlsEHS.KF2.BewSchaltCtr AdaGlsEHS.KF2.Speicher AdaGlsEHS.KF3.BewSchaltCtr AdaGlsEHS.KF3.Speicher AdaGlsEHS.KaltKF1.BewSchaltCtr AdaGlsEHS.KaltKF1.Speicher AdaGlsEHS.KaltKF2.BewSchaltCtr AdaGlsEHS.KaltKF2.Speicher AdaGlsEHS.KaltKF3.BewSchaltCtr AdaGlsEHS.KaltKF3.Speicher AdaGlsERS.KF1.BewSchaltCtr AdaGlsERS.KF1.Speicher AdaGlsERS.KF2.BewSchaltCtr AdaGlsERS.KF2.Speicher AdaGlsNFRS.KF1.BewSchaltCtr AdaGlsNFRS.KF1.Speicher AdaIae.Daten.BewCtr AdaIae.Daten.BewCtrIep AdaIae.Daten.IepBetrCtr AdaIae.Daten.IepSpeicher AdaIae.Daten.Speicher AdaIae.Iae.AnfahrCtr AdaIae.Kup.SchaltCtr AdaIaeuf.Daten.Speicher AdaIaeufRead.Daten.Speicher AdaK0.PF.PruefCtr AdaK0.PF.PruefStartCtr AdaK0.PF.SchaltCtr AdaK0.PF.Speicher AdaK0.TSF.PruefCtr AdaK0.TSF.SchaltCtr AdaK0.TSF.Speicher AdaK0.Timer.Lock AdaK0.Timer.Maxlock AdaK0Kalt.PF.PruefCtr AdaK0Kalt.PF.SchaltCtr AdaK0Kalt.PF.Speicher AdaKup.AdaBE.GlsKf1 AdaKup.AdaBE.GlsKf2 AdaKup.AdaBE.GlsKf3 AdaKup.PF.PruefCtr AdaKup.PF.PruefStartCtr AdaKup.PF.SchaltCtr AdaKup.PF.Speicher AdaKup.TSF.PruefCtr AdaKup.TSF.SchaltCtr AdaKup.TSF.Speicher AdaKupKalt.AdaBE.GlsKf1 AdaKupKalt.AdaBE.GlsKf2 AdaKupKalt.AdaBE.GlsKf3 AdaKupKalt.PF.PruefCtr AdaKupKalt.PF.SchaltCtr AdaKupKalt.PF.Speicher BPDaten.SchlafMV.ResetErkennungPosVUeb IAE.Std.CIaeAbstell Kanal.Test.EndeEE MvG.AnzSchleppstart.Ctr MvG.Betriebspunkt.Ctr MvG.GetrTemp.Ctr MvG.HisSpeicherLoesen.Ctr MvG.IaeBelastung.Ctr MvG.IaeTemp.Ctr MvG.IaeZustand.Ctr MvG.IepBetriebsstunden.Ctr MvG.K0BelagTemp.Ctr MvG.K0Belastung.Ctr MvG.K0Zustand.Ctr MvG.KflWechsel.Ctr MvG.KupTemp.Ctr MvG.MotorStartTemp.Ctr MvG.Schaltungen.Ctr NoIni.MOBEF.MESchlupfCounter NoIni.MvG.Version Nvr.Verwaltung.Versionierung PulsAda.Daten.NPruefschleife PulsAda.Daten.NPruefzyklen PulsAda.Daten.NPulsgrenz PulsAda.Daten.Prueftyp PulsAda.Daten.Pulsid PulsAda.Daten.ZwSpPf PulsAda.Daten.ZwSpTsf PulsAdaKalt.Daten.NPruefschleife PulsAdaKalt.Daten.NPruefzyklen PulsAdaKalt.Daten.NPulsgrenz PulsAdaKalt.Daten.Prueftyp PulsAdaKalt.Daten.Pulsid PulsAdaKalt.Daten.ZwSpPf PulsAdaKalt.Daten.ZwSpTsf Sonstige.InfoSpeicher.Eintrag Sonstige.InfoSpeicher.Init Sonstige.InfoSpeicher.Zaehler Sonstige.Itf.AbstellTemperatur Sonstige.Itf.Dummy Sonstige.PosVUew.Zaehler Sonstige.Test.StartEE StadaK0.Daten.PF StadaK0.Daten.TSF StadaKup.Daten.PF StadaKup.Daten.TSF Temp.Stada.preadaption_finish_counter Ueberwachungen.Parksperrenmagnet.TmaxPmueb /end LOC_MEASUREMENT
 /begin SUB_FUNCTION EEPROM_V2 /end SUB_FUNCTION
/end FUNCTION
/begin FUNCTION EEPROM_V2 "EEPROM Management Version 2"
 /begin LOC_MEASUREMENT iNvrInSWP.ee_urstart_info_eeprom iNvrInSWP.f_externer_loesch_auftrag iNvrInSWP.n_aufruf_eeprom_default iNvrInSWP.n_aufruf_eeprom_update iNvrInSWP.n_aufruf_eeprom_valid iNvrInSWP.n_aufruf_statistics_update iNvrInSWP.n_aufruf_statistics_valid iNvrKoordinator.ee_anzeige_block_history iNvrKoordinator.ee_management_status iNvrKoordinator.ee_systemstart_ueber_reset /end LOC_MEASUREMENT
/end FUNCTION
/begin FUNCTION KAS "Das Paket KAS (Kupplungsansteuerung ausserhalb Schaltung) enthält alle Klassen und Funktionalitäten, welche einen regelnden Zugriff auf die Schaltkupplung benötigen." /begin SUB_FUNCTION KAS_KOORDINATOR KAS_BIBLIO IAE /end SUB_FUNCTION /end FUNCTION
/end MODULE
/end PROJECT
