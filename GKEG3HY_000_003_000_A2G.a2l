ASAP2_VERSION 1 51
/begin PROJECT _929_929 "Gen2_BMW_System_Supplier_Lib"
/begin HEADER "" VERSION "C_03_03" PROJECT_NO _929_929 /end HEADER
/begin MODULE DIM ""
/begin MOD_COMMON "" BYTE_ORDER MSB_FIRST ALIGNMENT_BYTE 1 ALIGNMENT_WORD 2 ALIGNMENT_LONG 4 ALIGNMENT_FLOAT32_IEEE 4 /end MOD_COMMON
/begin CHARACTERISTIC BM_NMINEMABMODUS1_LLS_HAS "Bitmaske zur Festlegung, welche aktuell relevante
Einzelfunktionen der Leerlaufsimulation der HAS zu
einem Drehzahlabbau im Modus1 fuehrt (schnell) -
Codierung wie z_lls_fktaktiv_has_sbe" VALUE 0x264544 ULONG_COL_DIRECT_M_S7_S3 0 void_int_f_M_S7_S3 0 4294967295 /end CHARACTERISTIC
/begin CHARACTERISTIC BM_NMINEMMODUS1_LLS_HAS "Bitmaske zur Festlegung, welche aktuell relevante Einzelfunktionen der Leerlaufsimulation der HAS zu einem Drehzahlauf im Modus1 fuehrt  (schnell) - Codierung wie z_lls_fktaktiv_has_sbe" VALUE 0x264548 ULONG_COL_DIRECT_M_S7_S3 0 void_int_f_M_S7_S3 0 4294967295 /end CHARACTERISTIC
/begin CHARACTERISTIC BM_NMINEMMODUS2_LLS_HAS "Bitmaske zur Festlegung, welche aktuell relevante Einzelfunktionen der Leerlaufsimulation der HAS zu einem Drehzahlauf im Modus2 fuehrt  (zuegig und komfortabel) - Codierung wie z_lls_fktaktiv_has_sbe" VALUE 0x26454C ULONG_COL_DIRECT_M_S7_S3 0 void_int_f_M_S7_S3 0 4294967295 /end CHARACTERISTIC
/begin CHARACTERISTIC BM_ZABSMSA_MSA_HAS "Bitmaske zur Festlegung der Anforderung der Beeinflussung der MSA-Funktionalitaet bei aktiven ABS-/ESP-Regelzustaenden - Codierung wie z_msa_has_sbe" VALUE 0x26ED4D UBYTE_COL_DIRECT_M_S7_S3 0 void_int_M_S7_S3 0 255 /end CHARACTERISTIC
/begin CHARACTERISTIC BM_ZBERGMSA_MSA_HAS "Bitmaske zur Festlegung der Anforderung der Beeinflussung der MSA-Funktionalitaet  am Berg - Codierung wie z_msa_has_sbe" VALUE 0x26ED4E UBYTE_COL_DIRECT_M_S7_S3 0 void_int_M_S7_S3 0 255 /end CHARACTERISTIC
/begin CHARACTERISTIC BM_ZCGETRMSA_MSA_HAS "Bitmaske zur Festlegung der Anforderung der Beeinflussung der MSA-Funktionalitaet in Abhaengigkeit der Getriebeoeltemperatur - Codierung wie z_msa_has_sbe" VALUE 0x26ED4F UBYTE_COL_DIRECT_M_S7_S3 0 void_int_M_S7_S3 0 255 /end CHARACTERISTIC
/begin CHARACTERISTIC BM_ZDIAGMSA_MSA_HAS "Bitmaske zur Festlegung der Anforderung der Beeinflussung der MSA-Funktionalitaet bei aktiver Diagnose-Ersatztfunktion-Codierung wie z_msa_has_sbe" VALUE 0x26ED51 UBYTE_COL_DIRECT_M_S7_S3 0 void_int_M_S7_S3 0 255 /end CHARACTERISTIC
/begin CHARACTERISTIC BM_ZDIAGMSASTARTVERBOT_MSA_HAS "Bitmaske zur Konfiguration der Anforderung einer Einschaltverhinderung der Beeinflussung der MSA-Funktionalitaet bei aktiver Diagnose-Ersatzfunktion-Codierung wie z_msa_has_sbe" VALUE 0x26ED50 UBYTE_COL_DIRECT_M_S7_S3 0 void_int_M_S7_S3 0 255 /end CHARACTERISTIC
/begin CHARACTERISTIC BM_ZFKTAKTIV_ALA_HAS "Bitmaske zur Festlegung, welche der Einzelfunktionen der Anlasseranforderung der HAS (ALA) aktiviert sind, Codierung wie z_ala_fktaktiv_has." VALUE 0x26E108 UWORD_COL_DIRECT_M_S7_S3 0 b_int_24_M_S7_S3 0 65535 /end CHARACTERISTIC
/begin CHARACTERISTIC BM_ZFKTAKTIV_LLS_HAS "Bitmaske zur Festlegung, welche der Einzelfunktionen der Leerlaufsimulation der HAS aktiviert sind - Codierung wie z_lls_fktaktiv_has" VALUE 0x264550 ULONG_COL_DIRECT_M_S7_S3 0 void_int_f_M_S7_S3 0 4294967295 /end CHARACTERISTIC
/begin CHARACTERISTIC BM_ZFSTMSA_MSA_HAS "Bitmaske zur Festlegung der Anforderung der Beeinflussung der MSA-Funktionalitaet  in Abhaengigkeit der Vorgabe der Fahrstrategie - Codierung wie z_msa_has_sbe" VALUE 0x26ED52 UBYTE_COL_DIRECT_M_S7_S3 0 void_int_M_S7_S3 0 255 /end CHARACTERISTIC
/begin CHARACTERISTIC BM_ZIAEMSAKRI_MSA_HAS "Bitmaske zur Festlegung der Anforderung der Beeinflussung der MSA-Funktionalitaet in Abhaengigkeit des IAE Betriebszustands Kriechen - Codierung wie z_msa_has_sbe" VALUE 0x26ED53 UBYTE_COL_DIRECT_M_S7_S3 0 void_int_M_S7_S3 0 255 /end CHARACTERISTIC
/begin CHARACTERISTIC BM_ZIAEMSASYN_MSA_HAS "Bitmaske zur Festlegung der Anforderung der Beeinflussung der MSA-Funktionalitaet in Abhaengigkeit des IAE Betriebszustands Synchronisieren - Codierung wie z_msa_has_sbe" VALUE 0x26ED54 UBYTE_COL_DIRECT_M_S7_S3 0 void_int_M_S7_S3 0 255 /end CHARACTERISTIC
/begin CHARACTERISTIC BM_ZKFLMSA_MSA_HAS "Bitmaske zur Festlegung der Anforderung der Beeinflussung der MSA-Funktionalitaet  in Abhaengigkeit des Kraftfluss-Status - Codierung wie z_msa_has_sbe" VALUE 0x26ED55 UBYTE_COL_DIRECT_M_S7_S3 0 void_int_M_S7_S3 0 255 /end CHARACTERISTIC
/begin CHARACTERISTIC BM_ZNDK0MSA_MSA_HAS "Bitmaske zur Festlegung der Anforderung der Beeinflussung der MSA-Funktionalitaet in Abhaengigkeit der Differenzdrehzahl K0 - Codierung wie z_msa_has_sbe" VALUE 0x26ED56 UBYTE_COL_DIRECT_M_S7_S3 0 void_int_M_S7_S3 0 255 /end CHARACTERISTIC
/begin CHARACTERISTIC BM_ZSASMSAGE_MSA_HAS "Bitmaske zur Festlegung der Anforderung der Beeinflussung der MSA-Funktionalitaet bei aktivem Schaltablauf beim Gangeinlegen - Codierung wie z_msa_has_sbe" VALUE 0x26ED57 UBYTE_COL_DIRECT_M_S7_S3 0 void_int_M_S7_S3 0 255 /end CHARACTERISTIC
/begin CHARACTERISTIC BM_ZSTADAMSA_MSA_HAS "Bitmaske zur Freigabe der Anforderung der Beeinflussung der MSA-Funktionalitaet in Abhaengigkeit der Vorgabe der Stillstandadaption - Codierung wie z_msa_has_sbe" VALUE 0x26ED58 UBYTE_COL_DIRECT_M_S7_S3 0 void_int_M_S7_S3 0 255 /end CHARACTERISTIC
/begin CHARACTERISTIC BM_ZVGFMSA_MSA_HAS "Bitmaske zur Festlegung der Anforderung der Beeinflussung der MSA-Funktionalitaet in Abhaengigkeit des Fahrzeuggeschwindigkeitsgradienten - Codierung wie z_msa_has_sbe" VALUE 0x26ED59 UBYTE_COL_DIRECT_M_S7_S3 0 void_int_M_S7_S3 0 255 /end CHARACTERISTIC
/begin CHARACTERISTIC CG_MINDAT_LLS_HAS "Minimaler Temperaturgradient der DAT-Modell-Temperatur der Minimaldrehzahlvorgabe zur Verhinderung DAT-Massenanschlagen (DAT) zur Ausgabe als minimale EM-Drehzahl der Leerlaufsimulation der HAS (LLS)" VALUE 0x264554 FLOAT32_IEEE_COL_DIRECT_M_S7_S3 0 cg_fl_M_S7_S3 -500 0 /end CHARACTERISTIC
/begin CHARACTERISTIC CS_DAT_LLS_HAS "Schwelle der DAT-Modell-Temperatur zur Aktivierung der Leerlaufsimulation der HAS (LLS) zur Verhinderung DAT-Massenanschlagen" VALUE 0x264558 FLOAT32_IEEE_COL_DIRECT_M_S7_S3 0 c_fl_M_S7_S3 -50 200 /end CHARACTERISTIC
/begin CHARACTERISTIC CS_GETR_CGETR_MSA_HAS "Getriebeoeltemperaturschwelle zur Aktivierung der Beeinflussung der MSA-Funktionalitaet in Abhaengigkeit der Getriebeoeltemperatur" VALUE 0x264588 FLOAT32_IEEE_COL_DIRECT_M_S7_S3 0 c_fl_M_S7_S3 -50 200 /end CHARACTERISTIC
/begin CHARACTERISTIC CS_GETR1_CGETR_ALA_HAS "Getriebeoeltemperaturschwelle zur Aktivierung der Anlasseranforderung in Abhaengigkeit der Getriebeoeltemperatur bei kaltem Getriebeoel (CGETR) der Anlasseranforderung der HAS (ALA)" VALUE 0x264560 FLOAT32_IEEE_COL_DIRECT_M_S7_S3 0 c_fl_M_S7_S3 -50 200 /end CHARACTERISTIC
/begin CHARACTERISTIC CS_GETR1_CGETR_LLS_HAS "Getriebeoeltemperaturschwelle zur Aktivierung der Leerlaufsimulation in Abhaengigkeit der Getriebeoeltemperatur (Hotmode)" VALUE 0x264564 FLOAT32_IEEE_COL_DIRECT_M_S7_S3 0 c_fl_M_S7_S3 -50 200 /end CHARACTERISTIC
/begin CHARACTERISTIC CS_GETR1CRVKRI_LLS_HAS "Getriebeoeltemperaturschwelle zur Aktivierung der Creep-Ruckel-Verhinderung (CRV) der Minimaldrehzahlvorgabe bei Kriechbetrieb (KRI) der Leerlaufsimulation der HAS (LLS)" VALUE 0x26455C FLOAT32_IEEE_COL_DIRECT_M_S7_S3 0 c_fl_M_S7_S3 -50 200 /end CHARACTERISTIC
/begin CHARACTERISTIC CS_GETR2_CGETR_ALA_HAS "Getriebeoeltemperaturschwelle zur Deaktivierung der Anlasseranforderung in Abhaengigkeit der Getriebeoeltemperatur bei kaltem Getriebeoel (CGETR) der Anlasseranforderung der HAS (ALA)" VALUE 0x26456C FLOAT32_IEEE_COL_DIRECT_M_S7_S3 0 c_fl_M_S7_S3 -50 200 /end CHARACTERISTIC
/begin CHARACTERISTIC CS_GETR2_CGETR_LLS_HAS "Getriebeoeltemperaturschwelle zur Deaktivierung der Leerlaufsimulation in Abhaengigkeit der Getriebeoeltemperatur (Hotmode)" VALUE 0x264570 FLOAT32_IEEE_COL_DIRECT_M_S7_S3 0 c_fl_M_S7_S3 -50 200 /end CHARACTERISTIC
/begin CHARACTERISTIC CS_GETR2CRVKRI_LLS_HAS "Getriebeoeltemperaturschwelle zur Deaktivierung der Creep-Ruckel-Verhinderung (CRV) der Minimaldrehzahlvorgabe bei Kriechbetrieb (KRI) der Leerlaufsimulation der HAS (LLS)" VALUE 0x264568 FLOAT32_IEEE_COL_DIRECT_M_S7_S3 0 c_fl_M_S7_S3 -50 200 /end CHARACTERISTIC
/begin CHARACTERISTIC CS_GETRIEBE_BBR_HAS "Temperaturschwelle fuer Ber. z_sas" VALUE 0x26457C FLOAT32_IEEE_COL_DIRECT_M_S7_S3 0 c_fl_M_S7_S3 -30 100 /end CHARACTERISTIC
/begin CHARACTERISTIC CS_GETRIEBEMAX_BMI_HAS "max. Getriebeoeltemperatur, bei der ein gebruecktes EFahren angefordert wird" VALUE 0x264574 FLOAT32_IEEE_COL_DIRECT_M_S7_S3 0 c_fl_M_S7_S3 -50 200 /end CHARACTERISTIC
/begin CHARACTERISTIC CS_GETRIEBEMIN_BMI_HAS "min. Getriebeoeltemperatur, bei der ein gebruecktes EFahren angefordert wird" VALUE 0x264578 FLOAT32_IEEE_COL_DIRECT_M_S7_S3 0 c_fl_M_S7_S3 -50 200 /end CHARACTERISTIC
/begin CHARACTERISTIC CS_GETRKALT1_CGETR_LLS_HAS "Getriebeoeltemperaturschwelle zur Aktivierung der Leerlaufsimulation in Abhaengigkeit der Getriebeoeltemperatur bei kaltem Getriebeoel" VALUE 0x264580 FLOAT32_IEEE_COL_DIRECT_M_S7_S3 0 c_fl_M_S7_S3 -50 200 /end CHARACTERISTIC
/begin CHARACTERISTIC CS_GETRKALT2_CGETR_LLS_HAS "Getriebeoeltemperaturschwelle zur Deaktivierung der Leerlaufsimulation in Abhaengigkeit der Getriebeoeltemperatur bei kaltem Getriebeoel" VALUE 0x264584 FLOAT32_IEEE_COL_DIRECT_M_S7_S3 0 c_fl_M_S7_S3 -50 200 /end CHARACTERISTIC
/begin CHARACTERISTIC FK_MK0MBERZUS_HAS "Filterkoeffizient zur PT1-Filterung des K0-Moments der HAS zur Motormomentbe-grenzung in der SAB beim Zustart" VALUE 0x26458C FLOAT32_IEEE_COL_DIRECT_M_S7_S3 0 void_fl_M_S7_S3 0 1 /end CHARACTERISTIC
/begin CHARACTERISTIC FK_NMINEMAB1_1_LLS_HAS "Filterkoeffizient zur PT2-Filterung des Referenzwerts der minimalen EM-Drehzahl beim Drehzahlabbau- Modus1 der Leerlaufsimulation der HAS (LLS) 1.PT1-Glied" VALUE 0x264590 FLOAT32_IEEE_COL_DIRECT_M_S7_S3 0 void_fl_M_S7_S3 0 1 /end CHARACTERISTIC
/begin CHARACTERISTIC FK_NMINEMAB1_2_LLS_HAS "Filterkoeffizient zur PT2-Filterung des Referenzwerts der minimalen EM-Drehzahl beim Drehzahlabbau- Modus1 der Leerlaufsimulation der HAS (LLS) 2.PT1-Glied" VALUE 0x264594 FLOAT32_IEEE_COL_DIRECT_M_S7_S3 0 void_fl_M_S7_S3 0 1 /end CHARACTERISTIC
/begin CHARACTERISTIC FK_NMINEMAB3_1_LLS_HAS "Filterkoeffizient zur PT2-Filterung des Referenzwerts der minimalen EM-Drehzahl beim Drehzahlabbau- Modus3 der Leerlaufsimulation der HAS (LLS) 1.PT1-Glied" VALUE 0x264598 FLOAT32_IEEE_COL_DIRECT_M_S7_S3 0 void_fl_M_S7_S3 0 1 /end CHARACTERISTIC
/begin CHARACTERISTIC FK_NMINEMAB3_2_LLS_HAS "Filterkoeffizient zur PT2-Filterung des Referenzwerts der minimalen EM-Drehzahl beim Drehzahlabbau- Modus3 der Leerlaufsimulation der HAS (LLS) 2.PT1-Glied" VALUE 0x26459C FLOAT32_IEEE_COL_DIRECT_M_S7_S3 0 void_fl_M_S7_S3 0 1 /end CHARACTERISTIC
/begin CHARACTERISTIC FK_NMINEMAUF1_1_LLS_HAS "Filterkoeffizient zur PT2-Filterung des Referenzwerts der minimalen EM-Drehzahl beim Drehzahlaufbau-Modus1 der Leerlaufsimulation der HAS (LLS) - 1.PT1-Glied" VALUE 0x2645A0 FLOAT32_IEEE_COL_DIRECT_M_S7_S3 0 void_fl_M_S7_S3 0 1 /end CHARACTERISTIC
/begin CHARACTERISTIC FK_NMINEMAUF1_2_LLS_HAS "Filterkoeffizient zur PT2-Filterung des Referenzwerts der minimalen EM-Drehzahl beim Drehzahlaufbau-Modus1 der Leerlaufsimulation der HAS (LLS) - 2.PT1-Glied" VALUE 0x2645A4 FLOAT32_IEEE_COL_DIRECT_M_S7_S3 0 void_fl_M_S7_S3 0 1 /end CHARACTERISTIC
/begin CHARACTERISTIC FK_NMINEMAUF2_1_LLS_HAS "Filterkoeffizient zur PT2-Filterung des Referenzwerts der minimalen EM-Drehzahl beim Drehzahlaufbau-Modus2 der Leerlaufsimulation der HAS (LLS) - 1.PT1-Glied" VALUE 0x2645A8 FLOAT32_IEEE_COL_DIRECT_M_S7_S3 0 void_fl_M_S7_S3 0 1 /end CHARACTERISTIC
/begin CHARACTERISTIC FK_NMINEMAUF2_2_LLS_HAS "Filterkoeffizient zur PT2-Filterung des Referenzwerts der minimalen EM-Drehzahl beim Drehzahlaufbau-Modus2 der Leerlaufsimulation der HAS (LLS) - 2.PT1-Glied" VALUE 0x2645AC FLOAT32_IEEE_COL_DIRECT_M_S7_S3 0 void_fl_M_S7_S3 0 1 /end CHARACTERISTIC
/begin CHARACTERISTIC FK_NMINEMAUF3_1_LLS_HAS "Filterkoeffizient zur PT2-Filterung des Referenzwerts der minimalen EM-Drehzahl beim Drehzahlaufbau-Modus3 der Leerlaufsimulation der HAS (LLS) - 1.PT1-Glied" VALUE 0x2645B0 FLOAT32_IEEE_COL_DIRECT_M_S7_S3 0 void_fl_M_S7_S3 0 1 /end CHARACTERISTIC
/begin CHARACTERISTIC FK_NMINEMAUF3_2_LLS_HAS "Filterkoeffizient zur PT2-Filterung des Referenzwerts der minimalen EM-Drehzahl beim Drehzahlaufbau-Modus3 der Leerlaufsimulation der HAS (LLS) - 2.PT1-Glied" VALUE 0x2645B4 FLOAT32_IEEE_COL_DIRECT_M_S7_S3 0 void_fl_M_S7_S3 0 1 /end CHARACTERISTIC
/begin CHARACTERISTIC FPWS_MAXKRI_LLS_HAS "Maximaler Fahrpedalwert zur Aktivierung der Minimaldrehzahlvorgabe bei Kriechbetrieb (KRI) der Leerlaufsimulation der HAS (LLS)" VALUE 0x2645B8 FLOAT32_IEEE_COL_DIRECT_M_S7_S3 0 rel_fl_M_S7_S3 0 100 /end CHARACTERISTIC
/begin CHARACTERISTIC KF_ANALYSEABLVAR_HAS_W "Umsetzungstabelle der Ablaufvariante auf die Schnittstelle Analyse_has_sbe, Werte von 0 - 8" MAP 0x26430C UBYTE_COL_DIRECT_M_S7_S3 0 void_int_M_S7_S3 0 8
 /begin AXIS_DESCR COM_AXIS z_ablaufvariante_has_stg void_int_M_S7_S3 8 0 30 AXIS_PTS_REF KF_ANALYSEABLVAR_HAS_X /end AXIS_DESCR
 /begin AXIS_DESCR COM_AXIS z_hybfkt_stg void_int_M_S7_S3 3 0 15 AXIS_PTS_REF KF_ANALYSEABLVAR_HAS_Y /end AXIS_DESCR
/end CHARACTERISTIC
/begin CHARACTERISTIC KF_CINITDAT_LLS_HAS_W "Init-wert der DAT-Modell-Temperatur in Abhaengigkeit des Minimalwerts aus VM-, Getriebe- und Umgebungstemperatur der Minimaldrehzahlvorgabe zur Verhinderung DAT-Massenanschlagen zur Ausgabe als minimale EM-Drehzahl der Leerlaufsimulation der HAS" MAP 0x2637D0 FLOAT32_IEEE_COL_DIRECT_M_S7_S3 0 c_fl_M_S7_S3 -50 200
 /begin AXIS_DESCR COM_AXIS NO_INPUT_QUANTITY c_fl_M_S7_S3 8 -50 200 AXIS_PTS_REF KF_CINITDAT_LLS_HAS_X /end AXIS_DESCR
 /begin AXIS_DESCR COM_AXIS NO_INPUT_QUANTITY c_fl_M_S7_S3 6 -50 200 AXIS_PTS_REF KF_CINITDAT_LLS_HAS_Y /end AXIS_DESCR
/end CHARACTERISTIC
/begin CHARACTERISTIC KF_MEMRESVMSTART_HAS_W "Kennlinie fuer Momentenreserve EM ueber Ablaufvariante und VM-Startmoment" MAP 0x2638C8 FLOAT32_IEEE_COL_DIRECT_M_S7_S3 0 trq_fl_a_M_S7_S3 0 500
 /begin AXIS_DESCR COM_AXIS NO_INPUT_QUANTITY sts_fl_M_S7_S3 5 -3.40282346639E+038 3.40282346639E+038 AXIS_PTS_REF KF_MEMRESVMSTART_HAS_X /end AXIS_DESCR
 /begin AXIS_DESCR COM_AXIS m_vm_start_in trq_fl_a_M_S7_S3 6 -3.40282E+038 3.40282E+038 AXIS_PTS_REF KF_MEMRESVMSTART_HAS_Y /end AXIS_DESCR
/end CHARACTERISTIC
/begin CHARACTERISTIC KF_MK0MBERZUSBASIS_HAS_W "Basiswert des K0 Moments beim Zustart zur Bestimmung des K0-Moments der HAS zur Motormomentbegrenzung in der SAB in Abhaengigkeit des K0-Referenzmoments und der K0 Differenzdrehzahl" MAP 0x26396C FLOAT32_IEEE_COL_DIRECT_M_S7_S3 0 trq_fl_a_M_S7_S3 -1000 1000
 /begin AXIS_DESCR COM_AXIS NO_INPUT_QUANTITY m_fl_M_S7_S3 7 -3.40282E+038 3.40282E+038 AXIS_PTS_REF KF_MK0MBERZUSBASIS_HAS_X /end AXIS_DESCR
 /begin AXIS_DESCR COM_AXIS nd_k0_in n_fl_M_S7_S3 7 -3.40282E+038 3.40282E+038 AXIS_PTS_REF KF_MK0MBERZUSBASIS_HAS_Y /end AXIS_DESCR
/end CHARACTERISTIC
/begin CHARACTERISTIC KF_MMOTMAX_HAS_W "Maximales Getriebeeingangsmoment" MAP 0x263A68 FLOAT32_IEEE_COL_DIRECT_M_S7_S3 0 trq_fl_a_M_S7_S3 0 5000
 /begin AXIS_DESCR COM_AXIS NO_INPUT_QUANTITY sts_fl_M_S7_S3 10 -3.40282346639E+038 3.40282346639E+038 AXIS_PTS_REF KF_MMOTMAX_HAS_X /end AXIS_DESCR
 /begin AXIS_DESCR COM_AXIS NO_INPUT_QUANTITY void_fl_M_S7_S3 6 -3.40282E+038 3.40282E+038 AXIS_PTS_REF KF_MMOTMAX_HAS_Y /end AXIS_DESCR
/end CHARACTERISTIC
/begin CHARACTERISTIC KF_NGMINEMMIN3_LLS_HAS_W "Minimaler Drehzahlgradient der ungefilterten minimalen EM-Drehzahl in Abhaengigkeit der ungefilterten minimalen EM-Drehzahl und des Zielwerts der minimalen EM-Drehzahl im Drehzahlabbau-Modus 3 (komfortabel) der Leerlaufsimulation der HAS (LLS)" MAP 0x263B98 FLOAT32_IEEE_COL_DIRECT_M_S7_S3 0 ng_fl_M_S7_S3 -50000 0
 /begin AXIS_DESCR COM_AXIS NO_INPUT_QUANTITY n_fl_M_S7_S3 6 -3.40282E+038 3.40282E+038 AXIS_PTS_REF KF_NGMINEMMIN3_LLS_HAS_X /end AXIS_DESCR
 /begin AXIS_DESCR COM_AXIS NO_INPUT_QUANTITY n_fl_M_S7_S3 4 -3.40282E+038 3.40282E+038 AXIS_PTS_REF KF_NGMINEMMIN3_LLS_HAS_Y /end AXIS_DESCR
/end CHARACTERISTIC
/begin CHARACTERISTIC KF_NOSECIAEKRI_LLS_HAS_W "Festlegung des Drehzahloffsets auf die sekundaere IAE-Drehzahl der Mindrehzahlvorgabe bei Kriechbetrieb(KRI) in Abhaengigkeit des Fahrzeugbremsdrucks und der sekundaeren IAE-Drehzahl zur Ausgabe als minimale EM-Drehzahl der Leerlaufsimulation der HAS(LLS)" MAP 0x263C20 FLOAT32_IEEE_COL_DIRECT_M_S7_S3 0 n_fl_M_S7_S3 0 10000
 /begin AXIS_DESCR COM_AXIS p_bremse_fzg_in p_fl_M_S7_S3 6 0 127 AXIS_PTS_REF KF_NOSECIAEKRI_LLS_HAS_X /end AXIS_DESCR
 /begin AXIS_DESCR COM_AXIS NO_INPUT_QUANTITY n_fl_M_S7_S3 4 0 10000 AXIS_PTS_REF KF_NOSECIAEKRI_LLS_HAS_Y /end AXIS_DESCR
/end CHARACTERISTIC
/begin CHARACTERISTIC KF_PMAX_FZP_HAS_W "Maximaler Systemdruck ueber FZP in Abhaengigkeit von E-Maschinen-Drehzahl und Getriebetemperatur" MAP 0x263CA8 FLOAT32_IEEE_COL_DIRECT_M_S7_S3 0 void_fl_M_S7_S3 0 30
 /begin AXIS_DESCR COM_AXIS c_getriebe_egs_in c_fl_M_S7_S3 5 -3.40282E+038 3.40282E+038 AXIS_PTS_REF KF_PMAX_FZP_HAS_X /end AXIS_DESCR
 /begin AXIS_DESCR COM_AXIS n_em_in trq_fl_a_M_S7_S3 6 -3.40282E+038 3.40282E+038 AXIS_PTS_REF KF_PMAX_FZP_HAS_Y /end AXIS_DESCR
/end CHARACTERISTIC
/begin CHARACTERISTIC KF_ZNOMINEMGANG_LLS_HAS_W "Unterdrueckung der Drehzahlausgabe n_min_em_has_sbe abhaengig von Ist- und Zielgang" MAP 0x26432C UBYTE_COL_DIRECT_M_S7_S3 0 void_int_M_S7_S3 0 1
 /begin AXIS_DESCR COM_AXIS istgang_egs_in st_int_M_S7_S3 8 -128 127 AXIS_PTS_REF KF_ZNOMINEMGANG_LLS_HAS_X /end AXIS_DESCR
 /begin AXIS_DESCR COM_AXIS zielgang_egs_in st_int_M_S7_S3 8 -128 127 AXIS_PTS_REF KF_ZNOMINEMGANG_LLS_HAS_Y /end AXIS_DESCR
/end CHARACTERISTIC
/begin CHARACTERISTIC KL_ABLVARZSASAKTIV_BBR_HAS_Y "Ablaufvariante zur Beeinflussung der K0 Ansteuerung im Zustandsuebergang I-NIT_KL15 (14) nach LADEN (5) (Aenderung der Befuellreihenfolge) durch die HAS" CURVE 0x264384 UBYTE_COL_DIRECT_M_S7_S3 0 sts_int_M_S7_S3 0 1
 /begin AXIS_DESCR COM_AXIS z_ablaufvariante_has_stg sts_int_M_S7_S3 8 0 99 AXIS_PTS_REF KL_ABLVARZSASAKTIV_BBR_HAS_X /end AXIS_DESCR
/end CHARACTERISTIC
/begin CHARACTERISTIC KL_CGMAXVMAUSDAT_LLS_HAS_Y "Maximaler Temperaturgradient der DAT-Modell-Temperatur bei VM aus oder offener K0 der Minimaldrehzahlvorgabe zur Verhinderung DAT in Abhaengigkeit der DAT-Modell-Temperatur zur Ausgabe als minimale EMDrehzahl der Leerlaufsimulation der HAS" CURVE 0x263D6C FLOAT32_IEEE_COL_DIRECT_M_S7_S3 0 cg_fl_M_S7_S3 0 500
 /begin AXIS_DESCR COM_AXIS NO_INPUT_QUANTITY c_fl_M_S7_S3 8 -3.40282E+038 3.40282E+038 AXIS_PTS_REF KL_CGMAXVMAUSDAT_LLS_HAS_X /end AXIS_DESCR
/end CHARACTERISTIC
/begin CHARACTERISTIC KL_CGMAXVMEINDAT_LLS_HAS_Y "Maximaler Temperaturgradient der DAT-Modell-Temperatur bei VM ein und geschlossener K0 der Minimaldrehzahlvorgabe zur Verhinderung DAT in Abhaengigkeit der DAT-Modell-Temperatur zur Ausgabe als minimale EM-Drehzahl der Leerlaufsimulation der HAS" CURVE 0x263DAC FLOAT32_IEEE_COL_DIRECT_M_S7_S3 0 cg_fl_M_S7_S3 0 500
 /begin AXIS_DESCR COM_AXIS NO_INPUT_QUANTITY c_int_M_S7_S3 8 -3.40282E+038 3.40282E+038 AXIS_PTS_REF KL_CGMAXVMEINDAT_LLS_HAS_X /end AXIS_DESCR
/end CHARACTERISTIC
/begin CHARACTERISTIC KL_CSGETRAUS_CGETR_MSA_HAS_Y "Getriebeoeltemperaturschwelle abhaengig von der Temperatur des Getriebes bei Systemstart zur Deaktivierung der Beeinflussung der MSA-Funktionalitaet in Abhaengigkeit der Getriebeoeltemperatur" CURVE 0x263DDC FLOAT32_IEEE_COL_DIRECT_M_S7_S3 0 c_fl_M_S7_S3 -50 200
 /begin AXIS_DESCR COM_AXIS NO_INPUT_QUANTITY c_fl_M_S7_S3 4 -50 200 AXIS_PTS_REF KL_CSGETRAUS_CGETR_MSA_HAS_X /end AXIS_DESCR
/end CHARACTERISTIC
/begin CHARACTERISTIC KL_KNMINEMANGEHOBENDAT_LLS_HAS_Y "Faktor zur Bestimmung des Maximalwerts der kontinuierlich angehobenen EM-Mindrehzahl der Mindrehzahlvorgabe zur Verhinderung DAT-Massenanschlagen (DAT) in Abhaengigkeit der Abtriebsdrehzahl zur Ausgabe als minimale EMDrehzahl der Leerlaufsim. der HAS(LLS)" CURVE 0x263E0C FLOAT32_IEEE_COL_DIRECT_M_S7_S3 0 void_fl_M_S7_S3 0 1
 /begin AXIS_DESCR COM_AXIS n_ab_egs_in n_fl_M_S7_S3 8 0 10000 AXIS_PTS_REF KL_KNMINEMANGEHOBENDAT_LLS_HAS_X /end AXIS_DESCR
/end CHARACTERISTIC
/begin CHARACTERISTIC KL_MSMOTMAXIAEENTK_ALA_HAS_Y "Maximalmoment zur Festlegung des Lastzustands in Abhaengigkeit des Istgangs der Anlasserstartanforderung bei unguenstigen Bedingungen zur IAEEntkopplung (IAEENTK) der Anlasseranforderung der HAS (ALA)" CURVE 0x263E54 FLOAT32_IEEE_COL_DIRECT_M_S7_S3 0 trq_fl_a_M_S7_S3 -1000 1000
 /begin AXIS_DESCR COM_AXIS NO_INPUT_QUANTITY sts_fl_M_S7_S3 10 -1 8 AXIS_PTS_REF KL_MSMOTMAXIAEENTK_ALA_HAS_X /end AXIS_DESCR
/end CHARACTERISTIC
/begin CHARACTERISTIC KL_MSMOTMINIAEENTK_ALA_HAS_Y "Minimalmoment zur Festlegung des Lastzustands in Abhaengigkeit des Istgangs der Anlasserstartanforderung bei unguenstigen Bedingungen zur IAE-Entkopplung (IAEENTK) der Anlasseranforderung der HAS (ALA)" CURVE 0x263EA4 FLOAT32_IEEE_COL_DIRECT_M_S7_S3 0 trq_fl_a_M_S7_S3 -1000 1000
 /begin AXIS_DESCR COM_AXIS NO_INPUT_QUANTITY sts_fl_M_S7_S3 10 -1 8 AXIS_PTS_REF KL_MSMOTMINIAEENTK_ALA_HAS_X /end AXIS_DESCR
/end CHARACTERISTIC
/begin CHARACTERISTIC KL_NGMINEMMAX1_LLS_HAS_Y "Maximaler Drehzahlgradient der ungefilterten minimalen EM-Drehzahl in Abhaengigkeit der ungefilterten minimalen EM-Drehzahl im Drehzahlaufbau Modus 1 (schnell) der Leerlaufsimulation der HAS (LLS)" CURVE 0x263F34 FLOAT32_IEEE_COL_DIRECT_M_S7_S3 0 ng_fl_M_S7_S3 0 50000
 /begin AXIS_DESCR COM_AXIS NO_INPUT_QUANTITY n_fl_M_S7_S3 6 -3.40282E+038 3.40282E+038 AXIS_PTS_REF KL_NGMINEMMAX1_LLS_HAS_X /end AXIS_DESCR
/end CHARACTERISTIC
/begin CHARACTERISTIC KL_NGMINEMMAX2_LLS_HAS_Y "Maximaler Drehzahlgradient der ungefilterten minimalen EM-Drehzahl in Abhaengigkeit der ungefilterten minimalen EM-Drehzahl im Drehzahlaufbau Modus 2 (zuegig und komfortabel) der Leerlaufsimulation der HAS (LLS)" CURVE 0x263F64 FLOAT32_IEEE_COL_DIRECT_M_S7_S3 0 ng_fl_M_S7_S3 0 50000
 /begin AXIS_DESCR COM_AXIS NO_INPUT_QUANTITY n_fl_M_S7_S3 6 -3.40282E+038 3.40282E+038 AXIS_PTS_REF KL_NGMINEMMAX2_LLS_HAS_X /end AXIS_DESCR
/end CHARACTERISTIC
/begin CHARACTERISTIC KL_NGMINEMMAX3_LLS_HAS_Y "Maximaler Drehzahlgradient der ungefilterten minimalen EM-Drehzahl in Abhaengigkeit der ungefilterten minimalen EM-Drehzahl im Drehzahlaufbau Modus 3 (komfortabel) der Leerlaufsimulation der HAS (LLS)" CURVE 0x263F94 FLOAT32_IEEE_COL_DIRECT_M_S7_S3 0 ng_fl_M_S7_S3 0 50000
 /begin AXIS_DESCR COM_AXIS NO_INPUT_QUANTITY n_fl_M_S7_S3 6 -3.40282E+038 3.40282E+038 AXIS_PTS_REF KL_NGMINEMMAX3_LLS_HAS_X /end AXIS_DESCR
/end CHARACTERISTIC
/begin CHARACTERISTIC KL_NMINEM_PSYS_LP1_LLS_HAS_Y "Mindestdrehzahl der EM zur Sicherstellung der Oelversorgung nach Leistungspunkt 1 in Abhaengigkeit der Getriebeoeltemperatur der Leerlaufsimulation der HAS (LLS)" CURVE 0x26418C FLOAT32_IEEE_COL_DIRECT_M_S7_S3 0 n_fl_M_S7_S3 0 10000
 /begin AXIS_DESCR COM_AXIS c_getriebe_egs_in c_int_M_S7_S3 8 -3.40282E+038 3.40282E+038 AXIS_PTS_REF KL_NMINEM_PSYS_LP1_LLS_HAS_X /end AXIS_DESCR
/end CHARACTERISTIC
/begin CHARACTERISTIC KL_NMINEMANGEHOBENDAT_LLS_HAS_Y "Festlegung der angehobenen EM-Minimaldrehzahl der Minimaldrehzahlvorgabe zur Verhinderung DAT-Massenanschlagen (DAT) in Abhaengigkeit der DAT-Modell-Temperatur zur Ausgabe als minimale EM-Drehzahl der Leerlaufsimulation der HAS (LLS)" CURVE 0x263FCC FLOAT32_IEEE_COL_DIRECT_M_S7_S3 0 n_fl_M_S7_S3 0 10000
 /begin AXIS_DESCR COM_AXIS NO_INPUT_QUANTITY c_fl_M_S7_S3 8 -40 120 AXIS_PTS_REF KL_NMINEMANGEHOBENDAT_LLS_HAS_X /end AXIS_DESCR
/end CHARACTERISTIC
/begin CHARACTERISTIC KL_NMINEMBASISDAT_LLS_HAS_Y "Festlegung der Basis-EM-Minimaldrehzahl der Minimaldrehzahlvorgabe zur Verhinderung DAT-Massenanschlagen (DAT) in Abhaengigkeit der DAT-Modell- Temperatur zur Ausgabe als minimale EMDrehzahl der Leerlaufsimulation der HAS (LLS)" CURVE 0x26400C FLOAT32_IEEE_COL_DIRECT_M_S7_S3 0 n_fl_M_S7_S3 0 10000
 /begin AXIS_DESCR COM_AXIS NO_INPUT_QUANTITY c_fl_M_S7_S3 8 -40 120 AXIS_PTS_REF KL_NMINEMBASISDAT_LLS_HAS_X /end AXIS_DESCR
/end CHARACTERISTIC
/begin CHARACTERISTIC KL_NMINEMFZPKRI_LLS_HAS_Y "Festlegung der minimalen EM- und damit FZP-Drehzahl bei Kriechbetrieb (KRI) in Abhaengigkeit der Getriebeoeltemperatur zur Ausgabe als minimale EM-Drehzahl der Leerlaufsimulation der HAS (LLS)" CURVE 0x26404C FLOAT32_IEEE_COL_DIRECT_M_S7_S3 0 n_fl_M_S7_S3 0 10000
 /begin AXIS_DESCR COM_AXIS c_getriebe_egs_in c_int_M_S7_S3 8 -40 150 AXIS_PTS_REF KL_NMINEMFZPKRI_LLS_HAS_X /end AXIS_DESCR
/end CHARACTERISTIC
/begin CHARACTERISTIC KL_NMINEMIAEADAP_LLS_HAS_Y "Festlegung der Minimaldrehzahl der IAE-Adaption in Abhaengigkeit der Getriebeoeltemperatur zur Ausgabe als minimale EM-Drehzahl der Leerlaufsimulation der HAS (LLS)" CURVE 0x2640B4 FLOAT32_IEEE_COL_DIRECT_M_S7_S3 0 n_fl_M_S7_S3 0 10000
 /begin AXIS_DESCR COM_AXIS c_getriebe_egs_in c_fl_M_S7_S3 6 -3.40282E+038 3.40282E+038 AXIS_PTS_REF KL_NMINEMIAEADAP_LLS_HAS_X /end AXIS_DESCR
/end CHARACTERISTIC
/begin CHARACTERISTIC KL_NMINEMIAEADAPIEP_LLS_HAS_Y "Festlegung der Minimaldrehzahl der IAE-Adaption bei IEP-Betrieb in Abhaengigkeit der Getriebeoeltemperatur zur Ausgabe als minimale EM-Drehzahl der Leerlaufsimulation der HAS" CURVE 0x264084 FLOAT32_IEEE_COL_DIRECT_M_S7_S3 0 n_fl_M_S7_S3 0 10000
 /begin AXIS_DESCR COM_AXIS c_getriebe_egs_in c_fl_M_S7_S3 6 -3.40282E+038 3.40282E+038 AXIS_PTS_REF KL_NMINEMIAEADAPIEP_LLS_HAS_X /end AXIS_DESCR
/end CHARACTERISTIC
/begin CHARACTERISTIC KL_NMINEMK0ADAP_LLS_HAS_Y "Festlegung der Minimaldrehzahl der K0-Adaption in Abhaengigkeit der Getriebeoeltemperatur zur Ausgabe als minimale EM-Drehzahl der Leerlaufsimulation der HAS (LLS)" CURVE 0x2640E4 FLOAT32_IEEE_COL_DIRECT_M_S7_S3 0 n_fl_M_S7_S3 0 10000
 /begin AXIS_DESCR COM_AXIS c_getriebe_egs_in c_fl_M_S7_S3 6 -3.40282E+038 3.40282E+038 AXIS_PTS_REF KL_NMINEMK0ADAP_LLS_HAS_X /end AXIS_DESCR
/end CHARACTERISTIC
/begin CHARACTERISTIC KL_NMINEMPARKSP_LLS_HAS_Y "Festlegung der Minimaldrehzahl auf Anforderung des Parksperrenmoduls zum Auslegen der Parksperre im Gefaelle in Abhaengigkeit der Getriebeoeltemperatur zur Ausgabe als minimale EM-Drehzahl der Leerlaufsimulation der HAS (LLS)" CURVE 0x26410C FLOAT32_IEEE_COL_DIRECT_M_S7_S3 0 n_fl_M_S7_S3 0 10000
 /begin AXIS_DESCR COM_AXIS c_getriebe_egs_in c_fl_M_S7_S3 4 -40 215 AXIS_PTS_REF KL_NMINEMPARKSP_LLS_HAS_X /end AXIS_DESCR
/end CHARACTERISTIC
/begin CHARACTERISTIC KL_NMINEMSTADA_LLS_HAS_Y "Festlegung der Minimaldrehzahl der Schaltkupplungs-Adaption in Abhaengigkeit der Getriebeoeltemperatur zur Ausgabe als minimale EM-Drehzahl der Leerlaufsimulation der HAS (LLS)" CURVE 0x264134 FLOAT32_IEEE_COL_DIRECT_M_S7_S3 0 n_fl_M_S7_S3 0 10000
 /begin AXIS_DESCR COM_AXIS c_getriebe_egs_in c_fl_M_S7_S3 6 -10000 10000 AXIS_PTS_REF KL_NMINEMSTADA_LLS_HAS_X /end AXIS_DESCR
/end CHARACTERISTIC
/begin CHARACTERISTIC KL_NMINEMVGF_LLS_HAS_Y "Festlegung der Minimaldrehzahl zur Sicherstellung Oelversorgung beim starken Abbremsen in Abhaengigkeit der Leerlauf-Solldrehzahl des VM zur Ausgabe als minimale EM-Drehzahl der Leerlauf simulation der HAS (LLS)" CURVE 0x26415C FLOAT32_IEEE_COL_DIRECT_M_S7_S3 0 n_int_x_M_S7_S3 0 1000
 /begin AXIS_DESCR COM_AXIS n_soll_ll_vm_in n_int_x_M_S7_S3 4 0 1000 AXIS_PTS_REF KL_NMINEMVGF_LLS_HAS_X /end AXIS_DESCR
/end CHARACTERISTIC
/begin CHARACTERISTIC KL_NOSOLLLVMIAEENTK_ALA_HAS_Y "Drehzahloffset auf die LL-Solldrehzahl des VM in Abhaengigkeit des Istgangs zur Bestimmung der Anlasserstartanforderung bei unguenstigen Bedingungen zur IAE-Entkopplung (IAEENTK) der Anlasseranforderung der HAS (ALA)" CURVE 0x2641D4 FLOAT32_IEEE_COL_DIRECT_M_S7_S3 0 n_fl_M_S7_S3 -10000 10000
 /begin AXIS_DESCR COM_AXIS NO_INPUT_QUANTITY sts_fl_M_S7_S3 10 -1 8 AXIS_PTS_REF KL_NOSOLLLVMIAEENTK_ALA_HAS_X /end AXIS_DESCR
/end CHARACTERISTIC
/begin CHARACTERISTIC KL_PSBREMSEKRI_LLS_HAS_Y "Bremsdruckschwelle zur Aktivierung der Minimaldrehzahlvorgabe bei Kriechbetrieb (KRI) in Abhaengigkeit des Fahrzeug-Neigungswinkels zur Ausgabe als minimale EM-Drehzahl der Leerlaufsimulation der HAS (LLS)" CURVE 0x264218 FLOAT32_IEEE_COL_DIRECT_M_S7_S3 0 p_fl_M_S7_S3 0 127
 /begin AXIS_DESCR COM_AXIS phi_neigung_in phigrad_fl_M_S7_S3 7 -200 200 AXIS_PTS_REF KL_PSBREMSEKRI_LLS_HAS_X /end AXIS_DESCR
/end CHARACTERISTIC
/begin CHARACTERISTIC KL_PSBREMSERUECKKRI_LLS_HAS_Y "Bremsdruckschwelle zur Ruecknahme der Minimaldrehzahlvorgabe bei Kriechbetrieb (KRI) in Abhaengigkeit des Fahrzeug-Neigungswinkels zur Ausgabe als minimale EM-Drehzahl der Leerlaufsimulation der HAS (LLS)" CURVE 0x264250 FLOAT32_IEEE_COL_DIRECT_M_S7_S3 0 p_fl_M_S7_S3 0 127
 /begin AXIS_DESCR COM_AXIS phi_neigung_in phigrad_fl_M_S7_S3 7 -200 200 AXIS_PTS_REF KL_PSBREMSERUECKKRI_LLS_HAS_X /end AXIS_DESCR
/end CHARACTERISTIC
/begin CHARACTERISTIC KL_STKRAFTFLUSS_BMI_HAS_Y "Aktivierung gebruecktes EFahren in Abhaengigkeit vom status_kraftflusss_egs_in" CURVE 0x26ED1B UBYTE_COL_DIRECT_M_S7_S3 0 void_int_M_S7_S3 0 1
 /begin AXIS_DESCR COM_AXIS status_kraftfluss_egs_in sts_int_M_S7_S3 7 0 6 AXIS_PTS_REF KL_STKRAFTFLUSS_BMI_HAS_X /end AXIS_DESCR
/end CHARACTERISTIC
/begin CHARACTERISTIC KL_TVRUECKKRI_LLS_HAS_Y "Verzoegerungszeit zum Ruecksetzen der Minimaldrehzahlvorgabe bei Kriechbetrieb (KRI) in Abhaengigkeit des Fahrzeugbremsdrucks zur Ausgabe als minimale EM-Drehzahl der Leerlaufsimulation der HAS (LLS)" CURVE 0x264284 FLOAT32_IEEE_COL_DIRECT_M_S7_S3 0 t_fl_M_S7_S3 0 10
 /begin AXIS_DESCR COM_AXIS p_bremse_fzg_in p_fl_M_S7_S3 6 0 127 AXIS_PTS_REF KL_TVRUECKKRI_LLS_HAS_X /end AXIS_DESCR
/end CHARACTERISTIC
/begin CHARACTERISTIC KL_TZSASHASMAX_BBR_HAS_Y "Maximaler Zeitraum nach Erkennung der Betriebsbe-reitschaft des Hybridsystems in dem die  Beeinflussung der SAS Befuellreihenfolge durch die HAS aktiv ist" CURVE 0x2642FC UWORD_COL_DIRECT_M_S7_S3 0 t_int_n_M_S7_S3 0 500
 /begin AXIS_DESCR COM_AXIS NO_INPUT_QUANTITY c_int_v_M_S7_S3 8 -127 1000 AXIS_PTS_REF KL_TZSASHASMAX_BBR_HAS_X /end AXIS_DESCR
/end CHARACTERISTIC
/begin CHARACTERISTIC KL_VSFIAEZU_LLS_HAS_Y "Fahrzeuggeschwindigkeitsschwelle zur Unterdrueckung der Ausgabe der minimalen EM-Drehzahl der Leerlaufsimulation der HAS (LLS) bei geschlossener
IAE in Abhaengigkeit des Istgangs" CURVE 0x2642C4 FLOAT32_IEEE_COL_DIRECT_M_S7_S3 0 v_fl_M_S7_S3 0 500
 /begin AXIS_DESCR COM_AXIS NO_INPUT_QUANTITY void_fl_M_S7_S3 10 -1 8 AXIS_PTS_REF KL_VSFIAEZU_LLS_HAS_X /end AXIS_DESCR
/end CHARACTERISTIC
/begin CHARACTERISTIC M_K0MBERMAX_HAS "Maximalwert des K0-Moments der HAS zur Motormomentbegrenzung in der SAB" VALUE 0x2645E0 FLOAT32_IEEE_COL_DIRECT_M_S7_S3 0 trq_fl_a_M_S7_S3 0 1000 /end CHARACTERISTIC
/begin CHARACTERISTIC M_MOTMAX1_K0SCHUTZ_HAS "Erster Grenzwert des Maximalmoments der Begrenzung der EM-Drehzahl zum Schutz der Trennkupplung K0 des Gefuehrten Getriebeschutz der HAS" VALUE 0x2645E4 FLOAT32_IEEE_COL_DIRECT_M_S7_S3 0 trq_fl_a_M_S7_S3 0 1000 /end CHARACTERISTIC
/begin CHARACTERISTIC M_MOTMAX2_K0SCHUTZ_HAS "Zweiter Grenzwert des Maximalmoments der Begrenzung der EM-Drehzahl zum Schutz der Trennkupplung K0 des Gefuehrten Getriebeschutz der HAS" VALUE 0x2645E8 FLOAT32_IEEE_COL_DIRECT_M_S7_S3 0 trq_fl_a_M_S7_S3 0 1000 /end CHARACTERISTIC
/begin CHARACTERISTIC M_MOTMAXNEMFEHLER_MBEGRFUW_HAS "Maximal zulaessiges Motormoment bei gueltigem EM-Drehzahlsignal der Momentenbegrenzung bei Anzeige einer EM-Fehlfunktion durch die Funktionsueberwachung der EM des Gefuehrten Getriebeschutz der HAS" VALUE 0x2645EC FLOAT32_IEEE_COL_DIRECT_M_S7_S3 0 trq_fl_a_M_S7_S3 0 1000 /end CHARACTERISTIC
/begin CHARACTERISTIC M_MOTMAXNEMOK_MBEGRFUW_HAS "Maximal zulaessiges Motormoment bei fehlerhaftem oder ersetztem EM-Drehzahlsignal der Momentenbegrenzung bei Anzeige einer EM-Fehlfunktion durch die Funktionsueberwachung der EM des Gefuehrten Getriebeschutz der HAS" VALUE 0x2645F0 FLOAT32_IEEE_COL_DIRECT_M_S7_S3 0 trq_fl_a_M_S7_S3 0 1000 /end CHARACTERISTIC
/begin CHARACTERISTIC MG_K0MBERZUSNEG_HAS "Negativer Grenzgradient des K0-Moments der HAS zur Motormomentbegrenzung in der SAB beim Zustart" VALUE 0x2645BC FLOAT32_IEEE_COL_DIRECT_M_S7_S3 0 trqg_fl_k_M_S7_S3 -50000 0 /end CHARACTERISTIC
/begin CHARACTERISTIC MG_K0MBERZUSPOS_HAS "Positiver Grenzgradient des K0-Moments der HAS zur Motormomentbegrenzung in der SAB beim Zustart" VALUE 0x2645C0 FLOAT32_IEEE_COL_DIRECT_M_S7_S3 0 trqg_fl_k_M_S7_S3 0 50000 /end CHARACTERISTIC
/begin CHARACTERISTIC MS_MOTMANH_LLS_HAS "Schwellwert des Summen-Istmoments zur Vorgabe einer EM-Minimaldrehzahl der Leerlaufsimulation der HAS (LLS) bei kraft-schluessigem Getriebe" VALUE 0x2645C8 FLOAT32_IEEE_COL_DIRECT_M_S7_S3 0 trq_fl_a_M_S7_S3 -1000 1000 /end CHARACTERISTIC
/begin CHARACTERISTIC MS_WUNSCHFPWMANH_LLS_HAS "Schwellwert des Fahrerwunschmoments zur Vorgabe einer EM-Minimaldrehzahl der Leerlaufsimulation der HAS (LLS) bei kraftschluessigem Getriebe" VALUE 0x2645CC FLOAT32_IEEE_COL_DIRECT_M_S7_S3 0 trq_fl_a_M_S7_S3 -1000 1000 /end CHARACTERISTIC
/begin CHARACTERISTIC MS_WUNSCHFPWTVSRSSAS_MSA_HAS "Momentenschwelle zur Erkennung Schubbetrieb zur Initialisierung der Verzoegerungs-zeit zur Ruecknahme der Anforderung der Beeinflussung der MSA-Funktionalitaet bei aktivem Schaltablauf bei Schub RS im Hybridfahren" VALUE 0x2645D0 FLOAT32_IEEE_COL_DIRECT_M_S7_S3 0 trq_fl_a_M_S7_S3 -1000 1000 /end CHARACTERISTIC
/begin CHARACTERISTIC N_AB_POAB_BMI_HAS "Drehzahlschwelle, bei der das gebrueckte E-Fahren deaktiviert wird, wenn Fahrtrichtung ungleich der eingelegten Waehlhebelposition" VALUE 0x264684 FLOAT32_IEEE_COL_DIRECT_M_S7_S3 0 n_fl_M_S7_S3 0 10000 /end CHARACTERISTIC
/begin CHARACTERISTIC N_AB_POAB_LLS_HAS "Drehzahlschwelle ab der die Mindestdreh-zahl ausgegeben wird, wenn Fahrtrichtung ungleich der eingelegten Waehlhebelposition" VALUE 0x264688 FLOAT32_IEEE_COL_DIRECT_M_S7_S3 0 n_fl_M_S7_S3 0 10000 /end CHARACTERISTIC
/begin CHARACTERISTIC N_MINEMALAE_LLS_HAS "Festlegung der Minimaldrehzahl in Abhaen-gigkeit des Laengsbeschleunigungsstatus der Leerlaufsimulation der HAS (LLS) " VALUE 0x26468C FLOAT32_IEEE_COL_DIRECT_M_S7_S3 0 n_fl_M_S7_S3 0 10000 /end CHARACTERISTIC
/begin CHARACTERISTIC N_MINEMBEFFZP_LLS_HAS "Festlegung der EM Minimaldrehzahl bei Anforderung zur Befuellung der FZP zur Ausgabe als minimale EM-Drehzahl der Leerlaufsimulation der HAS (LLS)" VALUE 0x264690 FLOAT32_IEEE_COL_DIRECT_M_S7_S3 0 n_fl_M_S7_S3 0 10000 /end CHARACTERISTIC
/begin CHARACTERISTIC N_MINEMEFAHRENPVU_LLS_HAS "Festlegung der Minimaldrehzahl bei aktiver Unterstuetzung der Positionsventil-Ueberwachung  durch die HAS im Zustand EFahren zur Ausgabe als minimale EM-Drehzahl der HAS-Leerlaufsimulation (LLS)" VALUE 0x264694 FLOAT32_IEEE_COL_DIRECT_M_S7_S3 0 n_fl_M_S7_S3 0 10000 /end CHARACTERISTIC
/begin CHARACTERISTIC N_MINEMIAE_LLS_HAS "Festlegung der Minimaldrehzahl bei allgemeiner Anforderung durch das IAE-Modul zur Ausgabe als minimale EM-Drehzahl der Leerlaufsimulation der HAS (LLS)" VALUE 0x264698 FLOAT32_IEEE_COL_DIRECT_M_S7_S3 0 n_fl_M_S7_S3 0 10000 /end CHARACTERISTIC
/begin CHARACTERISTIC N_MINEMKFL_LLS_HAS "Festlegung der Minimaldrehzahl in Abhaen-gigkeit des Kraftfluss-Status zur Sicherstellung der Oelversorgung bei einem in Neutral rollenden Fahrzeug zur Ausgabe als minimale EM-Drehzahl der Leerlaufsimulation der HAS (LLS)" VALUE 0x26469C FLOAT32_IEEE_COL_DIRECT_M_S7_S3 0 n_fl_M_S7_S3 0 10000 /end CHARACTERISTIC
/begin CHARACTERISTIC N_MINEMMAXCRVKRI_LLS_HAS "Maximalwert zur Begrenzung der Minimaldrehzahlvorgabe bei Kriechbetrieb bei aktiver Creep-Ruckel-Verhinderung (CRV) der Minimaldrehzahlvorgabe bei Kriechbetrieb (KRI) der Leerlaufsimulation der HAS (LLS)" VALUE 0x2646A0 FLOAT32_IEEE_COL_DIRECT_M_S7_S3 0 n_fl_M_S7_S3 0 10000 /end CHARACTERISTIC
/begin CHARACTERISTIC N_MINEMMAXKRI_LLS_HAS "Maximalwert zur Begrenzung der Minimaldrehzahlvorgabe bei Kriechbetrieb (KRI) der Leerlaufsimulation der HAS (LLS)" VALUE 0x2646A4 FLOAT32_IEEE_COL_DIRECT_M_S7_S3 0 n_fl_M_S7_S3 0 10000 /end CHARACTERISTIC
/begin CHARACTERISTIC N_MINEMPOAB_LLS_HAS "Festlegung der Minimaldrehzahl wenn Fahrtrichtung ungleich der eingelegten Waehlhebelposition zur Ausgabe als minimale EM-Drehzahl der Leerlaufsimulation der HAS (LLS)" VALUE 0x2646A8 FLOAT32_IEEE_COL_DIRECT_M_S7_S3 0 n_fl_M_S7_S3 0 10000 /end CHARACTERISTIC
/begin CHARACTERISTIC N_MINEMSTAT_LLS_HAS "Festlegung der Minimaldrehzahl als statische Vorgabe zur Ausgabe als minimale EM-Drehzahl der Leerlaufsimulation der HAS (LLS)" VALUE 0x2646AC FLOAT32_IEEE_COL_DIRECT_M_S7_S3 0 n_fl_M_S7_S3 0 10000 /end CHARACTERISTIC
/begin CHARACTERISTIC N_MINEMVMSTARTENPVU_LLS_HAS "Festlegung der Minimaldrehzahl bei aktiver Unterstuetzung der Positionsventil-Ueberwachung  durch die HAS beim VM Starten zur Ausgabe als minimale EM-Drehzahl der HAS-Leerlaufsimulation (LLS)" VALUE 0x2646B0 FLOAT32_IEEE_COL_DIRECT_M_S7_S3 0 n_fl_M_S7_S3 0 10000 /end CHARACTERISTIC
/begin CHARACTERISTIC N_SOLLLVMMINIAEENTK_ALA_HAS "Minimaldrehzahl der Leerlauf-Solldrehzahl des VM zur Bestimmung der Anlasserstartanforderung bei unguenstigen Bedingungen zur IAE-Entkopplung (IAEENTK) der Anlasseranforderung der HAS (ALA) " VALUE 0x2646B4 FLOAT32_IEEE_COL_DIRECT_M_S7_S3 0 n_fl_M_S7_S3 0 10000 /end CHARACTERISTIC
/begin CHARACTERISTIC NDS_GETRIEBE_BMI_HAS "Differenzdrehzahlschwelle Getriebe zur Aktivierung gebruecktes EFahren (Schlupf im Getriebe)" VALUE 0x2645F8 FLOAT32_IEEE_COL_DIRECT_M_S7_S3 0 n_fl_M_S7_S3 -10000 10000 /end CHARACTERISTIC
/begin CHARACTERISTIC NDS_IAE_BMI_HAS "Max. Differenzdrehzahl nd_iae_bmi_has zur Aktivierung fuer das gebrueckte EFahren" VALUE 0x2645FC FLOAT32_IEEE_COL_DIRECT_M_S7_S3 0 n_fl_M_S7_S3 -10000 10000 /end CHARACTERISTIC
/begin CHARACTERISTIC NDS_K0_GE_NDK0_MSA_HAS "Differenzdrehzahlschwelle zur Erkennung von einer zu grossen ND_K0 waehrend Gangeinle-gen" VALUE 0x264610 FLOAT32_IEEE_COL_DIRECT_M_S7_S3 0 n_fl_M_S7_S3 -10000 10000 /end CHARACTERISTIC
/begin CHARACTERISTIC NDS_K01_NDK0_MSA_HAS "Untere negative Differenzdrehzahlschwelle der K0 zur Aktivierung der Beeinflussung der MSA-Funktionalitaet in Abhaengigkeit der Differenzdrehzahl der K0" VALUE 0x264600 FLOAT32_IEEE_COL_DIRECT_M_S7_S3 0 n_fl_M_S7_S3 -10000 0 /end CHARACTERISTIC
/begin CHARACTERISTIC NDS_K02_NDK0_MSA_HAS "Obere negative Differenzdrehzahlschwelle der K0 zur Deaktivierung der Beeinflussung der MSA-Funktionalitaet in Abhaengigkeit der Differenzdrehzahl der K0" VALUE 0x264604 FLOAT32_IEEE_COL_DIRECT_M_S7_S3 0 n_fl_M_S7_S3 -10000 0 /end CHARACTERISTIC
/begin CHARACTERISTIC NDS_K0MIN1_K0SCHUTZ_HAS "K0-Differenzdrehzahlschwelle zur Aktivierung und damit zur Ausgabe des ersten Grenzwerts des Maximalmoments der Begrenzung der EM-Drehzahl
zum Schutz der Trennkupplung K0 des Gefuehrten Getriebeschutz der HAS" VALUE 0x264608 FLOAT32_IEEE_COL_DIRECT_M_S7_S3 0 n_fl_M_S7_S3 -10000 0 /end CHARACTERISTIC
/begin CHARACTERISTIC NDS_K0MIN2_K0SCHUTZ_HAS "K0-Differenzdrehzahlschwelle zur Ausgabe des zweiten Grenzwerts des Maximalmoments der Begrenzung der EM-Drehzahl zum Schutz der Trennkupplung K0 des Gefuehrten Getriebeschutz der HAS" VALUE 0x26460C FLOAT32_IEEE_COL_DIRECT_M_S7_S3 0 n_fl_M_S7_S3 -10000 0 /end CHARACTERISTIC
/begin CHARACTERISTIC NG_MINEMMIN1_LLS_HAS "Minimaler Drehzahlgradient der ungefilterten minimalen EM-Drehzahl im Drehzahlabbau-Modus 1 (schnell) der Leerlaufsimulation der HAS (LLS)" VALUE 0x264614 FLOAT32_IEEE_COL_DIRECT_M_S7_S3 0 ng_fl_M_S7_S3 -50000 0 /end CHARACTERISTIC
/begin CHARACTERISTIC NO_EMNMINEMINIT_LLS_HAS "Drehzahl-Offset auf EM-Drehzahl der HAS zur Initialisierung des Gradientenbegrenzers und PT2-Filters" VALUE 0x264648 FLOAT32_IEEE_COL_DIRECT_M_S7_S3 0 n_fl_M_S7_S3 -10000 10000 /end CHARACTERISTIC
/begin CHARACTERISTIC NO_MINEMEFAHRENPVU_LLS_HAS "Offset zur Bestimmung der Minimaldrehzahl bei aktiver Unterstuetzung der Positionsventil-Ueberwachung durch die HAS im Zustand E-Fahren zur Ausgabe als minimale EM-Drehzahl der Leerlaufsimulation der HAS (LLS)" VALUE 0x26464C FLOAT32_IEEE_COL_DIRECT_M_S7_S3 0 n_fl_M_S7_S3 -10000 10000 /end CHARACTERISTIC
/begin CHARACTERISTIC NO_MINEMVMSTARTENPVU_LLS_HAS "Offset zur Bestimmung der Minimaldrehzahl bei aktiver Unterstuetzung der Positionsventil-Ueberwachung durch die HAS beim VM Starten zur Ausgabe als minimale EM-Drehzahl der Leerlaufsimulation der HAS (LLS)" VALUE 0x264650 FLOAT32_IEEE_COL_DIRECT_M_S7_S3 0 n_fl_M_S7_S3 -10000 10000 /end CHARACTERISTIC
/begin CHARACTERISTIC NO_SECIAEGANG1CRVKRI_LLS_HAS "Drehzahl-Offset auf die sekundaere IAE-Drehzahl im 1.Gang der Creep-Ruckel-Verhinderung (CRV) der Minimaldrehzahlvorgabe bei Kriechbetrieb (KRI) der Leerlaufsimulation der HAS (LLS)" VALUE 0x264654 FLOAT32_IEEE_COL_DIRECT_M_S7_S3 0 n_fl_M_S7_S3 0 10000 /end CHARACTERISTIC
/begin CHARACTERISTIC NO_SECIAEGANG2CRVKRI_LLS_HAS "Drehzahl-Offset auf die sekundaere IAE-Drehzahl im 2.Gang der Creep-Ruckel-Verhinderung (CRV) der Minimaldrehzahlvorgabe bei Kriechbetrieb (KRI) der Leerlaufsimulation der HAS (LLS)" VALUE 0x264658 FLOAT32_IEEE_COL_DIRECT_M_S7_S3 0 n_fl_M_S7_S3 0 10000 /end CHARACTERISTIC
/begin CHARACTERISTIC NO_SECIAEGANGRCRVKRI_LLS_HAS "Drehzahl-Offset auf die sekundaere IAE-Drehzahl im R-Gang der Creep-Ruckel-Verhinderung (CRV) der Minimaldrehzahlvorgabe bei Kriechbetrieb (KRI) der Leerlaufsimulation der HAS (LLS)" VALUE 0x26465C FLOAT32_IEEE_COL_DIRECT_M_S7_S3 0 n_fl_M_S7_S3 0 10000 /end CHARACTERISTIC
/begin CHARACTERISTIC NO_SOLLEMHSTNMINEMINIT_LLS_HAS "Drehzahl-Offset auf die EM-Solldrehzahl der HST zur Initialisierung des Gradientenbegrenzers und PT2-Filters der Leerlaufsimulation der HAS (LLS)" VALUE 0x264660 FLOAT32_IEEE_COL_DIRECT_M_S7_S3 0 n_fl_M_S7_S3 -10000 10000 /end CHARACTERISTIC
/begin CHARACTERISTIC NO_SOLLLLVMKRI_LLS_HAS "Negativer Drehzahl-Offset auf die LL-Solldrehzahl des VM zur Begrenzuhng der Minimaldrehzahlvorgabe bei Kriechbetrieb (KRI) des Leerlaufsimulation der HAS (LLS)" VALUE 0x264664 FLOAT32_IEEE_COL_DIRECT_M_S7_S3 0 n_fl_M_S7_S3 -10000 0 /end CHARACTERISTIC
/begin CHARACTERISTIC NOG_SECIAEMINCRVKRI_LLS_HAS "Gradient zum Abbau des Drehzahl-Offset auf die sekundaere IAE-Drehzahl der Creep-Ruckel-Verhinderung (CRV) der Minimaldrehzahlvorgabe bei Kriechbetrieb (KRI) der Leerlaufsimulation der HAS (LLS)" VALUE 0x264618 FLOAT32_IEEE_COL_DIRECT_M_S7_S3 0 ng_fl_M_S7_S3 -50000 0 /end CHARACTERISTIC
/begin CHARACTERISTIC NOS_EMNMINEMABBAUABBRDAT_LLS_HAS "Schwellwert des Drehzahl-Offsets der EM-Drehzahl zur minimalen EM-Drehzahl der LLS zur Aktivierung des Abbruchs des Abbaus der EM-Minimaldrehzahl der Minimaldrehzahlvorgabe zur Verhinderung DAT- Massenanschlagen (DAT) der Leerlaufsimulation der HAS (LLS)" VALUE 0x264624 FLOAT32_IEEE_COL_DIRECT_M_S7_S3 0 n_fl_M_S7_S3 0 10000 /end CHARACTERISTIC
/begin CHARACTERISTIC NOS_EMNMINEMABBAUDAT_LLS_HAS "Schwellwert des Drehzahl-Offsets der EM-Drehzahl zur maximalen Minimaldrehzahl zur Aktivierung des Abbaus der EM-Minimaldrehzahl der Minimaldrehzahlvorgabe zur Verhinderung DAT-Massenanschlagen (DAT) der Leerlaufsimulation der HAS (LLS)" VALUE 0x264628 FLOAT32_IEEE_COL_DIRECT_M_S7_S3 0 n_fl_M_S7_S3 0 10000 /end CHARACTERISTIC
/begin CHARACTERISTIC NOS_EMNMINEMANHDAT_LLS_HAS "Schwellwert des Drehzahl-Offsets der EM-Drehzahl zur Basis-Minimaldrehzahl zur Aktivierung der Anhebung der EM-Minimaldrehzahl der Minimaldrehzahlvorgabe zur Verhinderung DAT-Massenanschlagen (DAT) der Leerlaufsimulation der HAS (LLS)" VALUE 0x26462C FLOAT32_IEEE_COL_DIRECT_M_S7_S3 0 n_fl_M_S7_S3 0 10000 /end CHARACTERISTIC
/begin CHARACTERISTIC NOS_SECIAEGANG1AKTCRVKRI_LLS_HAS "Schwellwert des Drehzahl-Offsets auf die sekundaere IAE-Drehzahl im 1.Gang zur Aktivierung der Creep-Ruckel-Verhinderung (CRV) der Minimaldrehzahlvorgabe bei Kriechbetrieb (KRI) der Leerlaufsimulation der HAS (LLS)" VALUE 0x264630 FLOAT32_IEEE_COL_DIRECT_M_S7_S3 0 n_fl_M_S7_S3 0 10000 /end CHARACTERISTIC
/begin CHARACTERISTIC NOS_SECIAEGANG1DEAKTCRVKRI_LLS_HAS "Schwellwert des Drehzahl-Offsets auf die sekundaere IAE-Drehzahl im 1.Gang zur Deaktivierung der Creep-Ruckel-Verhinderung (CRV) der Minimaldrehzahlvorgabe bei Kriechbetrieb (KRI) der Leerlaufsimulation der HAS (LLS)" VALUE 0x264634 FLOAT32_IEEE_COL_DIRECT_M_S7_S3 0 n_fl_M_S7_S3 0 10000 /end CHARACTERISTIC
/begin CHARACTERISTIC NOS_SECIAEGANG2AKTCRVKRI_LLS_HAS "Schwellwert des Drehzahl-Offsets auf die sekundaere IAE-Drehzahl im 2.Gang zur Aktivierung der Creep-Ruckel-Verhinderung (CRV) der Minimaldrehzahlvorgabe bei Kriechbetrieb (KRI) der Leerlaufsimulation der HAS (LLS)" VALUE 0x264638 FLOAT32_IEEE_COL_DIRECT_M_S7_S3 0 n_fl_M_S7_S3 0 10000 /end CHARACTERISTIC
/begin CHARACTERISTIC NOS_SECIAEGANG2DEAKTCRVKRI_LLS_HAS "Schwellwert des Drehzahl-Offsets auf die sekundaere IAE-Drehzahl im 2.Gang zur Deaktivierung der Creep-Ruckel-Verhinderung (CRV) der Minimaldrehzahlvorgabe bei Kriechbetrieb (KRI) der Leerlaufsimulation der HAS (LLS)" VALUE 0x26463C FLOAT32_IEEE_COL_DIRECT_M_S7_S3 0 n_fl_M_S7_S3 0 10000 /end CHARACTERISTIC
/begin CHARACTERISTIC NOS_SECIAEGANGRAKTCRVKRI_LLS_HAS "Schwellwert des Drehzahl-Offsets auf die sekundaere IAE-Drehzahl im R-Gang zur Aktivierung der Creep-Ruckel-Verhinderung (CRV) der Minimaldrehzahlvorgabe bei Kriechbetrieb (KRI) der Leerlaufsimulation der HAS (LLS)" VALUE 0x264640 FLOAT32_IEEE_COL_DIRECT_M_S7_S3 0 n_fl_M_S7_S3 0 10000 /end CHARACTERISTIC
/begin CHARACTERISTIC NOS_SECIAEGANGRDEAKTCRVKRI_LLS_HAS "Schwellwert des Drehzahl-Offsets auf die sekundaere IAE-Drehzahl im R-Gang zur Deaktivierung der Creep-Ruckel-Verhinderung (CRV) der Minimaldrehzahlvorgabe bei Kriechbetrieb (KRI) der Leerlaufsimulation der HAS (LLS)" VALUE 0x264644 FLOAT32_IEEE_COL_DIRECT_M_S7_S3 0 n_fl_M_S7_S3 0 10000 /end CHARACTERISTIC
/begin CHARACTERISTIC NS_EM_BMI_HAS "Drehzahlschwelle n_em_in zur Aktivierung gebruecktes EFahren" VALUE 0x264668 FLOAT32_IEEE_COL_DIRECT_M_S7_S3 0 n_fl_M_S7_S3 -10000 10000 /end CHARACTERISTIC
/begin CHARACTERISTIC NS_EM_NDK0_MSA_HAS "EM Drehzahlschwelle zur Aktivierung der Beeinflussung der MSA-Funktionalitaet bei geringer EM Drehzahl in Abhaengigkeit der Differenzdrehzahl der K0 zum Schutz der K0" VALUE 0x26466C FLOAT32_IEEE_COL_DIRECT_M_S7_S3 0 n_fl_M_S7_S3 0 10000 /end CHARACTERISTIC
/begin CHARACTERISTIC NS_EM_STATUSEFAHRENMOD2_HAS "EM Drehzahlschwelle zur Sicherstellung der Oelversorgung bei der Ruecknahme des Status E-Fahren im Umschaltmodus 2 der Bestimmung des Status E-Fahren der HAS" VALUE 0x264670 FLOAT32_IEEE_COL_DIRECT_M_S7_S3 0 n_fl_M_S7_S3 0 10000 /end CHARACTERISTIC
/begin CHARACTERISTIC NS_EM_STATUSEFAHRENMOD3_HAS "EM Drehzahlschwelle zur Sicherstellung der Oelversorgung beim Setzen des Status E-Fahren im Umschaltmodus 3 der Bestimmung des Status E-Fahren der HAS" VALUE 0x264674 FLOAT32_IEEE_COL_DIRECT_M_S7_S3 0 n_fl_M_S7_S3 0 10000 /end CHARACTERISTIC
/begin CHARACTERISTIC NS_VM1_NDK0_MSA_HAS "Erste VM Drehzahlschwelle zur Aktivierung der Beeinflussung der MSA-Funktionalitaet K0 bei geringer EM Drehzahl in Abhaengigkeit der Differenzdrehzahl der zum Schutz der K0" VALUE 0x264678 FLOAT32_IEEE_COL_DIRECT_M_S7_S3 0 n_fl_M_S7_S3 0 10000 /end CHARACTERISTIC
/begin CHARACTERISTIC NS_VM2_NDK0_MSA_HAS "Zweite VM Drehzahlschwelle zur Aktivierung der Beeinflussung der MSA-Funktionalitaet bei geringer EM Drehzahl in Abhaengigkeit der Differenzdrehzahl der K0 zum Schutz der K0" VALUE 0x26467C FLOAT32_IEEE_COL_DIRECT_M_S7_S3 0 n_fl_M_S7_S3 0 10000 /end CHARACTERISTIC
/begin CHARACTERISTIC PHIS_NEIGUNG_OS_BMI_HAS "Max. Neigungswinkelin Grad fuer den Einstieg in das gebrueckte E-Fahren" VALUE 0x2646D0 FLOAT32_IEEE_COL_DIRECT_M_S7_S3 0 phigrad_fl_M_S7_S3 -100 100 /end CHARACTERISTIC
/begin CHARACTERISTIC PHIS_NEIGUNG_US_BMI_HAS "Min. Neigungswinkel in Grad fuer den Einstieg in das gebrueckte E-Fahren" VALUE 0x2646D4 FLOAT32_IEEE_COL_DIRECT_M_S7_S3 0 phigrad_fl_M_S7_S3 -100 100 /end CHARACTERISTIC
/begin CHARACTERISTIC PHIS_NEIGUNG1CVRKRI_LLS_HAS "Schwellwert des Fahrzeugneigungswinkels zur Aktivierung der Creep-Ruckel-Verhinderung (CRV) der Minimaldrehzahlvorgabe bei Kriechbetrieb (KRI) der Leerlaufsimulation der HAS (LLS)" VALUE 0x2646B8 FLOAT32_IEEE_COL_DIRECT_M_S7_S3 0 phigrad_fl_M_S7_S3 -42 42 /end CHARACTERISTIC
/begin CHARACTERISTIC PHIS_NEIGUNG2CVRKRI_LLS_HAS "Schwellwert des Fahrzeugneigungswinkels zur Deaktivierung der Creep-Ruckel-Verhinderung (CRV- ) der Minimaldrehzahlvorgabe bei Kriechbetrieb (KRI) der Leerlaufsimulation der HAS (LLS)" VALUE 0x2646BC FLOAT32_IEEE_COL_DIRECT_M_S7_S3 0 phigrad_fl_M_S7_S3 -42 42 /end CHARACTERISTIC
/begin CHARACTERISTIC PHIS_NEIGUNGD1_BERG_MSA_HAS "Schwellwert des Fahrzeugneigungswinkels zur Aktivierung der Beeinflussung der MSA-Funktionalitaet am Berg an der Steigung in Position D - Steigung = positiver Wert " VALUE 0x2646C0 FLOAT32_IEEE_COL_DIRECT_M_S7_S3 0 phigrad_fl_M_S7_S3 0 42 /end CHARACTERISTIC
/begin CHARACTERISTIC PHIS_NEIGUNGD2_BERG_MSA_HAS "Schwellwert des Fahrzeugneigungswinkels zur Deaktivierung der Beeinflussung der MSA-Funktionalitaet am Berg an der Steigung in Position D - Steigung = positiver Wert" VALUE 0x2646C4 FLOAT32_IEEE_COL_DIRECT_M_S7_S3 0 phigrad_fl_M_S7_S3 0 42 /end CHARACTERISTIC
/begin CHARACTERISTIC PHIS_NEIGUNGR1_BERG_MSA_HAS "Schwellwert des Fahrzeugneigungswinkels zur Aktivierung der Beeinflussung der MSA-Funktionalitaet am Berg im Gefaelle in Position R - Gefaelle = negativer Wert" VALUE 0x2646C8 FLOAT32_IEEE_COL_DIRECT_M_S7_S3 0 phigrad_fl_M_S7_S3 -42 0 /end CHARACTERISTIC
/begin CHARACTERISTIC PHIS_NEIGUNGR2_BERG_MSA_HAS "Schwellwert des Fahrzeugneigungswinkels zur Deaktivierung der Beeinflussung der MSA-Funktionalitaet am Berg im Gefaelle in Position R - Gefaelle = negativer Wert" VALUE 0x2646CC FLOAT32_IEEE_COL_DIRECT_M_S7_S3 0 phigrad_fl_M_S7_S3 -42 0 /end CHARACTERISTIC
/begin CHARACTERISTIC ST_ABLAUFMK0MBERZUS_HAS "Festlegung des Zustands beim Ablauf VM Zustart, ab dem das K0-Moment der HAS zur Motormomentbegrenzung in der SAB dem modifizierten K0-Ist-Moment der HAS entspricht" VALUE 0x26E10A UWORD_COL_DIRECT_M_S7_S3 0 sts_int_y_M_S7_S3 0 1000 /end CHARACTERISTIC
/begin CHARACTERISTIC STATUS_ABLAUFMEMRESRUECK_HAS "Statuswert oberhalb dessen  das EM-Reservemoment fuer den VM-Start abgebaut wird." VALUE 0x26ED5A UBYTE_COL_DIRECT_M_S7_S3 0 sts_int_M_S7_S3 0 50 /end CHARACTERISTIC
/begin CHARACTERISTIC STATUS_IAEADAP_BMI_HAS "Status der IAE-Adaption, der zum Verlassen des IAE Hybrid Betriebsmodus E-Fahren Kraftschluss fuehrt - Wert 0: keine Beeinflussung BMI" VALUE 0x26ED5B UBYTE_COL_DIRECT_M_S7_S3 0 sts_int_M_S7_S3 0 3 /end CHARACTERISTIC
/begin CHARACTERISTIC STATUS_K0_BBR_HAS "Einfluss fuer z_sas bei niedrigen Temperaturen" VALUE 0x26ED5E UBYTE_COL_DIRECT_M_S7_S3 0 sts_int_M_S7_S3 0 8 /end CHARACTERISTIC
/begin CHARACTERISTIC STATUS_K0ADAP_BMI_HAS "Status der K0-Adaption, der zum Verlassen des IAE Hybrid Betriebsmodus E-Fahren Kraftschluss fuehrt - Wert 0: keine Beeinflussung BMI" VALUE 0x26ED5C UBYTE_COL_DIRECT_M_S7_S3 0 sts_int_M_S7_S3 0 1 /end CHARACTERISTIC
/begin CHARACTERISTIC STATUS_K0ADAP_LLS_HAS "Status der K0-Adaption, der zur Ausgabe der minimalen EM-Drehzahl der Leerlaufsimulation der HAS (LLS) fuehrt - Wert 0: keine Drehzahlausgabe" VALUE 0x26ED5D UBYTE_COL_DIRECT_M_S7_S3 0 sts_int_M_S7_S3 0 3 /end CHARACTERISTIC
/begin CHARACTERISTIC STATUS_PSYS_LP_BMI_HAS "Status der Druckversorgung (Leistungspunkt LP1= 2; LP2= 3; LP3 =4)" VALUE 0x26ED5F UBYTE_COL_DIRECT_M_S7_S3 0 sts_int_M_S7_S3 0 4 /end CHARACTERISTIC
/begin CHARACTERISTIC STATUS_ZAEHLERK0ADA_ALA_HAS "Grenzwert des Adaptionszaehlers der K0-Adaption der Anlasserstartanforderung in Abhaengigkeit des Fortschritts der K0-Adaption (K0ADA) der Anlasseranforderung der HAS (ALA)" VALUE 0x26ED60 UBYTE_COL_DIRECT_M_S7_S3 0 sts_int_M_S7_S3 0 255 /end CHARACTERISTIC
/begin CHARACTERISTIC SWI_ANALYSE_AKTIV_HAS "Schalter zur Aktivierung der Analysefunktion MvG VM-Start" VALUE 0x26ED61 UBYTE_COL_DIRECT_M_S7_S3 0 swi_int_M_S7_S3 0 1 /end CHARACTERISTIC
/begin CHARACTERISTIC SWI_AUTOHOLDKRI_LLS_HAS "Schalter zur Aktivierung der Beruecksichtigung der Autohold-Bedingung bei der Aktivierung der Minimaldrehzahlvorgabe bei Kriechbetrieb (KRI) der Leerlaufsimulation der HAS (LLS)" VALUE 0x26ED62 UBYTE_COL_DIRECT_M_S7_S3 0 swi_int_M_S7_S3 0 1 /end CHARACTERISTIC
/begin CHARACTERISTIC SWI_BBR_AUS_BZ2_HAS "Schalter zur Aktivierung der Erkennung der Anforderung der K0 Ansteuerung aus dem Hybrid-Betriebszustand Abgekoppelt in P/N (2) der Beeinflussung der SAS Befuellreihenfolge durch die HAS" VALUE 0x26ED65 UBYTE_COL_DIRECT_M_S7_S3 0 swi_int_M_S7_S3 0 1 /end CHARACTERISTIC
/begin CHARACTERISTIC SWI_BBRFUWAKTIV_HAS "Schalter zur Aktivierung der Beeinflussung der Befuellreihenfolge durch die Hybrid Ablaufsteuerung bei erkannter EM-Fehlfunktion beim Zustart" VALUE 0x26ED63 UBYTE_COL_DIRECT_M_S7_S3 0 swi_int_M_S7_S3 0 1 /end CHARACTERISTIC
/begin CHARACTERISTIC SWI_BBRFUWGETRBEREIT_HAS "Schalter zur Aktivierung der Beruecksichtigung der Getriebebereitschaft bei der Beeinflussung der Befuellreihenfolge durch die Hybrid Ablaufsteuerung bei erkannter EM-Fehlfunktion beim Zustart" VALUE 0x26ED64 UBYTE_COL_DIRECT_M_S7_S3 0 swi_int_M_S7_S3 0 1 /end CHARACTERISTIC
/begin CHARACTERISTIC SWI_BMI_EFAHREN_KRAFTSCHLUSS "" VALUE 0x26ED68 UBYTE_COL_DIRECT_M_S7_S3 0 swi_int_M_S7_S3 0 1 /end CHARACTERISTIC
/begin CHARACTERISTIC SWI_CRVKRI_LLS_HAS "Schalter zur Aktivierung der Creep-Ruckel-Verhinderung (CRV) der Minimaldrehzahlvorgabe bei Kriechbetrieb (KRI) der Leerlaufsimulation der HAS (LLS)" VALUE 0x26ED69 UBYTE_COL_DIRECT_M_S7_S3 0 swi_int_M_S7_S3 0 1 /end CHARACTERISTIC
/begin CHARACTERISTIC SWI_EFAHRENCRVKRI_LLS_HAS "Schalter zur Beschraenkung der Aktivierung der Creep-Ruckel-Verhinderung (CRV) auf den Hybrid- Betriebszustand E-Fahren der Minimaldrehzahlvorgabe bei Kriechbetrieb (KRI) der Leerlaufsimulation der HAS (LLS)" VALUE 0x26ED6A UBYTE_COL_DIRECT_M_S7_S3 0 swi_int_M_S7_S3 0 1 /end CHARACTERISTIC
/begin CHARACTERISTIC SWI_ISTGANG1SAS_LLS_HAS "Schalter zur dauerhaften Aktivierung der Leerlaufsimulation der HAS (LLS) bei aktivem Schaltablauf bis zum Erreichen des 1.Gangs" VALUE 0x26ED6B UBYTE_COL_DIRECT_M_S7_S3 0 swi_int_M_S7_S3 0 1 /end CHARACTERISTIC
/begin CHARACTERISTIC SWI_ISTGANG2SAS_LLS_HAS "Schalter zur dauerhaften Aktivierung der Leerlaufsimulation der HAS (LLS) bei aktivem Schaltablauf bis zum Erreichen des 2.Gangs" VALUE 0x26ED6C UBYTE_COL_DIRECT_M_S7_S3 0 swi_int_M_S7_S3 0 1 /end CHARACTERISTIC
/begin CHARACTERISTIC SWI_MEMRESVMSTART_BAS_HAS "Schalter zur Aktivierung der kontinuierlichen Vorgabe des EM-Reservemoments fuer den VM-Start entsprechend Schleppstart" VALUE 0x26ED70 UBYTE_COL_DIRECT_M_S7_S3 0 swi_int_M_S7_S3 0 1 /end CHARACTERISTIC
/begin CHARACTERISTIC SWI_MK0REF_MK0MBER_HAS "Schalter zur Auswahl  des K0-Referenzmoments zur Bestimmung des K0-Moments der HAS zur Motormomentbegrenzung in der SAB - 0 = m_soll_k0_has_fkt, 1 = m_k0_in" VALUE 0x26ED76 UBYTE_COL_DIRECT_M_S7_S3 0 swi_int_M_S7_S3 0 1 /end CHARACTERISTIC
/begin CHARACTERISTIC SWI_MMOTMAX_K0SCHUTZ_HAS "Schalter zur Aktivierung der Begrenzung der EMDrehzahl zum Schutz der Trennkupplung K0 des Gefuehrten Getriebeschutz der HAS" VALUE 0x26ED77 UBYTE_COL_DIRECT_M_S7_S3 0 swi_int_M_S7_S3 0 1 /end CHARACTERISTIC
/begin CHARACTERISTIC SWI_MPSFUWAKTIV_HAS "Schalter zur Aktivierung der Anforderung der Modifikation des Pumpendruckstatus durch die Hybrid Ablaufsteuerung bei erkannter EM-Fehlfunktion beim Zustart" VALUE 0x26ED78 UBYTE_COL_DIRECT_M_S7_S3 0 swi_int_M_S7_S3 0 1 /end CHARACTERISTIC
/begin CHARACTERISTIC SWI_NAUFERKNSOLLEM_LLS_HAS "Schalter zur Auswahl der Basisdrehzahl bei der Bestimmung ob ein Drehzahlaufbau stattfinden wird bei EM-Drehzahlfuehrung durch ein sonstiges Steuergeraetder Leerlaufsimulation der HAS (LLS) - 0 = n_em_in, 1 = n_soll_em_hst_in" VALUE 0x26ED79 UBYTE_COL_DIRECT_M_S7_S3 0 swi_int_M_S7_S3 0 1 /end CHARACTERISTIC
/begin CHARACTERISTIC SWI_NEMFUEHRUNG_LLS_HAS "Schalter zur Festlegung des Steuergeraets, das die Fuehrung der minimalen EM-Drehzahl uebernimmt, der Leerlaufsimulation der HAS (LLS) - 0 = Drehzahlfuehrung durch ein sonstiges Steuergeraet, 1= Drehzahlfuehrung durch die EGS" VALUE 0x26ED7A UBYTE_COL_DIRECT_M_S7_S3 0 swi_int_M_S7_S3 0 1 /end CHARACTERISTIC
/begin CHARACTERISTIC SWI_NMINEMANHDAT_LLS_HAS "Schalter zur Aktivierung der Anhebung der EMMinimaldrehzahl bei aktiver Minimaldrehzahlvorgabe zur Verhinderung DAT-Massenanschlagen (DAT- ) zur Ausgabe als minimale EM-Drehzahl der Leerlaufsimulation der HAS (LLS)" VALUE 0x26ED7B UBYTE_COL_DIRECT_M_S7_S3 0 swi_int_M_S7_S3 0 1 /end CHARACTERISTIC
/begin CHARACTERISTIC SWI_NMINEMANHSPRUNGDAT_LLS_HAS "Schalter zur Aktivierung der sprungfoermigen Anhebung der EM-Minimaldrehzahl bei aktiver Minimaldrehzahlvorgabe zur Verhinderung DAT-Massenanschlagen (DAT) zur Ausgabe als minimale EM-Drehzahl der Leerlaufsimulation der HAS (LLS)" VALUE 0x26ED7C UBYTE_COL_DIRECT_M_S7_S3 0 swi_int_M_S7_S3 0 1 /end CHARACTERISTIC
/begin CHARACTERISTIC SWI_NMINEMNGEFINIT_LLS_HAS "Schalter zur Aktivierung der alleinigen Initialisierung des Gradientenbegrenzers der EM-Drehzahlfuehrung der Leerlaufsimulation der HAS (LLS)" VALUE 0x26ED7D UBYTE_COL_DIRECT_M_S7_S3 0 swi_int_M_S7_S3 0 1 /end CHARACTERISTIC
/begin CHARACTERISTIC SWI_NMINEMPSYSLP1IEP_LLS_HAS "Schalter zur Aktivierung der Ausgabe einer EM-Minimaldrehzahl zur Sicherstellung der Oelversorgung nach Leistungspunkt LP1 der Leerlaufsimulation der
HAS (LLS) bei IEP Fehleranzeige" VALUE 0x26ED7E UBYTE_COL_DIRECT_M_S7_S3 0 swi_int_M_S7_S3 0 1 /end CHARACTERISTIC
/begin CHARACTERISTIC SWI_SCHALTANFSAS_LLS_HAS "Schalter zur Aktivierung der der Leerlaufsimulation der HAS (LLS) bei aktivem Schaltablauf bereits bei Anforderung einer Schaltung durch die FST" VALUE 0x26ED7F UBYTE_COL_DIRECT_M_S7_S3 0 swi_int_M_S7_S3 0 1 /end CHARACTERISTIC
/begin CHARACTERISTIC SWI_TMAXSASAKTIV_MSA_HAS "Schalter zur Aktivierung der Ruecknahme der Anforderung der Beeinflussung der MSA-Funktionalitaet bei aktivem Schaltablauf waehrend einer laufenden Schaltung" VALUE 0x26ED80 UBYTE_COL_DIRECT_M_S7_S3 0 swi_int_M_S7_S3 0 1 /end CHARACTERISTIC
/begin CHARACTERISTIC SWI_ZNLLSOLLIAEKRI_LLS_HAS "Schalter zur Aktivierung der zusaetzlichen Beruecksichtigung der Anforderung des IAE-Moduls bei der Aktivierung der Leerlaufsimulation der HAS (LLS) bei Kriechbetrieb" VALUE 0x26ED83 UBYTE_COL_DIRECT_M_S7_S3 0 swi_int_M_S7_S3 0 1 /end CHARACTERISTIC
/begin CHARACTERISTIC SWI_ZUST_AKTIV_CGETR_LLS_HAS "Schalter zur Aktivierung der zusaetzlichen Beruecksichtigung der Hybrid-Zustaende in Verbindung mit der Getriebetemperatur zur Aktivierung der Leerlaufsimulation der HAS (LLS)" VALUE 0x26ED84 UBYTE_COL_DIRECT_M_S7_S3 0 swi_int_M_S7_S3 0 1 /end CHARACTERISTIC
/begin CHARACTERISTIC T_NMINEMBEFFZP_LLS_HAS "Zeitraum nach Erkennung der Betriebsbereitschaft zur Vorgabe einer EM-Minimaldrehzahl zur Befuellung der Fluegelzellenpumpe nach Systemstart der Leerlaufsimulation der HAS" VALUE 0x26E10C UWORD_COL_DIRECT_M_S7_S3 0 t_int_n_M_S7_S3 0 10 /end CHARACTERISTIC
/begin CHARACTERISTIC T_NMINEMMANH_LLS_HAS "Zeitraum nach einer Momentenanhebung zur Vorgabe einer EM-Minimaldrehzahl der Leerlaufsimulation der HAS (LLS)- Beachte: Wert Null deaktiviert die Funktion " VALUE 0x26E10E UWORD_COL_DIRECT_M_S7_S3 0 t_int_n_M_S7_S3 0 10 /end CHARACTERISTIC
/begin CHARACTERISTIC T_NMINEMPAUS_LLS_HAS "Zeitraum nach dem Auslegen der Parksperre zur Vorgabe einer EM-Minimaldrehzahl der Leerlaufsimulation der HAS" VALUE 0x26E110 UWORD_COL_DIRECT_M_S7_S3 0 t_int_n_M_S7_S3 0 10 /end CHARACTERISTIC
/begin CHARACTERISTIC T_NMINEMPOSNICHTRRANG_LLS_HAS "Maximale Dauer der Vorgabe der EM-Minimaldrehzahl bei Rangierbetrieb in allen Waehlhebelpositionen ausser R der Leerlaufsimulation der HAS (LLS)" VALUE 0x2646D8 ULONG_COL_DIRECT_M_S7_S3 0 t_int_M_S7_S3 0 5000 /end CHARACTERISTIC
/begin CHARACTERISTIC T_NMINEMPOSRRANG_LLS_HAS "Maximale Dauer der Vorgabe der EM-Minimaldrehzahl bei Rangierbetrieb in Waehlhebelposition R der Leerlaufsimulation der HAS (LLS)" VALUE 0x2646DC ULONG_COL_DIRECT_M_S7_S3 0 t_int_M_S7_S3 0 5000 /end CHARACTERISTIC
/begin CHARACTERISTIC T_VAUSD_BERG_MSA_HAS "Verzoegerungszeit zur Deaktivierung der Beeinflussung der MSA-Funktionalitaet am Berg beim Gang auslegen aus Position D" VALUE 0x2646E0 ULONG_COL_DIRECT_M_S7_S3 0 t_int_M_S7_S3 0 5 /end CHARACTERISTIC
/begin CHARACTERISTIC T_VAUSR_BERG_MSA_HAS "Verzoegerungszeit zur Deaktivierung der Beeinflussung der MSA-Funktionalitaet am Berg beim Gang auslegen aus Position R" VALUE 0x2646E4 ULONG_COL_DIRECT_M_S7_S3 0 t_int_M_S7_S3 0 5 /end CHARACTERISTIC
/begin CHARACTERISTIC T_VBRE_ABS_MSA_HAS "Verzoegerungszeit zur Deaktivierung der Beeinflussung der MSA-Funktionalitaet bei aktiven ABS-/ESP-Regelzustaenden beim Bremsen" VALUE 0x2646E8 ULONG_COL_DIRECT_M_S7_S3 0 t_int_M_S7_S3 0 5 /end CHARACTERISTIC
/begin CHARACTERISTIC T_VNEMBED_NDK0_MSA_HAS "Verzoegerungszeit nach Ueberschreiten der ersten VM Drehzahlschwelle  zur Aktivierung der Beeinflussung der MSA-Funktionalitaet bei geringer EM Drehzahl in Abhaengigkeit der Differenzdrehzahl der K0 zum Schutz der K0" VALUE 0x2646EC FLOAT32_IEEE_COL_DIRECT_M_S7_S3 0 t_fl_M_S7_S3 0 600 /end CHARACTERISTIC
/begin CHARACTERISTIC T_VNMINEMVGF_LLS_HAS "Verzoegerungszeit zum Ruecksetzen der minimalen EM Drehzahl zur Sicherstellung Oelversorgung beim starken Abbremsen der Leerlaufsimulation der HAS - Beachte: Wert Null deaktiviert die Funktion" VALUE 0x26E116 UWORD_COL_DIRECT_M_S7_S3 0 t_int_n_M_S7_S3 0 10 /end CHARACTERISTIC
/begin CHARACTERISTIC T_VRUECKAUTOHOLDKRI_LLS_HAS "Verzoegerungszeit zum Ruecksetzen der Minimaldrehzahlvorgabe bei Kriechbetrieb (KRI) bei Aktivierung der Autohold-Funktion zur Ausgabe als minimale EM-Drehzahl der Leerlaufsimulation der HAS (LLS)" VALUE 0x26E118 UWORD_COL_DIRECT_M_S7_S3 0 t_int_n_M_S7_S3 0 10 /end CHARACTERISTIC
/begin CHARACTERISTIC T_VRUECKGELSAS_MSA_HAS "Verzoegerungszeit zur Ruecknahme der Beeinflussung der MSA-Funktionalitaet bei aktivem Schaltablauf beim Gangeinlegen" VALUE 0x2646F0 FLOAT32_IEEE_COL_DIRECT_M_S7_S3 0 t_fl_M_S7_S3 0 10 /end CHARACTERISTIC
/begin CHARACTERISTIC T_VRUECKHILLHOLDKRI_LLS_HAS "Verzoegerungszeit zum Ruecksetzen der Minimaldrehzahlvorgabe bei Kriechbetrieb (KRI) bei Deaktivierung der Hillhold-Funktion zur Ausgabe als minimale EM-Drehzahl der Leerlaufsimulation der HAS (LLS)" VALUE 0x26E11A UWORD_COL_DIRECT_M_S7_S3 0 t_int_n_M_S7_S3 0 10 /end CHARACTERISTIC
/begin CHARACTERISTIC T_ZSASFUWMAX_BBR_HAS "Maximaler Zeitraum nach Erkennung der EM-Fehlfunktion beim Zustart in dem die Beeinflussung der SAS Befuellreihenfolge durch die HAS aktiv ist" VALUE 0x26E120 UWORD_COL_DIRECT_M_S7_S3 0 t_int_n_M_S7_S3 0 5 /end CHARACTERISTIC
/begin CHARACTERISTIC T_ZSASHASAKTIV_BBR_HAS "Zeitraum nach Erkennung der Betriebsbereitschaft des Hybridsystems, in dem die Beeinflussung der SAS Befuellreihenfolge durch die HAS bestaetigt werden muss" VALUE 0x26E122 UWORD_COL_DIRECT_M_S7_S3 0 t_int_n_M_S7_S3 0 5 /end CHARACTERISTIC
/begin CHARACTERISTIC T_ZSASSLSTMAX_BBR_HAS "Timer fuer die maximale Zeitraum nach Erkennen eines Schleppstarts in dem die Beeinflussung des SAS Befuellreihenfolge anstehen darf " VALUE 0x26E124 UWORD_COL_DIRECT_M_S7_S3 0 t_int_n_M_S7_S3 0 5 /end CHARACTERISTIC
/begin CHARACTERISTIC TAB_BMZFKTMSA_MSA_HAS "Tabelle der Bitmasken zur Festlegung der Anforderung der Beeinflussung der MSA-Funktionalitaet bei aktiver Hybridfunktion in Abhaengigkeit der aktiven Hybridfunktion - Codierung wie z_msa_has_sbe" VAL_BLK 0x2644D0 UBYTE_COL_DIRECT_M_S7_S3 0 sts_int_M_S7_S3 0 255 NUMBER 16 /end CHARACTERISTIC
/begin CHARACTERISTIC TAB_BMZMSAAKTIV_MSA_HAS "Bitmaske zur Festlegung, welche der Beeinflussungsmoeglichkeiten der MSA-Funktionalitaet durch die HAS aktiviert sind - f(st_ist_bz_has_stg)" VAL_BLK 0x2644E0 UBYTE_COL_DIRECT_M_S7_S3 0 sts_int_M_S7_S3 0 255 NUMBER 16 /end CHARACTERISTIC
/begin CHARACTERISTIC TAB_BMZSASMSAHS_MSA_HAS "Festlegung der Anforderung der Beeinflussung der MSA-Funktionalitaet bei aktivem Schaltablauf Hochschaltung in Abhaengigkeit des Zielgangs - Codierung wie z_msa_has_sbe" VAL_BLK 0x26ED22 UBYTE_COL_DIRECT_M_S7_S3 0 void_int_M_S7_S3 0 255 NUMBER 9 /end CHARACTERISTIC
/begin CHARACTERISTIC TAB_BMZSASMSARS_MSA_HAS "Festlegung der Anforderung der Beeinflussung der MSA-Funktionalitaet bei aktivem Schaltablauf Rueckschaltung in Abhaengigkeit des Zielgangs - Codierung wie z_msa_has_sbe" VAL_BLK 0x26ED2B UBYTE_COL_DIRECT_M_S7_S3 0 void_int_M_S7_S3 0 255 NUMBER 9 /end CHARACTERISTIC
/begin CHARACTERISTIC TAB_MGEMRESRUECK_HAS "Momentengradient zur Ruecknahme des EM-Reservemoments beim VM-Start in Abhaengigkeit des IAE Status" VAL_BLK 0x2643AC FLOAT32_IEEE_COL_DIRECT_M_S7_S3 0 trqg_fl_k_M_S7_S3 -50000 0 NUMBER 9 /end CHARACTERISTIC
/begin CHARACTERISTIC TAB_NSEMMINFKT_LLS_HAS "Festlegung der minimalen EM-Drehzahl unterhalb derer die LLS bei aktiver Hybridfunktion nicht aktiviert wird in Abhaengigkeit der von der Hybrid-Zustandssteuerung angeforderten Hybridfunktion des Moduls Leerlaufsimulation der HAS (LLS)" VAL_BLK 0x2643D0 FLOAT32_IEEE_COL_DIRECT_M_S7_S3 0 n_int_x_M_S7_S3 0 10000 NUMBER 16 /end CHARACTERISTIC
/begin CHARACTERISTIC TAB_NSVMMAXFKT_LLS_HAS "Festlegung der maximalen VM-Drehzahl oberhalb derer die LLS bei aktiver Hybridfunktion deaktiviert wird in Abhaengigkeit der von der Hybrid-Zustandssteuerung angeforderten Hybridfunktion des Moduls Leerlaufsimulation der HAS (LLS)" VAL_BLK 0x264410 FLOAT32_IEEE_COL_DIRECT_M_S7_S3 0 n_int_x_M_S7_S3 0 10000 NUMBER 16 /end CHARACTERISTIC
/begin CHARACTERISTIC TAB_PMAX_IEP_HAS "Maximaler Systemdruck abhaengig vom Zustand der IEP" VAL_BLK 0x264450 FLOAT32_IEEE_COL_DIRECT_M_S7_S3 0 p_fl_M_S7_S3 0 30 NUMBER 5 /end CHARACTERISTIC
/begin CHARACTERISTIC TAB_STATUSEFAHREN_BMI_HAS "Festlegung des Status E-Fahren der HAS in Abhaengigkeit des Betriebszustands der Hybrid-Zustandssteuerung" VAL_BLK 0x2644F0 UBYTE_COL_DIRECT_M_S7_S3 0 sts_int_M_S7_S3 0 1 NUMBER 16 /end CHARACTERISTIC
/begin CHARACTERISTIC TAB_STATUSEFAHREN_OUT_HAS "Festlegung des Status E-Fahren der HAS in Abhaengigkeit des Betriebszustands der Hybrid-Zustandssteuerung" VAL_BLK 0x264500 UBYTE_COL_DIRECT_M_S7_S3 0 sts_int_M_S7_S3 0 1 NUMBER 16 /end CHARACTERISTIC
/begin CHARACTERISTIC TAB_STATUSIAE_IAE_ALA_HAS "Tabelle zur Festlegung der IAE-Zustaende zur Aktivierung der Anlasseranforderung in Abhaengigkeit des IAE Betriebszustands (IAE) der Anlasseranforderung der HAS (ALA) in Abhaengigkeit des IAEStatus" VAL_BLK 0x26ED3D UBYTE_COL_DIRECT_M_S7_S3 0 sts_int_e_M_S7_S3 0 1 NUMBER 9 /end CHARACTERISTIC
/begin CHARACTERISTIC TAB_STATUSK0FKT_LLS_HAS "Festlegung des Werts des K0-Status oberhalb dem die LLS bei aktiver Hybridfunktion deaktiviert wird in Abhaengigkeit der von der Hybrid-Zustandssteuerung angeforderten Hybridfunktion des Moduls Leerlaufsimulation der HAS (LLS)" VAL_BLK 0x264510 UBYTE_COL_DIRECT_M_S7_S3 0 sts_int_M_S7_S3 0 10 NUMBER 16 /end CHARACTERISTIC
/begin CHARACTERISTIC TAB_STKRAFTFLUSS_NDK0_MSA_HAS "Erkennen Gangeinlegen zur Beeinflussung der MSA-Funktionalitaet bei einer zu grossen ND_K0" VAL_BLK 0x26ED46 UBYTE_COL_DIRECT_M_S7_S3 0 sts_int_M_S7_S3 0 1 NUMBER 7 /end CHARACTERISTIC
/begin CHARACTERISTIC TAB_TMAXSRSSAS_MSA_HAS "Maximalzeit der Anforderung der Beeinflussung der MSA-Funktionalitaet bei aktivem Schaltablauf bei Schub RS im Hybridfahren in Abhaengigkeit des Zielgangs" VAL_BLK 0x264464 ULONG_COL_DIRECT_M_S7_S3 0 t_int_M_S7_S3 0 1000 NUMBER 9 /end CHARACTERISTIC
/begin CHARACTERISTIC TAB_TVRUECKSRSSAS_MSA_HAS "Verzoegerungszeit zur Ruecknahme der Anforderung der Beeinflussung der MSA-Funktionalitaet bei aktivem Schaltablauf bei Schub RS im Hybridfahren in Abhaengigkeit des Zielgangs" VAL_BLK 0x264488 ULONG_COL_DIRECT_M_S7_S3 0 t_int_M_S7_S3 0 10 NUMBER 9 /end CHARACTERISTIC
/begin CHARACTERISTIC TAB_ZSTATUSEFAHREN_BMI_MOD_HAS "Festlegung des Umschaltmodus des Status E-Fahren des IAE Hybrid Betriebsmodus  der HAS in Abhaengigkeit der von der Hybrid-Zustandssteuerung angeforderten Hybridfunktion" VAL_BLK 0x264524 UBYTE_COL_DIRECT_M_S7_S3 0 sts_int_M_S7_S3 0 3 NUMBER 16 /end CHARACTERISTIC
/begin CHARACTERISTIC TAB_ZSTATUSEFAHREN_OUT_MOD_HAS "Festlegung des Umschaltmodus des Status E-Fahren der HAS in Abhaengigkeit der von der Hybrid-Zustandssteuerung angeforderten Hybridfunktion" VAL_BLK 0x264534 UBYTE_COL_DIRECT_M_S7_S3 0 sts_int_M_S7_S3 0 3 NUMBER 16 /end CHARACTERISTIC
/begin CHARACTERISTIC VGS_F1_VGF_MSA_HAS "Fahrzeuggeschwindigkeitsgradientenschwelle zur Aktivierung der Beeinflussung der MSA-Funktionalitaet in Abhaengigkeit des Fahrzeuggeschwindigkeitsgradienten" VALUE 0x2646F4 FLOAT32_IEEE_COL_DIRECT_M_S7_S3 0 vg_fl_M_S7_S3 -100 100 /end CHARACTERISTIC
/begin CHARACTERISTIC VGS_F2_VGF_MSA_HAS "Fahrzeuggeschwindigkeitsgradientenschwelle zur Deaktivierung der Beeinflussung der MSA-Funktionalitaet in Abhaengigkeit des Fahrzeuggeschwindigkeitsgradienten" VALUE 0x2646F8 FLOAT32_IEEE_COL_DIRECT_M_S7_S3 0 vg_fl_M_S7_S3 -100 100 /end CHARACTERISTIC
/begin CHARACTERISTIC VGS_FBRE_ABS_MSA_HAS "Fahrzeuggeschwindigkeitsgradientenschwelle zur Aktivierung der Beeinflussung der MSA-Funktionalitaet bei aktiven ABS-/ESP-Regelzustaenden beim Bremsen" VALUE 0x264704 FLOAT32_IEEE_COL_DIRECT_M_S7_S3 0 vg_fl_M_S7_S3 -100 100 /end CHARACTERISTIC
/begin CHARACTERISTIC VGS_FBRE1VGF_LLS_HAS "Fahrzeuggeschwindigkeitsgradienten-schwelle zum Setzen der minimalen EM Drehzahl zur Sicherstellung Oelversorgung beim starken Abbremsen der Leerlaufsimulation der HAS (LLS)" VALUE 0x2646FC FLOAT32_IEEE_COL_DIRECT_M_S7_S3 0 vg_fl_M_S7_S3 -100 100 /end CHARACTERISTIC
/begin CHARACTERISTIC VGS_FBRE2VGF_LLS_HAS "Fahrzeuggeschwindigkeitsgradientenschwelle zum Ruecksetzen der minimalen EM Drehzahl zur Sicherstellung Oelversorgung beim starken Abbremsen der Leerlaufsimulation der HAS (LLS)" VALUE 0x264700 FLOAT32_IEEE_COL_DIRECT_M_S7_S3 0 vg_fl_M_S7_S3 -100 100 /end CHARACTERISTIC
/begin CHARACTERISTIC VGS_FKRI_IAE_MSA_HAS "Fahrzeuggeschwindigkeitsgradientenschwelle zur Aktivierung der Beeinflussung der MSA-Funktionalitaet in Abhaengigkeit des IAE Betriebszustands Kriechen" VALUE 0x264708 FLOAT32_IEEE_COL_DIRECT_M_S7_S3 0 vg_fl_M_S7_S3 0 100 /end CHARACTERISTIC
/begin CHARACTERISTIC VS_F_GE_ALA_HAS "Fahrzeuggeschwindigkeitsschwelle zur Aktivierung der Anlasserstartanforderung beim Gangeinlegen (GE) der Anlasseranforderung der HAS (ALA)" VALUE 0x26474C FLOAT32_IEEE_COL_DIRECT_M_S7_S3 0 v_fl_M_S7_S3 0 500 /end CHARACTERISTIC
/begin CHARACTERISTIC VS_F1_KFL_MSA_HAS "Fahrzeuggeschwindigkeitsschwelle zur Aktiverung der Beeinflussung der MSA-Funktionalitaet in Abhaengigkeit des Kraftfluss-Status" VALUE 0x264710 FLOAT32_IEEE_COL_DIRECT_M_S7_S3 0 v_fl_M_S7_S3 0 500 /end CHARACTERISTIC
/begin CHARACTERISTIC VS_F1DAT_LLS_HAS "Fahrzeuggeschwindigkeitsschwelle zur Aktivierung der Minimaldrehzahlvorgabe zur Verhinderung DAT-Massenanschlagen ( DAT) zur Ausgabe als minimale EM-Drehzahl der Leerlaufsimulation der HAS (LLS)" VALUE 0x26470C FLOAT32_IEEE_COL_DIRECT_M_S7_S3 0 v_fl_M_S7_S3 0 500 /end CHARACTERISTIC
/begin CHARACTERISTIC VS_F2_KFL_MSA_HAS "Fahrzeuggeschwindigkeitsschwelle zur Deaktivierung der Beeinflussung der MSA-Funktionalitaet in Abhaengigkeit des Kraftfluss-Status" VALUE 0x264718 FLOAT32_IEEE_COL_DIRECT_M_S7_S3 0 v_fl_M_S7_S3 0 500 /end CHARACTERISTIC
/begin CHARACTERISTIC VS_F2DAT_LLS_HAS "Fahrzeuggeschwindigkeitsschwelle zur Deaktivierung der Minimaldrehzahlvorgabe zur Verhinderung DAT-Massenanschlagen ( DAT) zur Ausgabe als minimale EM-Drehzahl der Leerlaufsimulation der HAS (LLS)" VALUE 0x264714 FLOAT32_IEEE_COL_DIRECT_M_S7_S3 0 v_fl_M_S7_S3 0 500 /end CHARACTERISTIC
/begin CHARACTERISTIC VS_FBRE_ABS_MSA_HAS "Fahrzeuggeschwindigkeitsschwelle zur Deaktivierung der Beeinflussung der MSA-Funktionalitaet bei aktiven ABS-/ESP-Regelzustaenden beim Bremsen" VALUE 0x264720 FLOAT32_IEEE_COL_DIRECT_M_S7_S3 0 v_fl_M_S7_S3 0 500 /end CHARACTERISTIC
/begin CHARACTERISTIC VS_FBREVGF_LLS_HAS "Fahrzeuggeschwindigkeitsschwelle zum Setzen bzw. Ruecksetzen der minimalen EM Drehzahl zur Sicherstellung Oelversorgung beim starken Abbremsen der Leerlaufsimulation der HAS (LLS)" VALUE 0x26471C FLOAT32_IEEE_COL_DIRECT_M_S7_S3 0 v_fl_M_S7_S3 0 500 /end CHARACTERISTIC
/begin CHARACTERISTIC VS_FD1_BERG_MSA_HAS "Fahrzeuggeschwindigkeitsschwelle zur Aktivierung der Beeinflussung der MSA-Funktionalitaet am Berg an der Steigung in Position D " VALUE 0x264724 FLOAT32_IEEE_COL_DIRECT_M_S7_S3 0 v_fl_M_S7_S3 0 500 /end CHARACTERISTIC
/begin CHARACTERISTIC VS_FD2_BERG_MSA_HAS "Fahrzeuggeschwindigkeitsschwelle zur Deaktivierung der Beeinflussung der MSA-Funktionalitaet am Berg an der Steigung in Position D" VALUE 0x264728 FLOAT32_IEEE_COL_DIRECT_M_S7_S3 0 v_fl_M_S7_S3 0 500 /end CHARACTERISTIC
/begin CHARACTERISTIC VS_FKFL_LLS_HAS "Fahrzeuggeschwindigkeitsschwelle zur Aktiverung der minimalen EM-Drehzahl der Leerlaufsimulation der HAS (LLS) in Abhaengigkeit des Kraftfluss-Status zur Sicherstellung der Oelversorgung bei einem in Neutral rollenden Fahrzeug" VALUE 0x26472C FLOAT32_IEEE_COL_DIRECT_M_S7_S3 0 v_fl_M_S7_S3 0 500 /end CHARACTERISTIC
/begin CHARACTERISTIC VS_FKRI_IAE_MSA_HAS "Fahrzeuggeschwindigkeitsschwelle zur Deaktivierung der Beeinflussung der MSA-Funktionalitaet in Abhaengigkeit des IAE Betriebszustands Kriechen bei Fahrzeugstillstand" VALUE 0x264730 FLOAT32_IEEE_COL_DIRECT_M_S7_S3 0 v_fl_M_S7_S3 0 500 /end CHARACTERISTIC
/begin CHARACTERISTIC VS_FKRI_LLS_HAS "Fahrzeuggeschwindigkeitsschwelle zur Aktivierung der Minimaldrehzahlvorgabe bei Kriechbetrieb (KRI) zur Ausgabe als minimale EM-Drehzahl der Leerlaufsimulation der HAS (LLS)" VALUE 0x264734 FLOAT32_IEEE_COL_DIRECT_M_S7_S3 0 v_fl_M_S7_S3 0 500 /end CHARACTERISTIC
/begin CHARACTERISTIC VS_FMAX_VGF_MSA_HAS "Maximale Fahrzeuggeschwindigkeitsschwelle zur Aktivierung der Beeinflussung der MSA-Funktionalitaet in Abhaengigkeit des Fahrzeuggeschwindigkeitsgradienten" VALUE 0x26473C FLOAT32_IEEE_COL_DIRECT_M_S7_S3 0 v_fl_M_S7_S3 0 500 /end CHARACTERISTIC
/begin CHARACTERISTIC VS_FMAXRANG_LLS_HAS "Maximale Fahrzeuggeschwindigkeit zur Aktivierung der Minimaldrehzahlvorgabe bei Rangierbetrieb (RANG) zur Ausgabe als minimale EMDrehzahl der Leerlaufsimulation der HAS (LLS)" VALUE 0x264738 FLOAT32_IEEE_COL_DIRECT_M_S7_S3 0 v_fl_M_S7_S3 0 500 /end CHARACTERISTIC
/begin CHARACTERISTIC VS_FMIN_VGF_MSA_HAS "Minimale Fahrzeuggeschwindigkeitsschwelle zur Aktiverung bzw. Deaktivierung der Beeinflussung der MSA-Funktionalitaet in Abhaengigkeit des Fahrzeuggeschwin-digkeitsgradienten" VALUE 0x264740 FLOAT32_IEEE_COL_DIRECT_M_S7_S3 0 v_fl_M_S7_S3 0 500 /end CHARACTERISTIC
/begin CHARACTERISTIC VS_FR1_BERG_MSA_HAS "Fahrzeuggeschwindigkeitsschwelle zur Aktivierung der Beeinflussung der MSA-Funktionalitaet am Berg im Gefaelle in Position R " VALUE 0x264744 FLOAT32_IEEE_COL_DIRECT_M_S7_S3 0 v_fl_M_S7_S3 0 500 /end CHARACTERISTIC
/begin CHARACTERISTIC VS_FR2_BERG_MSA_HAS "Fahrzeuggeschwindigkeitsschwelle zur Deaktivierung der Beeinflussung der MSA-Funktionalitaet am Berg im Gefaelle in Position R " VALUE 0x264748 FLOAT32_IEEE_COL_DIRECT_M_S7_S3 0 v_fl_M_S7_S3 0 500 /end CHARACTERISTIC
/begin AXIS_PTS KF_ANALYSEABLVAR_HAS_X "X-Achse: z_ablaufvariante_has_hst_in" 0x264324 z_ablaufvariante_has_stg UBYTE_X_INCR_DIRECT_M_S7_S3 0 void_int_M_S7_S3 8 0 30 /end AXIS_PTS
/begin AXIS_PTS KF_ANALYSEABLVAR_HAS_Y "X-Achse: z_hybfkt_stg" 0x26ECAE z_hybfkt_stg UBYTE_X_INCR_DIRECT_M_S7_S3 0 void_int_M_S7_S3 3 0 15 /end AXIS_PTS
/begin AXIS_PTS KF_CINITDAT_LLS_HAS_X "" 0x263890 NO_INPUT_QUANTITY FLOAT32_IEEE_X_INCR_DIRECT_M_S7_S3 0 c_fl_M_S7_S3 8 -50 200 /end AXIS_PTS
/begin AXIS_PTS KF_CINITDAT_LLS_HAS_Y "" 0x2638B0 NO_INPUT_QUANTITY FLOAT32_IEEE_X_INCR_DIRECT_M_S7_S3 0 c_fl_M_S7_S3 6 -50 200 /end AXIS_PTS
/begin AXIS_PTS KF_MEMRESVMSTART_HAS_X "Kennlinie fuer Momentenreserve EM ueber Ablaufvariante und VM-Startmoment" 0x263940 NO_INPUT_QUANTITY FLOAT32_IEEE_X_INCR_DIRECT_M_S7_S3 0 sts_fl_M_S7_S3 5 -3.40282346639E+038 3.40282346639E+038 /end AXIS_PTS
/begin AXIS_PTS KF_MEMRESVMSTART_HAS_Y "Kennlinie fuer Momentenreserve EM ueber Ablaufvariante und VM-Startmoment" 0x263954 m_vm_start_in FLOAT32_IEEE_X_INCR_DIRECT_M_S7_S3 0 trq_fl_a_M_S7_S3 6 -3.40282E+038 3.40282E+038 /end AXIS_PTS
/begin AXIS_PTS KF_MK0MBERZUSBASIS_HAS_X "Basiswert des K0 Moments beim Zustart zur Bestimmung des K0-Moments der HAS zur Motormomentbegrenzung in der SAB in Abhaengigkeit des K0-Referenzmoments und der K0 Differenzdrehzahl" 0x263A30 NO_INPUT_QUANTITY FLOAT32_IEEE_X_INCR_DIRECT_M_S7_S3 0 m_fl_M_S7_S3 7 -3.40282E+038 3.40282E+038 /end AXIS_PTS
/begin AXIS_PTS KF_MK0MBERZUSBASIS_HAS_Y "Basiswert des K0 Moments beim Zustart zur Bestimmung des K0-Moments der HAS zur Motormomentbegrenzung in der SAB in Abhaengigkeit des K0-Referenzmoments und der K0 Differenzdrehzahl" 0x263A4C nd_k0_in FLOAT32_IEEE_X_INCR_DIRECT_M_S7_S3 0 n_fl_M_S7_S3 7 -3.40282E+038 3.40282E+038 /end AXIS_PTS
/begin AXIS_PTS KF_MMOTMAX_HAS_X "Maximales Getriebeeingangsmoment: Gangindex" 0x263B58 NO_INPUT_QUANTITY FLOAT32_IEEE_X_INCR_DIRECT_M_S7_S3 0 sts_fl_M_S7_S3 10 -3.40282346639E+038 3.40282346639E+038 /end AXIS_PTS
/begin AXIS_PTS KF_MMOTMAX_HAS_Y "Maximales Getriebeeingangsmoment: Druck" 0x263B80 NO_INPUT_QUANTITY FLOAT32_IEEE_X_INCR_DIRECT_M_S7_S3 0 void_fl_M_S7_S3 6 -3.40282E+038 3.40282E+038 /end AXIS_PTS
/begin AXIS_PTS KF_NGMINEMMIN3_LLS_HAS_X "Eingang: Istagng, Unterdrueckung der Drehzahlausgabe n_min_em_has_sbe abhaengig von Ist- und Zielgang" 0x263BF8 NO_INPUT_QUANTITY FLOAT32_IEEE_X_INCR_DIRECT_M_S7_S3 0 n_fl_M_S7_S3 6 -3.40282E+038 3.40282E+038 /end AXIS_PTS
/begin AXIS_PTS KF_NGMINEMMIN3_LLS_HAS_Y "Eingang: Zielgang, Unterdrueckung der Drehzahlausgabe n_min_em_has_sbe abhaengig von Ist- und Zielgang" 0x263C10 NO_INPUT_QUANTITY FLOAT32_IEEE_X_INCR_DIRECT_M_S7_S3 0 n_fl_M_S7_S3 4 -3.40282E+038 3.40282E+038 /end AXIS_PTS
/begin AXIS_PTS KF_NOSECIAEKRI_LLS_HAS_X "Festlegung des Drehzahloffsets auf die sekundaere IAE-Drehzahl der Mindrehzahlvorgabe bei Kriechbetrieb(KRI) in Abhaengigkeit des Fahrzeugbremsdrucks und der sekundaeren IAE-Drehzahl zur Ausgabe als minimale EM-Drehzahl der Leerlaufsimulation der HAS(LLS)" 0x263C80 p_bremse_fzg_in FLOAT32_IEEE_X_INCR_DIRECT_M_S7_S3 0 p_fl_M_S7_S3 6 0 127 /end AXIS_PTS
/begin AXIS_PTS KF_NOSECIAEKRI_LLS_HAS_Y "Festlegung des Drehzahloffsets auf die sekundaere IAE-Drehzahl der Mindrehzahlvorgabe bei Kriechbetrieb(KRI) in Abhaengigkeit des Fahrzeugbremsdrucks und der sekundaeren IAE-Drehzahl zur Ausgabe als minimale EM-Drehzahl der Leerlaufsimulation der HAS(LLS)" 0x263C98 NO_INPUT_QUANTITY FLOAT32_IEEE_X_INCR_DIRECT_M_S7_S3 0 n_fl_M_S7_S3 4 0 10000 /end AXIS_PTS
/begin AXIS_PTS KF_PMAX_FZP_HAS_X "Maximaler Systemdruck ueber FZP in Abhaengigkeit von E-Maschinen-Drehzahl und Getriebetemperatur: Temperatur" 0x263D20 c_getriebe_egs_in FLOAT32_IEEE_X_INCR_DIRECT_M_S7_S3 0 c_fl_M_S7_S3 5 -3.40282E+038 3.40282E+038 /end AXIS_PTS
/begin AXIS_PTS KF_PMAX_FZP_HAS_Y "Maximaler Systemdruck ueber FZP in Abhaengigkeit von E-Maschinen-Drehzahl und Getriebetemperatur: Drehzahl" 0x263D34 n_em_in FLOAT32_IEEE_X_INCR_DIRECT_M_S7_S3 0 trq_fl_a_M_S7_S3 6 -3.40282E+038 3.40282E+038 /end AXIS_PTS
/begin AXIS_PTS KF_ZNOMINEMGANG_LLS_HAS_X "Eingang: Istagng, Unterdrueckung der Drehzahlausgabe n_min_em_has_sbe abhaengig von Ist- und Zielgang" 0x26436C istgang_egs_in SBYTE_X_INCR_DIRECT_M_S7_S3 0 st_int_M_S7_S3 8 -128 127 /end AXIS_PTS
/begin AXIS_PTS KF_ZNOMINEMGANG_LLS_HAS_Y "Eingang: Zielgang, Unterdrueckung der Drehzahlausgabe n_min_em_has_sbe abhaengig von Ist- und Zielgang" 0x264374 zielgang_egs_in SBYTE_X_INCR_DIRECT_M_S7_S3 0 st_int_M_S7_S3 8 -128 127 /end AXIS_PTS
/begin AXIS_PTS KL_ABLVARZSASAKTIV_BBR_HAS_X "Ablaufvariante zur Beeinflussung der K0 Ansteuerung im Zustandsuebergang I-NIT_KL15 (14) nach LADEN (5) (Aenderung der Befuellreihenfolge) durch die HAS" 0x26437C z_ablaufvariante_has_stg UBYTE_X_INCR_DIRECT_M_S7_S3 0 sts_int_M_S7_S3 8 0 99 /end AXIS_PTS
/begin AXIS_PTS KL_CGMAXVMAUSDAT_LLS_HAS_X "" 0x263D4C NO_INPUT_QUANTITY FLOAT32_IEEE_X_INCR_DIRECT_M_S7_S3 0 c_fl_M_S7_S3 8 -3.40282E+038 3.40282E+038 /end AXIS_PTS
/begin AXIS_PTS KL_CGMAXVMEINDAT_LLS_HAS_X "" 0x263D8C NO_INPUT_QUANTITY FLOAT32_IEEE_X_INCR_DIRECT_M_S7_S3 0 c_int_M_S7_S3 8 -3.40282E+038 3.40282E+038 /end AXIS_PTS
/begin AXIS_PTS KL_CSGETRAUS_CGETR_MSA_HAS_X "Getriebeoeltemperaturschwelle abhaengig von der Temperatur des Getriebes bei Systemstart zur Deaktivierung der Beeinflussung der MSA-Funktionalitaet in Abhaengigkeit der Getriebeoeltemperatur" 0x263DCC NO_INPUT_QUANTITY FLOAT32_IEEE_X_INCR_DIRECT_M_S7_S3 0 c_fl_M_S7_S3 4 -50 200 /end AXIS_PTS
/begin AXIS_PTS KL_KNMINEMANGEHOBENDAT_LLS_HAS_X "" 0x263DEC n_ab_egs_in FLOAT32_IEEE_X_INCR_DIRECT_M_S7_S3 0 n_fl_M_S7_S3 8 0 10000 /end AXIS_PTS
/begin AXIS_PTS KL_MSMOTMAXIAEENTK_ALA_HAS_X "X-Achse: istgang_egs_in" 0x263E2C NO_INPUT_QUANTITY FLOAT32_IEEE_X_INCR_DIRECT_M_S7_S3 0 sts_fl_M_S7_S3 10 -1 8 /end AXIS_PTS
/begin AXIS_PTS KL_MSMOTMINIAEENTK_ALA_HAS_X "X-Achse: istgang_egs_in" 0x263E7C NO_INPUT_QUANTITY FLOAT32_IEEE_X_INCR_DIRECT_M_S7_S3 0 sts_fl_M_S7_S3 10 -1 8 /end AXIS_PTS
/begin AXIS_PTS KL_NGMINEMMAX1_LLS_HAS_X "Maximaler Drehzahlgradient der ungefilterten minimalen EM-Drehzahl in Abhaengigkeit der ungefilterten minimalen EM-Drehzahl im Drehzahlaufbau Modus 1 (schnell) der Leerlaufsimulation der HAS (LLS)" 0x263F1C NO_INPUT_QUANTITY FLOAT32_IEEE_X_INCR_DIRECT_M_S7_S3 0 n_fl_M_S7_S3 6 -3.40282E+038 3.40282E+038 /end AXIS_PTS
/begin AXIS_PTS KL_NGMINEMMAX2_LLS_HAS_X "Maximaler Drehzahlgradient der ungefilterten minimalen EM-Drehzahl in Abhaengigkeit der ungefilterten minimalen EM-Drehzahl im Drehzahlaufbau Modus 2 (zuegig und komfortabel) der Leerlaufsimulation der HAS (LLS)" 0x263F4C NO_INPUT_QUANTITY FLOAT32_IEEE_X_INCR_DIRECT_M_S7_S3 0 n_fl_M_S7_S3 6 -3.40282E+038 3.40282E+038 /end AXIS_PTS
/begin AXIS_PTS KL_NGMINEMMAX3_LLS_HAS_X "Maximaler Drehzahlgradient der ungefilterten minimalen EM-Drehzahl in Abhaengigkeit der ungefilterten minimalen EM-Drehzahl im Drehzahlaufbau Modus 3 (komfortabel) der Leerlaufsimulation der HAS (LLS)" 0x263F7C NO_INPUT_QUANTITY FLOAT32_IEEE_X_INCR_DIRECT_M_S7_S3 0 n_fl_M_S7_S3 6 -3.40282E+038 3.40282E+038 /end AXIS_PTS
/begin AXIS_PTS KL_NMINEM_PSYS_LP1_LLS_HAS_X "" 0x26416C c_getriebe_egs_in FLOAT32_IEEE_X_INCR_DIRECT_M_S7_S3 0 c_int_M_S7_S3 8 -3.40282E+038 3.40282E+038 /end AXIS_PTS
/begin AXIS_PTS KL_NMINEMANGEHOBENDAT_LLS_HAS_X "" 0x263FAC NO_INPUT_QUANTITY FLOAT32_IEEE_X_INCR_DIRECT_M_S7_S3 0 c_fl_M_S7_S3 8 -40 120 /end AXIS_PTS
/begin AXIS_PTS KL_NMINEMBASISDAT_LLS_HAS_X "" 0x263FEC NO_INPUT_QUANTITY FLOAT32_IEEE_X_INCR_DIRECT_M_S7_S3 0 c_fl_M_S7_S3 8 -40 120 /end AXIS_PTS
/begin AXIS_PTS KL_NMINEMFZPKRI_LLS_HAS_X "Festlegung der minimalen EM- und damit FZP-Drehzahl bei Kriechbetrieb (KRI) in Abhaengigkeit der Getriebeoeltemperatur zur Ausgabe als minimale EM-Drehzahl der Leerlaufsimulation der HAS (LLS)" 0x26402C c_getriebe_egs_in FLOAT32_IEEE_X_INCR_DIRECT_M_S7_S3 0 c_int_M_S7_S3 8 -40 150 /end AXIS_PTS
/begin AXIS_PTS KL_NMINEMIAEADAP_LLS_HAS_X "" 0x26409C c_getriebe_egs_in FLOAT32_IEEE_X_INCR_DIRECT_M_S7_S3 0 c_fl_M_S7_S3 6 -3.40282E+038 3.40282E+038 /end AXIS_PTS
/begin AXIS_PTS KL_NMINEMIAEADAPIEP_LLS_HAS_X "" 0x26406C c_getriebe_egs_in FLOAT32_IEEE_X_INCR_DIRECT_M_S7_S3 0 c_fl_M_S7_S3 6 -3.40282E+038 3.40282E+038 /end AXIS_PTS
/begin AXIS_PTS KL_NMINEMK0ADAP_LLS_HAS_X "" 0x2640CC c_getriebe_egs_in FLOAT32_IEEE_X_INCR_DIRECT_M_S7_S3 0 c_fl_M_S7_S3 6 -3.40282E+038 3.40282E+038 /end AXIS_PTS
/begin AXIS_PTS KL_NMINEMPARKSP_LLS_HAS_X "Festlegung der Minimaldrehzahl auf Anforderung des Parksperrenmoduls zum Auslegen der Parksperre im Gefaelle in Abhaengigkeit der Getriebeoeltemperatur zur Ausgabe als minimale EM-Drehzahl der Leerlaufsimulation der HAS (LLS)" 0x2640FC c_getriebe_egs_in FLOAT32_IEEE_X_INCR_DIRECT_M_S7_S3 0 c_fl_M_S7_S3 4 -40 215 /end AXIS_PTS
/begin AXIS_PTS KL_NMINEMSTADA_LLS_HAS_X "Festlegung der Minimaldrehzahl der Schaltkupplungs-Adaption in Abhaengigkeit der Getriebeoeltemperatur zur Ausgabe als minimale EM-Drehzahl der Leerlaufsimulation der HAS (LLS)" 0x26411C c_getriebe_egs_in FLOAT32_IEEE_X_INCR_DIRECT_M_S7_S3 0 c_fl_M_S7_S3 6 -10000 10000 /end AXIS_PTS
/begin AXIS_PTS KL_NMINEMVGF_LLS_HAS_X "Festlegung der Minimaldrehzahl zur Sicherstellung Oelversorgung beim starken Abbremsen in Abhaengigkeit der Leerlauf-Solldrehzahl des VM zur Ausgabe als minimale EM-Drehzahl der Leerlauf simulation der HAS (LLS)" 0x26414C n_soll_ll_vm_in FLOAT32_IEEE_X_INCR_DIRECT_M_S7_S3 0 n_int_x_M_S7_S3 4 0 1000 /end AXIS_PTS
/begin AXIS_PTS KL_NOSOLLLVMIAEENTK_ALA_HAS_X "X-Achse: istgang_egs_in" 0x2641AC NO_INPUT_QUANTITY FLOAT32_IEEE_X_INCR_DIRECT_M_S7_S3 0 sts_fl_M_S7_S3 10 -1 8 /end AXIS_PTS
/begin AXIS_PTS KL_PSBREMSEKRI_LLS_HAS_X "Bremsdruckschwelle zur Aktivierung der Minimaldrehzahlvorgabe bei Kriechbetrieb (KRI) in Abhaengigkeit des Fahrzeug-Neigungswinkels zur Ausgabe als minimale EM-Drehzahl der Leerlaufsimulation der HAS (LLS)" 0x2641FC phi_neigung_in FLOAT32_IEEE_X_INCR_DIRECT_M_S7_S3 0 phigrad_fl_M_S7_S3 7 -200 200 /end AXIS_PTS
/begin AXIS_PTS KL_PSBREMSERUECKKRI_LLS_HAS_X "Bremsdruckschwelle zur Ruecknahme der Minimaldrehzahlvorgabe bei Kriechbetrieb (KRI) in Abhaengigkeit des Fahrzeug-Neigungswinkels zur Ausgabe als minimale EM-Drehzahl der Leerlaufsimulation der HAS (LLS)" 0x264234 phi_neigung_in FLOAT32_IEEE_X_INCR_DIRECT_M_S7_S3 0 phigrad_fl_M_S7_S3 7 -200 200 /end AXIS_PTS
/begin AXIS_PTS KL_STKRAFTFLUSS_BMI_HAS_X "X-Achse: status_kraftfluss_egs_in" 0x26ED14 status_kraftfluss_egs_in UBYTE_X_INCR_DIRECT_M_S7_S3 0 sts_int_M_S7_S3 7 0 6 /end AXIS_PTS
/begin AXIS_PTS KL_TVRUECKKRI_LLS_HAS_X "Verzoegerungszeit zum Ruecksetzen der Minimaldrehzahlvorgabe bei Kriechbetrieb (KRI) in Abhaengigkeit des Fahrzeugbremsdrucks zur Ausgabe als minimale EM-Drehzahl der Leerlaufsimulation der HAS (LLS)" 0x26426C p_bremse_fzg_in FLOAT32_IEEE_X_INCR_DIRECT_M_S7_S3 0 p_fl_M_S7_S3 6 0 127 /end AXIS_PTS
/begin AXIS_PTS KL_TZSASHASMAX_BBR_HAS_X "Maximaler Zeitraum nach Erkennung der Betriebsbereitschaft des Hybridsystems in dem die  Beeinflussung der SAS Befuellreihenfolge durch die HAS aktiv ist" 0x2642EC NO_INPUT_QUANTITY SWORD_X_INCR_DIRECT_M_S7_S3 0 c_int_v_M_S7_S3 8 -127 1000 /end AXIS_PTS
/begin AXIS_PTS KL_VSFIAEZU_LLS_HAS_X "Fahrzeuggeschwindigkeitsschwelle zur Unterdrueckung der Ausgabe der minimalen EM-Drehzahl der Leerlaufsimulation der HAS (LLS) bei geschlossener
IAE in Abhaengigkeit des Istgangs" 0x26429C NO_INPUT_QUANTITY FLOAT32_IEEE_X_INCR_DIRECT_M_S7_S3 0 void_fl_M_S7_S3 10 -1 8 /end AXIS_PTS
/begin MEASUREMENT abstellpos_vm_in "Abstellposition VM vor naechstem ZOT" UWORD void_int_c_M_S7_S3 1 100 0 360 ECU_ADDRESS 0xFFF86784 /end MEASUREMENT
/begin MEASUREMENT abstellpos_vm_status_in "Status Abstellposition VM" UBYTE void_int_M_S7_S3 1 100 0 2 ECU_ADDRESS 0xFFF86CC5 /end MEASUREMENT
/begin MEASUREMENT bremspedal_in "Signal Bremsschalter" UBYTE E_BREMSPED_M_S7_S3 1 100 0 1 ECU_ADDRESS 0xFFF86C9B /end MEASUREMENT
/begin MEASUREMENT c_dat_lls_has "Temperatur des drehzahladaptiven Tilger (DAT) im Leerlaufsimulation der HAS" FLOAT32_IEEE c_fl_M_S7_S3 1 100 -50 200 ECU_ADDRESS 0xFFF85C24 /end MEASUREMENT
/begin MEASUREMENT c_getriebe_egs_in "" FLOAT32_IEEE c_int_M_S7_S3 1 100 -40 215 ECU_ADDRESS 0xFFF86214 /end MEASUREMENT
/begin MEASUREMENT c_getriebesysstart_msa_has "Temperatur des Getriebes bei Systemstart der MSA Beeinflussung der HAS" SWORD c_int_v_M_S7_S3 1 100 -50 200 ECU_ADDRESS 0xFFF984C6 /end MEASUREMENT
/begin MEASUREMENT c_umgebung_in "Aussentemperatur gefiltert" FLOAT32_IEEE c_fl_M_S7_S3 1 100 -40 85 ECU_ADDRESS 0xFFF86284 /end MEASUREMENT
/begin MEASUREMENT c_vm_in "" FLOAT32_IEEE c_fl_M_S7_S3 1 100 -3.40282E+038 3.40282E+038 ECU_ADDRESS 0xFFF86288 /end MEASUREMENT
/begin MEASUREMENT drehrichtung_nab_in "Drehrichtung Abtriebsdrehzahl" UBYTE E_DREHRICH_M_S7_S3 1 100 0 2 ECU_ADDRESS 0xFFF86C9C /end MEASUREMENT
/begin MEASUREMENT drehrichtung_nem_in "Drehrichtung der E-Maschine" UBYTE E_DREHRICH_M_S7_S3 1 100 0 2 ECU_ADDRESS 0xFFF86C9D /end MEASUREMENT
/begin MEASUREMENT fpw_in "Prozent Fahrpedalstellung" UBYTE rel_int_M_S7_S3 1 100 0 255 ECU_ADDRESS 0xFFF86C9E /end MEASUREMENT
/begin MEASUREMENT gangwechsel_egs_in "Flag waehrend laufender Schaltung, bei synchron verlassen bis synchron erreicht" UBYTE void_int_M_S7_S3 1 100 0 1 ECU_ADDRESS 0xFFF86C9F /end MEASUREMENT
/begin MEASUREMENT i_gang_lev2_egs_in "Uebergabe der aktuellen Ganguebersetzung i_gang nach ASILB ermittelt aus den Kupplungsstroemen" FLOAT32_IEEE void_fl_M_S7_S3 1 100 -3.40282E+038 3.40282E+038 ECU_ADDRESS 0xFFF86218 /end MEASUREMENT
/begin MEASUREMENT i_istgang_egs "Uebersetzung des aktuellen Gangs" FLOAT32_IEEE ratio_fl_M_S7_S3 1 100 0 8 ECU_ADDRESS 0xFFF861B4 /end MEASUREMENT
/begin MEASUREMENT i_zielgang_egs "Uebersetzung des Zielgangs" FLOAT32_IEEE ratio_fl_M_S7_S3 1 100 0 8 ECU_ADDRESS 0xFFF861B8 /end MEASUREMENT
/begin MEASUREMENT istgang_egs_in "" SBYTE void_int_M_S7_S3 1 100 -128 127 ECU_ADDRESS 0xFFF86CA0 /end MEASUREMENT
/begin MEASUREMENT kolbenpos_k0_in "" FLOAT32_IEEE sts_fl_M_S7_S3 1 100 -3.40282E+038 3.40282E+038 ECU_ADDRESS 0xFFF8621C /end MEASUREMENT
/begin MEASUREMENT m_em_in "" FLOAT32_IEEE trq_fl_a_M_S7_S3 1 100 -1024 1024 ECU_ADDRESS 0xFFF86220 /end MEASUREMENT
/begin MEASUREMENT m_iae_in "" FLOAT32_IEEE trq_fl_a_M_S7_S3 1 100 -32768 32767 ECU_ADDRESS 0xFFF86224 /end MEASUREMENT
/begin MEASUREMENT m_k0_in "" FLOAT32_IEEE trq_fl_a_M_S7_S3 1 100 -32768 32767 ECU_ADDRESS 0xFFF86228 /end MEASUREMENT
/begin MEASUREMENT m_k0_mber_zus_basis "Basiswert des K0 Moments beim Zustart zur Bestimmung des K0-Moments der HAS zur Motormomentbegrenzung in der SAB" FLOAT32_IEEE trq_fl_a_M_S7_S3 1 100 -3.40282E+038 3.40282E+038 ECU_ADDRESS 0xFFF98300 /end MEASUREMENT
/begin MEASUREMENT m_k0_mber_zus_gbegr "Gradientenbegrenzter Basiswert des K0 Moments beim Zustart zur Bestimmung des K0-Moments der HAS zur Motormomentbegrenzung in der SAB" FLOAT32_IEEE trq_fl_a_M_S7_S3 1 100 -3.40282E+038 3.40282E+038 ECU_ADDRESS 0xFFF98304 /end MEASUREMENT
/begin MEASUREMENT m_k0_mod_has_fkt "" FLOAT32_IEEE trq_fl_a_M_S7_S3 1 100 -1200 1200 ECU_ADDRESS 0xFFF86184 /end MEASUREMENT
/begin MEASUREMENT m_max_dyn_em_in "" FLOAT32_IEEE trq_fl_a_M_S7_S3 1 100 -3.40282E+038 3.40282E+038 ECU_ADDRESS 0xFFF8622C /end MEASUREMENT
/begin MEASUREMENT m_max_em_has_fkt "" FLOAT32_IEEE trq_fl_a_M_S7_S3 1 100 -1200 1200 ECU_ADDRESS 0xFFF86188 /end MEASUREMENT
/begin MEASUREMENT m_max_iae_has_fkt "" FLOAT32_IEEE trq_fl_a_M_S7_S3 1 100 -1200 1200 ECU_ADDRESS 0xFFF8618C /end MEASUREMENT
/begin MEASUREMENT m_min_dyn_em_in "" FLOAT32_IEEE trq_fl_a_M_S7_S3 1 100 -3.40282E+038 3.40282E+038 ECU_ADDRESS 0xFFF86230 /end MEASUREMENT
/begin MEASUREMENT m_min_em_has_fkt "" FLOAT32_IEEE trq_fl_a_M_S7_S3 1 100 -1200 1200 ECU_ADDRESS 0xFFF86190 /end MEASUREMENT
/begin MEASUREMENT m_min_vm_in "" FLOAT32_IEEE trq_fl_a_M_S7_S3 1 100 -3.40282E+038 3.40282E+038 ECU_ADDRESS 0xFFF8628C /end MEASUREMENT
/begin MEASUREMENT m_mot_in "" FLOAT32_IEEE trq_fl_a_M_S7_S3 1 100 -1024 1024 ECU_ADDRESS 0xFFF86234 /end MEASUREMENT
/begin MEASUREMENT m_motmax_k0schutz_has "Maximale zulaessiges Motormoment der Begrenzung der EM-Drehzahl zum Schutz der Trennkupplung K0 des Gefuehrten Getriebeschutz der HAS" FLOAT32_IEEE trq_fl_a_M_S7_S3 1 100 0 1000 ECU_ADDRESS 0xFFF98308 /end MEASUREMENT
/begin MEASUREMENT m_motmax_kupschutz_has "Maximale zulaessiges Motormoment der Begrenzung des Getriebeeingangsmoments zum Schutz der Schaltkupplungen des Gefuehrten Getriebeschutz der HAS" FLOAT32_IEEE trq_fl_a_M_S7_S3 1 100 0 5000 ECU_ADDRESS 0xFFF9830C /end MEASUREMENT
/begin MEASUREMENT m_motmax_mbegrfuw_has "Maximal zulaessiges Motormoment der Momentenbegrenzung bei Anzeige einer EM-Fehlfunktion durch die Funktionsueberwachung der EM (FUW) des Gefuehrten Getriebeschutz der HAS" UWORD trq_fl_M_S7_S3 1 100 0 1000 ECU_ADDRESS 0xFFF984C8 /end MEASUREMENT
/begin MEASUREMENT m_soll_em_has_fkt "" FLOAT32_IEEE trq_fl_a_M_S7_S3 1 100 -1200 1200 ECU_ADDRESS 0xFFF86194 /end MEASUREMENT
/begin MEASUREMENT m_soll_em_hst_in "" FLOAT32_IEEE trq_fl_a_M_S7_S3 1 100 -32768 32767 ECU_ADDRESS 0xFFF86238 /end MEASUREMENT
/begin MEASUREMENT m_soll_k0_has_fkt "" FLOAT32_IEEE trq_fl_a_M_S7_S3 1 100 -1200 1200 ECU_ADDRESS 0xFFF86198 /end MEASUREMENT
/begin MEASUREMENT m_soll_res_em_has_fkt "" FLOAT32_IEEE trq_fl_a_M_S7_S3 1 100 -1200 1200 ECU_ADDRESS 0xFFF8619C /end MEASUREMENT
/begin MEASUREMENT m_soll_vm_hst_in "" FLOAT32_IEEE trq_fl_a_M_S7_S3 1 100 -32768 32767 ECU_ADDRESS 0xFFF8623C /end MEASUREMENT
/begin MEASUREMENT m_soll_vm_l_hst_in "" FLOAT32_IEEE trq_fl_a_M_S7_S3 1 100 -3.40282E+038 3.40282E+038 ECU_ADDRESS 0xFFF86290 /end MEASUREMENT
/begin MEASUREMENT m_vm_in "" FLOAT32_IEEE trq_fl_a_M_S7_S3 1 100 -1024 1023.5 ECU_ADDRESS 0xFFF86240 /end MEASUREMENT
/begin MEASUREMENT m_vm_start_in "" FLOAT32_IEEE trq_fl_a_M_S7_S3 1 100 -1024 1023.5 ECU_ADDRESS 0xFFF86244 /end MEASUREMENT
/begin MEASUREMENT m_wunsch_fpw_hst_fil "Gefiltertes Wunschmoment" FLOAT32_IEEE trqg_fl_k_M_S7_S3 1 100 -2000 2000 ECU_ADDRESS 0xFFF861BC /end MEASUREMENT
/begin MEASUREMENT m_wunsch_fpw_hst_in "" FLOAT32_IEEE trq_fl_a_M_S7_S3 1 100 -3.40282E+038 3.40282E+038 ECU_ADDRESS 0xFFF86294 /end MEASUREMENT
/begin MEASUREMENT m_wunsch_fpw_in "" FLOAT32_IEEE trq_fl_a_M_S7_S3 1 100 -32768 32767 ECU_ADDRESS 0xFFF86248 /end MEASUREMENT
/begin MEASUREMENT m_ziel_k0_hst_in "Target torque of K0 sent by ECU" FLOAT32_IEEE trq_fl_a_M_S7_S3 1 100 -1000 2000 ECU_ADDRESS 0xFFF8624C /end MEASUREMENT
/begin MEASUREMENT mg_mot_in "Gradient des Getriebeeingangsmoment" FLOAT32_IEEE trqg_fl_k_M_S7_S3 1 100 -2000 2000 ECU_ADDRESS 0xFFF861C0 /end MEASUREMENT
/begin MEASUREMENT mg_soll_k0_has_fkt "" FLOAT32_IEEE trqg_fl_k_M_S7_S3 1 100 -3000 3000 ECU_ADDRESS 0xFFF861A0 /end MEASUREMENT
/begin MEASUREMENT mg_wunsch_fpw_hst_in "Gradient des gefilterten oder koordinierten Fahrerwunschmoments aus Fahrpedalinterpretation" FLOAT32_IEEE trqg_fl_k_M_S7_S3 1 100 -2000 2000 ECU_ADDRESS 0xFFF861C4 /end MEASUREMENT
/begin MEASUREMENT mg_wunsch_fpw_in "Gradient des Fahrerwunschmoments aus Fahrpedalinterpretation" FLOAT32_IEEE trqg_fl_k_M_S7_S3 1 100 -2000 2000 ECU_ADDRESS 0xFFF861C8 /end MEASUREMENT
/begin MEASUREMENT modus_e_fahren_hst_in "Electric driving mode concerning state of charging mode of high voltage battery" UBYTE E_MODUSEFAH_M_S7_S3 1 100 0 1 ECU_ADDRESS 0xFFF86CC6 /end MEASUREMENT
/begin MEASUREMENT n_ab_egs_in "" FLOAT32_IEEE n_fl_M_S7_S3 1 100 0 65535 ECU_ADDRESS 0xFFF86250 /end MEASUREMENT
/begin MEASUREMENT n_em_in "" FLOAT32_IEEE n_fl_M_S7_S3 1 100 -3.40282E+038 3.40282E+038 ECU_ADDRESS 0xFFF86254 /end MEASUREMENT
/begin MEASUREMENT n_min_em_alae_lls_has "Minimalwert der minimalen EM Drehzahl der Leerlaufsimulation der HAS (LLS) in Abhaengigkeit des Laengsbeschleunigungsstatus" UWORD n_int_M_S7_S3 1 100 0 10000 ECU_ADDRESS 0xFFF865C0 /end MEASUREMENT
/begin MEASUREMENT n_min_em_anh_max_dat_lls_has "Maximalwert der kontinuierlichen Anhebung der minimalen EM-Drehzahl der Leerlaufsimulation der HAS (LLS) zur Verhinderung DAT-Massenanschlagen" UWORD n_int_M_S7_S3 1 100 0 10000 ECU_ADDRESS 0xFFF865C2 /end MEASUREMENT
/begin MEASUREMENT n_min_em_beffzp_lls_has "Minimalwert der minimalen EM Drehzahl der Leerlaufsimulation der HAS (LLS) bei Anforderung zur Befuellung der FZP nach Systemstart" UWORD n_int_M_S7_S3 1 100 0 10000 ECU_ADDRESS 0xFFF865C4 /end MEASUREMENT
/begin MEASUREMENT n_min_em_bz_lls_has "Minimalwert der minimalen EM Drehzahl der Leerlaufsimulation der HAS (LLS) in den Hybrid-Betriebszustaenden ENTK_VMEIN und EFAHREN_VMEIN" UWORD n_int_M_S7_S3 1 100 0 10000 ECU_ADDRESS 0xFFF865C6 /end MEASUREMENT
/begin MEASUREMENT n_min_em_cgetr_lls_has "Minimalwert der minimalen EM Drehzahl der Leerlaufsimulation der HAS (LLS) in Abhaengigkeit der Getriebeoeltemperatur" UWORD n_int_M_S7_S3 1 100 0 10000 ECU_ADDRESS 0xFFF865C8 /end MEASUREMENT
/begin MEASUREMENT n_min_em_dat_lls_has "Minimalwert der minimalen EM Drehzahl der Leerlaufsimulation der HAS (LLS) zur Verhinderung DAT-Massenanschlagen" UWORD n_int_M_S7_S3 1 100 0 10000 ECU_ADDRESS 0xFFF865CA /end MEASUREMENT
/begin MEASUREMENT n_min_em_diag_lls_has "Minimalwert der minimalen EM Drehzahl der Leerlaufsimulation der HAS (LLS) bei aktiver Diagnose-Ersatzfunktion" UWORD n_int_M_S7_S3 1 100 0 10000 ECU_ADDRESS 0xFFF865CC /end MEASUREMENT
/begin MEASUREMENT n_min_em_fkt_lls_has "Minimalwert der minimalen EM Drehzahl der Leerlaufsimulation der HAS (LLS) bei aktiver Hybridfunktion" UWORD n_int_M_S7_S3 1 100 0 10000 ECU_ADDRESS 0xFFF865CE /end MEASUREMENT
/begin MEASUREMENT n_min_em_ge_lls_has "Minimalwert der minimalen EM Drehzahl der Leerlaufsimulation der HAS (LLS) beim Gangeinlegen" UWORD n_int_M_S7_S3 1 100 0 10000 ECU_ADDRESS 0xFFF865D0 /end MEASUREMENT
/begin MEASUREMENT n_min_em_iae_lls_has "Minimalwert der minimale EM Drehzahl der Leerlaufsimulation der HAS (LLS) bei Anforderung der IAE-Adaption" UWORD n_int_M_S7_S3 1 100 0 10000 ECU_ADDRESS 0xFFF865D2 /end MEASUREMENT
/begin MEASUREMENT n_min_em_iaeada_lls_has "Minimalwert der minimalen EM Drehzahl der Leerlaufsimulation der HAS (LLS) bei Anforderung des Moduls IAE Adaption" UWORD n_int_M_S7_S3 1 100 0 10000 ECU_ADDRESS 0xFFF865D4 /end MEASUREMENT
/begin MEASUREMENT n_min_em_iep_lls_has "Minimalwert der minimalen EM Drehzahl der Leerlaufsimulation der HAS (LLS) bei IEP Fehleranzeige" UWORD n_int_M_S7_S3 1 100 0 10000 ECU_ADDRESS 0xFFF865D6 /end MEASUREMENT
/begin MEASUREMENT n_min_em_k0ada_lls_has "Minimalwert der minimalen EM Drehzahl der Leerlaufsimulation der HAS (LLS) bei Anforderung der K0-Adaption" UWORD n_int_M_S7_S3 1 100 0 10000 ECU_ADDRESS 0xFFF865D8 /end MEASUREMENT
/begin MEASUREMENT n_min_em_kfl_lls_has "Minimalwert der minimalen EM Drehzahl der Leerlaufsimula-tion der HAS (LLS) in Abhaengigkeit des Kraftfluss-Status zur Sicherstellung der Oelversorgung bei einem in Neutral rollenden Fahrzeug" UWORD n_int_M_S7_S3 1 100 0 10000 ECU_ADDRESS 0xFFF984CA /end MEASUREMENT
/begin MEASUREMENT n_min_em_kri_lls_has "Minimalwert der minimalen EM-Drehzahl der Leerlaufsimulation der HAS (LLS) bei Kriechbetrieb" UWORD n_int_M_S7_S3 1 100 0 10000 ECU_ADDRESS 0xFFF984CC /end MEASUREMENT
/begin MEASUREMENT n_min_em_lls_has_ngef "Nicht gefilterte und nicht abgesicherte minimale EM Drehzahl der Leerlaufsimulation der HAS (LLS)" FLOAT32_IEEE n_fl_M_S7_S3 1 100 -3.40282E+038 3.40282E+038 ECU_ADDRESS 0xFFF98310 /end MEASUREMENT
/begin MEASUREMENT n_min_em_lls_has_ref "Nicht abgesicherte minimale EM Drehzahl der Leerlaufsimulation der HAS (LLS)" FLOAT32_IEEE n_fl_M_S7_S3 1 100 -3.40282E+038 3.40282E+038 ECU_ADDRESS 0xFFF98314 /end MEASUREMENT
/begin MEASUREMENT n_min_em_lls_has_ziel "Zielwert der minimale EM Drehzahl der Leerlaufsimulation der HAS (LLS)" UWORD n_int_M_S7_S3 1 100 0 10000 ECU_ADDRESS 0xFFF865DA /end MEASUREMENT
/begin MEASUREMENT n_min_em_manh_lls_has "Minimalwert der minimalen EM Drehzahl der Leerlaufsimulation der HAS (LLS) bei Momentenanhebung" UWORD n_int_M_S7_S3 1 100 0 10000 ECU_ADDRESS 0xFFF865DC /end MEASUREMENT
/begin MEASUREMENT n_min_em_parksp_lls_has "Minimalwert der minimalen EM Drehzahl der Leerlaufsimulation der HAS (LLS) bei Anforderung durch ATSYS zum Auslegen der Parksperre im Gefaelle" UWORD n_int_M_S7_S3 1 100 0 10000 ECU_ADDRESS 0xFFF865DE /end MEASUREMENT
/begin MEASUREMENT n_min_em_paus_lls_has "Minimalwert der minimalen EM Drehzahl der Leerlaufsimulation der HAS (LLS) zum sicheren Auslegen der Parksperre" UWORD n_int_M_S7_S3 1 100 0 10000 ECU_ADDRESS 0xFFF865E0 /end MEASUREMENT
/begin MEASUREMENT n_min_em_poab_lls_has "Minimalwert der minimalen EM Drehzahl der Leerlaufsimulation der HAS (LLS) wenn Fahrtrichtung ungleich Waehlhebelposition" UWORD n_int_M_S7_S3 1 100 0 10000 ECU_ADDRESS 0xFFF984CE /end MEASUREMENT
/begin MEASUREMENT n_min_em_psys_lp3_has_sbe "Mindestdrehzahl der EM zur Sicherstellung des Leistungspunkt 3 der Bestimmung des Status Systemdruck der HAS" FLOAT32_IEEE n_fl_M_S7_S3 1 100 0 10000 ECU_ADDRESS 0xFFF861CC /end MEASUREMENT
/begin MEASUREMENT n_min_em_pvu_lls_has "Minimalwert der minimalen EM-Drehzahl der Leerlaufsimulation der HAS (LLS) bei aktiver Unterstuetzung der Positionsventil-Ueberwachung durch die HAS" UWORD n_int_M_S7_S3 1 100 0 65535 ECU_ADDRESS 0xFFF984D0 /end MEASUREMENT
/begin MEASUREMENT n_min_em_rang_lls_has "Minimalwert der minimalen EM-Drehzahl der Leerlaufsimulation der HAS (LLS) bei Rangierbetrieb" UWORD n_int_M_S7_S3 1 100 0 65535 ECU_ADDRESS 0xFFF984D2 /end MEASUREMENT
/begin MEASUREMENT n_min_em_sas_lls_has "Minimalwert der minimalen EM Drehzahl der Leerlaufsimulation der HAS (LLS) bei aktivem Schaltablauf" UWORD n_int_M_S7_S3 1 100 0 10000 ECU_ADDRESS 0xFFF865E2 /end MEASUREMENT
/begin MEASUREMENT n_min_em_stada_lls_has "Minimalwert der minimalen EM Drehzahl der Leerlaufsimulation der HAS (LLS) bei Anforderung des Moduls Stillstandadaption" UWORD n_int_M_S7_S3 1 100 0 10000 ECU_ADDRESS 0xFFF865E4 /end MEASUREMENT
/begin MEASUREMENT n_min_em_stat_lls_has "Minimalwert der minimalen EM Drehzahl der Leerlaufsimulation der HAS (LLS) als statische Vorgabe" UWORD n_int_M_S7_S3 1 100 0 10000 ECU_ADDRESS 0xFFF865E6 /end MEASUREMENT
/begin MEASUREMENT n_min_em_vgf_lls_has "Minimalwert der minimalen EM Drehzahl der Leerlaufsimulation der HAS (LLS) beim starken Abbremsen" UWORD n_int_M_S7_S3 1 100 0 10000 ECU_ADDRESS 0xFFF865E8 /end MEASUREMENT
/begin MEASUREMENT n_mineminit_lls_has "Initialisierungsdrehzahl des Gradientenbegrenzers und PT2-Filters der Leerlaufsimulation der HAS (LLS)" UWORD n_int_M_S7_S3 1 100 0 10000 ECU_ADDRESS 0xFFF865EA /end MEASUREMENT
/begin MEASUREMENT n_mot_soll_iae_in "" FLOAT32_IEEE n_fl_M_S7_S3 1 100 -3.40282E+038 3.40282E+038 ECU_ADDRESS 0xFFF86258 /end MEASUREMENT
/begin MEASUREMENT n_sec_iae "Sekundaere IAE-Drehzahl" FLOAT32_IEEE n_fl_M_S7_S3 1 100 -10000 10000 ECU_ADDRESS 0xFFF861D0 /end MEASUREMENT
/begin MEASUREMENT n_sec_iae_ist_lls_has "Abtriebsseitige IAE-Drehzahl bezogen auf den Getriebeeeingang und den aktuellen Istgang der Leerlaufsimulation der HAS (LLS)" UWORD n_int_M_S7_S3 1 100 0 10000 ECU_ADDRESS 0xFFF865EC /end MEASUREMENT
/begin MEASUREMENT n_soll_em_has_fkt "" FLOAT32_IEEE n_fl_M_S7_S3 1 100 0 8000 ECU_ADDRESS 0xFFF861A4 /end MEASUREMENT
/begin MEASUREMENT n_soll_em_hst_in "" FLOAT32_IEEE n_fl_M_S7_S3 1 100 -3.40282E+038 3.40282E+038 ECU_ADDRESS 0xFFF86298 /end MEASUREMENT
/begin MEASUREMENT n_soll_ll_vm_in "" FLOAT32_IEEE n_fl_M_S7_S3 1 100 0 2540 ECU_ADDRESS 0xFFF8625C /end MEASUREMENT
/begin MEASUREMENT n_soll_vm_has_fkt "" FLOAT32_IEEE n_fl_M_S7_S3 1 100 0 8000 ECU_ADDRESS 0xFFF861A8 /end MEASUREMENT
/begin MEASUREMENT n_t_egs_in "" FLOAT32_IEEE n_fl_M_S7_S3 1 100 0 65535 ECU_ADDRESS 0xFFF86260 /end MEASUREMENT
/begin MEASUREMENT n_vm_in "" FLOAT32_IEEE n_fl_M_S7_S3 1 100 0 65535 ECU_ADDRESS 0xFFF86264 /end MEASUREMENT
/begin MEASUREMENT nd_k0_in "Differenzdrehzahl der Trennkupplung" FLOAT32_IEEE n_fl_M_S7_S3 1 100 -10000 10000 ECU_ADDRESS 0xFFF861D4 /end MEASUREMENT
/begin MEASUREMENT nd_min_saf_has_fkt "Anforderung min. Drehzahlsprung an ASIS" FLOAT32_IEEE n_fl_M_S7_S3 1 100 0 8000 ECU_ADDRESS 0xFFF861AC /end MEASUREMENT
/begin MEASUREMENT nd_soll_iae_fkt "Differenzdrehzahl der Anfahrkupplung" FLOAT32_IEEE ng_fl_M_S7_S3 1 100 -8000 8000 ECU_ADDRESS 0xFFF861B0 /end MEASUREMENT
/begin MEASUREMENT ndg_k0_in "Gradienten der Differenzdrehzahl der Trennkupplung" FLOAT32_IEEE ng_fl_M_S7_S3 1 100 -10000 10000 ECU_ADDRESS 0xFFF861D8 /end MEASUREMENT
/begin MEASUREMENT ng_minemmax_lls_has "Gradient beim Drehzahlaufbau der ungefilterten minimalen EM-Drehzahl der Leerlaufsimulation der HAS (LLS)" ULONG ng_int_z_M_S7_S3 1 100 0 50000 ECU_ADDRESS 0xFFF85C28 /end MEASUREMENT
/begin MEASUREMENT ng_minemmin_lls_has "Gradient beim Drehzahlabbau der ungefilterten minimalen EM-Drehzahl der Leerlaufsimulation der HAS (LLS)" SLONG ng_int_z_M_S7_S3 1 100 -50000 0 ECU_ADDRESS 0xFFF85C2C /end MEASUREMENT
/begin MEASUREMENT ng_vm_in "Gradient der VM Drehzahl" FLOAT32_IEEE ng_fl_M_S7_S3 1 100 -10000 10000 ECU_ADDRESS 0xFFF861DC /end MEASUREMENT
/begin MEASUREMENT no_seciae_crv_kri_lls_has "Drehzahloffset auf die sekundaere IAE-Drehzahl bezogen auf den Getriebeeingang der Creep-Ruckel-Verhinderung (CRV) der Leerlaufsimulation der HAS (LLS) bei Kriechbetrieb" FLOAT32_IEEE n_fl_M_S7_S3 1 100 0 10000 ECU_ADDRESS 0xFFF85C30 /end MEASUREMENT
/begin MEASUREMENT no_seciae_kri_lls_has "Drehzahloffset auf die sekundaere IAE-Drehzahl bezogen auf den Getriebeeingang der Leerlaufsimulation der HAS (LLS) bei Kriechbetrieb" FLOAT32_IEEE n_fl_M_S7_S3 1 100 0 10000 ECU_ADDRESS 0xFFF85C34 /end MEASUREMENT
/begin MEASUREMENT osmode_next_in "" UBYTE sts_int_M_S7_S3 1 100 0 255 ECU_ADDRESS 0xFFF86CA1 /end MEASUREMENT
/begin MEASUREMENT p_bremse_fzg_in "" FLOAT32_IEEE p_fl_M_S7_S3 1 100 0 127 ECU_ADDRESS 0xFFF86268 /end MEASUREMENT
/begin MEASUREMENT phi_neigung_in "" FLOAT32_IEEE phigrad_fl_M_S7_S3 1 100 -3.40282E+038 3.40282E+038 ECU_ADDRESS 0xFFF8626C /end MEASUREMENT
/begin MEASUREMENT pos_egs_in "Waehlhebelposition" UBYTE E_POS_M_S7_S3 1 100 0 8 ECU_ADDRESS 0xFFF86CA2 /end MEASUREMENT
/begin MEASUREMENT schalt_mode_egs_in "" UWORD void_int_c_M_S7_S3 1 100 0 65535 ECU_ADDRESS 0xFFF86780 /end MEASUREMENT
/begin MEASUREMENT soc_in "Interface provides state of charge of high-voltage battery" UBYTE rel_int_M_S7_S3 1 100 0 100 ECU_ADDRESS 0xFFF86CC7 /end MEASUREMENT
/begin MEASUREMENT sollgang_egs_in "" SBYTE void_int_M_S7_S3 1 100 -128 127 ECU_ADDRESS 0xFFF86CA3 /end MEASUREMENT
/begin MEASUREMENT st_ablauf_fkt "Phase des Ablauf" UWORD st_int_g_M_S7_S3 1 100 0 65535 ECU_ADDRESS 0xFFF86774 /end MEASUREMENT
/begin MEASUREMENT st_ist_bz_has_stg "Istzustand OML" UBYTE E_STBZHAS_M_S7_S3 1 100 0 15 ECU_ADDRESS 0xFFF86C55 /end MEASUREMENT
/begin MEASUREMENT st_ist_hcomd_has_stg "Innere Zustaende der OML" UWORD st_int_g_M_S7_S3 1 100 0 4999 ECU_ADDRESS 0xFFF86772 /end MEASUREMENT
/begin MEASUREMENT st_nmin_dat_lls_has "Zustand der Anhebung der EM-Minimaldrehzahl der Leerlaufsimulation der HAS (LLS) zur Verhinderung DAT-Massenanschlagen" UBYTE E_STNDATLLS_M_S7_S3 1 100 0 4 ECU_ADDRESS 0xFFF8696C /end MEASUREMENT
/begin MEASUREMENT st_ziel_bz_has_stg "Zielzustand OML" UBYTE E_STBZHAS_M_S7_S3 1 100 0 15 ECU_ADDRESS 0xFFF86C56 /end MEASUREMENT
/begin MEASUREMENT status_ablauf_has_fkt "" UBYTE sts_int_M_S7_S3 1 100 0 50 ECU_ADDRESS 0xFFF86C5A /end MEASUREMENT
/begin MEASUREMENT status_abs_in "Information, ob aktuell ein Eingriff durch das ABS System vorgenommen wird" UBYTE E_STATUSABS_M_S7_S3 1 100 0 2 ECU_ADDRESS 0xFFF86CC8 /end MEASUREMENT
/begin MEASUREMENT status_alaengs_adaoff_in "Information, ob die Adaptionen aufgrund erkannter Laengsbeschleunigung deaktiviert wird. 0 = Adaption aktiv aufgrund erkannter Laengsbeschleunigung
1 = Adaption inaktiv aufgrund nicht erkannter Laengsbeschleunigung" UBYTE sts_int_M_S7_S3 1 100 0 1 ECU_ADDRESS 0xFFF86CA4 /end MEASUREMENT
/begin MEASUREMENT status_asr_in "Information, ob ein Regeleingriff durch ein Assistenzsystem (ESP, ASR) vorliegt" UBYTE E_STATUSASR_M_S7_S3 1 100 0 1 ECU_ADDRESS 0xFFF86CC9 /end MEASUREMENT
/begin MEASUREMENT status_autohold_in "Status der Systeme zur Fahrzeug- Rollverhinderung" UBYTE E_STATUSNAA_M_S7_S3 1 100 0 1 ECU_ADDRESS 0xFFF86CA5 /end MEASUREMENT
/begin MEASUREMENT status_betriebsbereit_hst_in "" UBYTE sts_int_M_S7_S3 1 100 0 1 ECU_ADDRESS 0xFFF86CCA /end MEASUREMENT
/begin MEASUREMENT status_c_k0_in "Interface returns information concerning energy balance of clutch 0" UBYTE E_STATUSCK0_M_S7_S3 1 100 0 2 ECU_ADDRESS 0xFFF86CA6 /end MEASUREMENT
/begin MEASUREMENT status_cumgebung_in "Statusinformation in GET_CKB_TOUT" UBYTE E_SIGSTATUS_M_S7_S3 1 100 0 2 ECU_ADDRESS 0xFFF86CCB /end MEASUREMENT
/begin MEASUREMENT status_efahren_bmi_has "Status E-Fahren der HAS zur Festlegung der entsprechenden Portout-Groesse in der HAS Signalaufbereitung_Out" UBYTE sts_int_M_S7_S3 1 100 0 1 ECU_ADDRESS 0xFFF98402 /end MEASUREMENT
/begin MEASUREMENT status_efahren_bmi_ist "Festgelegter Status E-Fahren zur Bestimmung des Hybrid-Betriebsmodus der IAE bezogen auf den Ist-Betriebszustand der Zustandsteuerung" UBYTE sts_int_M_S7_S3 1 100 0 1 ECU_ADDRESS 0xFFF98403 /end MEASUREMENT
/begin MEASUREMENT status_efahren_bmi_ziel "Festgelegter Status E-Fahren zur Bestimmung des Hybrid-Betriebsmodus der IAE bezogen auf den Ziel-Betriebszustand der Zustandsteuerung" UBYTE sts_int_M_S7_S3 1 100 0 1 ECU_ADDRESS 0xFFF98404 /end MEASUREMENT
/begin MEASUREMENT status_efahren_out_ist "Festgelegter Status E-Fahren der HAS bezogen auf den Ist-Betriebszustand der Zustandsteuerung" UBYTE sts_int_M_S7_S3 1 100 0 1 ECU_ADDRESS 0xFFF98405 /end MEASUREMENT
/begin MEASUREMENT status_efahren_out_ziel "Festgelegter Status E-Fahren der HAS bezogen auf den Ziel-Betriebszustand der Zustandsteuerung" UBYTE sts_int_M_S7_S3 1 100 0 1 ECU_ADDRESS 0xFFF98406 /end MEASUREMENT
/begin MEASUREMENT status_fehler_iep_in "" UBYTE E_FEHLERIEP_M_S7_S3 1 100 0 1 ECU_ADDRESS 0xFFF86CA7 /end MEASUREMENT
/begin MEASUREMENT status_getrbereit_in "Status des hydraulischen Drucks des Getriebes" UBYTE sts_int_M_S7_S3 1 100 0 255 ECU_ADDRESS 0xFFF86CCC /end MEASUREMENT
/begin MEASUREMENT status_hillhold_in "Status der Systeme zur Fahrzeug- Rollverhinderung" UBYTE E_STATUSNAA_M_S7_S3 1 100 0 1 ECU_ADDRESS 0xFFF86CA8 /end MEASUREMENT
/begin MEASUREMENT status_iae_adap_in "Status der Adaption des Integrierten Anfahrelements IAE" UBYTE E_STATUSADA_M_S7_S3 1 100 0 2 ECU_ADDRESS 0xFFF86CA9 /end MEASUREMENT
/begin MEASUREMENT status_iae_in "" UBYTE E_STATUSIAE_M_S7_S3 1 100 0 8 ECU_ADDRESS 0xFFF86CAA /end MEASUREMENT
/begin MEASUREMENT status_iep_in "" UBYTE E_STATUSIEP_M_S7_S3 1 100 0 4 ECU_ADDRESS 0xFFF86CAB /end MEASUREMENT
/begin MEASUREMENT status_k0_adap_in "" UBYTE E_STATUSADA_M_S7_S3 1 100 0 2 ECU_ADDRESS 0xFFF86CAC /end MEASUREMENT
/begin MEASUREMENT status_k0_adap_zaehler_in "Zaehler k0 adaption" UBYTE void_int_M_S7_S3 1 100 0 255 ECU_ADDRESS 0xFFF86CAD /end MEASUREMENT
/begin MEASUREMENT status_k0_befuellung_in "Interface provides the current filling mode of clutch 0" UBYTE E_STAK0BEF_M_S7_S3 1 100 0 3 ECU_ADDRESS 0xFFF86CAE /end MEASUREMENT
/begin MEASUREMENT status_k0_in "" UBYTE E_STATUSK0_M_S7_S3 1 100 0 5 ECU_ADDRESS 0xFFF86CAF /end MEASUREMENT
/begin MEASUREMENT status_kl15_in "" UBYTE sts_int_M_S7_S3 1 100 0 1 ECU_ADDRESS 0xFFF86CCD /end MEASUREMENT
/begin MEASUREMENT status_kraftfluss_egs_in "" UBYTE E_STATUSKSL_M_S7_S3 1 100 0 6 ECU_ADDRESS 0xFFF86CB0 /end MEASUREMENT
/begin MEASUREMENT status_kraftfluss_lev2_egs_in "Power flow (controled) information concerning ASIL B" UBYTE sts_int_M_S7_S3 1 100 0 2 ECU_ADDRESS 0xFFF86CB1 /end MEASUREMENT
/begin MEASUREMENT status_ll_vm_in "" UBYTE sts_int_M_S7_S3 1 100 0 255 ECU_ADDRESS 0xFFF86CB2 /end MEASUREMENT
/begin MEASUREMENT status_nem_in "Status zur Drehzahl E-Motor" UBYTE E_SIGSTATUS_M_S7_S3 1 100 0 2 ECU_ADDRESS 0xFFF86CB3 /end MEASUREMENT
/begin MEASUREMENT status_nreg_em_hst_in "" UBYTE sts_int_M_S7_S3 1 100 0 255 ECU_ADDRESS 0xFFF86CCE /end MEASUREMENT
/begin MEASUREMENT status_nvm_in "Status zur Drehzahl VM-Motor" UBYTE E_SIGSTATUS_M_S7_S3 1 100 0 2 ECU_ADDRESS 0xFFF86CB4 /end MEASUREMENT
/begin MEASUREMENT status_posvueb_in "Erkennung PosV Diagnose" UBYTE sts_int_M_S7_S3 1 100 0 255 ECU_ADDRESS 0xFFF86CCF /end MEASUREMENT
/begin MEASUREMENT status_psys_has_sbe "Anzeige des Status Pumpendruck der HAS" UBYTE E_STATUSPSY_M_S7_S3 1 100 0 4 ECU_ADDRESS 0xFFF86C6C /end MEASUREMENT
/begin MEASUREMENT status_radschlupf_rse_has_sbe "Anzeige des Status der Radschlupferkennung (RSE) der HAS" UBYTE E_STATUSRSE_M_S7_S3 1 100 0 1 ECU_ADDRESS 0xFFF86C6D /end MEASUREMENT
/begin MEASUREMENT status_sa_vm_in "00 Keine Beeinflussung; 01 Schubabschaltung aktiv; 10 Nicht stellbarer Bereich; 11 Signal ungueltig" UBYTE sts_int_e_M_S7_S3 1 100 0 1 ECU_ADDRESS 0xFFF86CD0 /end MEASUREMENT
/begin MEASUREMENT status_schaltart_svh_has_sbe "Schaltart der angeforderten Schaltung der Schaltverhinderung der HAS (0 = keine Schaltung angefordert) - Bit-Codierung (m/oL = mit/ohne Lastanh.) =  bit0=ZRSmL, 1=ZHSmL, 2=SRSmL, 3=SHSmL, 4=ZRSoL, 5=ZHSoL, 6=SRSoL, 7=SHSoL" UBYTE sts_int_M_S7_S3 1 100 0 255 ECU_ADDRESS 0xFFF86C6E /end MEASUREMENT
/begin MEASUREMENT status_schaltung_egs_in "Anzeige ob Schaltung des Getriebes aktiv ist" SBYTE sts_int_M_S7_S3 1 100 -9 9 ECU_ADDRESS 0xFFF86C6F /end MEASUREMENT
/begin MEASUREMENT status_soc_in "Interface provides status information of soc_in" UBYTE E_SIGSTATUS_M_S7_S3 1 100 0 2 ECU_ADDRESS 0xFFF86CD1 /end MEASUREMENT
/begin MEASUREMENT status_sync_schaltung_sbe "Anzeige der Synchronerkennung der aktuellen Schaltung innerhalb der HAS" UBYTE sts_int_M_S7_S3 1 100 0 1 ECU_ADDRESS 0xFFF86C70 /end MEASUREMENT
/begin MEASUREMENT status_vf_in "Signalstatus fuer die Fahrzeugistgeschwindigkeit  gebildet aus der Getriebe-Abtriebsdrehzahl" UBYTE E_SIGSTATUS_M_S7_S3 1 100 0 2 ECU_ADDRESS 0xFFF86CB5 /end MEASUREMENT
/begin MEASUREMENT status_vfref_in "Signalstatus fuer die Fahrzeuggeschwindigkeit ueber Grund" UBYTE E_SIGSTATUS_M_S7_S3 1 100 0 2 ECU_ADDRESS 0xFFF86CB6 /end MEASUREMENT
/begin MEASUREMENT status_waschstr_in "" UBYTE sts_int_M_S7_S3 1 100 0 255 ECU_ADDRESS 0xFFF86CB7 /end MEASUREMENT
/begin MEASUREMENT t_abs_msa_has "Verzoegerungszeit zur Deaktivierung der Beeinflussung der MSA-Funktionalitaet bei aktiven ABS-/ESP-Regelzustaenden" UWORD t_int_n_M_S7_S3 1 100 0 5 ECU_ADDRESS 0xFFF984D4 /end MEASUREMENT
/begin MEASUREMENT t_berg_msa_has "Timer der Verzoegerungszeit zur Deaktivierung der Beeinflussung der MSA-Funktionalitaet am Berg beim Gang auslegen" UWORD t_int_n_M_S7_S3 1 100 0 5 ECU_ADDRESS 0xFFF984D6 /end MEASUREMENT
/begin MEASUREMENT t_betrieb_pvu_has_ee_in "" ULONG t_int_M_S7_S3 1 100 0 10000 ECU_ADDRESS 0xFFF86270 /end MEASUREMENT
/begin MEASUREMENT t_betrieb_pvu_has_sbe "Betriebsdauer seit dem letzten Ablauf der Diagnosefunktion \"Positionsventil-Ueberwachung\" der Funktion zur Unterstuet-zung der Positionsventil-Ueberwachung der HAS" ULONG t_int_M_S7_S3 1 100 0 1000000 ECU_ADDRESS 0xFFF861E0 /end MEASUREMENT
/begin MEASUREMENT t_maxsas_msa_has "Timer der Maximalzeit der Anforderung der Beeinflussung der MSA-Funktionalitaet bei aktivem Schaltablauf in Abhaengigkeit des Ziel-Betriebszustands der Hybrid-Zustandssteuerung" ULONG t_int_M_S7_S3 1 100 0 1000 ECU_ADDRESS 0xFFF98318 /end MEASUREMENT
/begin MEASUREMENT t_nembed_ndk0_msa_has "Timer der Verzoegerungszeit nach Ueberschreiten der ersten VM Drehzahlschwelle  zur Aktivierung der Beeinflussung der MSA-Funktionalitaet bei geringer EM Drehzahl in Abhaengigkeit der Differenzdrehzahl der K0 zum Schutz der K0" FLOAT32_IEEE t_fl_M_S7_S3 1 100 0 600 ECU_ADDRESS 0xFFF9831C /end MEASUREMENT
/begin MEASUREMENT t_nminem_beffzp_lls_has "Timer fuer den Zeitraum nach Erkennung der Betriebsbereitschaft zur Vorgabe einer EM-Minimaldrehzahl zur Befuellung der Fluegelzellenpumpe nach Systemstart der Leerlaufsimulation der HAS" UWORD t_int_n_M_S7_S3 1 100 0 10 ECU_ADDRESS 0xFFF865EE /end MEASUREMENT
/begin MEASUREMENT t_nminem_kri_lls_has "Timer der Verzoegerungszeit zum Ruecksetzen der minimalen EM-Drehzahl bei Kriechbetrieb der Leerlaufsimulation der HAS" UWORD t_int_n_M_S7_S3 1 100 0 10 ECU_ADDRESS 0xFFF865F0 /end MEASUREMENT
/begin MEASUREMENT t_nminem_manh_lls_has "Timer fuer den Zeitraum nach einer Anhebung des Fahrerwunschmoments oder des Summen-Istmoments bei kraft-schluessigem Getriebe zur Vorgabe einer EM-Minimaldrehzahl der Leerlaufsimulation der HAS" UWORD t_int_n_M_S7_S3 1 100 0 10 ECU_ADDRESS 0xFFF865F2 /end MEASUREMENT
/begin MEASUREMENT t_nminem_paus_lls_has "Timer fuer den Zeitraum nach dem Auslegen der Parksperre zur Vorgabe einer EM-Minimaldrehzahl der Leerlaufsimulation der HAS" UWORD t_int_n_M_S7_S3 1 100 0 10 ECU_ADDRESS 0xFFF865F4 /end MEASUREMENT
/begin MEASUREMENT t_nminem_rang_lls_has "Timer der maximalen Dauer der Vorgabe der EM-Minimaldrehzahl bei Rangierbetrieb der Leerlaufsimulation der HAS" ULONG t_int_M_S7_S3 1 100 0 5000 ECU_ADDRESS 0xFFF85C38 /end MEASUREMENT
/begin MEASUREMENT t_nminem_vgf_lls_has "Timer der Verzoegerungszeit zum Ruecksetzen der minimalen EM Drehzahl zur Sicherstellung Oelversorgung beim starken Abbremsen der Leerlaufsimulation der HAS" UWORD t_int_n_M_S7_S3 1 100 0 10 ECU_ADDRESS 0xFFF865F6 /end MEASUREMENT
/begin MEASUREMENT t_vrueckgesas_msa_has "Timer der Verzoegerungszeit zur Ruecknahme der Anforderung der Beeinflussung der MSA-Funktionalitaet bei aktivem Schaltablauf beim Gangeinlegen" UWORD t_int_n_M_S7_S3 1 100 0 10 ECU_ADDRESS 0xFFF984D8 /end MEASUREMENT
/begin MEASUREMENT t_vruecksas_msa_has "Timer der Verzoegerungszeit zur Ruecknahme der Anforderung der Beeinflussung der MSA-Funktionalitaet bei aktivem Schaltablauf in Abhaengigkeit des Ziel-Betriebszustands der Hybrid-Zustandssteuerung" UWORD t_int_n_M_S7_S3 1 100 0 10 ECU_ADDRESS 0xFFF984DA /end MEASUREMENT
/begin MEASUREMENT t_zsasfuwmax_bbr "Timer fur den maximalen Zeitraum nach Erkennung der EM-Fehlfunktion beim Zustart in dem die Beeinflussung der SAS Befuellreihenfolge durch die HAS aktiv ist" UWORD t_int_n_M_S7_S3 1 100 0 5 ECU_ADDRESS 0xFFF865F8 /end MEASUREMENT
/begin MEASUREMENT t_zsashasaktiv_bbr "Timer fuer den Zeitraum nach Erkennung der Betriebsbereitschaft des Hybridsystems, in dem die Beeinflussung der SAS Befuellreihenfolge durch die HAS aktiv ist" UWORD t_int_n_M_S7_S3 1 100 0 5 ECU_ADDRESS 0xFFF865FA /end MEASUREMENT
/begin MEASUREMENT t_zsashasmax_bbr "Timer fuer den maximalen Zeitraum nach Erkennung der Betriebsbereitschaft des Hybridsystems, in dem die Beeinflussung der SAS Befuellreihenfolge durch die HAS aktiv ist" UWORD t_int_n_M_S7_S3 1 100 0 500 ECU_ADDRESS 0xFFF865FC /end MEASUREMENT
/begin MEASUREMENT t_zsasslstmax_bbr "Timer fuer die maximale Zeitraum nach Erkennen eines Schleppstarts in dem die Beeinflussung des SAS Befuellrei-henfolge anstehen darf" UWORD t_int_n_M_S7_S3 1 100 0 5 ECU_ADDRESS 0xFFF865FE /end MEASUREMENT
/begin MEASUREMENT v_f_in "" FLOAT32_IEEE v_fl_M_S7_S3 1 100 0 500 ECU_ADDRESS 0xFFF86274 /end MEASUREMENT
/begin MEASUREMENT v_f_ref_in "Fahrzeuggeschwindigkeit ueber Grund" UWORD v_int_M_S7_S3 1 100 0 511 ECU_ADDRESS 0xFFF86782 /end MEASUREMENT
/begin MEASUREMENT v_f_sbe "Fahrzeuggeschwindigkeit auf Basis der Getriebeabtriebsdrehzahl in der  Hybridablaufsteuerung" FLOAT32_IEEE v_fl_M_S7_S3 1 100 0 500 ECU_ADDRESS 0xFFF861E4 /end MEASUREMENT
/begin MEASUREMENT vg_f_sbe "Fahrzeuggeschwindigkeitsgradient auf Basis der Getriebeabtriebsdrehzahl in der  Hybridablaufsteuerung" FLOAT32_IEEE vg_fl_M_S7_S3 1 100 -100 100 ECU_ADDRESS 0xFFF861E8 /end MEASUREMENT
/begin MEASUREMENT z_ablauf_has_hst_in "" UBYTE sts_int_M_S7_S3 1 100 0 15 ECU_ADDRESS 0xFFF86CB8 /end MEASUREMENT
/begin MEASUREMENT z_ablauf_has_stg "Zusaetzliche Steuergroesse zur Ablaufsteuerung" UBYTE ctrl_int_M_S7_S3 1 100 0 15 ECU_ADDRESS 0xFFF86C57 /end MEASUREMENT
/begin MEASUREMENT z_ablauf_svh_reset_has_fkt "" UBYTE sts_int_M_S7_S3 1 100 0 255 ECU_ADDRESS 0xFFF86C5B /end MEASUREMENT
/begin MEASUREMENT z_ablaufreinit_frk_dihi "Zeigt an, dass der aktuelle HAS-Ablauf erneut begonnen werden soll" UBYTE sts_int_e_M_S7_S3 1 100 0 1 ECU_ADDRESS 0xFFF86C40 /end MEASUREMENT
/begin MEASUREMENT z_ablaufvariante_has_hst_in "" UBYTE sts_int_M_S7_S3 1 100 0 99 ECU_ADDRESS 0xFFF86CB9 /end MEASUREMENT
/begin MEASUREMENT z_ablaufvariante_has_stg "Ablaufvariante, die  die OML ausgibt" UBYTE sts_int_M_S7_S3 1 100 0 99 ECU_ADDRESS 0xFFF86C58 /end MEASUREMENT
/begin MEASUREMENT z_ablaufvariante_kalt_zus "Anzeige der aktiven Ablaufvariante Kaltstart beim Zustart - 0 = kein Kaltstart, 1 = Kaltstart mit abgesenkter EM-Drehzahl" UBYTE st_int_M_S7_S3 1 100 0 255 ECU_ADDRESS 0xFFF86C5C /end MEASUREMENT
/begin MEASUREMENT z_abs_msa_has "Anforderung der Beeinflussung der MSA-Funktionalitaet bei aktiven ABS-/ESP-Regelzustaenden durch die Hybridablaufsteuerung - Codierung wie z_msa_has_sbe" UBYTE sts_int_M_S7_S3 1 100 0 255 ECU_ADDRESS 0xFFF98408 /end MEASUREMENT
/begin MEASUREMENT z_aktiv_schlupf_kraftschluss_bmi_has "Flag zur Anzeige Aktivierung Uebergang Schlupf -> Kraftschluss" UBYTE void_int_d_M_S7_S3 1 100 0 1 ECU_ADDRESS 0xFFF8696D /end MEASUREMENT
/begin MEASUREMENT z_ala_fktaktiv_has "Anzeige der aktiven Einzelfunktion der Anlasserstartanforderung, d.h. der Fkt. die eine Anforderung stellt, Codierung bit0=CGETR, 1=GE, 2=IAE, 3=frei, 4=SAS, 5=IAEENTK, 6=frei, 7=frei, 8=BZ, 9=frei, 10=frei, 11=RSE, 12=frei, 13=K0ADA, 14=frei, 15=DIAG" UWORD sts_int_y_M_S7_S3 1 100 0 65535 ECU_ADDRESS 0xFFF86600 /end MEASUREMENT
/begin MEASUREMENT z_ala_frk_dihi "Zeigt an, dass die Anlasserstartanforderung der HAS aktiviert werden soll" UBYTE sts_int_e_M_S7_S3 1 100 0 1 ECU_ADDRESS 0xFFF86C41 /end MEASUREMENT
/begin MEASUREMENT z_analyse_aktiv_has_sbe "Aktiverung Berechnung Analyse MvG VM Start" UBYTE void_int_d_M_S7_S3 1 100 0 1 ECU_ADDRESS 0xFFF8696E /end MEASUREMENT
/begin MEASUREMENT z_ba_has_k0_hst_in "" UBYTE st_int_M_S7_S3 1 100 0 1 ECU_ADDRESS 0xFFF86CD2 /end MEASUREMENT
/begin MEASUREMENT z_ba_has_vm_hst_in "" UBYTE st_int_M_S7_S3 1 100 0 1 ECU_ADDRESS 0xFFF86CD3 /end MEASUREMENT
/begin MEASUREMENT z_bed_schlupf_kraftschluss_bmi_has "Flag zur Anzeige Aktivierung Uebergang Schlupf -> Kraftschluss" UBYTE void_int_d_M_S7_S3 1 100 0 1 ECU_ADDRESS 0xFFF8696F /end MEASUREMENT
/begin MEASUREMENT z_berg_msa_has "Anforderung der Beeinflussung der MSA-Funktionalitaet am Berg durch die Hybridablaufsteuerung - Codierung wie z_msa_has_sbe" UBYTE st_int_M_S7_S3 1 100 0 255 ECU_ADDRESS 0xFFF98409 /end MEASUREMENT
/begin MEASUREMENT z_cgetr_msa_has "Anforderung der Beeinflussung der MSA-Funktionalitaet in Abhaengigkeit der Getriebeoeltemperatur durch die Hybridablaufsteuerung - Codierung wie z_msa_has_sbe" UBYTE sts_int_M_S7_S3 1 100 0 255 ECU_ADDRESS 0xFFF9840A /end MEASUREMENT
/begin MEASUREMENT z_crvkri_lls_has "Anzeige der aktiven Creep-Ruckel-Verhinderung (CRV) der Leerlaufsimulation der HAS (LLS) bei Kriechbetrieb" UBYTE sts_int_M_S7_S3 1 100 0 1 ECU_ADDRESS 0xFFF86970 /end MEASUREMENT
/begin MEASUREMENT z_deaktiv_abo_frk_dihi "Zeigt an, dass die ABO Funktion verlassen werden soll." UBYTE sts_int_e_M_S7_S3 1 100 0 1 ECU_ADDRESS 0xFFF86C42 /end MEASUREMENT
/begin MEASUREMENT z_diag_ersfkt_has_in "Funktionsschnittstelle zur Ermittlung ob irgendeine Ersatzmassnahme in der Diagnoseverwaltung aktiv ist" ULONG b_int_M_S7_S3 1 100 0 4294967295 ECU_ADDRESS 0xFFF86278 /end MEASUREMENT
/begin MEASUREMENT z_diag_ersfkt_hi_96_has_in "Anzeige ob Ersatzmassnahme in der Diagnoseverwaltung aktiv ist bit 64...95" ULONG b_int_M_S7_S3 1 100 0 4294967295 ECU_ADDRESS 0xFFF8627C /end MEASUREMENT
/begin MEASUREMENT z_diag_ersfkt_hi_has_in "Funktionsschnittstelle zur Ermittlung ob irgendeine Ersatzmassnahme in der Diagnoseverwaltung aktiv ist" ULONG b_int_M_S7_S3 1 100 0 4294967295 ECU_ADDRESS 0xFFF86280 /end MEASUREMENT
/begin MEASUREMENT z_diag_msa_has "Anforderung der Beeinflussung der MSA-Funktionalitaet bei aktiver Diagnose-Ersatzfunktion durch die Hybridablaufsteuerung - Codierung wie z_msa_has_sbe" UBYTE sts_int_M_S7_S3 1 100 0 255 ECU_ADDRESS 0xFFF9840B /end MEASUREMENT
/begin MEASUREMENT z_diag_notgang_has_in "Notganginformation" UBYTE b_int_b_M_S7_S3 1 100 0 255 ECU_ADDRESS 0xFFF86CBA /end MEASUREMENT
/begin MEASUREMENT z_diagnotgang_bmi_has "Anzeige der Beeinflussung des Hybrid-Betriebsmodus der IAE durch die Diagnose Notgang-Information - 0 = keine Beeinflussung, 1 = Ueberfuehrung in den Zustand E-Fahren Kraftschluss" UBYTE sts_int_M_S7_S3 1 100 0 1 ECU_ADDRESS 0xFFF9840C /end MEASUREMENT
/begin MEASUREMENT z_emaktiv_fuw_zus_fkt "Anzeige der EM Fehlfuntion der Funktionsueberwachung der EM beim Zustart" UBYTE b_int_h_M_S7_S3 1 100 0 1 ECU_ADDRESS 0xFFF86C5D /end MEASUREMENT
/begin MEASUREMENT z_emfehler_frk_dihi "Zeigt an, dass eine EM Fehlfunktion erkannt wurde, die in der HAS ausgewertet werden soll" UBYTE sts_int_e_M_S7_S3 1 100 0 1 ECU_ADDRESS 0xFFF86C43 /end MEASUREMENT
/begin MEASUREMENT z_fehler15_eh_fkt "" UBYTE st_int_M_S7_S3 1 100 0 1 ECU_ADDRESS 0xFFF86C5E /end MEASUREMENT
/begin MEASUREMENT z_fkt_msa_has "Anforderung der Beeinflussung der MSA-Funktionalitaet bei aktiver Hybridfunktion durch die Hybridablaufsteuerung - Codierung wie z_msa_has_sbe" UBYTE sts_int_M_S7_S3 1 100 0 255 ECU_ADDRESS 0xFFF9840D /end MEASUREMENT
/begin MEASUREMENT z_freigabe_pvu_has_sbe "Freigabe zur Aktivierung der Diagnosefunktion \"Positionsventil-Ueberwachung\" der Funktion zur Unterstuetzung der Positi-onsventil-Ueberwachung der HAS" UBYTE st_int_M_S7_S3 1 100 0 1 ECU_ADDRESS 0xFFF86C71 /end MEASUREMENT
/begin MEASUREMENT z_fst_msa_has "Anforderung der Beeinflussung der MSA-Funktionalitaet bei aktiver Hybridfunktion in Abhaengigkeit der Vorgabe der Fahrstrategie  - Codierung wie z_msa_has_sbe" UBYTE sts_int_M_S7_S3 1 100 0 255 ECU_ADDRESS 0xFFF9840E /end MEASUREMENT
/begin MEASUREMENT z_fuwdeakt_frk_dihi "Zeigt an, dass die FUW-Funktion nicht aktiviert werden darf" UBYTE sts_int_e_M_S7_S3 1 100 0 1 ECU_ADDRESS 0xFFF86C44 /end MEASUREMENT
/begin MEASUREMENT z_ge_ndk0_msa_has "Motorstartanforderung waehrend Gangeinlegen bei nd_k0 ueber Schwelle NDS_K0_GE_NDK0_MSA_HAS" UBYTE sts_int_M_S7_S3 1 100 0 1 ECU_ADDRESS 0xFFF9840F /end MEASUREMENT
/begin MEASUREMENT z_gebruefahrenaus_frk_dihi "Erkennung Aufheben gebruecktes E Fahren" UBYTE sts_int_e_M_S7_S3 1 100 0 1 ECU_ADDRESS 0xFFF86C45 /end MEASUREMENT
/begin MEASUREMENT z_hybfkt_stg "Anforderung der Aktivierung einer Hybridfunktion durch die Hyrid-Zustandssteuerung" UBYTE E_HYBFKT_M_S7_S3 1 100 0 15 ECU_ADDRESS 0xFFF86C59 /end MEASUREMENT
/begin MEASUREMENT z_iae_msa_has "Anforderung der Beeinflussung der MSA-Funktionalitaet in Abhaengigkeit des IAE Betriebszustands durch die Hybridablaufsteuerung - Codierung wie z_msa_has_sbe" UBYTE sts_int_M_S7_S3 1 100 0 255 ECU_ADDRESS 0xFFF98410 /end MEASUREMENT
/begin MEASUREMENT z_iep_in "" UBYTE E_ZIEP_M_S7_S3 1 100 0 4 ECU_ADDRESS 0xFFF86CBB /end MEASUREMENT
/begin MEASUREMENT z_iepein_frk_dihi "Zeigt an, dass die IEP aktiviert werden soll, wenn ein EM-Drehzahl Signalfehler vorliegt, um die Oelversorgung weiterhin sicher zu stellen." UBYTE sts_int_e_M_S7_S3 1 100 0 1 ECU_ADDRESS 0xFFF86C46 /end MEASUREMENT
/begin MEASUREMENT z_k0_befuellopt_has_fkt "" UBYTE st_int_M_S7_S3 1 100 0 1 ECU_ADDRESS 0xFFF86C5F /end MEASUREMENT
/begin MEASUREMENT z_k0_fst_in "" UBYTE E_ZK0FSTIN_M_S7_S3 1 100 0 3 ECU_ADDRESS 0xFFF86CBC /end MEASUREMENT
/begin MEASUREMENT z_k0_has_fkt "" UBYTE E_ZK0_M_S7_S3 1 100 0 5 ECU_ADDRESS 0xFFF86C60 /end MEASUREMENT
/begin MEASUREMENT z_k0ansteuerung_bbr "Erkennung der Anforderung der K0 Ansteuerung der Beeinflussung der SAS Befuellreihenfolge durch die HAS" UBYTE st_int_M_S7_S3 1 100 0 1 ECU_ADDRESS 0xFFF86971 /end MEASUREMENT
/begin MEASUREMENT z_k0syncmk0erh_frk_dihi "Zeigt an, dass eine K0-Zwangsynchronisation mittels Erhoehung des K0-Moments erfolgen soll" UBYTE sts_int_e_M_S7_S3 1 100 0 1 ECU_ADDRESS 0xFFF86C47 /end MEASUREMENT
/begin MEASUREMENT z_kfl_msa_has "Anforderung der Beeinflussung der MSA-Funktionalitaet in Abhaengigkeit des Kraftfluss-Status durch die Hybridab-laufsteuerung - Codierung wie z_msa_has_sbe" UBYTE sts_int_M_S7_S3 1 100 0 255 ECU_ADDRESS 0xFFF98413 /end MEASUREMENT
/begin MEASUREMENT z_kps_stada_in "Sollvorgabe fuer die Trennkupplung K0 durch die Stillstandsadaption" UBYTE sts_int_M_S7_S3 1 100 0 255 ECU_ADDRESS 0xFFF86CBD /end MEASUREMENT
/begin MEASUREMENT z_lls_fktnmax_has "Anzeige der Einzelfunktion mit der hoechsten Drehzahlvorgabe der Leerlaufsimulation der HAS - Codierung wie z_lls_fktaktiv_has " ULONG sts_int_m_M_S7_S3 1 100 0 4294967295 ECU_ADDRESS 0xFFF85C3C /end MEASUREMENT
/begin MEASUREMENT z_lls_fktrelevant_has "Anzeige der aktuell relevanten Einzelfktunktion der Leer-laufsimulation der HAS - Codierung wie z_lls_fktaktiv_has " ULONG sts_int_m_M_S7_S3 1 100 0 4294967295 ECU_ADDRESS 0xFFF85C40 /end MEASUREMENT
/begin MEASUREMENT z_m_max_iae_has_fkt "" UBYTE st_int_M_S7_S3 1 100 0 50 ECU_ADDRESS 0xFFF86C61 /end MEASUREMENT
/begin MEASUREMENT z_m_soll_em_has_fkt "" UBYTE st_int_l_M_S7_S3 1 100 0 1 ECU_ADDRESS 0xFFF86C62 /end MEASUREMENT
/begin MEASUREMENT z_modus_em_hst_in "" UBYTE sts_int_M_S7_S3 1 100 0 255 ECU_ADDRESS 0xFFF86CBE /end MEASUREMENT
/begin MEASUREMENT z_msa_aktiv_has "Bitmaske zur Festlegung, welche der Beeinflussungsmoeglichkeiten der MSA-Funktionalitaet durch die HAS aktiviert sind - Codierung wie z_msa_has_sbe" UBYTE sts_int_M_S7_S3 1 100 0 255 ECU_ADDRESS 0xFFF98414 /end MEASUREMENT
/begin MEASUREMENT z_msa_fktaktiv_has "Anzeige der aktiven Einzelfkt. der Beeinfl. der MSA-Funktionalitaet durch die HAS, Codierung: bit0=CGETR,bit1=VGF,bit2=ABS,bit3=KFL,bit4=SAS,bit5=IAE,bit6=STADA,bit7=frei,bit8=frei,bit9=frei,bit10=FKT,bit11=BERG,bit12=FST,bit13=frei,bit14=NDK0,bit15=DIAG" UWORD sts_int_y_M_S7_S3 1 100 0 65535 ECU_ADDRESS 0xFFF984E2 /end MEASUREMENT
/begin MEASUREMENT z_msa_fst_in "Anforderung einer Abschaltverhinderung durch die Fahrstrategie ASIS" UBYTE sts_int_M_S7_S3 1 100 0 255 ECU_ADDRESS 0xFFF86CBF /end MEASUREMENT
/begin MEASUREMENT z_msa_has_sbe "Anforderung der Beeinflussung der MSA-Funktionalitaet durch die Hybridablaufsteuerung - Codierung: bit0 = AVZ, bit1 = AVH, bit2 = EAF, bit3 = EVH, bit4 = Deaktivierung, bit7 = Stoerungsbedingt" UBYTE sts_int_M_S7_S3 1 100 0 255 ECU_ADDRESS 0xFFF86C7A /end MEASUREMENT
/begin MEASUREMENT z_msa_stada_in "Anforderung einer Abschaltverhinderung durch die Stillstandadaption" UBYTE sts_int_M_S7_S3 1 100 0 6 ECU_ADDRESS 0xFFF86CD4 /end MEASUREMENT
/begin MEASUREMENT z_n_min_em_parksp_has_in "Anforderung einer EM-Drehzahlanhebung beim Auslegen der Parksperre infolge unzureichender Oelversorgung" UBYTE b_int_b_M_S7_S3 1 100 0 1 ECU_ADDRESS 0xFFF86CC0 /end MEASUREMENT
/begin MEASUREMENT z_n_soll_em_has_fkt "" UBYTE st_int_M_S7_S3 1 100 0 50 ECU_ADDRESS 0xFFF86C63 /end MEASUREMENT
/begin MEASUREMENT z_n_soll_vm_has_fkt "" UBYTE st_int_M_S7_S3 1 100 0 50 ECU_ADDRESS 0xFFF86C64 /end MEASUREMENT
/begin MEASUREMENT z_nabmodus_lls_has "EM-Drehzahlabbaumodus der Leerlaufsimulation der HAS (LLS)" UBYTE E_ZNMODUS_M_S7_S3 1 100 0 4 ECU_ADDRESS 0xFFF86978 /end MEASUREMENT
/begin MEASUREMENT z_naufmodus_lls_has "EM-Drehzahlaufbaumodus der Leerlaufsimulation der HAS (LLS)" UBYTE E_ZNMODUS_M_S7_S3 1 100 0 4 ECU_ADDRESS 0xFFF86979 /end MEASUREMENT
/begin MEASUREMENT z_ndk0_msa_has "Anforderung der Beeinflussung der MSA-Funktionalitaet bei hohen negativen Differenzdrehzahlen an der K0 Hybridablaufsteuerung - Codierung wie z_msa_has_sbe" UBYTE sts_int_M_S7_S3 1 100 0 255 ECU_ADDRESS 0xFFF98415 /end MEASUREMENT
/begin MEASUREMENT z_nembed_ndk0_msa_has "Aktivierungsbedingung der Beeinflussung der MSA-Funktionalitaet bei geringer EM Drehzahl in Abhaengigkeit der Differenzdrehzahl der K0 zum Schutz der K0" UBYTE b_int_h_M_S7_S3 1 100 0 1 ECU_ADDRESS 0xFFF98416 /end MEASUREMENT
/begin MEASUREMENT z_nemmin_frk_dihi "Zeigt an, dass die EM Leerlauf angehoben werden soll." UBYTE sts_int_e_M_S7_S3 1 100 0 1 ECU_ADDRESS 0xFFF86C48 /end MEASUREMENT
/begin MEASUREMENT z_nllsoll_iae_in "Anforderung der IAE, dass eine definierte LL-Drehzahl durch den Motor eingestellt werden soll" UBYTE E_ZNLLSOLL_M_S7_S3 1 100 0 3 ECU_ADDRESS 0xFFF86CC1 /end MEASUREMENT
/begin MEASUREMENT z_nllsoll_iep_in "" UBYTE void_int_d_M_S7_S3 1 100 0 1 ECU_ADDRESS 0xFFF86CC2 /end MEASUREMENT
/begin MEASUREMENT z_nmineminit_lls_has "Flag zur Initialisierung des Gradientenbegrenzers und des PT2-Filters der EM-Drehzahlfuehrung der Leerlaufsimulation der HAS (LLS)" UBYTE st_int_l_M_S7_S3 1 100 0 1 ECU_ADDRESS 0xFFF8697A /end MEASUREMENT
/begin MEASUREMENT z_nminemngefinit_lls_has "Flag zur alleinigen Initialisierung des Gradientenbegrenzers der EMDrehzahlfuehrung der Leerlaufsimulation der HAS (LLS)" UBYTE st_int_l_M_S7_S3 1 100 0 1 ECU_ADDRESS 0xFFF8697B /end MEASUREMENT
/begin MEASUREMENT z_nminemnull_frk_dihi "Zeigt an, dass die Ausgabe der minimalen EM Drehzahl der HAS unterdrueckt werden soll." UBYTE sts_int_e_M_S7_S3 1 100 0 1 ECU_ADDRESS 0xFFF86C49 /end MEASUREMENT
/begin MEASUREMENT z_nsollvmanh_frk_dihi "Zeigt an, dass die VM-Solldrehzahl waehrend eines Start-Ablaufs angehoben werden soll" UBYTE sts_int_e_M_S7_S3 1 100 0 1 ECU_ADDRESS 0xFFF86C4A /end MEASUREMENT
/begin MEASUREMENT z_nsollvmnull_frk_dihi "Zeigt an, dass die VM-Solldrehzahl Vorgabe unterbunden werden soll" UBYTE sts_int_e_M_S7_S3 1 100 0 1 ECU_ADDRESS 0xFFF86C4B /end MEASUREMENT
/begin MEASUREMENT z_nvmsollbegr_frk_dihi "Zeigt an, dass die VM-Solldrehzahl auf die EM-Istdrehzahl be-grenzt werden soll" UBYTE sts_int_e_M_S7_S3 1 100 0 1 ECU_ADDRESS 0xFFF86C4C /end MEASUREMENT
/begin MEASUREMENT z_oea_hst_in "Anforderung fuer das gebrueckte E-Anfahren der HST" UBYTE sts_int_M_S7_S3 1 100 0 1 ECU_ADDRESS 0xFFF86CC3 /end MEASUREMENT
/begin MEASUREMENT z_p_hys_k0_has_fkt "Hysteresekompensation" UBYTE st_int_M_S7_S3 1 100 0 1 ECU_ADDRESS 0xFFF86C65 /end MEASUREMENT
/begin MEASUREMENT z_ponr_fkt "point of no return" UBYTE st_int_M_S7_S3 1 100 0 1 ECU_ADDRESS 0xFFF86C66 /end MEASUREMENT
/begin MEASUREMENT z_pvu_has_sbe "Beeinflussung des Hybridsystems zur Unterstuetzung der Positionsventil- Ueberwachung der HAS-Codierung: 0 = keine Beeinflussung, 1 = Beeinflussung Stufe 1, 2 = Beeinflussung Stufe 2" UBYTE st_int_M_S7_S3 1 100 0 2 ECU_ADDRESS 0xFFF86C72 /end MEASUREMENT
/begin MEASUREMENT z_respschlepp_sas_fkt "" UBYTE st_int_M_S7_S3 1 100 0 1 ECU_ADDRESS 0xFFF86C67 /end MEASUREMENT
/begin MEASUREMENT z_saf_has_fkt "Schaltanforderung 1...aktiv" UBYTE st_int_M_S7_S3 1 100 0 1 ECU_ADDRESS 0xFFF86C68 /end MEASUREMENT
/begin MEASUREMENT z_sas_fuw_bbr "Aktivierung der Beeinflussung der SAS Befuellreihenfolge durch die HAS
bei erkannter EM-Fehlfunktion beim Zustart" UBYTE st_int_l_M_S7_S3 1 100 0 1 ECU_ADDRESS 0xFFF8697C /end MEASUREMENT
/begin MEASUREMENT z_sas_msa_ge_has "Anforderung der Beeinflussung der MSA-Funktionalitaet bei aktivem Schaltablauf beim Gangeinlegen durch die Hybridablaufsteuerung - Codierung wie z_msa_has_sbe" UBYTE sts_int_M_S7_S3 1 100 0 255 ECU_ADDRESS 0xFFF8697D /end MEASUREMENT
/begin MEASUREMENT z_sas_msa_has "Anforderung der Beeinflussung der MSA-Funktionalitaet bei aktivem Schaltablauf durch die Hybridablaufsteuerung - Codierung wie z_msa_has_sbe" UBYTE sts_int_M_S7_S3 1 100 0 255 ECU_ADDRESS 0xFFF98417 /end MEASUREMENT
/begin MEASUREMENT z_sas_msa_rshs_has "Anforderung der Beeinflussung der MSA-Funktionalitaet bei aktivem Schaltablauf bei RS und HS durch die Hybridablaufsteuerung - Codierung wie z_msa_has_sbe" UBYTE sts_int_M_S7_S3 1 100 0 255 ECU_ADDRESS 0xFFF8697E /end MEASUREMENT
/begin MEASUREMENT z_sas_slst_bbr "Aktivierung der Beeinflussung der SAS Befuellreihenfolge durch die HAS waehrend eines Schleppstart-Ablaufs" UBYTE st_int_l_M_S7_S3 1 100 0 1 ECU_ADDRESS 0xFFF8697F /end MEASUREMENT
/begin MEASUREMENT z_sas_sysstart_bbr "Aktivierung der Beeinflussung der SAS Befuellreihenfolge durch die HAS bei Systemstart" UBYTE st_int_l_M_S7_S3 1 100 0 1 ECU_ADDRESS 0xFFF86980 /end MEASUREMENT
/begin MEASUREMENT z_sbe_has_fkt "Schaltbeeinflussung  1...aktiv" UBYTE st_int_M_S7_S3 1 100 0 1 ECU_ADDRESS 0xFFF86C69 /end MEASUREMENT
/begin MEASUREMENT z_schaltprioverh_frk_dihi "Zeigt an, dass die Schaltungspriorisierung bei einem Zustart-Ablauf  uterbunden werden soll" UBYTE sts_int_e_M_S7_S3 1 100 0 1 ECU_ADDRESS 0xFFF86C4D /end MEASUREMENT
/begin MEASUREMENT z_stada_msa_has "Anforderung der Beeinflussung der MSA-Funktionalitaet in Abhaengigkeit der Vorgabe der Still-standadaption - Codierung wie z_msa_has_sbe" UBYTE sts_int_M_S7_S3 1 100 0 255 ECU_ADDRESS 0xFFF98418 /end MEASUREMENT
/begin MEASUREMENT z_statusefahren_bmi_modus "Umschaltmodus zur Festl. des Zeitpunkts der Umschaltung auf den Zielzust. des Status E-Fahren zur Best.des Hybrid-Betriebsmodus der IAE, Code: 0=am Ende des Zust.uebergangs,1=zu Beginn des Zust.uebergangs,2=nach der K0 Befuellung,3=beim Oeffnen der K0" UBYTE st_int_M_S7_S3 1 100 0 3 ECU_ADDRESS 0xFFF98419 /end MEASUREMENT
/begin MEASUREMENT z_statusefahren_out_modus "Umschaltmodus zur Festl. des Zeitpunkts der Umschaltung auf den Zielzust. des Status E-Fahren der HAS bei einem Zustandsuebergang, Cod.: 0=am Ende des Zustandsuebergangs,1=zu Beginn des Zustandsuebergangs,2=nach der K0 Befuellung,3=beim Oeffnen der K0" UBYTE st_int_M_S7_S3 1 100 0 3 ECU_ADDRESS 0xFFF9841A /end MEASUREMENT
/begin MEASUREMENT z_statuspsysmps_frk_dihi "Zeigt an, dass der Pumpendruck-Status der ATSYS modifiziert werden soll" UBYTE sts_int_e_M_S7_S3 1 100 0 1 ECU_ADDRESS 0xFFF86C4E /end MEASUREMENT
/begin MEASUREMENT z_svh_frk_dihi "Zeigt an, dass die Schaltverhinderung (SVH) aktiviert werden soll" UBYTE sts_int_e_M_S7_S3 1 100 0 1 ECU_ADDRESS 0xFFF86C4F /end MEASUREMENT
/begin MEASUREMENT z_vgf_msa_has "Anforderung der Beeinflussung der MSA-Funktionalitaet in Abhaengigkeit des Fahrzeuggeschwindigkeitsgradienten durch die Hybridablaufsteuerung - Codierung wie z_msa_has_sbe" UBYTE sts_int_M_S7_S3 1 100 0 255 ECU_ADDRESS 0xFFF9841B /end MEASUREMENT
/begin MEASUREMENT z_vmstartanf_frk_dihi "Zeigt an, dass der VM gestartet werden soll." UBYTE sts_int_e_M_S7_S3 1 100 0 1 ECU_ADDRESS 0xFFF86C50 /end MEASUREMENT
/begin MEASUREMENT z_vmstartverbot_frk_dihi "Zeigt an, dass der VM nicht gestartet werden darf." UBYTE sts_int_e_M_S7_S3 1 100 0 1 ECU_ADDRESS 0xFFF86C51 /end MEASUREMENT
/begin MEASUREMENT z_vmstopverbot_frk_dihi "Zeigt an, dass der VM nicht gestoppt werden darf." UBYTE sts_int_e_M_S7_S3 1 100 0 1 ECU_ADDRESS 0xFFF86C52 /end MEASUREMENT
/begin MEASUREMENT z_zuendfreigabe_vm_fkt "" UBYTE st_int_M_S7_S3 1 100 0 1 ECU_ADDRESS 0xFFF86C6A /end MEASUREMENT
/begin MEASUREMENT z_zuendfreigabe_vm_has_fkt "" UBYTE st_int_M_S7_S3 1 100 0 1 ECU_ADDRESS 0xFFF86C6B /end MEASUREMENT
/begin MEASUREMENT z_zust_halten_frk_dihi "Zeigt an, ob der Betriebszustand \"HAS Zustand halten\" aktiv sein soll." UBYTE sts_int_e_M_S7_S3 1 100 0 1 ECU_ADDRESS 0xFFF86C53 /end MEASUREMENT
/begin MEASUREMENT z_zust_init_frk_dihi "Zeigt an, ob der Betriebszustand \"HAS Zustand Init\" aktiv sein soll." UBYTE sts_int_e_M_S7_S3 1 100 0 1 ECU_ADDRESS 0xFFF86C54 /end MEASUREMENT
/begin MEASUREMENT zielgang_egs_in "" SBYTE sts_int_M_S7_S3 1 100 -128 127 ECU_ADDRESS 0xFFF86CC4 /end MEASUREMENT
/begin COMPU_METHOD SAB_04PROZENT_S2_S3 "int = ((phys * 10) / 4) - (0) %" RAT_FUNC "%5.3" "%" COEFFS 0 10 -0 0 0 4 /end COMPU_METHOD
/begin COMPU_METHOD SAB_4PROZENT5_S2_S3 "int = ((phys * 5) / 4) - (0) %" RAT_FUNC "%5.3" "%" COEFFS 0 5 -0 0 0 4 /end COMPU_METHOD
/begin COMPU_METHOD SAB_05PROZENT_S2_S3 "int = ((phys * 10) / 5) - (0) %" RAT_FUNC "%5.3" "%" COEFFS 0 10 -0 0 0 5 /end COMPU_METHOD
/begin COMPU_METHOD SAB_M_2NM_S2_S3 "int = ((phys * 1) / 2) - (0) Nm" RAT_FUNC "%5.3" "Nm" COEFFS 0 1 -0 0 0 2 /end COMPU_METHOD
/begin COMPU_METHOD SAB_M_3NM_S2_S3 "int = ((phys * 1) / 3) - (0) Nm" RAT_FUNC "%5.3" "Nm" COEFFS 0 1 -0 0 0 3 /end COMPU_METHOD
/begin COMPU_METHOD SAB_M_2NM_M100_S2_S3 "int = ((phys * 1) / 2) - (-50) Nm" RAT_FUNC "%5.3" "Nm" COEFFS 0 1 100 0 0 2 /end COMPU_METHOD
/begin COMPU_METHOD SAB_M_NM5_S2_S3 "int = ((phys * 5) / 1) - (0) Nm" RAT_FUNC "%5.3" "Nm" COEFFS 0 5 -0 0 0 1 /end COMPU_METHOD
/begin COMPU_METHOD SAB_M_NM8_S2_S3 "int = ((phys * 8) / 1) - (0) Nm" RAT_FUNC "%5.3" "Nm" COEFFS 0 8 -0 0 0 1 /end COMPU_METHOD
/begin COMPU_METHOD SAB_M_Quanten_S2_S3 "int = ((phys * 1) / 1) - (0) Quanten" RAT_FUNC "%2.0" "Quanten" COEFFS 0 1 -0 0 0 1 /end COMPU_METHOD
/begin COMPU_METHOD SAB_M_Quanten_M509_S2_S3 "int = ((phys * 1) / 1) - (-509) Quanten" RAT_FUNC "%2.0" "Quanten" COEFFS 0 1 509 0 0 1 /end COMPU_METHOD
/begin COMPU_METHOD b_int_M_S7_S3 "Bit Feld" RAT_FUNC "%10.0" "-" COEFFS 0 1 0 0 0 1 /end COMPU_METHOD
/begin COMPU_METHOD b_int_24_M_S7_S3 "Bit Feld" RAT_FUNC "%5.0" "-" COEFFS 0 1 0 0 0 1 /end COMPU_METHOD
/begin COMPU_METHOD b_int_b_M_S7_S3 "Bit Feld" RAT_FUNC "%3.0" "-" COEFFS 0 1 0 0 0 1 /end COMPU_METHOD
/begin COMPU_METHOD b_int_h_M_S7_S3 "Bit Feld" RAT_FUNC "%1.0" "-" COEFFS 0 1 0 0 0 1 /end COMPU_METHOD
/begin COMPU_METHOD c_fl_M_S7_S3 "Temperatur" RAT_FUNC "%12.6" "°C" COEFFS 0 1 0 0 0 1 /end COMPU_METHOD
/begin COMPU_METHOD c_int_M_S7_S3 "Temperatur" RAT_FUNC "%12.6" "°C" COEFFS 0 1 0 0 0 1 /end COMPU_METHOD
/begin COMPU_METHOD c_int_v_M_S7_S3 "Temperatur" RAT_FUNC "%5.0" "°C" COEFFS 0 1 0 0 0 1 /end COMPU_METHOD
/begin COMPU_METHOD cg_fl_M_S7_S3 "Temperaturgradient" RAT_FUNC "%12.6" "°K/s" COEFFS 0 1 0 0 0 1 /end COMPU_METHOD
/begin COMPU_METHOD ctrl_int_M_S7_S3 "Steuerwort" RAT_FUNC "%3.0" "-" COEFFS 0 1 0 0 0 1 /end COMPU_METHOD
/begin COMPU_METHOD E_BREMSPED_M_S7_S3 "" TAB_VERB "%12.6" "" COMPU_TAB_REF CONV_TAB_E_BREMSPED_M_S7_S3 /end COMPU_METHOD
/begin COMPU_METHOD E_DREHRICH_M_S7_S3 "" TAB_VERB "%12.6" "" COMPU_TAB_REF CONV_TAB_E_DREHRICH_M_S7_S3 /end COMPU_METHOD
/begin COMPU_METHOD E_FEHLERIEP_M_S7_S3 "" TAB_VERB "%12.6" "" COMPU_TAB_REF CONV_TAB_E_FEHLERIEP_M_S7_S3 /end COMPU_METHOD
/begin COMPU_METHOD E_HYBFKT_M_S7_S3 "" TAB_VERB "%12.6" "" COMPU_TAB_REF CONV_TAB_E_HYBFKT_M_S7_S3 /end COMPU_METHOD
/begin COMPU_METHOD E_MODUSEFAH_M_S7_S3 "" TAB_VERB "%12.6" "" COMPU_TAB_REF CONV_TAB_E_MODUSEFAH_M_S7_S3 /end COMPU_METHOD
/begin COMPU_METHOD E_POS_M_S7_S3 "" TAB_VERB "%12.6" "" COMPU_TAB_REF CONV_TAB_E_POS_M_S7_S3 /end COMPU_METHOD
/begin COMPU_METHOD E_SIGSTATUS_M_S7_S3 "" TAB_VERB "%12.6" "" COMPU_TAB_REF CONV_TAB_E_SIGSTATUS_M_S7_S3 /end COMPU_METHOD
/begin COMPU_METHOD E_STAK0BEF_M_S7_S3 "" TAB_VERB "%12.6" "" COMPU_TAB_REF CONV_TAB_E_STAK0BEF_M_S7_S3 /end COMPU_METHOD
/begin COMPU_METHOD E_STATUSABS_M_S7_S3 "" TAB_VERB "%12.6" "" COMPU_TAB_REF CONV_TAB_E_STATUSABS_M_S7_S3 /end COMPU_METHOD
/begin COMPU_METHOD E_STATUSADA_M_S7_S3 "" TAB_VERB "%12.6" "" COMPU_TAB_REF CONV_TAB_E_STATUSADA_M_S7_S3 /end COMPU_METHOD
/begin COMPU_METHOD E_STATUSASR_M_S7_S3 "" TAB_VERB "%12.6" "" COMPU_TAB_REF CONV_TAB_E_STATUSASR_M_S7_S3 /end COMPU_METHOD
/begin COMPU_METHOD E_STATUSCK0_M_S7_S3 "" TAB_VERB "%12.6" "" COMPU_TAB_REF CONV_TAB_E_STATUSCK0_M_S7_S3 /end COMPU_METHOD
/begin COMPU_METHOD E_STATUSIAE_M_S7_S3 "" TAB_VERB "%12.6" "" COMPU_TAB_REF CONV_TAB_E_STATUSIAE_M_S7_S3 /end COMPU_METHOD
/begin COMPU_METHOD E_STATUSIEP_M_S7_S3 "" TAB_VERB "%12.6" "" COMPU_TAB_REF CONV_TAB_E_STATUSIEP_M_S7_S3 /end COMPU_METHOD
/begin COMPU_METHOD E_STATUSK0_M_S7_S3 "" TAB_VERB "%12.6" "" COMPU_TAB_REF CONV_TAB_E_STATUSK0_M_S7_S3 /end COMPU_METHOD
/begin COMPU_METHOD E_STATUSKSL_M_S7_S3 "" TAB_VERB "%12.6" "" COMPU_TAB_REF CONV_TAB_E_STATUSKSL_M_S7_S3 /end COMPU_METHOD
/begin COMPU_METHOD E_STATUSNAA_M_S7_S3 "" TAB_VERB "%12.6" "" COMPU_TAB_REF CONV_TAB_E_STATUSNAA_M_S7_S3 /end COMPU_METHOD
/begin COMPU_METHOD E_STATUSPSY_M_S7_S3 "" TAB_VERB "%12.6" "" COMPU_TAB_REF CONV_TAB_E_STATUSPSY_M_S7_S3 /end COMPU_METHOD
/begin COMPU_METHOD E_STATUSRSE_M_S7_S3 "" TAB_VERB "%12.6" "" COMPU_TAB_REF CONV_TAB_E_STATUSRSE_M_S7_S3 /end COMPU_METHOD
/begin COMPU_METHOD E_STBZHAS_M_S7_S3 "" TAB_VERB "%12.6" "" COMPU_TAB_REF CONV_TAB_E_STBZHAS_M_S7_S3 /end COMPU_METHOD
/begin COMPU_METHOD E_STNDATLLS_M_S7_S3 "" TAB_VERB "%12.6" "" COMPU_TAB_REF CONV_TAB_E_STNDATLLS_M_S7_S3 /end COMPU_METHOD
/begin COMPU_METHOD E_ZIEP_M_S7_S3 "" TAB_VERB "%12.6" "" COMPU_TAB_REF CONV_TAB_E_ZIEP_M_S7_S3 /end COMPU_METHOD
/begin COMPU_METHOD E_ZK0_M_S7_S3 "" TAB_VERB "%12.6" "" COMPU_TAB_REF CONV_TAB_E_ZK0_M_S7_S3 /end COMPU_METHOD
/begin COMPU_METHOD E_ZK0FSTIN_M_S7_S3 "" TAB_VERB "%12.6" "" COMPU_TAB_REF CONV_TAB_E_ZK0FSTIN_M_S7_S3 /end COMPU_METHOD
/begin COMPU_METHOD E_ZNLLSOLL_M_S7_S3 "" TAB_VERB "%12.6" "" COMPU_TAB_REF CONV_TAB_E_ZNLLSOLL_M_S7_S3 /end COMPU_METHOD
/begin COMPU_METHOD E_ZNMODUS_M_S7_S3 "" TAB_VERB "%12.6" "" COMPU_TAB_REF CONV_TAB_E_ZNMODUS_M_S7_S3 /end COMPU_METHOD
/begin COMPU_METHOD m_fl_M_S7_S3 "Masse" RAT_FUNC "%12.6" "kg" COEFFS 0 1 0 0 0 1 /end COMPU_METHOD
/begin COMPU_METHOD n_fl_M_S7_S3 "Drehzahl" RAT_FUNC "%12.6" "1/min" COEFFS 0 1 0 0 0 1 /end COMPU_METHOD
/begin COMPU_METHOD n_int_M_S7_S3 "Drehzahl" RAT_FUNC "%5.0" "1/min" COEFFS 0 1 0 0 0 1 /end COMPU_METHOD
/begin COMPU_METHOD n_int_x_M_S7_S3 "Drehzahl" RAT_FUNC "%12.6" "1/min" COEFFS 0 1 0 0 0 1 /end COMPU_METHOD
/begin COMPU_METHOD ng_fl_M_S7_S3 "Drehzahlgradient" RAT_FUNC "%12.6" "1/min/s" COEFFS 0 1 0 0 0 1 /end COMPU_METHOD
/begin COMPU_METHOD ng_int_z_M_S7_S3 "Drehzahlgradient" RAT_FUNC "%10.0" "1/min/s" COEFFS 0 1 0 0 0 1 /end COMPU_METHOD
/begin COMPU_METHOD p_fl_M_S7_S3 "Druck" RAT_FUNC "%12.6" "bar" COEFFS 0 1 0 0 0 1 /end COMPU_METHOD
/begin COMPU_METHOD phigrad_fl_M_S7_S3 "Winkel in grad" RAT_FUNC "%12.6" "grad" COEFFS 0 1 0 0 0 1 /end COMPU_METHOD
/begin COMPU_METHOD ratio_fl_M_S7_S3 "Uebersetzungsverhaeltnis" RAT_FUNC "%12.6" "-" COEFFS 0 1 0 0 0 1 /end COMPU_METHOD
/begin COMPU_METHOD rel_fl_M_S7_S3 "Relative Groesse" RAT_FUNC "%12.6" "%" COEFFS 0 1 0 0 0 1 /end COMPU_METHOD
/begin COMPU_METHOD rel_int_M_S7_S3 "Relative Groesse" RAT_FUNC "%3.0" "%" COEFFS 0 1 0 0 0 1 /end COMPU_METHOD
/begin COMPU_METHOD st_int_M_S7_S3 "Zustandsgroesse" RAT_FUNC "%3.0" "-" COEFFS 0 1 0 0 0 1 /end COMPU_METHOD
/begin COMPU_METHOD st_int_g_M_S7_S3 "Zustandsgroesse" RAT_FUNC "%5.0" "-" COEFFS 0 1 0 0 0 1 /end COMPU_METHOD
/begin COMPU_METHOD st_int_l_M_S7_S3 "Zustandsgroesse" RAT_FUNC "%1.0" "-" COEFFS 0 1 0 0 0 1 /end COMPU_METHOD
/begin COMPU_METHOD sts_fl_M_S7_S3 "Status" RAT_FUNC "%12.6" "-" COEFFS 0 1 0 0 0 1 /end COMPU_METHOD
/begin COMPU_METHOD sts_int_M_S7_S3 "Status" RAT_FUNC "%3.0" "-" COEFFS 0 1 0 0 0 1 /end COMPU_METHOD
/begin COMPU_METHOD sts_int_e_M_S7_S3 "Status" RAT_FUNC "%1.0" "-" COEFFS 0 1 0 0 0 1 /end COMPU_METHOD
/begin COMPU_METHOD sts_int_m_M_S7_S3 "Status" RAT_FUNC "%10.0" "-" COEFFS 0 1 0 0 0 1 /end COMPU_METHOD
/begin COMPU_METHOD sts_int_y_M_S7_S3 "Status" RAT_FUNC "%5.0" "-" COEFFS 0 1 0 0 0 1 /end COMPU_METHOD
/begin COMPU_METHOD swi_int_M_S7_S3 "Schalter" RAT_FUNC "%1.0" "-" COEFFS 0 1 0 0 0 1 /end COMPU_METHOD
/begin COMPU_METHOD t_fl_M_S7_S3 "Zeit" RAT_FUNC "%12.6" "s" COEFFS 0 1 0 0 0 1 /end COMPU_METHOD
/begin COMPU_METHOD t_int_M_S7_S3 "Zeit" RAT_FUNC "%11.2" "s" COEFFS 0 1 0 0 0 0.01 /end COMPU_METHOD
/begin COMPU_METHOD t_int_n_M_S7_S3 "Zeit" RAT_FUNC "%6.2" "s" COEFFS 0 1 0 0 0 0.01 /end COMPU_METHOD
/begin COMPU_METHOD trq_fl_M_S7_S3 "Moment" RAT_FUNC "%5.0" "Nm" COEFFS 0 1 0 0 0 1 /end COMPU_METHOD
/begin COMPU_METHOD trq_fl_a_M_S7_S3 "Moment" RAT_FUNC "%12.6" "Nm" COEFFS 0 1 0 0 0 1 /end COMPU_METHOD
/begin COMPU_METHOD trqg_fl_k_M_S7_S3 "Momentengradient" RAT_FUNC "%12.6" "Nm/s" COEFFS 0 1 0 0 0 1 /end COMPU_METHOD
/begin COMPU_METHOD v_fl_M_S7_S3 "Geschwindigkeit" RAT_FUNC "%12.6" "km/h" COEFFS 0 1 0 0 0 1 /end COMPU_METHOD
/begin COMPU_METHOD v_int_M_S7_S3 "Geschwindigkeit" RAT_FUNC "%5.0" "km/h" COEFFS 0 1 0 0 0 1 /end COMPU_METHOD
/begin COMPU_METHOD vg_fl_M_S7_S3 "Geschwindigkeitsgradient" RAT_FUNC "%12.6" "km/h/s" COEFFS 0 1 0 0 0 1 /end COMPU_METHOD
/begin COMPU_METHOD void_fl_M_S7_S3 "ohne Umrechnung" RAT_FUNC "%12.6" "-" COEFFS 0 1 0 0 0 1 /end COMPU_METHOD
/begin COMPU_METHOD void_int_M_S7_S3 "ohne Umrechnung" RAT_FUNC "%3.0" "-" COEFFS 0 1 0 0 0 1 /end COMPU_METHOD
/begin COMPU_METHOD void_int_c_M_S7_S3 "ohne Umrechnung" RAT_FUNC "%5.0" "-" COEFFS 0 1 0 0 0 1 /end COMPU_METHOD
/begin COMPU_METHOD void_int_d_M_S7_S3 "ohne Umrechnung" RAT_FUNC "%1.0" "-" COEFFS 0 1 0 0 0 1 /end COMPU_METHOD
/begin COMPU_METHOD void_int_f_M_S7_S3 "ohne Umrechnung" RAT_FUNC "%10.0" "-" COEFFS 0 1 0 0 0 1 /end COMPU_METHOD
/begin COMPU_VTAB CONV_TAB_E_BREMSPED_M_S7_S3 "Conversion table" TAB_VERB 2 0 "NICHT_GETRETEN" 1 "GETRETEN" /end COMPU_VTAB
/begin COMPU_VTAB CONV_TAB_E_DREHRICH_M_S7_S3 "Conversion table" TAB_VERB 3 0 "UNBESTIMMT" 1 "VORWAERTS" 2 "RUECKWAERTS" /end COMPU_VTAB
/begin COMPU_VTAB CONV_TAB_E_FEHLERIEP_M_S7_S3 "Conversion table" TAB_VERB 2 0 "NORMALBETRIEB" 1 "FEHLER" /end COMPU_VTAB
/begin COMPU_VTAB CONV_TAB_E_HYBFKT_M_S7_S3 "Conversion table" TAB_VERB 14 0 "PASSIV" 1 "ANKOPPELN_VM" 3 "GANGEINLEGEN" 4 "GANGAUSLEGEN" 5 "OHNABLAUFFKT" 7 "VM_ZUSTART" 8 "ABSTELLEN_VM" 9 "NICHTDEFINIERT_4" 10 "VM_SCHLEPPSTART" 11 "VM_NOTSTART" 12 "VM_EIN" 13 "VM_AUS" 14 "ABSTELLPOSOPT_VM" 15 "FEHLER" /end COMPU_VTAB
/begin COMPU_VTAB CONV_TAB_E_MODUSEFAH_M_S7_S3 "Conversion table" TAB_VERB 2 0 "LADUNG_ABBAUEN" 1 "LADUNG_ERHALTEN" /end COMPU_VTAB
/begin COMPU_VTAB CONV_TAB_E_POS_M_S7_S3 "Conversion table" TAB_VERB 9 0 "D1" 1 "D2" 2 "D3" 3 "D4" 4 "D5" 5 "D" 6 "N" 7 "R" 8 "P" /end COMPU_VTAB
/begin COMPU_VTAB CONV_TAB_E_SIGSTATUS_M_S7_S3 "Conversion table" TAB_VERB 3 0 "SIGNAL_OK" 1 "ERSATZWERT" 2 "SIGNAL_FEHLER" /end COMPU_VTAB
/begin COMPU_VTAB CONV_TAB_E_STAK0BEF_M_S7_S3 "Conversion table" TAB_VERB 4 0 "NICHT_AKTIV" 1 "STANDARD_BEF" 2 "OPTIMIERTBEF" 3 "REDUZIERTBEF" /end COMPU_VTAB
/begin COMPU_VTAB CONV_TAB_E_STATUSABS_M_S7_S3 "Conversion table" TAB_VERB 3 1 "AKTIV" 0 "NICHT_AKTIV" 2 "FEHLER" /end COMPU_VTAB
/begin COMPU_VTAB CONV_TAB_E_STATUSADA_M_S7_S3 "Conversion table" TAB_VERB 3 0 "KEINADAPTION" 1 "TOUCHPOINT_ADAPTION" 2 "REIBWERT_ADAPTION" /end COMPU_VTAB
/begin COMPU_VTAB CONV_TAB_E_STATUSASR_M_S7_S3 "Conversion table" TAB_VERB 2 0 "NICHT_AKTIV" 1 "AKTIV" /end COMPU_VTAB
/begin COMPU_VTAB CONV_TAB_E_STATUSCK0_M_S7_S3 "Conversion table" TAB_VERB 3 0 "NORMAL" 1 "ZU_HEISS" 2 "UEBERHITZT" /end COMPU_VTAB
/begin COMPU_VTAB CONV_TAB_E_STATUSIAE_M_S7_S3 "Conversion table" TAB_VERB 9 0 "NICHTDEFINIERT" 1 "OFFEN" 2 "ANGELEGT" 3 "ANFAHREN" 4 "ENTKOPPELT" 5 "ENTKOPPELT_ANFAHREN" 6 "SYNCHRONISIEREN" 7 "GESCHLOSSEN" 8 "OEFFNEN" /end COMPU_VTAB
/begin COMPU_VTAB CONV_TAB_E_STATUSIEP_M_S7_S3 "Conversion table" TAB_VERB 5 0 "AUS" 1 "SLEEP" 2 "LP1" 3 "LP2" 4 "LP3" /end COMPU_VTAB
/begin COMPU_VTAB CONV_TAB_E_STATUSK0_M_S7_S3 "Conversion table" TAB_VERB 6 0 "OFFEN" 1 "ANGELEGT" 2 "DRUCKSTELLUNG" 3 "SCHLUPFGEREGELT" 4 "GEREGELTGESCHL" 5 "GESCHLOSSEN" /end COMPU_VTAB
/begin COMPU_VTAB CONV_TAB_E_STATUSKSL_M_S7_S3 "Conversion table" TAB_VERB 7 0 "KEIN_KRAFTSCHLUSS" 1 "VORW_AUF_ABBAUEND" 2 "VORWAERTS" 3 "RUECKW_AUF_ABBAUEND" 4 "RUECKWAERTS" 5 "VORWAERTS_SCHLUPF" 6 "RUECKWAERTS_SCHLUPF" /end COMPU_VTAB
/begin COMPU_VTAB CONV_TAB_E_STATUSNAA_M_S7_S3 "Conversion table" TAB_VERB 2 0 "NICHT_AKTIV" 1 "AKTIV" /end COMPU_VTAB
/begin COMPU_VTAB CONV_TAB_E_STATUSPSY_M_S7_S3 "Conversion table" TAB_VERB 5 0 "AUS" 1 "NICHTDEFINIERT" 2 "LP1" 3 "LP2" 4 "LP3" /end COMPU_VTAB
/begin COMPU_VTAB CONV_TAB_E_STATUSRSE_M_S7_S3 "Conversion table" TAB_VERB 2 0 "KEIN_RADSCHLUPF" 1 "DURCHDREHEN_ERKANNT" /end COMPU_VTAB
/begin COMPU_VTAB CONV_TAB_E_STBZHAS_M_S7_S3 "Conversion table" TAB_VERB 16 0 "INIT_INAKTIV" 1 "ANGEKOPPELT" 2 "ENTKOPPELT" 3 "EFAHREN" 4 "STOP" 5 "LADEN" 6 "ENTK_VMEIN" 7 "EFAHREN_VMEIN" 8 "HYBRID" 9 "NICHTDEFINIERT_1" 10 "NICHTDEFINIERT_2" 11 "NICHTDEFINIERT_3" 12 "NICHTDEFINIERT_4" 13 "NICHTDEFINIERT_5" 14 "INIT_KL15" 15 "FEHLER" /end COMPU_VTAB
/begin COMPU_VTAB CONV_TAB_E_STNDATLLS_M_S7_S3 "Conversion table" TAB_VERB 5 0 "BASIS" 1 "ANHEBUNG" 2 "ANGEHOBEN" 3 "ABBAU" 4 "ANGEHOBEN_SPRUNG" /end COMPU_VTAB
/begin COMPU_VTAB CONV_TAB_E_ZIEP_M_S7_S3 "Conversion table" TAB_VERB 5 0 "AUS" 1 "SLEEP" 2 "LP1" 3 "LP2" 4 "LP3" /end COMPU_VTAB
/begin COMPU_VTAB CONV_TAB_E_ZK0_M_S7_S3 "Conversion table" TAB_VERB 6 0 "OEFFNENSW" 1 "BEFUELLEN" 2 "DRUCKSTELLUNG" 3 "SCHLUPFREGELUNG" 4 "GEREGELTGESCHL" 5 "GESCHLOSSEN" /end COMPU_VTAB
/begin COMPU_VTAB CONV_TAB_E_ZK0FSTIN_M_S7_S3 "Conversion table" TAB_VERB 4 0 "OFFEN" 1 "SCHLUPFGEREGELT" 2 "GEREGELTGESCHL" 3 "GESCHLOSSEN" /end COMPU_VTAB
/begin COMPU_VTAB CONV_TAB_E_ZNLLSOLL_M_S7_S3 "Conversion table" TAB_VERB 4 0 "KEINANF" 1 "ANF_ADAP" 2 "ANF_ALLG" 3 "ANF_ADAP_IEP" /end COMPU_VTAB
/begin COMPU_VTAB CONV_TAB_E_ZNMODUS_M_S7_S3 "Conversion table" TAB_VERB 5 0 "KEIN_AUFBAU" 1 "SCHNELL" 2 "ZUEGIG" 3 "KOMFORTABEL" 4 "UNTERDRUECKT" /end COMPU_VTAB
/begin FUNCTION SFSBo138_Leerlaufsimulation ""
 /begin DEF_CHARACTERISTIC KF_ZNOMINEMGANG_LLS_HAS_W KF_ZNOMINEMGANG_LLS_HAS_X KF_ZNOMINEMGANG_LLS_HAS_Y KL_VSFIAEZU_LLS_HAS_Y KL_VSFIAEZU_LLS_HAS_X BM_ZFKTAKTIV_LLS_HAS SWI_NEMFUEHRUNG_LLS_HAS NO_EMNMINEMINIT_LLS_HAS NO_SOLLEMHSTNMINEMINIT_LLS_HAS SWI_NMINEMNGEFINIT_LLS_HAS BM_NMINEMABMODUS1_LLS_HAS BM_NMINEMMODUS1_LLS_HAS BM_NMINEMMODUS2_LLS_HAS /end DEF_CHARACTERISTIC
 /begin LOC_MEASUREMENT n_mineminit_lls_has z_nmineminit_lls_has z_nminemngefinit_lls_has n_min_em_alae_lls_has n_min_em_beffzp_lls_has n_min_em_bz_lls_has n_min_em_cgetr_lls_has n_min_em_dat_lls_has n_min_em_diag_lls_has n_min_em_fkt_lls_has n_min_em_ge_lls_has n_min_em_iae_lls_has n_min_em_iaeada_lls_has n_min_em_iep_lls_has n_min_em_k0ada_lls_has n_min_em_kfl_lls_has n_min_em_kri_lls_has n_min_em_lls_has_ref n_min_em_lls_has_ziel n_min_em_manh_lls_has n_min_em_parksp_lls_has n_min_em_paus_lls_has n_min_em_poab_lls_has n_min_em_pvu_lls_has n_min_em_rang_lls_has n_min_em_sas_lls_has n_min_em_stada_lls_has n_min_em_stat_lls_has n_min_em_vgf_lls_has z_lls_fktnmax_has z_lls_fktrelevant_has z_nabmodus_lls_has z_naufmodus_lls_has z_nminemnull_frk_dihi z_nemmin_frk_dihi z_hybfkt_stg st_ziel_bz_has_stg st_ist_bz_has_stg i_istgang_egs status_schaltung_egs_in n_min_em_psys_lp3_has_sbe vg_f_sbe v_f_sbe z_pvu_has_sbe c_getriebe_egs_in istgang_egs_in m_wunsch_fpw_in n_ab_egs_in n_em_in n_soll_ll_vm_in n_vm_in p_bremse_fzg_in sollgang_egs_in status_iae_in status_k0_in pos_egs_in zielgang_egs_in m_mot_in status_k0_adap_in status_waschstr_in status_kraftfluss_egs_in z_n_min_em_parksp_has_in status_alaengs_adaoff_in z_nllsoll_iae_in status_nem_in phi_neigung_in v_f_in fpw_in drehrichtung_nab_in bremspedal_in status_autohold_in status_hillhold_in status_vf_in z_nllsoll_iep_in c_vm_in n_soll_em_hst_in status_getrbereit_in status_betriebsbereit_hst_in c_umgebung_in status_cumgebung_in /end LOC_MEASUREMENT
 /begin SUB_FUNCTION SFSBo171_vgf_lls_has SFSBo169_stada_lls_has SFSBo163_parksp_lls_has SFSBo161_kri_lls_has SFSBo159_k0ada_lls_has SFSBo158_iep_lls_has SFSBo157_iaeada_lls_has SFSBo152_dat_lls_has SFSBo144_Fuehrung_minimaler_EM_Drehzahl SFSBo149_beffzp_lls_has SFSBo162_manh_lls_has SFSBo164_paus_lls_has SFSBo167_rang_lls_has SFSBo141_Bestimmung_Einzelfunktion_mit_hoechster_Vorgabe SFSBo153_diag_lls_has SFSBo154_fkt_lls_has SFSBo150_bz_lls_has SFSBo166_pvu_lls_has SFSBo151_cgetr_lls_has SFSBo168_sas_lls_has SFSBo155_ge_lls_has SFSBo160_kfl_lls_has SFSBo165_poab_lls_has SFSBo142_Bestimmung_relevanten_Einzelfkt SFSBo148_alae_lls_has SFSBo156_iae_lls_has SFSBo143_Decoder_ui32 SFSBo196_Bitwise_AND_ui32 SFSBo197_Bitwise_AND_ui32_1 SFSBo198_Bitwise_AND_ui32_2 SFSBo170_stat_lls_has /end SUB_FUNCTION
/end FUNCTION
/begin FUNCTION SFSBo141_Bestimmung_Einzelfunktion_mit_hoechster_Vorgabe "" /begin LOC_MEASUREMENT z_lls_fktnmax_has /end LOC_MEASUREMENT /begin SUB_FUNCTION SFSBo172_Encoder_3 /end SUB_FUNCTION /end FUNCTION
/begin FUNCTION SFSBo142_Bestimmung_relevanten_Einzelfkt "" /begin DEF_CHARACTERISTIC SWI_NAUFERKNSOLLEM_LLS_HAS SWI_NEMFUEHRUNG_LLS_HAS /end DEF_CHARACTERISTIC /begin LOC_MEASUREMENT n_em_in n_soll_em_hst_in /end LOC_MEASUREMENT /end FUNCTION
/begin FUNCTION SFSBo143_Decoder_ui32 "" /begin DEF_CHARACTERISTIC BM_ZFKTAKTIV_LLS_HAS /end DEF_CHARACTERISTIC /end FUNCTION
/begin FUNCTION SFSBo144_Fuehrung_minimaler_EM_Drehzahl ""
 /begin DEF_CHARACTERISTIC KF_NGMINEMMIN3_LLS_HAS_W KF_NGMINEMMIN3_LLS_HAS_X KF_NGMINEMMIN3_LLS_HAS_Y KL_NGMINEMMAX1_LLS_HAS_Y KL_NGMINEMMAX1_LLS_HAS_X KL_NGMINEMMAX2_LLS_HAS_Y KL_NGMINEMMAX2_LLS_HAS_X KL_NGMINEMMAX3_LLS_HAS_Y KL_NGMINEMMAX3_LLS_HAS_X NG_MINEMMIN1_LLS_HAS FK_NMINEMAB1_1_LLS_HAS FK_NMINEMAB1_2_LLS_HAS FK_NMINEMAB3_1_LLS_HAS FK_NMINEMAB3_2_LLS_HAS FK_NMINEMAUF1_1_LLS_HAS FK_NMINEMAUF1_2_LLS_HAS FK_NMINEMAUF2_1_LLS_HAS FK_NMINEMAUF2_2_LLS_HAS FK_NMINEMAUF3_1_LLS_HAS FK_NMINEMAUF3_2_LLS_HAS /end DEF_CHARACTERISTIC
 /begin LOC_MEASUREMENT n_min_em_lls_has_ngef ng_minemmax_lls_has ng_minemmin_lls_has z_nmineminit_lls_has z_nminemngefinit_lls_has z_nabmodus_lls_has z_naufmodus_lls_has /end LOC_MEASUREMENT
 /begin SUB_FUNCTION Run_SFSBo185_CL_PT1 Run_SFSBo186_CL_PT1_1 /end SUB_FUNCTION
/end FUNCTION
/begin FUNCTION SFSBo148_alae_lls_has "" /begin DEF_CHARACTERISTIC N_MINEMALAE_LLS_HAS /end DEF_CHARACTERISTIC /begin LOC_MEASUREMENT status_alaengs_adaoff_in /end LOC_MEASUREMENT /end FUNCTION
/begin FUNCTION SFSBo149_beffzp_lls_has "" /begin DEF_CHARACTERISTIC N_MINEMBEFFZP_LLS_HAS T_NMINEMBEFFZP_LLS_HAS /end DEF_CHARACTERISTIC /begin LOC_MEASUREMENT t_nminem_beffzp_lls_has status_betriebsbereit_hst_in /end LOC_MEASUREMENT /end FUNCTION
/begin FUNCTION SFSBo15_Anlasserstartanforderung ""
 /begin LOC_MEASUREMENT z_ala_frk_dihi st_ziel_bz_has_stg st_ist_bz_has_stg i_istgang_egs status_schaltung_egs_in status_radschlupf_rse_has_sbe c_getriebe_egs_in istgang_egs_in m_wunsch_fpw_in n_ab_egs_in n_em_in n_soll_ll_vm_in p_bremse_fzg_in status_iae_in pos_egs_in zielgang_egs_in m_mot_in status_kraftfluss_egs_in v_f_in status_k0_adap_zaehler_in abstellpos_vm_in m_wunsch_fpw_hst_in /end LOC_MEASUREMENT
 /begin SUB_FUNCTION SFSBo19_Anlasserstart_Anforderung_Variante2 SFSBo18_Anlasserstart_Anforderung_Variante1 /end SUB_FUNCTION
/end FUNCTION
/begin FUNCTION SFSBo150_bz_lls_has ""
 /begin LOC_MEASUREMENT st_ziel_bz_has_stg st_ist_bz_has_stg n_min_em_psys_lp3_has_sbe /end LOC_MEASUREMENT
/end FUNCTION
/begin FUNCTION SFSBo151_cgetr_lls_has ""
 /begin DEF_CHARACTERISTIC CS_GETR1_CGETR_LLS_HAS CS_GETR2_CGETR_LLS_HAS CS_GETRKALT1_CGETR_LLS_HAS CS_GETRKALT2_CGETR_LLS_HAS SWI_ZUST_AKTIV_CGETR_LLS_HAS /end DEF_CHARACTERISTIC
 /begin LOC_MEASUREMENT st_ist_bz_has_stg n_min_em_psys_lp3_has_sbe c_getriebe_egs_in /end LOC_MEASUREMENT
/end FUNCTION
/begin FUNCTION SFSBo152_dat_lls_has ""
 /begin DEF_CHARACTERISTIC KL_KNMINEMANGEHOBENDAT_LLS_HAS_Y KL_KNMINEMANGEHOBENDAT_LLS_HAS_X KL_NMINEMANGEHOBENDAT_LLS_HAS_Y KL_NMINEMANGEHOBENDAT_LLS_HAS_X KL_NMINEMBASISDAT_LLS_HAS_Y KL_NMINEMBASISDAT_LLS_HAS_X KF_CINITDAT_LLS_HAS_W KF_CINITDAT_LLS_HAS_X KF_CINITDAT_LLS_HAS_Y KL_CGMAXVMAUSDAT_LLS_HAS_Y KL_CGMAXVMAUSDAT_LLS_HAS_X KL_CGMAXVMEINDAT_LLS_HAS_Y KL_CGMAXVMEINDAT_LLS_HAS_X CG_MINDAT_LLS_HAS CS_DAT_LLS_HAS NOS_EMNMINEMABBAUABBRDAT_LLS_HAS NOS_EMNMINEMABBAUDAT_LLS_HAS NOS_EMNMINEMANHDAT_LLS_HAS SWI_NMINEMANHDAT_LLS_HAS SWI_NMINEMANHSPRUNGDAT_LLS_HAS VS_F1DAT_LLS_HAS VS_F2DAT_LLS_HAS /end DEF_CHARACTERISTIC
 /begin LOC_MEASUREMENT c_dat_lls_has n_min_em_anh_max_dat_lls_has st_nmin_dat_lls_has st_ziel_bz_has_stg st_ist_bz_has_stg c_getriebe_egs_in n_ab_egs_in n_em_in status_nem_in v_f_in status_vf_in c_vm_in status_betriebsbereit_hst_in c_umgebung_in status_cumgebung_in /end LOC_MEASUREMENT
 /begin SUB_FUNCTION Run_SFSBo204_cLimiter_Gradient_ /end SUB_FUNCTION
/end FUNCTION
/begin FUNCTION SFSBo153_diag_lls_has "" /begin LOC_MEASUREMENT z_nemmin_frk_dihi n_min_em_psys_lp3_has_sbe /end LOC_MEASUREMENT /end FUNCTION
/begin FUNCTION SFSBo154_fkt_lls_has ""
 /begin DEF_CHARACTERISTIC TAB_NSEMMINFKT_LLS_HAS TAB_NSVMMAXFKT_LLS_HAS TAB_STATUSK0FKT_LLS_HAS /end DEF_CHARACTERISTIC
 /begin LOC_MEASUREMENT z_hybfkt_stg n_min_em_psys_lp3_has_sbe n_em_in n_soll_ll_vm_in n_vm_in status_k0_in /end LOC_MEASUREMENT
/end FUNCTION
/begin FUNCTION SFSBo155_ge_lls_has ""
 /begin LOC_MEASUREMENT n_min_em_psys_lp3_has_sbe pos_egs_in status_kraftfluss_egs_in /end LOC_MEASUREMENT
/end FUNCTION
/begin FUNCTION SFSBo156_iae_lls_has "" /begin DEF_CHARACTERISTIC N_MINEMIAE_LLS_HAS /end DEF_CHARACTERISTIC /begin LOC_MEASUREMENT z_nllsoll_iae_in /end LOC_MEASUREMENT /end FUNCTION
/begin FUNCTION SFSBo157_iaeada_lls_has ""
 /begin DEF_CHARACTERISTIC KL_NMINEMIAEADAPIEP_LLS_HAS_Y KL_NMINEMIAEADAPIEP_LLS_HAS_X KL_NMINEMIAEADAP_LLS_HAS_Y KL_NMINEMIAEADAP_LLS_HAS_X /end DEF_CHARACTERISTIC
 /begin LOC_MEASUREMENT c_getriebe_egs_in z_nllsoll_iae_in /end LOC_MEASUREMENT
/end FUNCTION
/begin FUNCTION SFSBo158_iep_lls_has ""
 /begin DEF_CHARACTERISTIC KL_NMINEM_PSYS_LP1_LLS_HAS_Y KL_NMINEM_PSYS_LP1_LLS_HAS_X SWI_NMINEMPSYSLP1IEP_LLS_HAS /end DEF_CHARACTERISTIC
 /begin LOC_MEASUREMENT n_min_em_psys_lp3_has_sbe c_getriebe_egs_in z_nllsoll_iep_in /end LOC_MEASUREMENT
/end FUNCTION
/begin FUNCTION SFSBo159_k0ada_lls_has ""
 /begin DEF_CHARACTERISTIC KL_NMINEMK0ADAP_LLS_HAS_Y KL_NMINEMK0ADAP_LLS_HAS_X STATUS_K0ADAP_LLS_HAS /end DEF_CHARACTERISTIC
 /begin LOC_MEASUREMENT c_getriebe_egs_in status_k0_adap_in /end LOC_MEASUREMENT
/end FUNCTION
/begin FUNCTION SFSBo160_kfl_lls_has "" /begin DEF_CHARACTERISTIC N_MINEMKFL_LLS_HAS VS_FKFL_LLS_HAS /end DEF_CHARACTERISTIC /begin LOC_MEASUREMENT v_f_sbe status_kraftfluss_egs_in /end LOC_MEASUREMENT /end FUNCTION
/begin FUNCTION SFSBo161_kri_lls_has ""
 /begin DEF_CHARACTERISTIC KF_NOSECIAEKRI_LLS_HAS_W KF_NOSECIAEKRI_LLS_HAS_X KF_NOSECIAEKRI_LLS_HAS_Y KL_NMINEMFZPKRI_LLS_HAS_Y KL_NMINEMFZPKRI_LLS_HAS_X KL_PSBREMSEKRI_LLS_HAS_Y KL_PSBREMSEKRI_LLS_HAS_X KL_PSBREMSERUECKKRI_LLS_HAS_Y KL_PSBREMSERUECKKRI_LLS_HAS_X KL_TVRUECKKRI_LLS_HAS_Y KL_TVRUECKKRI_LLS_HAS_X NOS_SECIAEGANG1AKTCRVKRI_LLS_HAS NOS_SECIAEGANG1DEAKTCRVKRI_LLS_HAS NOS_SECIAEGANG2AKTCRVKRI_LLS_HAS NOS_SECIAEGANG2DEAKTCRVKRI_LLS_HAS NOS_SECIAEGANGRAKTCRVKRI_LLS_HAS NOS_SECIAEGANGRDEAKTCRVKRI_LLS_HAS SWI_CRVKRI_LLS_HAS SWI_EFAHRENCRVKRI_LLS_HAS CS_GETR1CRVKRI_LLS_HAS CS_GETR2CRVKRI_LLS_HAS PHIS_NEIGUNG1CVRKRI_LLS_HAS PHIS_NEIGUNG2CVRKRI_LLS_HAS FPWS_MAXKRI_LLS_HAS NOG_SECIAEMINCRVKRI_LLS_HAS NO_SECIAEGANG1CRVKRI_LLS_HAS NO_SECIAEGANG2CRVKRI_LLS_HAS NO_SECIAEGANGRCRVKRI_LLS_HAS NO_SOLLLLVMKRI_LLS_HAS N_MINEMMAXCRVKRI_LLS_HAS N_MINEMMAXKRI_LLS_HAS SWI_AUTOHOLDKRI_LLS_HAS SWI_ZNLLSOLLIAEKRI_LLS_HAS VS_FKRI_LLS_HAS T_VRUECKAUTOHOLDKRI_LLS_HAS T_VRUECKHILLHOLDKRI_LLS_HAS /end DEF_CHARACTERISTIC
 /begin LOC_MEASUREMENT t_nminem_kri_lls_has n_sec_iae_ist_lls_has no_seciae_crv_kri_lls_has no_seciae_kri_lls_has z_crvkri_lls_has st_ziel_bz_has_stg st_ist_bz_has_stg i_istgang_egs c_getriebe_egs_in istgang_egs_in n_ab_egs_in n_soll_ll_vm_in p_bremse_fzg_in pos_egs_in status_kraftfluss_egs_in z_nllsoll_iae_in phi_neigung_in v_f_in fpw_in bremspedal_in status_autohold_in status_hillhold_in /end LOC_MEASUREMENT
 /begin SUB_FUNCTION Run_SFSBo209_cLimiter_Gradient_ Run_SFSBo210_cLimiter_Gradient_1 /end SUB_FUNCTION
/end FUNCTION
/begin FUNCTION SFSBo162_manh_lls_has ""
 /begin DEF_CHARACTERISTIC MS_MOTMANH_LLS_HAS MS_WUNSCHFPWMANH_LLS_HAS T_NMINEMMANH_LLS_HAS /end DEF_CHARACTERISTIC
 /begin LOC_MEASUREMENT t_nminem_manh_lls_has n_min_em_psys_lp3_has_sbe m_wunsch_fpw_in m_mot_in status_kraftfluss_egs_in /end LOC_MEASUREMENT
/end FUNCTION
/begin FUNCTION SFSBo163_parksp_lls_has "" /begin DEF_CHARACTERISTIC KL_NMINEMPARKSP_LLS_HAS_Y KL_NMINEMPARKSP_LLS_HAS_X /end DEF_CHARACTERISTIC /begin LOC_MEASUREMENT c_getriebe_egs_in z_n_min_em_parksp_has_in /end LOC_MEASUREMENT /end FUNCTION
/begin FUNCTION SFSBo164_paus_lls_has "" /begin DEF_CHARACTERISTIC T_NMINEMPAUS_LLS_HAS /end DEF_CHARACTERISTIC /begin LOC_MEASUREMENT t_nminem_paus_lls_has n_min_em_psys_lp3_has_sbe pos_egs_in /end LOC_MEASUREMENT /end FUNCTION
/begin FUNCTION SFSBo165_poab_lls_has "" /begin DEF_CHARACTERISTIC N_AB_POAB_LLS_HAS N_MINEMPOAB_LLS_HAS /end DEF_CHARACTERISTIC /begin LOC_MEASUREMENT n_ab_egs_in status_k0_in pos_egs_in drehrichtung_nab_in /end LOC_MEASUREMENT /end FUNCTION
/begin FUNCTION SFSBo166_pvu_lls_has ""
 /begin DEF_CHARACTERISTIC NO_MINEMEFAHRENPVU_LLS_HAS NO_MINEMVMSTARTENPVU_LLS_HAS N_MINEMEFAHRENPVU_LLS_HAS N_MINEMVMSTARTENPVU_LLS_HAS /end DEF_CHARACTERISTIC
 /begin LOC_MEASUREMENT st_ziel_bz_has_stg n_min_em_psys_lp3_has_sbe z_pvu_has_sbe /end LOC_MEASUREMENT
/end FUNCTION
/begin FUNCTION SFSBo167_rang_lls_has ""
 /begin DEF_CHARACTERISTIC T_NMINEMPOSNICHTRRANG_LLS_HAS T_NMINEMPOSRRANG_LLS_HAS VS_FMAXRANG_LLS_HAS /end DEF_CHARACTERISTIC
 /begin LOC_MEASUREMENT t_nminem_rang_lls_has st_ziel_bz_has_stg st_ist_bz_has_stg n_min_em_psys_lp3_has_sbe pos_egs_in v_f_in drehrichtung_nab_in /end LOC_MEASUREMENT
/end FUNCTION
/begin FUNCTION SFSBo168_sas_lls_has ""
 /begin DEF_CHARACTERISTIC SWI_ISTGANG1SAS_LLS_HAS SWI_ISTGANG2SAS_LLS_HAS SWI_SCHALTANFSAS_LLS_HAS /end DEF_CHARACTERISTIC
 /begin LOC_MEASUREMENT status_schaltung_egs_in n_min_em_psys_lp3_has_sbe istgang_egs_in sollgang_egs_in zielgang_egs_in status_getrbereit_in /end LOC_MEASUREMENT
/end FUNCTION
/begin FUNCTION SFSBo169_stada_lls_has ""
 /begin DEF_CHARACTERISTIC KL_NMINEMSTADA_LLS_HAS_Y KL_NMINEMSTADA_LLS_HAS_X STATUS_K0ADAP_LLS_HAS /end DEF_CHARACTERISTIC
 /begin LOC_MEASUREMENT c_getriebe_egs_in status_k0_adap_in /end LOC_MEASUREMENT
/end FUNCTION
/begin FUNCTION SFSBo170_stat_lls_has "" /begin DEF_CHARACTERISTIC N_MINEMSTAT_LLS_HAS /end DEF_CHARACTERISTIC /end FUNCTION
/begin FUNCTION SFSBo171_vgf_lls_has ""
 /begin DEF_CHARACTERISTIC KL_NMINEMVGF_LLS_HAS_Y KL_NMINEMVGF_LLS_HAS_X T_VNMINEMVGF_LLS_HAS VGS_FBRE1VGF_LLS_HAS VGS_FBRE2VGF_LLS_HAS VS_FBREVGF_LLS_HAS /end DEF_CHARACTERISTIC
 /begin LOC_MEASUREMENT t_nminem_vgf_lls_has vg_f_sbe v_f_sbe n_soll_ll_vm_in /end LOC_MEASUREMENT
/end FUNCTION
/begin FUNCTION SFSBo172_Encoder_3 "" /begin LOC_MEASUREMENT z_lls_fktnmax_has /end LOC_MEASUREMENT /begin SUB_FUNCTION SFSBo174_Encoder_ui32 /end SUB_FUNCTION /end FUNCTION
/begin FUNCTION SFSBo174_Encoder_ui32 "" /begin LOC_MEASUREMENT z_lls_fktnmax_has /end LOC_MEASUREMENT /end FUNCTION
/begin FUNCTION SFSBo18_Anlasserstart_Anforderung_Variante1 ""
 /begin LOC_MEASUREMENT st_ist_bz_has_stg i_istgang_egs c_getriebe_egs_in istgang_egs_in m_wunsch_fpw_in n_ab_egs_in n_em_in p_bremse_fzg_in status_iae_in zielgang_egs_in m_mot_in status_kraftfluss_egs_in abstellpos_vm_in m_wunsch_fpw_hst_in /end LOC_MEASUREMENT
 /begin SUB_FUNCTION SFSBo22_Bed_z_mmot_ala_has /end SUB_FUNCTION
/end FUNCTION
/begin FUNCTION SFSBo19_Anlasserstart_Anforderung_Variante2 "" /begin DEF_CHARACTERISTIC BM_ZFKTAKTIV_ALA_HAS /end DEF_CHARACTERISTIC
 /begin LOC_MEASUREMENT z_ala_fktaktiv_has z_ala_frk_dihi st_ziel_bz_has_stg st_ist_bz_has_stg status_schaltung_egs_in status_radschlupf_rse_has_sbe c_getriebe_egs_in istgang_egs_in n_em_in n_soll_ll_vm_in status_iae_in pos_egs_in m_mot_in status_kraftfluss_egs_in v_f_in status_k0_adap_zaehler_in /end LOC_MEASUREMENT
 /begin SUB_FUNCTION SFSBo34_IAEENTK SFSBo30_Encoder_ui16 SFSBo28_DIAG SFSBo26_BZ SFSBo37_SAS SFSBo36_RSE SFSBo27_CGETR SFSBo33_IAE SFSBo32_GE SFSBo35_K0ADA SFSBo29_Decoder_ui16 /end SUB_FUNCTION
/end FUNCTION
/begin FUNCTION SFSBo196_Bitwise_AND_ui32 "" /begin DEF_CHARACTERISTIC BM_NMINEMABMODUS1_LLS_HAS /end DEF_CHARACTERISTIC /end FUNCTION
/begin FUNCTION SFSBo197_Bitwise_AND_ui32_1 "" /begin DEF_CHARACTERISTIC BM_NMINEMMODUS1_LLS_HAS /end DEF_CHARACTERISTIC /end FUNCTION
/begin FUNCTION SFSBo198_Bitwise_AND_ui32_2 "" /begin DEF_CHARACTERISTIC BM_NMINEMMODUS2_LLS_HAS /end DEF_CHARACTERISTIC /end FUNCTION
/begin FUNCTION SFSBo2_SBEo ""
 /begin LOC_MEASUREMENT z_nvmsollbegr_frk_dihi z_statuspsysmps_frk_dihi z_nminemnull_frk_dihi z_emfehler_frk_dihi z_ablaufreinit_frk_dihi z_k0syncmk0erh_frk_dihi z_fuwdeakt_frk_dihi z_nemmin_frk_dihi z_vmstopverbot_frk_dihi z_vmstartverbot_frk_dihi z_zust_halten_frk_dihi z_zust_init_frk_dihi z_deaktiv_abo_frk_dihi z_vmstartanf_frk_dihi z_svh_frk_dihi z_iepein_frk_dihi z_nsollvmnull_frk_dihi z_ala_frk_dihi z_schaltprioverh_frk_dihi z_nsollvmanh_frk_dihi z_gebruefahrenaus_frk_dihi z_hybfkt_stg st_ziel_bz_has_stg st_ist_bz_has_stg st_ist_hcomd_has_stg z_ablauf_has_stg z_ablaufvariante_has_stg m_k0_mod_has_fkt m_max_em_has_fkt m_max_iae_has_fkt m_min_em_has_fkt m_soll_em_has_fkt m_soll_k0_has_fkt m_soll_res_em_has_fkt mg_soll_k0_has_fkt n_soll_em_has_fkt n_soll_vm_has_fkt nd_min_saf_has_fkt nd_soll_iae_fkt st_ablauf_fkt status_ablauf_has_fkt z_ablauf_svh_reset_has_fkt z_ablaufvariante_kalt_zus z_emaktiv_fuw_zus_fkt z_fehler15_eh_fkt z_k0_befuellopt_has_fkt z_k0_has_fkt z_m_max_iae_has_fkt z_m_soll_em_has_fkt z_n_soll_em_has_fkt z_n_soll_vm_has_fkt z_p_hys_k0_has_fkt z_ponr_fkt z_respschlepp_sas_fkt z_saf_has_fkt z_sbe_has_fkt z_zuendfreigabe_vm_fkt z_zuendfreigabe_vm_has_fkt i_istgang_egs i_zielgang_egs m_wunsch_fpw_hst_fil mg_wunsch_fpw_in mg_wunsch_fpw_hst_in n_sec_iae nd_k0_in ndg_k0_in ng_vm_in status_schaltung_egs_in n_min_em_psys_lp3_has_sbe status_psys_has_sbe vg_f_sbe v_f_sbe status_sync_schaltung_sbe z_pvu_has_sbe z_freigabe_pvu_has_sbe t_betrieb_pvu_has_sbe mg_mot_in status_radschlupf_rse_has_sbe status_schaltart_svh_has_sbe z_msa_has_sbe z_modus_em_hst_in c_getriebe_egs_in istgang_egs_in m_em_in m_iae_in m_k0_in m_max_dyn_em_in m_soll_em_hst_in m_soll_vm_hst_in m_vm_in m_vm_start_in m_wunsch_fpw_in n_ab_egs_in n_em_in n_soll_ll_vm_in n_t_egs_in n_vm_in osmode_next_in p_bremse_fzg_in sollgang_egs_in status_fehler_iep_in status_iae_in status_iep_in status_k0_in pos_egs_in z_ablauf_has_hst_in z_ablaufvariante_has_hst_in zielgang_egs_in z_k0_fst_in m_mot_in status_iae_adap_in z_diag_ersfkt_has_in z_diag_ersfkt_hi_has_in z_diag_notgang_has_in status_k0_adap_in status_waschstr_in status_kraftfluss_egs_in z_n_min_em_parksp_has_in n_mot_soll_iae_in status_alaengs_adaoff_in gangwechsel_egs_in z_nllsoll_iae_in status_nem_in status_nvm_in kolbenpos_k0_in z_kps_stada_in t_betrieb_pvu_has_ee_in status_ll_vm_in z_msa_fst_in m_min_dyn_em_in phi_neigung_in v_f_in drehrichtung_nem_in fpw_in drehrichtung_nab_in schalt_mode_egs_in m_ziel_k0_hst_in status_kraftfluss_lev2_egs_in i_gang_lev2_egs_in status_c_k0_in bremspedal_in status_autohold_in status_hillhold_in status_vf_in v_f_ref_in status_vfref_in z_diag_ersfkt_hi_96_has_in status_k0_adap_zaehler_in status_k0_befuellung_in z_oea_hst_in z_iep_in z_nllsoll_iep_in c_vm_in n_soll_em_hst_in abstellpos_vm_in abstellpos_vm_status_in status_nreg_em_hst_in m_min_vm_in m_soll_vm_l_hst_in z_msa_stada_in m_wunsch_fpw_hst_in status_getrbereit_in status_betriebsbereit_hst_in status_sa_vm_in z_ba_has_vm_hst_in z_ba_has_k0_hst_in status_abs_in status_asr_in modus_e_fahren_hst_in status_kl15_in status_posvueb_in soc_in status_soc_in c_umgebung_in status_cumgebung_in /end LOC_MEASUREMENT
 /begin SUB_FUNCTION SFSBo13_SBEo_SVH SFSBo12_SBEo_MSA SFSBo11_SBEo_MOM SFSBo10_SBEo_LLS SFSBo9_SBEo_K0 SFSBo8_SBEo_IEP SFSBo7_SBEo_IAE SFSBo6_SBEo_ALLG SFSBo5_SBEo_ALA /end SUB_FUNCTION
/end FUNCTION
/begin FUNCTION SFSBo22_Bed_z_mmot_ala_has "" /begin LOC_MEASUREMENT istgang_egs_in m_wunsch_fpw_in m_mot_in /end LOC_MEASUREMENT /end FUNCTION
/begin FUNCTION SFSBo251_Beruecksichtigung_VM_Abstellposition ""
 /begin LOC_MEASUREMENT st_ziel_bz_has_stg st_ist_bz_has_stg m_soll_res_em_has_fkt status_ablauf_has_fkt c_vm_in abstellpos_vm_in abstellpos_vm_status_in /end LOC_MEASUREMENT
/end FUNCTION
/begin FUNCTION SFSBo252_Beruecksichtigung_VM_Startmoments ""
 /begin DEF_CHARACTERISTIC KF_MEMRESVMSTART_HAS_W KF_MEMRESVMSTART_HAS_X KF_MEMRESVMSTART_HAS_Y SWI_MEMRESVMSTART_BAS_HAS /end DEF_CHARACTERISTIC
 /begin LOC_MEASUREMENT st_ist_bz_has_stg z_ablaufvariante_has_stg status_ablauf_has_fkt m_vm_start_in status_iae_in /end LOC_MEASUREMENT
 /begin SUB_FUNCTION SFSBo262_If_Action_Subsystem /end SUB_FUNCTION
/end FUNCTION
/begin FUNCTION SFSBo26_BZ "" /begin LOC_MEASUREMENT st_ziel_bz_has_stg st_ist_bz_has_stg /end LOC_MEASUREMENT /end FUNCTION
/begin FUNCTION SFSBo262_If_Action_Subsystem "" /begin DEF_CHARACTERISTIC STATUS_ABLAUFMEMRESRUECK_HAS TAB_MGEMRESRUECK_HAS /end DEF_CHARACTERISTIC /begin LOC_MEASUREMENT status_ablauf_has_fkt status_iae_in /end LOC_MEASUREMENT /end FUNCTION
/begin FUNCTION SFSBo27_CGETR "" /begin DEF_CHARACTERISTIC CS_GETR1_CGETR_ALA_HAS CS_GETR2_CGETR_ALA_HAS /end DEF_CHARACTERISTIC /begin LOC_MEASUREMENT c_getriebe_egs_in /end LOC_MEASUREMENT /end FUNCTION
/begin FUNCTION SFSBo273_MSA_Beeinflussung ""
 /begin DEF_CHARACTERISTIC KL_CSGETRAUS_CGETR_MSA_HAS_Y KL_CSGETRAUS_CGETR_MSA_HAS_X BM_ZABSMSA_MSA_HAS T_VBRE_ABS_MSA_HAS VGS_FBRE_ABS_MSA_HAS VS_FBRE_ABS_MSA_HAS BM_ZCGETRMSA_MSA_HAS CS_GETR_CGETR_MSA_HAS BM_ZDIAGMSASTARTVERBOT_MSA_HAS BM_ZDIAGMSA_MSA_HAS BM_ZFSTMSA_MSA_HAS BM_ZIAEMSAKRI_MSA_HAS BM_ZIAEMSASYN_MSA_HAS VGS_FKRI_IAE_MSA_HAS VS_FKRI_IAE_MSA_HAS BM_ZNDK0MSA_MSA_HAS NDS_K01_NDK0_MSA_HAS NDS_K02_NDK0_MSA_HAS NS_EM_NDK0_MSA_HAS NS_VM1_NDK0_MSA_HAS NS_VM2_NDK0_MSA_HAS T_VNEMBED_NDK0_MSA_HAS NDS_K0_GE_NDK0_MSA_HAS BM_ZSASMSAGE_MSA_HAS MS_WUNSCHFPWTVSRSSAS_MSA_HAS SWI_TMAXSASAKTIV_MSA_HAS T_VRUECKGELSAS_MSA_HAS BM_ZVGFMSA_MSA_HAS VGS_F1_VGF_MSA_HAS VGS_F2_VGF_MSA_HAS VS_FMAX_VGF_MSA_HAS VS_FMIN_VGF_MSA_HAS BM_ZBERGMSA_MSA_HAS PHIS_NEIGUNGD1_BERG_MSA_HAS PHIS_NEIGUNGD2_BERG_MSA_HAS PHIS_NEIGUNGR1_BERG_MSA_HAS PHIS_NEIGUNGR2_BERG_MSA_HAS T_VAUSD_BERG_MSA_HAS T_VAUSR_BERG_MSA_HAS VS_FD1_BERG_MSA_HAS VS_FD2_BERG_MSA_HAS VS_FR1_BERG_MSA_HAS VS_FR2_BERG_MSA_HAS BM_ZKFLMSA_MSA_HAS VS_F1_KFL_MSA_HAS VS_F2_KFL_MSA_HAS BM_ZSTADAMSA_MSA_HAS TAB_BMZFKTMSA_MSA_HAS TAB_STKRAFTFLUSS_NDK0_MSA_HAS TAB_BMZSASMSAHS_MSA_HAS TAB_BMZSASMSARS_MSA_HAS TAB_TMAXSRSSAS_MSA_HAS TAB_TVRUECKSRSSAS_MSA_HAS TAB_BMZMSAAKTIV_MSA_HAS /end DEF_CHARACTERISTIC
 /begin LOC_MEASUREMENT t_abs_msa_has c_getriebesysstart_msa_has t_nembed_ndk0_msa_has z_ge_ndk0_msa_has z_nembed_ndk0_msa_has t_maxsas_msa_has t_vruecksas_msa_has z_sas_msa_rshs_has t_vrueckgesas_msa_has z_sas_msa_ge_has z_abs_msa_has t_berg_msa_has z_berg_msa_has z_cgetr_msa_has z_diag_msa_has z_fkt_msa_has z_fst_msa_has z_iae_msa_has z_kfl_msa_has z_msa_aktiv_has z_msa_fktaktiv_has z_ndk0_msa_has z_sas_msa_has z_stada_msa_has z_vgf_msa_has z_vmstopverbot_frk_dihi z_vmstartverbot_frk_dihi z_vmstartanf_frk_dihi z_hybfkt_stg st_ziel_bz_has_stg st_ist_bz_has_stg i_istgang_egs nd_k0_in status_schaltung_egs_in vg_f_sbe v_f_sbe z_msa_has_sbe c_getriebe_egs_in n_ab_egs_in n_em_in n_vm_in status_iae_in status_k0_in pos_egs_in zielgang_egs_in status_kraftfluss_egs_in z_msa_fst_in phi_neigung_in v_f_in z_msa_stada_in m_wunsch_fpw_hst_in status_betriebsbereit_hst_in /end LOC_MEASUREMENT
 /begin SUB_FUNCTION SFSBo367_Bitwise_AND_ui8_ SFSBo370_Bitwise_AND_ui8_10 SFSBo381_Bitwise_OR_ui8_ SFSBo395_Bitwise_AND_ui8_10 Run_SFSBo371_abs_fl32 SFSBo277_Anzeigegroe_e_AVH_und_EAF SFSBo352_Bitwise_AND_ui8_ /end SUB_FUNCTION
/end FUNCTION
/begin FUNCTION SFSBo277_Anzeigegroe_e_AVH_und_EAF "" /begin LOC_MEASUREMENT z_msa_has_sbe /end LOC_MEASUREMENT /begin SUB_FUNCTION SFSBo344_Bitwise_AND_ui8_4 SFSBo348_Bitwise_AND_ui8_8 /end SUB_FUNCTION /end FUNCTION
/begin FUNCTION SFSBo28_DIAG "" /begin LOC_MEASUREMENT z_ala_frk_dihi /end LOC_MEASUREMENT /end FUNCTION
/begin FUNCTION SFSBo29_Decoder_ui16 "" /begin DEF_CHARACTERISTIC BM_ZFKTAKTIV_ALA_HAS /end DEF_CHARACTERISTIC /end FUNCTION
/begin FUNCTION SFSBo30_Encoder_ui16 "" /begin LOC_MEASUREMENT z_ala_fktaktiv_has /end LOC_MEASUREMENT /end FUNCTION
/begin FUNCTION SFSBo32_GE "" /begin DEF_CHARACTERISTIC VS_F_GE_ALA_HAS /end DEF_CHARACTERISTIC /begin LOC_MEASUREMENT pos_egs_in status_kraftfluss_egs_in v_f_in /end LOC_MEASUREMENT /end FUNCTION
/begin FUNCTION SFSBo33_IAE "" /begin DEF_CHARACTERISTIC TAB_STATUSIAE_IAE_ALA_HAS /end DEF_CHARACTERISTIC /begin LOC_MEASUREMENT status_iae_in /end LOC_MEASUREMENT /end FUNCTION
/begin FUNCTION SFSBo34_IAEENTK ""
 /begin DEF_CHARACTERISTIC KL_MSMOTMAXIAEENTK_ALA_HAS_Y KL_MSMOTMAXIAEENTK_ALA_HAS_X KL_MSMOTMINIAEENTK_ALA_HAS_Y KL_MSMOTMINIAEENTK_ALA_HAS_X KL_NOSOLLLVMIAEENTK_ALA_HAS_Y KL_NOSOLLLVMIAEENTK_ALA_HAS_X N_SOLLLVMMINIAEENTK_ALA_HAS /end DEF_CHARACTERISTIC
 /begin LOC_MEASUREMENT istgang_egs_in n_em_in n_soll_ll_vm_in status_iae_in m_mot_in status_kraftfluss_egs_in /end LOC_MEASUREMENT
/end FUNCTION
/begin FUNCTION SFSBo344_Bitwise_AND_ui8_4 "" /begin LOC_MEASUREMENT z_msa_has_sbe /end LOC_MEASUREMENT /end FUNCTION
/begin FUNCTION SFSBo348_Bitwise_AND_ui8_8 "" /begin LOC_MEASUREMENT z_msa_has_sbe /end LOC_MEASUREMENT /end FUNCTION
/begin FUNCTION SFSBo35_K0ADA "" /begin DEF_CHARACTERISTIC STATUS_ZAEHLERK0ADA_ALA_HAS /end DEF_CHARACTERISTIC /begin LOC_MEASUREMENT status_k0_adap_zaehler_in /end LOC_MEASUREMENT /end FUNCTION
/begin FUNCTION SFSBo352_Bitwise_AND_ui8_ "" /begin LOC_MEASUREMENT z_msa_has_sbe /end LOC_MEASUREMENT /end FUNCTION
/begin FUNCTION SFSBo36_RSE "" /begin LOC_MEASUREMENT status_radschlupf_rse_has_sbe /end LOC_MEASUREMENT /end FUNCTION
/begin FUNCTION SFSBo367_Bitwise_AND_ui8_ "" /begin DEF_CHARACTERISTIC BM_ZDIAGMSA_MSA_HAS /end DEF_CHARACTERISTIC /begin LOC_MEASUREMENT z_diag_msa_has /end LOC_MEASUREMENT /end FUNCTION
/begin FUNCTION SFSBo37_SAS "" /begin LOC_MEASUREMENT status_schaltung_egs_in /end LOC_MEASUREMENT /end FUNCTION
/begin FUNCTION SFSBo370_Bitwise_AND_ui8_10 "" /begin DEF_CHARACTERISTIC BM_ZFSTMSA_MSA_HAS /end DEF_CHARACTERISTIC /begin LOC_MEASUREMENT z_fst_msa_has z_msa_fst_in /end LOC_MEASUREMENT /end FUNCTION
/begin FUNCTION SFSBo381_Bitwise_OR_ui8_ "" /begin LOC_MEASUREMENT z_sas_msa_has /end LOC_MEASUREMENT /end FUNCTION
/begin FUNCTION SFSBo39_Analyse_MvG_VM_Start "" /begin DEF_CHARACTERISTIC SWI_ANALYSE_AKTIV_HAS /end DEF_CHARACTERISTIC
 /begin LOC_MEASUREMENT z_analyse_aktiv_has_sbe z_hybfkt_stg z_ablaufvariante_has_stg /end LOC_MEASUREMENT
 /begin SUB_FUNCTION SFSBo48_Analyse_MvG_VM_Start_aktiv /end SUB_FUNCTION
/end FUNCTION
/begin FUNCTION SFSBo395_Bitwise_AND_ui8_10 "" /begin DEF_CHARACTERISTIC BM_ZSTADAMSA_MSA_HAS /end DEF_CHARACTERISTIC /begin LOC_MEASUREMENT z_stada_msa_has z_msa_stada_in /end LOC_MEASUREMENT /end FUNCTION
/begin FUNCTION SFSBo40_BeeinflussungKupplungsBefuellreihenfolge ""
 /begin DEF_CHARACTERISTIC KL_ABLVARZSASAKTIV_BBR_HAS_Y KL_ABLVARZSASAKTIV_BBR_HAS_X SWI_BBR_AUS_BZ2_HAS CS_GETRIEBE_BBR_HAS STATUS_K0_BBR_HAS SWI_BBRFUWAKTIV_HAS /end DEF_CHARACTERISTIC
 /begin LOC_MEASUREMENT z_k0ansteuerung_bbr z_sas_sysstart_bbr z_sas_slst_bbr t_zsasslstmax_bbr z_hybfkt_stg st_ziel_bz_has_stg st_ist_bz_has_stg z_ablaufvariante_has_stg c_getriebe_egs_in status_k0_in status_getrbereit_in /end LOC_MEASUREMENT
 /begin SUB_FUNCTION SFSBo58_Timers_nach_Erkennen_Betriebsbereitschaft SFSBo55_Beeinflussung_bei_erkannter_EM_Fehlfunktion SFSBo70_Timer_t_zsasslstmax_bbr /end SUB_FUNCTION
/end FUNCTION
/begin FUNCTION SFSBo408_Bitwise_AND_ui8_ "" /begin LOC_MEASUREMENT z_ablauf_svh_reset_has_fkt status_schaltart_svh_has_sbe /end LOC_MEASUREMENT /end FUNCTION
/begin FUNCTION SFSBo409_Bitwise_AND_ui8_1 "" /begin LOC_MEASUREMENT status_schaltart_svh_has_sbe /end LOC_MEASUREMENT /end FUNCTION
/begin FUNCTION SFSBo41_Bestimmung_K0_Moments_zur_Motormomentbegrenzung ""
 /begin DEF_CHARACTERISTIC KF_MK0MBERZUSBASIS_HAS_W KF_MK0MBERZUSBASIS_HAS_X KF_MK0MBERZUSBASIS_HAS_Y FK_MK0MBERZUS_HAS MG_K0MBERZUSNEG_HAS MG_K0MBERZUSPOS_HAS M_K0MBERMAX_HAS ST_ABLAUFMK0MBERZUS_HAS SWI_MK0REF_MK0MBER_HAS /end DEF_CHARACTERISTIC
 /begin LOC_MEASUREMENT m_k0_mber_zus_basis m_k0_mber_zus_gbegr z_hybfkt_stg m_k0_mod_has_fkt m_soll_k0_has_fkt st_ablauf_fkt status_ablauf_has_fkt nd_k0_in m_k0_in status_k0_in /end LOC_MEASUREMENT
 /begin SUB_FUNCTION Run_SFSBo74_CL_PT1_m_k0_mber_has_sbe Run_SFSBo75_cLimiter_Gradient_m_k0_mber_zus_gbegr /end SUB_FUNCTION
/end FUNCTION
/begin FUNCTION SFSBo42_Gefuehrter_Getriebeschutz ""
 /begin DEF_CHARACTERISTIC KF_MMOTMAX_HAS_W KF_MMOTMAX_HAS_X KF_MMOTMAX_HAS_Y KF_PMAX_FZP_HAS_W KF_PMAX_FZP_HAS_X KF_PMAX_FZP_HAS_Y M_MOTMAX1_K0SCHUTZ_HAS M_MOTMAX2_K0SCHUTZ_HAS NDS_K0MIN1_K0SCHUTZ_HAS NDS_K0MIN2_K0SCHUTZ_HAS SWI_MMOTMAX_K0SCHUTZ_HAS M_MOTMAXNEMFEHLER_MBEGRFUW_HAS M_MOTMAXNEMOK_MBEGRFUW_HAS TAB_PMAX_IEP_HAS /end DEF_CHARACTERISTIC
 /begin LOC_MEASUREMENT m_motmax_k0schutz_has m_motmax_kupschutz_has m_motmax_mbegrfuw_has st_ablauf_fkt z_n_soll_vm_has_fkt nd_k0_in c_getriebe_egs_in istgang_egs_in n_em_in status_iep_in status_nem_in /end LOC_MEASUREMENT
/end FUNCTION
/begin FUNCTION SFSBo44_Mod_Pumpendruckstatus_MPS "" /begin DEF_CHARACTERISTIC SWI_MPSFUWAKTIV_HAS /end DEF_CHARACTERISTIC /begin LOC_MEASUREMENT z_statuspsysmps_frk_dihi status_psys_has_sbe status_iep_in /end LOC_MEASUREMENT /end FUNCTION
/begin FUNCTION SFSBo45_Status_EFahren_out ""
 /begin DEF_CHARACTERISTIC NS_EM_STATUSEFAHRENMOD2_HAS NS_EM_STATUSEFAHRENMOD3_HAS TAB_STATUSEFAHREN_OUT_HAS TAB_ZSTATUSEFAHREN_OUT_MOD_HAS /end DEF_CHARACTERISTIC
 /begin LOC_MEASUREMENT status_efahren_out_ist status_efahren_out_ziel z_statusefahren_out_modus z_hybfkt_stg st_ziel_bz_has_stg st_ist_bz_has_stg n_em_in status_k0_in /end LOC_MEASUREMENT
/end FUNCTION
/begin FUNCTION SFSBo48_Analyse_MvG_VM_Start_aktiv ""
 /begin DEF_CHARACTERISTIC KF_ANALYSEABLVAR_HAS_W KF_ANALYSEABLVAR_HAS_X KF_ANALYSEABLVAR_HAS_Y /end DEF_CHARACTERISTIC
 /begin LOC_MEASUREMENT z_hybfkt_stg z_ablaufvariante_has_stg /end LOC_MEASUREMENT
/end FUNCTION
/begin FUNCTION SFSBo5_SBEo_ALA ""
 /begin LOC_MEASUREMENT z_nvmsollbegr_frk_dihi z_statuspsysmps_frk_dihi z_nminemnull_frk_dihi z_emfehler_frk_dihi z_ablaufreinit_frk_dihi z_k0syncmk0erh_frk_dihi z_fuwdeakt_frk_dihi z_nemmin_frk_dihi z_vmstopverbot_frk_dihi z_vmstartverbot_frk_dihi z_zust_halten_frk_dihi z_zust_init_frk_dihi z_deaktiv_abo_frk_dihi z_vmstartanf_frk_dihi z_svh_frk_dihi z_iepein_frk_dihi z_nsollvmnull_frk_dihi z_ala_frk_dihi z_schaltprioverh_frk_dihi z_nsollvmanh_frk_dihi z_gebruefahrenaus_frk_dihi z_hybfkt_stg st_ziel_bz_has_stg st_ist_bz_has_stg st_ist_hcomd_has_stg z_ablauf_has_stg z_ablaufvariante_has_stg i_istgang_egs i_zielgang_egs m_wunsch_fpw_hst_fil mg_wunsch_fpw_in mg_wunsch_fpw_hst_in n_sec_iae nd_k0_in ndg_k0_in ng_vm_in status_schaltung_egs_in n_min_em_psys_lp3_has_sbe status_psys_has_sbe vg_f_sbe v_f_sbe status_sync_schaltung_sbe z_pvu_has_sbe z_freigabe_pvu_has_sbe t_betrieb_pvu_has_sbe mg_mot_in status_radschlupf_rse_has_sbe status_schaltart_svh_has_sbe z_modus_em_hst_in c_getriebe_egs_in istgang_egs_in m_em_in m_iae_in m_k0_in m_max_dyn_em_in m_soll_em_hst_in m_soll_vm_hst_in m_vm_in m_vm_start_in m_wunsch_fpw_in n_ab_egs_in n_em_in n_soll_ll_vm_in n_t_egs_in n_vm_in osmode_next_in p_bremse_fzg_in sollgang_egs_in status_fehler_iep_in status_iae_in status_iep_in status_k0_in pos_egs_in z_ablauf_has_hst_in z_ablaufvariante_has_hst_in zielgang_egs_in z_k0_fst_in m_mot_in status_iae_adap_in z_diag_ersfkt_has_in z_diag_ersfkt_hi_has_in z_diag_notgang_has_in status_k0_adap_in status_waschstr_in status_kraftfluss_egs_in z_n_min_em_parksp_has_in n_mot_soll_iae_in status_alaengs_adaoff_in gangwechsel_egs_in z_nllsoll_iae_in status_nem_in status_nvm_in kolbenpos_k0_in z_kps_stada_in t_betrieb_pvu_has_ee_in status_ll_vm_in z_msa_fst_in m_min_dyn_em_in phi_neigung_in v_f_in drehrichtung_nem_in fpw_in drehrichtung_nab_in schalt_mode_egs_in m_ziel_k0_hst_in status_kraftfluss_lev2_egs_in i_gang_lev2_egs_in status_c_k0_in bremspedal_in status_autohold_in status_hillhold_in status_vf_in v_f_ref_in status_vfref_in z_diag_ersfkt_hi_96_has_in status_k0_adap_zaehler_in status_k0_befuellung_in z_oea_hst_in z_iep_in z_nllsoll_iep_in c_vm_in n_soll_em_hst_in abstellpos_vm_in abstellpos_vm_status_in status_nreg_em_hst_in m_min_vm_in m_soll_vm_l_hst_in z_msa_stada_in m_wunsch_fpw_hst_in status_getrbereit_in /end LOC_MEASUREMENT
 /begin SUB_FUNCTION SFSBo15_Anlasserstartanforderung /end SUB_FUNCTION
/end FUNCTION
/begin FUNCTION SFSBo55_Beeinflussung_bei_erkannter_EM_Fehlfunktion "" /begin DEF_CHARACTERISTIC SWI_BBRFUWGETRBEREIT_HAS /end DEF_CHARACTERISTIC /begin LOC_MEASUREMENT z_sas_fuw_bbr t_zsasfuwmax_bbr status_getrbereit_in /end LOC_MEASUREMENT /begin SUB_FUNCTION SFSBo65_Bitwise_AND_ui8 SFSBo66_Timer_t_zsasfuwmax_bbr /end SUB_FUNCTION /end FUNCTION
/begin FUNCTION SFSBo58_Timers_nach_Erkennen_Betriebsbereitschaft ""
 /begin DEF_CHARACTERISTIC KL_TZSASHASMAX_BBR_HAS_Y KL_TZSASHASMAX_BBR_HAS_X T_ZSASHASAKTIV_BBR_HAS /end DEF_CHARACTERISTIC
 /begin LOC_MEASUREMENT t_zsashasaktiv_bbr t_zsashasmax_bbr c_getriebe_egs_in /end LOC_MEASUREMENT
/end FUNCTION
/begin FUNCTION SFSBo6_SBEo_ALLG ""
 /begin LOC_MEASUREMENT z_nvmsollbegr_frk_dihi z_statuspsysmps_frk_dihi z_nminemnull_frk_dihi z_emfehler_frk_dihi z_ablaufreinit_frk_dihi z_k0syncmk0erh_frk_dihi z_fuwdeakt_frk_dihi z_nemmin_frk_dihi z_vmstopverbot_frk_dihi z_vmstartverbot_frk_dihi z_zust_halten_frk_dihi z_zust_init_frk_dihi z_deaktiv_abo_frk_dihi z_vmstartanf_frk_dihi z_svh_frk_dihi z_iepein_frk_dihi z_nsollvmnull_frk_dihi z_ala_frk_dihi z_schaltprioverh_frk_dihi z_nsollvmanh_frk_dihi z_gebruefahrenaus_frk_dihi z_hybfkt_stg st_ziel_bz_has_stg st_ist_bz_has_stg st_ist_hcomd_has_stg z_ablauf_has_stg z_ablaufvariante_has_stg m_k0_mod_has_fkt m_max_em_has_fkt m_max_iae_has_fkt m_min_em_has_fkt m_soll_em_has_fkt m_soll_k0_has_fkt m_soll_res_em_has_fkt mg_soll_k0_has_fkt n_soll_em_has_fkt n_soll_vm_has_fkt nd_min_saf_has_fkt nd_soll_iae_fkt st_ablauf_fkt status_ablauf_has_fkt z_ablauf_svh_reset_has_fkt z_ablaufvariante_kalt_zus z_emaktiv_fuw_zus_fkt z_fehler15_eh_fkt z_k0_befuellopt_has_fkt z_k0_has_fkt z_m_max_iae_has_fkt z_m_soll_em_has_fkt z_n_soll_em_has_fkt z_n_soll_vm_has_fkt z_p_hys_k0_has_fkt z_ponr_fkt z_respschlepp_sas_fkt z_saf_has_fkt z_sbe_has_fkt z_zuendfreigabe_vm_fkt z_zuendfreigabe_vm_has_fkt i_istgang_egs i_zielgang_egs m_wunsch_fpw_hst_fil mg_wunsch_fpw_in mg_wunsch_fpw_hst_in n_sec_iae nd_k0_in ndg_k0_in ng_vm_in status_schaltung_egs_in n_min_em_psys_lp3_has_sbe status_psys_has_sbe vg_f_sbe v_f_sbe status_sync_schaltung_sbe z_pvu_has_sbe z_freigabe_pvu_has_sbe t_betrieb_pvu_has_sbe mg_mot_in status_radschlupf_rse_has_sbe status_schaltart_svh_has_sbe z_modus_em_hst_in c_getriebe_egs_in istgang_egs_in m_em_in m_iae_in m_k0_in m_max_dyn_em_in m_soll_em_hst_in m_soll_vm_hst_in m_vm_in m_vm_start_in m_wunsch_fpw_in n_ab_egs_in n_em_in n_soll_ll_vm_in n_t_egs_in n_vm_in osmode_next_in p_bremse_fzg_in sollgang_egs_in status_fehler_iep_in status_iae_in status_iep_in status_k0_in pos_egs_in z_ablauf_has_hst_in z_ablaufvariante_has_hst_in zielgang_egs_in z_k0_fst_in m_mot_in status_iae_adap_in z_diag_ersfkt_has_in z_diag_ersfkt_hi_has_in z_diag_notgang_has_in status_k0_adap_in status_waschstr_in status_kraftfluss_egs_in z_n_min_em_parksp_has_in n_mot_soll_iae_in status_alaengs_adaoff_in gangwechsel_egs_in z_nllsoll_iae_in status_nem_in status_nvm_in kolbenpos_k0_in z_kps_stada_in t_betrieb_pvu_has_ee_in status_ll_vm_in z_msa_fst_in m_min_dyn_em_in phi_neigung_in v_f_in drehrichtung_nem_in fpw_in drehrichtung_nab_in schalt_mode_egs_in m_ziel_k0_hst_in status_kraftfluss_lev2_egs_in i_gang_lev2_egs_in status_c_k0_in bremspedal_in status_autohold_in status_hillhold_in status_vf_in v_f_ref_in status_vfref_in z_diag_ersfkt_hi_96_has_in status_k0_adap_zaehler_in status_k0_befuellung_in z_oea_hst_in z_iep_in z_nllsoll_iep_in c_vm_in n_soll_em_hst_in abstellpos_vm_in abstellpos_vm_status_in status_nreg_em_hst_in m_min_vm_in m_soll_vm_l_hst_in z_msa_stada_in m_wunsch_fpw_hst_in status_getrbereit_in status_betriebsbereit_hst_in status_sa_vm_in z_ba_has_vm_hst_in z_ba_has_k0_hst_in status_abs_in status_asr_in modus_e_fahren_hst_in status_kl15_in status_posvueb_in soc_in status_soc_in c_umgebung_in status_cumgebung_in /end LOC_MEASUREMENT
 /begin SUB_FUNCTION SFSBo42_Gefuehrter_Getriebeschutz SFSBo41_Bestimmung_K0_Moments_zur_Motormomentbegrenzung SFSBo40_BeeinflussungKupplungsBefuellreihenfolge SFSBo39_Analyse_MvG_VM_Start SFSBo45_Status_EFahren_out SFSBo44_Mod_Pumpendruckstatus_MPS /end SUB_FUNCTION
/end FUNCTION
/begin FUNCTION SFSBo65_Bitwise_AND_ui8 "" /begin LOC_MEASUREMENT status_getrbereit_in /end LOC_MEASUREMENT /end FUNCTION
/begin FUNCTION SFSBo66_Timer_t_zsasfuwmax_bbr "" /begin DEF_CHARACTERISTIC T_ZSASFUWMAX_BBR_HAS /end DEF_CHARACTERISTIC /end FUNCTION
/begin FUNCTION SFSBo7_SBEo_IAE ""
 /begin LOC_MEASUREMENT z_nvmsollbegr_frk_dihi z_statuspsysmps_frk_dihi z_nminemnull_frk_dihi z_emfehler_frk_dihi z_ablaufreinit_frk_dihi z_k0syncmk0erh_frk_dihi z_fuwdeakt_frk_dihi z_nemmin_frk_dihi z_vmstopverbot_frk_dihi z_vmstartverbot_frk_dihi z_zust_halten_frk_dihi z_zust_init_frk_dihi z_deaktiv_abo_frk_dihi z_vmstartanf_frk_dihi z_svh_frk_dihi z_iepein_frk_dihi z_nsollvmnull_frk_dihi z_ala_frk_dihi z_schaltprioverh_frk_dihi z_nsollvmanh_frk_dihi z_gebruefahrenaus_frk_dihi z_hybfkt_stg st_ziel_bz_has_stg st_ist_bz_has_stg st_ist_hcomd_has_stg z_ablauf_has_stg z_ablaufvariante_has_stg i_istgang_egs i_zielgang_egs m_wunsch_fpw_hst_fil mg_wunsch_fpw_in mg_wunsch_fpw_hst_in n_sec_iae nd_k0_in ndg_k0_in ng_vm_in status_schaltung_egs_in n_min_em_psys_lp3_has_sbe status_psys_has_sbe vg_f_sbe v_f_sbe status_sync_schaltung_sbe z_pvu_has_sbe z_freigabe_pvu_has_sbe t_betrieb_pvu_has_sbe mg_mot_in status_radschlupf_rse_has_sbe status_schaltart_svh_has_sbe z_modus_em_hst_in c_getriebe_egs_in istgang_egs_in m_em_in m_iae_in m_k0_in m_max_dyn_em_in m_soll_em_hst_in m_soll_vm_hst_in m_vm_in m_vm_start_in m_wunsch_fpw_in n_ab_egs_in n_em_in n_soll_ll_vm_in n_t_egs_in n_vm_in osmode_next_in p_bremse_fzg_in sollgang_egs_in status_fehler_iep_in status_iae_in status_iep_in status_k0_in pos_egs_in z_ablauf_has_hst_in z_ablaufvariante_has_hst_in zielgang_egs_in z_k0_fst_in m_mot_in status_iae_adap_in z_diag_ersfkt_has_in z_diag_ersfkt_hi_has_in z_diag_notgang_has_in status_k0_adap_in status_waschstr_in status_kraftfluss_egs_in z_n_min_em_parksp_has_in n_mot_soll_iae_in status_alaengs_adaoff_in gangwechsel_egs_in z_nllsoll_iae_in status_nem_in status_nvm_in kolbenpos_k0_in z_kps_stada_in t_betrieb_pvu_has_ee_in status_ll_vm_in z_msa_fst_in m_min_dyn_em_in phi_neigung_in v_f_in drehrichtung_nem_in fpw_in drehrichtung_nab_in schalt_mode_egs_in m_ziel_k0_hst_in status_kraftfluss_lev2_egs_in i_gang_lev2_egs_in status_c_k0_in bremspedal_in status_autohold_in status_hillhold_in status_vf_in v_f_ref_in status_vfref_in z_diag_ersfkt_hi_96_has_in status_k0_adap_zaehler_in status_k0_befuellung_in z_oea_hst_in z_iep_in z_nllsoll_iep_in c_vm_in n_soll_em_hst_in abstellpos_vm_in abstellpos_vm_status_in status_nreg_em_hst_in m_min_vm_in m_soll_vm_l_hst_in z_msa_stada_in m_wunsch_fpw_hst_in status_getrbereit_in /end LOC_MEASUREMENT
 /begin SUB_FUNCTION SFSBo86_Betriebsmodus_IAE_BMI SFSBo88_Status_EFahren_BMI /end SUB_FUNCTION
/end FUNCTION
/begin FUNCTION SFSBo70_Timer_t_zsasslstmax_bbr "" /begin DEF_CHARACTERISTIC T_ZSASSLSTMAX_BBR_HAS /end DEF_CHARACTERISTIC /end FUNCTION
/begin FUNCTION SFSBo8_SBEo_IEP ""
 /begin LOC_MEASUREMENT z_nvmsollbegr_frk_dihi z_statuspsysmps_frk_dihi z_nminemnull_frk_dihi z_emfehler_frk_dihi z_ablaufreinit_frk_dihi z_k0syncmk0erh_frk_dihi z_fuwdeakt_frk_dihi z_nemmin_frk_dihi z_vmstopverbot_frk_dihi z_vmstartverbot_frk_dihi z_zust_halten_frk_dihi z_zust_init_frk_dihi z_deaktiv_abo_frk_dihi z_vmstartanf_frk_dihi z_svh_frk_dihi z_iepein_frk_dihi z_nsollvmnull_frk_dihi z_ala_frk_dihi z_schaltprioverh_frk_dihi z_nsollvmanh_frk_dihi z_gebruefahrenaus_frk_dihi z_hybfkt_stg st_ziel_bz_has_stg st_ist_bz_has_stg st_ist_hcomd_has_stg z_ablauf_has_stg z_ablaufvariante_has_stg m_k0_mod_has_fkt m_max_em_has_fkt m_max_iae_has_fkt m_min_em_has_fkt m_soll_em_has_fkt m_soll_k0_has_fkt m_soll_res_em_has_fkt mg_soll_k0_has_fkt n_soll_em_has_fkt n_soll_vm_has_fkt nd_min_saf_has_fkt nd_soll_iae_fkt st_ablauf_fkt status_ablauf_has_fkt z_ablauf_svh_reset_has_fkt z_ablaufvariante_kalt_zus z_emaktiv_fuw_zus_fkt z_fehler15_eh_fkt z_k0_befuellopt_has_fkt z_k0_has_fkt z_m_max_iae_has_fkt z_m_soll_em_has_fkt z_n_soll_em_has_fkt z_n_soll_vm_has_fkt z_p_hys_k0_has_fkt z_ponr_fkt z_respschlepp_sas_fkt z_saf_has_fkt z_sbe_has_fkt z_zuendfreigabe_vm_fkt z_zuendfreigabe_vm_has_fkt i_istgang_egs i_zielgang_egs m_wunsch_fpw_hst_fil mg_wunsch_fpw_in mg_wunsch_fpw_hst_in n_sec_iae nd_k0_in ndg_k0_in ng_vm_in status_schaltung_egs_in n_min_em_psys_lp3_has_sbe status_psys_has_sbe vg_f_sbe v_f_sbe status_sync_schaltung_sbe z_pvu_has_sbe z_freigabe_pvu_has_sbe t_betrieb_pvu_has_sbe mg_mot_in status_radschlupf_rse_has_sbe status_schaltart_svh_has_sbe z_modus_em_hst_in c_getriebe_egs_in istgang_egs_in m_em_in m_iae_in m_k0_in m_max_dyn_em_in m_soll_em_hst_in m_soll_vm_hst_in m_vm_in m_vm_start_in m_wunsch_fpw_in n_ab_egs_in n_em_in n_soll_ll_vm_in n_t_egs_in n_vm_in osmode_next_in p_bremse_fzg_in sollgang_egs_in status_fehler_iep_in status_iae_in status_iep_in status_k0_in pos_egs_in z_ablauf_has_hst_in z_ablaufvariante_has_hst_in zielgang_egs_in z_k0_fst_in m_mot_in status_iae_adap_in z_diag_ersfkt_has_in z_diag_ersfkt_hi_has_in z_diag_notgang_has_in status_k0_adap_in status_waschstr_in status_kraftfluss_egs_in z_n_min_em_parksp_has_in n_mot_soll_iae_in status_alaengs_adaoff_in gangwechsel_egs_in z_nllsoll_iae_in status_nem_in status_nvm_in kolbenpos_k0_in z_kps_stada_in t_betrieb_pvu_has_ee_in status_ll_vm_in z_msa_fst_in m_min_dyn_em_in phi_neigung_in v_f_in drehrichtung_nem_in fpw_in drehrichtung_nab_in schalt_mode_egs_in m_ziel_k0_hst_in status_kraftfluss_lev2_egs_in i_gang_lev2_egs_in status_c_k0_in bremspedal_in status_autohold_in status_hillhold_in status_vf_in v_f_ref_in status_vfref_in z_diag_ersfkt_hi_96_has_in status_k0_adap_zaehler_in status_k0_befuellung_in z_oea_hst_in z_iep_in z_nllsoll_iep_in c_vm_in n_soll_em_hst_in abstellpos_vm_in abstellpos_vm_status_in status_nreg_em_hst_in m_min_vm_in m_soll_vm_l_hst_in z_msa_stada_in m_wunsch_fpw_hst_in status_getrbereit_in status_betriebsbereit_hst_in status_sa_vm_in z_ba_has_vm_hst_in z_ba_has_k0_hst_in status_abs_in status_asr_in modus_e_fahren_hst_in status_kl15_in status_posvueb_in soc_in status_soc_in c_umgebung_in status_cumgebung_in /end LOC_MEASUREMENT
 /begin SUB_FUNCTION SFSBo105_IEP_Beeinflussung /end SUB_FUNCTION
/end FUNCTION
/begin FUNCTION SFSBo86_Betriebsmodus_IAE_BMI ""
 /begin DEF_CHARACTERISTIC KL_STKRAFTFLUSS_BMI_HAS_Y KL_STKRAFTFLUSS_BMI_HAS_X CS_GETRIEBEMAX_BMI_HAS CS_GETRIEBEMIN_BMI_HAS PHIS_NEIGUNG_OS_BMI_HAS PHIS_NEIGUNG_US_BMI_HAS N_AB_POAB_BMI_HAS NDS_GETRIEBE_BMI_HAS NDS_IAE_BMI_HAS NS_EM_BMI_HAS STATUS_IAEADAP_BMI_HAS STATUS_K0ADAP_BMI_HAS STATUS_PSYS_LP_BMI_HAS SWI_BMI_EFAHREN_KRAFTSCHLUSS /end DEF_CHARACTERISTIC
 /begin LOC_MEASUREMENT z_aktiv_schlupf_kraftschluss_bmi_has z_bed_schlupf_kraftschluss_bmi_has z_diagnotgang_bmi_has status_efahren_bmi_has z_nemmin_frk_dihi z_gebruefahrenaus_frk_dihi st_ziel_bz_has_stg st_ist_bz_has_stg i_istgang_egs n_sec_iae status_psys_has_sbe c_getriebe_egs_in n_ab_egs_in n_em_in pos_egs_in status_iae_adap_in z_diag_notgang_has_in status_k0_adap_in status_kraftfluss_egs_in phi_neigung_in drehrichtung_nab_in z_oea_hst_in z_nllsoll_iep_in /end LOC_MEASUREMENT
 /begin SUB_FUNCTION SFSBo93_Erkennung_Notgang /end SUB_FUNCTION
/end FUNCTION
/begin FUNCTION SFSBo88_Status_EFahren_BMI "" /begin DEF_CHARACTERISTIC TAB_STATUSEFAHREN_BMI_HAS TAB_ZSTATUSEFAHREN_BMI_MOD_HAS /end DEF_CHARACTERISTIC
 /begin LOC_MEASUREMENT status_efahren_bmi_has status_efahren_bmi_ist status_efahren_bmi_ziel z_statusefahren_bmi_modus z_hybfkt_stg st_ziel_bz_has_stg st_ist_bz_has_stg status_k0_in /end LOC_MEASUREMENT
/end FUNCTION
/begin RECORD_LAYOUT FLOAT32_IEEE_COL_DIRECT_M_S7_S3 FNC_VALUES 1 FLOAT32_IEEE COLUMN_DIR DIRECT /end RECORD_LAYOUT
/begin RECORD_LAYOUT FLOAT32_IEEE_X_INCR_DIRECT_M_S7_S3 AXIS_PTS_X 1 FLOAT32_IEEE INDEX_INCR DIRECT /end RECORD_LAYOUT
/begin RECORD_LAYOUT SBYTE_X_INCR_DIRECT_M_S7_S3 AXIS_PTS_X 1 SBYTE INDEX_INCR DIRECT /end RECORD_LAYOUT
/begin RECORD_LAYOUT SWORD_X_INCR_DIRECT_M_S7_S3 AXIS_PTS_X 1 SWORD INDEX_INCR DIRECT /end RECORD_LAYOUT
/begin RECORD_LAYOUT UBYTE_COL_DIRECT_M_S7_S3 FNC_VALUES 1 UBYTE COLUMN_DIR DIRECT /end RECORD_LAYOUT
/begin RECORD_LAYOUT UBYTE_X_INCR_DIRECT_M_S7_S3 AXIS_PTS_X 1 UBYTE INDEX_INCR DIRECT /end RECORD_LAYOUT
/begin RECORD_LAYOUT ULONG_COL_DIRECT_M_S7_S3 FNC_VALUES 1 ULONG COLUMN_DIR DIRECT /end RECORD_LAYOUT
/begin RECORD_LAYOUT UWORD_COL_DIRECT_M_S7_S3 FNC_VALUES 1 UWORD COLUMN_DIR DIRECT /end RECORD_LAYOUT
/end MODULE
/end PROJECT
