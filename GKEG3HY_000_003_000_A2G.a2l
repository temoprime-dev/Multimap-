ASAP2_VERSION 1 51
/begin PROJECT _929_929 "Gen2_BMW_System_Supplier_Lib"
/begin HEADER "" VERSION "C_03_03" PROJECT_NO _929_929 /end HEADER
/begin MODULE DIM ""
/begin MOD_COMMON "" BYTE_ORDER MSB_FIRST ALIGNMENT_BYTE 1 ALIGNMENT_WORD 2 ALIGNMENT_LONG 4 ALIGNMENT_FLOAT32_IEEE 4 /end MOD_COMMON
/begin CHARACTERISTIC KF_IGOUWIGNGTOB_R "Offset auf obere Uebersetzungschwelle bei GE" MAP 0x26094C kf_si16_S6_S3 32.767 UMR___1_1000_0_S6_S3 0 32.767
 /begin AXIS_DESCR STD_AXIS zff_atsys._.iSignale._.obj.sig_n_ab UMR_U_MIN_1_1_0_S6_S3 8 0 8160 DEPOSIT ABSOLUTE MONOTONY MON_INCREASE /end AXIS_DESCR
 /begin AXIS_DESCR STD_AXIS iUewIgetr.ng_t_ge_start UMR_U_MINSEC_1_1_0_S6_S3 2 -8000 8000 DEPOSIT ABSOLUTE MONOTONY MON_INCREASE /end AXIS_DESCR
/end CHARACTERISTIC
/begin CHARACTERISTIC KF_IGOUWIGNGTUN_R "Offset auf untere Uebersetzungschwelle bei GE" MAP 0x260988 kf_si16_S6_S3 32.767 UMR___1_1000_0_S6_S3 0 32.767
 /begin AXIS_DESCR STD_AXIS zff_atsys._.iSignale._.obj.sig_n_ab UMR_U_MIN_1_1_0_S6_S3 8 0 8160 DEPOSIT ABSOLUTE MONOTONY MON_INCREASE /end AXIS_DESCR
 /begin AXIS_DESCR STD_AXIS iUewIgetr.ng_t_ge_start UMR_U_MINSEC_1_1_0_S6_S3 2 -8000 8000 DEPOSIT ABSOLUTE MONOTONY MON_INCREASE /end AXIS_DESCR
/end CHARACTERISTIC
/begin CHARACTERISTIC KL_UWIGOB_R "obere Uebersetzungsschwelle fuer UWIG im Gang" CURVE 0x2609C4 kl_ui16_S6_S3 65.535 UMR___1_1000_0_S6_S3 0 65.535
 /begin AXIS_DESCR STD_AXIS zff_atsys._.iSignale._.obj.sig_n_ab UMR_U_MIN_1_1_0_S6_S3 8 0 8160 DEPOSIT ABSOLUTE MONOTONY MON_INCREASE /end AXIS_DESCR
/end CHARACTERISTIC
/begin CHARACTERISTIC KL_UWIGOBERS_R "Ersatzwert obere Uebersetzungsschwelle fuer UWIG im Gang" CURVE 0x2609E8 kl_ui16_S6_S3 65.535 UMR___1_1000_0_S6_S3 0 65.535
 /begin AXIS_DESCR STD_AXIS zff_atsys._.iSignale._.obj.sig_n_ab UMR_U_MIN_1_1_0_S6_S3 8 0 8160 DEPOSIT ABSOLUTE MONOTONY MON_INCREASE /end AXIS_DESCR
/end CHARACTERISTIC
/begin CHARACTERISTIC KL_UWIGUN_R "untere Uebersetzungsschwelle fuer UWIG im Gang" CURVE 0x260A0C kl_ui16_S6_S3 65.535 UMR___1_1000_0_S6_S3 0 65.535
 /begin AXIS_DESCR STD_AXIS zff_atsys._.iSignale._.obj.sig_n_ab UMR_U_MIN_1_1_0_S6_S3 8 0 8160 DEPOSIT ABSOLUTE MONOTONY MON_INCREASE /end AXIS_DESCR
/end CHARACTERISTIC
/begin CHARACTERISTIC KL_UWIGUNERS_R "Ersatzwert untere Uebersetzungsschwelle fuer UWIG im Gang" CURVE 0x260A30 kl_ui16_S6_S3 65.535 UMR___1_1000_0_S6_S3 0 65.535
 /begin AXIS_DESCR STD_AXIS zff_atsys._.iSignale._.obj.sig_n_ab UMR_U_MIN_1_1_0_S6_S3 8 0 8160 DEPOSIT ABSOLUTE MONOTONY MON_INCREASE /end AXIS_DESCR
/end CHARACTERISTIC
/begin CHARACTERISTIC ND_TOBUWIG_GE_R "Obergrenze Differenzdrehzahl waehrend Gangeinlegen bei kleinem n_ab" VALUE 0x26DFB8 kw_si16_S6_S3 5000 UMR_U_MIN_1_1_0_S6_S3 0 5000 /end CHARACTERISTIC
/begin CHARACTERISTIC ND_TUNUWIG_GE_R "Untergrenze Differenzdrehzahl waehrend Gangeinlegen bei kleinem n_ab" VALUE 0x26DFBA kw_si16_S6_S3 5000 UMR_U_MIN_1_1_0_S6_S3 -5000 0 /end CHARACTERISTIC
/begin CHARACTERISTIC T_VUWIG_R "Verzoegerungszeit nach Reglerstart bei GE" VALUE 0x26EA25 kw_ui8_S6_S3 2540 UMR_MSEC__10_1_0_S6_S3 0 2540 /end CHARACTERISTIC
/begin CHARACTERISTIC KF_IGOUWIGNGTOB_1 "Offset auf obere Uebersetzungschwelle bei GE" MAP 0x260A54 kf_si16_S6_S3 32.767 UMR___1_1000_0_S6_S3 0 32.767
 /begin AXIS_DESCR STD_AXIS zff_atsys._.iSignale._.obj.sig_n_ab UMR_U_MIN_1_1_0_S6_S3 8 0 8160 DEPOSIT ABSOLUTE MONOTONY MON_INCREASE /end AXIS_DESCR
 /begin AXIS_DESCR STD_AXIS iUewIgetr.ng_t_ge_start UMR_U_MINSEC_1_1_0_S6_S3 2 -8000 8000 DEPOSIT ABSOLUTE MONOTONY MON_INCREASE /end AXIS_DESCR
/end CHARACTERISTIC
/begin CHARACTERISTIC KF_IGOUWIGNGTUN_1 "Offset auf untere Uebersetzungschwelle bei GE" MAP 0x260A90 kf_si16_S6_S3 32.767 UMR___1_1000_0_S6_S3 0 32.767
 /begin AXIS_DESCR STD_AXIS zff_atsys._.iSignale._.obj.sig_n_ab UMR_U_MIN_1_1_0_S6_S3 8 0 8160 DEPOSIT ABSOLUTE MONOTONY MON_INCREASE /end AXIS_DESCR
 /begin AXIS_DESCR STD_AXIS iUewIgetr.ng_t_ge_start UMR_U_MINSEC_1_1_0_S6_S3 2 -8000 8000 DEPOSIT ABSOLUTE MONOTONY MON_INCREASE /end AXIS_DESCR
/end CHARACTERISTIC
/begin CHARACTERISTIC KL_UWIGOB_1 "obere Uebersetzungsschwelle fuer UWIG im Gang" CURVE 0x260ACC kl_ui16_S6_S3 65.535 UMR___1_1000_0_S6_S3 0 65.535
 /begin AXIS_DESCR STD_AXIS zff_atsys._.iSignale._.obj.sig_n_ab UMR_U_MIN_1_1_0_S6_S3 8 0 8160 DEPOSIT ABSOLUTE MONOTONY MON_INCREASE /end AXIS_DESCR
/end CHARACTERISTIC
/begin CHARACTERISTIC KL_UWIGOBERS_1 "Ersatzwert obere Uebersetzungsschwelle fuer UWIG im Gang" CURVE 0x260AF0 kl_ui16_S6_S3 65.535 UMR___1_1000_0_S6_S3 0 65.535
 /begin AXIS_DESCR STD_AXIS zff_atsys._.iSignale._.obj.sig_n_ab UMR_U_MIN_1_1_0_S6_S3 8 0 8160 DEPOSIT ABSOLUTE MONOTONY MON_INCREASE /end AXIS_DESCR
/end CHARACTERISTIC
/begin CHARACTERISTIC KL_UWIGUN_1 "untere Uebersetzungsschwelle fuer UWIG im Gang" CURVE 0x260B14 kl_ui16_S6_S3 65.535 UMR___1_1000_0_S6_S3 0 65.535
 /begin AXIS_DESCR STD_AXIS zff_atsys._.iSignale._.obj.sig_n_ab UMR_U_MIN_1_1_0_S6_S3 8 0 8160 DEPOSIT ABSOLUTE MONOTONY MON_INCREASE /end AXIS_DESCR
/end CHARACTERISTIC
/begin CHARACTERISTIC KL_UWIGUNERS_1 "Ersatzwert untere Uebersetzungsschwelle fuer UWIG im Gang" CURVE 0x260B38 kl_ui16_S6_S3 65.535 UMR___1_1000_0_S6_S3 0 65.535
 /begin AXIS_DESCR STD_AXIS zff_atsys._.iSignale._.obj.sig_n_ab UMR_U_MIN_1_1_0_S6_S3 8 0 8160 DEPOSIT ABSOLUTE MONOTONY MON_INCREASE /end AXIS_DESCR
/end CHARACTERISTIC
/begin CHARACTERISTIC ND_TOBUWIG_GE_1 "Obergrenze Differenzdrehzahl waehrend Gangeinlegen bei kleinem n_ab" VALUE 0x26DFBC kw_si16_S6_S3 5000 UMR_U_MIN_1_1_0_S6_S3 0 5000 /end CHARACTERISTIC
/begin CHARACTERISTIC ND_TUNUWIG_GE_1 "Untergrenze Differenzdrehzahl waehrend Gangeinlegen bei kleinem n_ab" VALUE 0x26DFBE kw_si16_S6_S3 5000 UMR_U_MIN_1_1_0_S6_S3 -5000 0 /end CHARACTERISTIC
/begin CHARACTERISTIC T_VUWIG_1 "Verzoegerungszeit nach Reglerstart bei GE" VALUE 0x26EA26 kw_ui8_S6_S3 2540 UMR_MSEC__10_1_0_S6_S3 0 2540 /end CHARACTERISTIC
/begin CHARACTERISTIC KF_IGOUWIGNGTOB_2 "Offset auf obere Uebersetzungschwelle bei GE" MAP 0x260B5C kf_si16_S6_S3 32.767 UMR___1_1000_0_S6_S3 0 32.767
 /begin AXIS_DESCR STD_AXIS zff_atsys._.iSignale._.obj.sig_n_ab UMR_U_MIN_1_1_0_S6_S3 8 0 8160 DEPOSIT ABSOLUTE MONOTONY MON_INCREASE /end AXIS_DESCR
 /begin AXIS_DESCR STD_AXIS iUewIgetr.ng_t_ge_start UMR_U_MINSEC_1_1_0_S6_S3 2 -8000 8000 DEPOSIT ABSOLUTE MONOTONY MON_INCREASE /end AXIS_DESCR
/end CHARACTERISTIC
/begin CHARACTERISTIC KF_IGOUWIGNGTUN_2 "Offset auf untere Uebersetzungschwelle bei GE" MAP 0x260B98 kf_si16_S6_S3 32.767 UMR___1_1000_0_S6_S3 0 32.767
 /begin AXIS_DESCR STD_AXIS zff_atsys._.iSignale._.obj.sig_n_ab UMR_U_MIN_1_1_0_S6_S3 8 0 8160 DEPOSIT ABSOLUTE MONOTONY MON_INCREASE /end AXIS_DESCR
 /begin AXIS_DESCR STD_AXIS iUewIgetr.ng_t_ge_start UMR_U_MINSEC_1_1_0_S6_S3 2 -8000 8000 DEPOSIT ABSOLUTE MONOTONY MON_INCREASE /end AXIS_DESCR
/end CHARACTERISTIC
/begin CHARACTERISTIC KL_UWIGOB_2 "obere Uebersetzungsschwelle fuer UWIG im Gang" CURVE 0x260BD4 kl_ui16_S6_S3 65.535 UMR___1_1000_0_S6_S3 0 65.535
 /begin AXIS_DESCR STD_AXIS zff_atsys._.iSignale._.obj.sig_n_ab UMR_U_MIN_1_1_0_S6_S3 8 0 8160 DEPOSIT ABSOLUTE MONOTONY MON_INCREASE /end AXIS_DESCR
/end CHARACTERISTIC
/begin CHARACTERISTIC KL_UWIGOBERS_2 "Ersatzwert obere Uebersetzungsschwelle fuer UWIG im Gang" CURVE 0x260BF8 kl_ui16_S6_S3 65.535 UMR___1_1000_0_S6_S3 0 65.535
 /begin AXIS_DESCR STD_AXIS zff_atsys._.iSignale._.obj.sig_n_ab UMR_U_MIN_1_1_0_S6_S3 8 0 8160 DEPOSIT ABSOLUTE MONOTONY MON_INCREASE /end AXIS_DESCR
/end CHARACTERISTIC
/begin CHARACTERISTIC KL_UWIGUN_2 "untere Uebersetzungsschwelle fuer UWIG im Gang" CURVE 0x260C1C kl_ui16_S6_S3 65.535 UMR___1_1000_0_S6_S3 0 65.535
 /begin AXIS_DESCR STD_AXIS zff_atsys._.iSignale._.obj.sig_n_ab UMR_U_MIN_1_1_0_S6_S3 8 0 8160 DEPOSIT ABSOLUTE MONOTONY MON_INCREASE /end AXIS_DESCR
/end CHARACTERISTIC
/begin CHARACTERISTIC KL_UWIGUNERS_2 "Ersatzwert untere Uebersetzungsschwelle fuer UWIG im Gang" CURVE 0x260C40 kl_ui16_S6_S3 65.535 UMR___1_1000_0_S6_S3 0 65.535
 /begin AXIS_DESCR STD_AXIS zff_atsys._.iSignale._.obj.sig_n_ab UMR_U_MIN_1_1_0_S6_S3 8 0 8160 DEPOSIT ABSOLUTE MONOTONY MON_INCREASE /end AXIS_DESCR
/end CHARACTERISTIC
/begin CHARACTERISTIC ND_TOBUWIG_GE_2 "Obergrenze Differenzdrehzahl waehrend Gangeinlegen bei kleinem n_ab" VALUE 0x26DFC0 kw_si16_S6_S3 5000 UMR_U_MIN_1_1_0_S6_S3 0 5000 /end CHARACTERISTIC
/begin CHARACTERISTIC ND_TUNUWIG_GE_2 "Untergrenze Differenzdrehzahl waehrend Gangeinlegen bei kleinem n_ab" VALUE 0x26DFC2 kw_si16_S6_S3 5000 UMR_U_MIN_1_1_0_S6_S3 -5000 0 /end CHARACTERISTIC
/begin CHARACTERISTIC T_VUWIG_2 "Verzoegerungszeit nach Reglerstart bei GE" VALUE 0x26EA27 kw_ui8_S6_S3 2540 UMR_MSEC__10_1_0_S6_S3 0 2540 /end CHARACTERISTIC
/begin CHARACTERISTIC KF_IGOUWIGNGTOB_3 "Offset auf obere Uebersetzungschwelle bei GE" MAP 0x260C64 kf_si16_S6_S3 32.767 UMR___1_1000_0_S6_S3 0 32.767
 /begin AXIS_DESCR STD_AXIS zff_atsys._.iSignale._.obj.sig_n_ab UMR_U_MIN_1_1_0_S6_S3 8 0 8160 DEPOSIT ABSOLUTE MONOTONY MON_INCREASE /end AXIS_DESCR
 /begin AXIS_DESCR STD_AXIS iUewIgetr.ng_t_ge_start UMR_U_MINSEC_1_1_0_S6_S3 2 -8000 8000 DEPOSIT ABSOLUTE MONOTONY MON_INCREASE /end AXIS_DESCR
/end CHARACTERISTIC
/begin CHARACTERISTIC KF_IGOUWIGNGTUN_3 "Offset auf untere Uebersetzungschwelle bei GE" MAP 0x260CA0 kf_si16_S6_S3 32.767 UMR___1_1000_0_S6_S3 0 32.767
 /begin AXIS_DESCR STD_AXIS zff_atsys._.iSignale._.obj.sig_n_ab UMR_U_MIN_1_1_0_S6_S3 8 0 8160 DEPOSIT ABSOLUTE MONOTONY MON_INCREASE /end AXIS_DESCR
 /begin AXIS_DESCR STD_AXIS iUewIgetr.ng_t_ge_start UMR_U_MINSEC_1_1_0_S6_S3 2 -8000 8000 DEPOSIT ABSOLUTE MONOTONY MON_INCREASE /end AXIS_DESCR
/end CHARACTERISTIC
/begin CHARACTERISTIC KL_UWIGOB_3 "obere Uebersetzungsschwelle fuer UWIG im Gang" CURVE 0x260CDC kl_ui16_S6_S3 65.535 UMR___1_1000_0_S6_S3 0 65.535
 /begin AXIS_DESCR STD_AXIS zff_atsys._.iSignale._.obj.sig_n_ab UMR_U_MIN_1_1_0_S6_S3 8 0 8160 DEPOSIT ABSOLUTE MONOTONY MON_INCREASE /end AXIS_DESCR
/end CHARACTERISTIC
/begin CHARACTERISTIC KL_UWIGOBERS_3 "Ersatzwert obere Uebersetzungsschwelle fuer UWIG im Gang" CURVE 0x260D00 kl_ui16_S6_S3 65.535 UMR___1_1000_0_S6_S3 0 65.535
 /begin AXIS_DESCR STD_AXIS zff_atsys._.iSignale._.obj.sig_n_ab UMR_U_MIN_1_1_0_S6_S3 8 0 8160 DEPOSIT ABSOLUTE MONOTONY MON_INCREASE /end AXIS_DESCR
/end CHARACTERISTIC
/begin CHARACTERISTIC KL_UWIGUN_3 "untere Uebersetzungsschwelle fuer UWIG im Gang" CURVE 0x260D24 kl_ui16_S6_S3 65.535 UMR___1_1000_0_S6_S3 0 65.535
 /begin AXIS_DESCR STD_AXIS zff_atsys._.iSignale._.obj.sig_n_ab UMR_U_MIN_1_1_0_S6_S3 8 0 8160 DEPOSIT ABSOLUTE MONOTONY MON_INCREASE /end AXIS_DESCR
/end CHARACTERISTIC
/begin CHARACTERISTIC KL_UWIGUNERS_3 "Ersatzwert untere Uebersetzungsschwelle fuer UWIG im Gang" CURVE 0x260D48 kl_ui16_S6_S3 65.535 UMR___1_1000_0_S6_S3 0 65.535
 /begin AXIS_DESCR STD_AXIS zff_atsys._.iSignale._.obj.sig_n_ab UMR_U_MIN_1_1_0_S6_S3 8 0 8160 DEPOSIT ABSOLUTE MONOTONY MON_INCREASE /end AXIS_DESCR
/end CHARACTERISTIC
/begin CHARACTERISTIC ND_TOBUWIG_GE_3 "Obergrenze Differenzdrehzahl waehrend Gangeinlegen bei kleinem n_ab" VALUE 0x26DFC4 kw_si16_S6_S3 5000 UMR_U_MIN_1_1_0_S6_S3 0 5000 /end CHARACTERISTIC
/begin CHARACTERISTIC ND_TUNUWIG_GE_3 "Untergrenze Differenzdrehzahl waehrend Gangeinlegen bei kleinem n_ab" VALUE 0x26DFC6 kw_si16_S6_S3 5000 UMR_U_MIN_1_1_0_S6_S3 -5000 0 /end CHARACTERISTIC
/begin CHARACTERISTIC T_VUWIG_3 "Verzoegerungszeit nach Reglerstart bei GE" VALUE 0x26EA28 kw_ui8_S6_S3 2540 UMR_MSEC__10_1_0_S6_S3 0 2540 /end CHARACTERISTIC
/begin CHARACTERISTIC KF_IGOUWIGNGTOB_4 "Offset auf obere Uebersetzungschwelle bei GE" MAP 0x260D6C kf_si16_S6_S3 32.767 UMR___1_1000_0_S6_S3 0 32.767
 /begin AXIS_DESCR STD_AXIS zff_atsys._.iSignale._.obj.sig_n_ab UMR_U_MIN_1_1_0_S6_S3 8 0 8160 DEPOSIT ABSOLUTE MONOTONY MON_INCREASE /end AXIS_DESCR
 /begin AXIS_DESCR STD_AXIS iUewIgetr.ng_t_ge_start UMR_U_MINSEC_1_1_0_S6_S3 2 -8000 8000 DEPOSIT ABSOLUTE MONOTONY MON_INCREASE /end AXIS_DESCR
/end CHARACTERISTIC
/begin CHARACTERISTIC KF_IGOUWIGNGTUN_4 "Offset auf untere Uebersetzungschwelle bei GE" MAP 0x260DA8 kf_si16_S6_S3 32.767 UMR___1_1000_0_S6_S3 0 32.767
 /begin AXIS_DESCR STD_AXIS zff_atsys._.iSignale._.obj.sig_n_ab UMR_U_MIN_1_1_0_S6_S3 8 0 8160 DEPOSIT ABSOLUTE MONOTONY MON_INCREASE /end AXIS_DESCR
 /begin AXIS_DESCR STD_AXIS iUewIgetr.ng_t_ge_start UMR_U_MINSEC_1_1_0_S6_S3 2 -8000 8000 DEPOSIT ABSOLUTE MONOTONY MON_INCREASE /end AXIS_DESCR
/end CHARACTERISTIC
/begin CHARACTERISTIC KL_UWIGOB_4 "obere Uebersetzungsschwelle fuer UWIG im Gang" CURVE 0x260DE4 kl_ui16_S6_S3 65.535 UMR___1_1000_0_S6_S3 0 65.535
 /begin AXIS_DESCR STD_AXIS zff_atsys._.iSignale._.obj.sig_n_ab UMR_U_MIN_1_1_0_S6_S3 8 0 8160 DEPOSIT ABSOLUTE MONOTONY MON_INCREASE /end AXIS_DESCR
/end CHARACTERISTIC
/begin CHARACTERISTIC KL_UWIGOBERS_4 "Ersatzwert obere Uebersetzungsschwelle fuer UWIG im Gang" CURVE 0x260E08 kl_ui16_S6_S3 65.535 UMR___1_1000_0_S6_S3 0 65.535
 /begin AXIS_DESCR STD_AXIS zff_atsys._.iSignale._.obj.sig_n_ab UMR_U_MIN_1_1_0_S6_S3 8 0 8160 DEPOSIT ABSOLUTE MONOTONY MON_INCREASE /end AXIS_DESCR
/end CHARACTERISTIC
/begin CHARACTERISTIC KL_UWIGUN_4 "untere Uebersetzungsschwelle fuer UWIG im Gang" CURVE 0x260E2C kl_ui16_S6_S3 65.535 UMR___1_1000_0_S6_S3 0 65.535
 /begin AXIS_DESCR STD_AXIS zff_atsys._.iSignale._.obj.sig_n_ab UMR_U_MIN_1_1_0_S6_S3 8 0 8160 DEPOSIT ABSOLUTE MONOTONY MON_INCREASE /end AXIS_DESCR
/end CHARACTERISTIC
/begin CHARACTERISTIC KL_UWIGUNERS_4 "Ersatzwert untere Uebersetzungsschwelle fuer UWIG im Gang" CURVE 0x260E50 kl_ui16_S6_S3 65.535 UMR___1_1000_0_S6_S3 0 65.535
 /begin AXIS_DESCR STD_AXIS zff_atsys._.iSignale._.obj.sig_n_ab UMR_U_MIN_1_1_0_S6_S3 8 0 8160 DEPOSIT ABSOLUTE MONOTONY MON_INCREASE /end AXIS_DESCR
/end CHARACTERISTIC
/begin CHARACTERISTIC ND_TOBUWIG_GE_4 "Obergrenze Differenzdrehzahl waehrend Gangeinlegen bei kleinem n_ab" VALUE 0x26DFC8 kw_si16_S6_S3 5000 UMR_U_MIN_1_1_0_S6_S3 0 5000 /end CHARACTERISTIC
/begin CHARACTERISTIC ND_TUNUWIG_GE_4 "Untergrenze Differenzdrehzahl waehrend Gangeinlegen bei kleinem n_ab" VALUE 0x26DFCA kw_si16_S6_S3 5000 UMR_U_MIN_1_1_0_S6_S3 -5000 0 /end CHARACTERISTIC
/begin CHARACTERISTIC T_VUWIG_4 "Verzoegerungszeit nach Reglerstart bei GE" VALUE 0x26EA29 kw_ui8_S6_S3 2540 UMR_MSEC__10_1_0_S6_S3 0 2540 /end CHARACTERISTIC
/begin CHARACTERISTIC KF_IGOUWIGNGTOB_5 "Offset auf obere Uebersetzungschwelle bei GE" MAP 0x260E74 kf_si16_S6_S3 32.767 UMR___1_1000_0_S6_S3 0 32.767
 /begin AXIS_DESCR STD_AXIS zff_atsys._.iSignale._.obj.sig_n_ab UMR_U_MIN_1_1_0_S6_S3 8 0 8160 DEPOSIT ABSOLUTE MONOTONY MON_INCREASE /end AXIS_DESCR
 /begin AXIS_DESCR STD_AXIS iUewIgetr.ng_t_ge_start UMR_U_MINSEC_1_1_0_S6_S3 2 -8000 8000 DEPOSIT ABSOLUTE MONOTONY MON_INCREASE /end AXIS_DESCR
/end CHARACTERISTIC
/begin CHARACTERISTIC KF_IGOUWIGNGTUN_5 "Offset auf untere Uebersetzungschwelle bei GE" MAP 0x260EB0 kf_si16_S6_S3 32.767 UMR___1_1000_0_S6_S3 0 32.767
 /begin AXIS_DESCR STD_AXIS zff_atsys._.iSignale._.obj.sig_n_ab UMR_U_MIN_1_1_0_S6_S3 8 0 8160 DEPOSIT ABSOLUTE MONOTONY MON_INCREASE /end AXIS_DESCR
 /begin AXIS_DESCR STD_AXIS iUewIgetr.ng_t_ge_start UMR_U_MINSEC_1_1_0_S6_S3 2 -8000 8000 DEPOSIT ABSOLUTE MONOTONY MON_INCREASE /end AXIS_DESCR
/end CHARACTERISTIC
/begin CHARACTERISTIC KL_UWIGOB_5 "obere Uebersetzungsschwelle fuer UWIG im Gang" CURVE 0x260EEC kl_ui16_S6_S3 65.535 UMR___1_1000_0_S6_S3 0 65.535
 /begin AXIS_DESCR STD_AXIS zff_atsys._.iSignale._.obj.sig_n_ab UMR_U_MIN_1_1_0_S6_S3 8 0 8160 DEPOSIT ABSOLUTE MONOTONY MON_INCREASE /end AXIS_DESCR
/end CHARACTERISTIC
/begin CHARACTERISTIC KL_UWIGOBERS_5 "Ersatzwert obere Uebersetzungsschwelle fuer UWIG im Gang" CURVE 0x260F10 kl_ui16_S6_S3 65.535 UMR___1_1000_0_S6_S3 0 65.535
 /begin AXIS_DESCR STD_AXIS zff_atsys._.iSignale._.obj.sig_n_ab UMR_U_MIN_1_1_0_S6_S3 8 0 8160 DEPOSIT ABSOLUTE MONOTONY MON_INCREASE /end AXIS_DESCR
/end CHARACTERISTIC
/begin CHARACTERISTIC KL_UWIGUN_5 "untere Uebersetzungsschwelle fuer UWIG im Gang" CURVE 0x260F34 kl_ui16_S6_S3 65.535 UMR___1_1000_0_S6_S3 0 65.535
 /begin AXIS_DESCR STD_AXIS zff_atsys._.iSignale._.obj.sig_n_ab UMR_U_MIN_1_1_0_S6_S3 8 0 8160 DEPOSIT ABSOLUTE MONOTONY MON_INCREASE /end AXIS_DESCR
/end CHARACTERISTIC
/begin CHARACTERISTIC KL_UWIGUNERS_5 "Ersatzwert untere Uebersetzungsschwelle fuer UWIG im Gang" CURVE 0x260F58 kl_ui16_S6_S3 65.535 UMR___1_1000_0_S6_S3 0 65.535
 /begin AXIS_DESCR STD_AXIS zff_atsys._.iSignale._.obj.sig_n_ab UMR_U_MIN_1_1_0_S6_S3 8 0 8160 DEPOSIT ABSOLUTE MONOTONY MON_INCREASE /end AXIS_DESCR
/end CHARACTERISTIC
/begin CHARACTERISTIC ND_TOBUWIG_GE_5 "Obergrenze Differenzdrehzahl waehrend Gangeinlegen bei kleinem n_ab" VALUE 0x26DFCC kw_si16_S6_S3 5000 UMR_U_MIN_1_1_0_S6_S3 0 5000 /end CHARACTERISTIC
/begin CHARACTERISTIC ND_TUNUWIG_GE_5 "Untergrenze Differenzdrehzahl waehrend Gangeinlegen bei kleinem n_ab" VALUE 0x26DFCE kw_si16_S6_S3 5000 UMR_U_MIN_1_1_0_S6_S3 -5000 0 /end CHARACTERISTIC
/begin CHARACTERISTIC T_VUWIG_5 "Verzoegerungszeit nach Reglerstart bei GE" VALUE 0x26EA2A kw_ui8_S6_S3 2540 UMR_MSEC__10_1_0_S6_S3 0 2540 /end CHARACTERISTIC
/begin CHARACTERISTIC KF_IGOUWIGNGTOB_6 "Offset auf obere Uebersetzungschwelle bei GE" MAP 0x260F7C kf_si16_S6_S3 32.767 UMR___1_1000_0_S6_S3 0 32.767
 /begin AXIS_DESCR STD_AXIS zff_atsys._.iSignale._.obj.sig_n_ab UMR_U_MIN_1_1_0_S6_S3 8 0 8160 DEPOSIT ABSOLUTE MONOTONY MON_INCREASE /end AXIS_DESCR
 /begin AXIS_DESCR STD_AXIS iUewIgetr.ng_t_ge_start UMR_U_MINSEC_1_1_0_S6_S3 2 -8000 8000 DEPOSIT ABSOLUTE MONOTONY MON_INCREASE /end AXIS_DESCR
/end CHARACTERISTIC
/begin CHARACTERISTIC KF_IGOUWIGNGTUN_6 "Offset auf untere Uebersetzungschwelle bei GE" MAP 0x260FB8 kf_si16_S6_S3 32.767 UMR___1_1000_0_S6_S3 0 32.767
 /begin AXIS_DESCR STD_AXIS zff_atsys._.iSignale._.obj.sig_n_ab UMR_U_MIN_1_1_0_S6_S3 8 0 8160 DEPOSIT ABSOLUTE MONOTONY MON_INCREASE /end AXIS_DESCR
 /begin AXIS_DESCR STD_AXIS iUewIgetr.ng_t_ge_start UMR_U_MINSEC_1_1_0_S6_S3 2 -8000 8000 DEPOSIT ABSOLUTE MONOTONY MON_INCREASE /end AXIS_DESCR
/end CHARACTERISTIC
/begin CHARACTERISTIC KL_UWIGOB_6 "obere Uebersetzungsschwelle fuer UWIG im Gang" CURVE 0x260FF4 kl_ui16_S6_S3 65.535 UMR___1_1000_0_S6_S3 0 65.535
 /begin AXIS_DESCR STD_AXIS zff_atsys._.iSignale._.obj.sig_n_ab UMR_U_MIN_1_1_0_S6_S3 8 0 8160 DEPOSIT ABSOLUTE MONOTONY MON_INCREASE /end AXIS_DESCR
/end CHARACTERISTIC
/begin CHARACTERISTIC KL_UWIGOBERS_6 "Ersatzwert obere Uebersetzungsschwelle fuer UWIG im Gang" CURVE 0x261018 kl_ui16_S6_S3 65.535 UMR___1_1000_0_S6_S3 0 65.535
 /begin AXIS_DESCR STD_AXIS zff_atsys._.iSignale._.obj.sig_n_ab UMR_U_MIN_1_1_0_S6_S3 8 0 8160 DEPOSIT ABSOLUTE MONOTONY MON_INCREASE /end AXIS_DESCR
/end CHARACTERISTIC
/begin CHARACTERISTIC KL_UWIGUN_6 "untere Uebersetzungsschwelle fuer UWIG im Gang" CURVE 0x26103C kl_ui16_S6_S3 65.535 UMR___1_1000_0_S6_S3 0 65.535
 /begin AXIS_DESCR STD_AXIS zff_atsys._.iSignale._.obj.sig_n_ab UMR_U_MIN_1_1_0_S6_S3 8 0 8160 DEPOSIT ABSOLUTE MONOTONY MON_INCREASE /end AXIS_DESCR
/end CHARACTERISTIC
/begin CHARACTERISTIC KL_UWIGUNERS_6 "Ersatzwert untere Uebersetzungsschwelle fuer UWIG im Gang" CURVE 0x261060 kl_ui16_S6_S3 65.535 UMR___1_1000_0_S6_S3 0 65.535
 /begin AXIS_DESCR STD_AXIS zff_atsys._.iSignale._.obj.sig_n_ab UMR_U_MIN_1_1_0_S6_S3 8 0 8160 DEPOSIT ABSOLUTE MONOTONY MON_INCREASE /end AXIS_DESCR
/end CHARACTERISTIC
/begin CHARACTERISTIC ND_TOBUWIG_GE_6 "Obergrenze Differenzdrehzahl waehrend Gangeinlegen bei kleinem n_ab" VALUE 0x26DFD0 kw_si16_S6_S3 5000 UMR_U_MIN_1_1_0_S6_S3 0 5000 /end CHARACTERISTIC
/begin CHARACTERISTIC ND_TUNUWIG_GE_6 "Untergrenze Differenzdrehzahl waehrend Gangeinlegen bei kleinem n_ab" VALUE 0x26DFD2 kw_si16_S6_S3 5000 UMR_U_MIN_1_1_0_S6_S3 -5000 0 /end CHARACTERISTIC
/begin CHARACTERISTIC T_VUWIG_6 "Verzoegerungszeit nach Reglerstart bei GE" VALUE 0x26EA2B kw_ui8_S6_S3 2540 UMR_MSEC__10_1_0_S6_S3 0 2540 /end CHARACTERISTIC
/begin CHARACTERISTIC KF_IGOUWIGNGTOB_7 "Offset auf obere Uebersetzungschwelle bei GE" MAP 0x261084 kf_si16_S6_S3 32.767 UMR___1_1000_0_S6_S3 0 32.767
 /begin AXIS_DESCR STD_AXIS zff_atsys._.iSignale._.obj.sig_n_ab UMR_U_MIN_1_1_0_S6_S3 8 0 8160 DEPOSIT ABSOLUTE MONOTONY MON_INCREASE /end AXIS_DESCR
 /begin AXIS_DESCR STD_AXIS iUewIgetr.ng_t_ge_start UMR_U_MINSEC_1_1_0_S6_S3 2 -8000 8000 DEPOSIT ABSOLUTE MONOTONY MON_INCREASE /end AXIS_DESCR
/end CHARACTERISTIC
/begin CHARACTERISTIC KF_IGOUWIGNGTUN_7 "Offset auf untere Uebersetzungschwelle bei GE" MAP 0x2610C0 kf_si16_S6_S3 32.767 UMR___1_1000_0_S6_S3 0 32.767
 /begin AXIS_DESCR STD_AXIS zff_atsys._.iSignale._.obj.sig_n_ab UMR_U_MIN_1_1_0_S6_S3 8 0 8160 DEPOSIT ABSOLUTE MONOTONY MON_INCREASE /end AXIS_DESCR
 /begin AXIS_DESCR STD_AXIS iUewIgetr.ng_t_ge_start UMR_U_MINSEC_1_1_0_S6_S3 2 -8000 8000 DEPOSIT ABSOLUTE MONOTONY MON_INCREASE /end AXIS_DESCR
/end CHARACTERISTIC
/begin CHARACTERISTIC KL_UWIGOB_7 "obere Uebersetzungsschwelle fuer UWIG im Gang" CURVE 0x2610FC kl_ui16_S6_S3 65.535 UMR___1_1000_0_S6_S3 0 65.535
 /begin AXIS_DESCR STD_AXIS zff_atsys._.iSignale._.obj.sig_n_ab UMR_U_MIN_1_1_0_S6_S3 8 0 8160 DEPOSIT ABSOLUTE MONOTONY MON_INCREASE /end AXIS_DESCR
/end CHARACTERISTIC
/begin CHARACTERISTIC KL_UWIGOBERS_7 "Ersatzwert obere Uebersetzungsschwelle fuer UWIG im Gang" CURVE 0x261120 kl_ui16_S6_S3 65.535 UMR___1_1000_0_S6_S3 0 65.535
 /begin AXIS_DESCR STD_AXIS zff_atsys._.iSignale._.obj.sig_n_ab UMR_U_MIN_1_1_0_S6_S3 8 0 8160 DEPOSIT ABSOLUTE MONOTONY MON_INCREASE /end AXIS_DESCR
/end CHARACTERISTIC
/begin CHARACTERISTIC KL_UWIGUN_7 "untere Uebersetzungsschwelle fuer UWIG im Gang" CURVE 0x261144 kl_ui16_S6_S3 65.535 UMR___1_1000_0_S6_S3 0 65.535
 /begin AXIS_DESCR STD_AXIS zff_atsys._.iSignale._.obj.sig_n_ab UMR_U_MIN_1_1_0_S6_S3 8 0 8160 DEPOSIT ABSOLUTE MONOTONY MON_INCREASE /end AXIS_DESCR
/end CHARACTERISTIC
/begin CHARACTERISTIC KL_UWIGUNERS_7 "Ersatzwert untere Uebersetzungsschwelle fuer UWIG im Gang" CURVE 0x261168 kl_ui16_S6_S3 65.535 UMR___1_1000_0_S6_S3 0 65.535
 /begin AXIS_DESCR STD_AXIS zff_atsys._.iSignale._.obj.sig_n_ab UMR_U_MIN_1_1_0_S6_S3 8 0 8160 DEPOSIT ABSOLUTE MONOTONY MON_INCREASE /end AXIS_DESCR
/end CHARACTERISTIC
/begin CHARACTERISTIC ND_TOBUWIG_GE_7 "Obergrenze Differenzdrehzahl waehrend Gangeinlegen bei kleinem n_ab" VALUE 0x26DFD4 kw_si16_S6_S3 5000 UMR_U_MIN_1_1_0_S6_S3 0 5000 /end CHARACTERISTIC
/begin CHARACTERISTIC ND_TUNUWIG_GE_7 "Untergrenze Differenzdrehzahl waehrend Gangeinlegen bei kleinem n_ab" VALUE 0x26DFD6 kw_si16_S6_S3 5000 UMR_U_MIN_1_1_0_S6_S3 -5000 0 /end CHARACTERISTIC
/begin CHARACTERISTIC T_VUWIG_7 "Verzoegerungszeit nach Reglerstart bei GE" VALUE 0x26EA2C kw_ui8_S6_S3 2540 UMR_MSEC__10_1_0_S6_S3 0 2540 /end CHARACTERISTIC
/begin CHARACTERISTIC KF_IGOUWIGNGTOB_8 "Offset auf obere Uebersetzungschwelle bei GE" MAP 0x26118C kf_si16_S6_S3 32.767 UMR___1_1000_0_S6_S3 0 32.767
 /begin AXIS_DESCR STD_AXIS zff_atsys._.iSignale._.obj.sig_n_ab UMR_U_MIN_1_1_0_S6_S3 8 0 8160 DEPOSIT ABSOLUTE MONOTONY MON_INCREASE /end AXIS_DESCR
 /begin AXIS_DESCR STD_AXIS iUewIgetr.ng_t_ge_start UMR_U_MINSEC_1_1_0_S6_S3 2 -8000 8000 DEPOSIT ABSOLUTE MONOTONY MON_INCREASE /end AXIS_DESCR
/end CHARACTERISTIC
/begin CHARACTERISTIC KF_IGOUWIGNGTUN_8 "Offset auf untere Uebersetzungschwelle bei GE" MAP 0x2611C8 kf_si16_S6_S3 32.767 UMR___1_1000_0_S6_S3 0 32.767
 /begin AXIS_DESCR STD_AXIS zff_atsys._.iSignale._.obj.sig_n_ab UMR_U_MIN_1_1_0_S6_S3 8 0 8160 DEPOSIT ABSOLUTE MONOTONY MON_INCREASE /end AXIS_DESCR
 /begin AXIS_DESCR STD_AXIS iUewIgetr.ng_t_ge_start UMR_U_MINSEC_1_1_0_S6_S3 2 -8000 8000 DEPOSIT ABSOLUTE MONOTONY MON_INCREASE /end AXIS_DESCR
/end CHARACTERISTIC
/begin CHARACTERISTIC KL_UWIGOB_8 "obere Uebersetzungsschwelle fuer UWIG im Gang" CURVE 0x261204 kl_ui16_S6_S3 65.535 UMR___1_1000_0_S6_S3 0 65.535
 /begin AXIS_DESCR STD_AXIS zff_atsys._.iSignale._.obj.sig_n_ab UMR_U_MIN_1_1_0_S6_S3 8 0 8160 DEPOSIT ABSOLUTE MONOTONY MON_INCREASE /end AXIS_DESCR
/end CHARACTERISTIC
/begin CHARACTERISTIC KL_UWIGOBERS_8 "Ersatzwert obere Uebersetzungsschwelle fuer UWIG im Gang" CURVE 0x261228 kl_ui16_S6_S3 65.535 UMR___1_1000_0_S6_S3 0 65.535
 /begin AXIS_DESCR STD_AXIS zff_atsys._.iSignale._.obj.sig_n_ab UMR_U_MIN_1_1_0_S6_S3 8 0 8160 DEPOSIT ABSOLUTE MONOTONY MON_INCREASE /end AXIS_DESCR
/end CHARACTERISTIC
/begin CHARACTERISTIC KL_UWIGUN_8 "untere Uebersetzungsschwelle fuer UWIG im Gang" CURVE 0x26124C kl_ui16_S6_S3 65.535 UMR___1_1000_0_S6_S3 0 65.535
 /begin AXIS_DESCR STD_AXIS zff_atsys._.iSignale._.obj.sig_n_ab UMR_U_MIN_1_1_0_S6_S3 8 0 8160 DEPOSIT ABSOLUTE MONOTONY MON_INCREASE /end AXIS_DESCR
/end CHARACTERISTIC
/begin CHARACTERISTIC KL_UWIGUNERS_8 "Ersatzwert untere Uebersetzungsschwelle fuer UWIG im Gang" CURVE 0x261270 kl_ui16_S6_S3 65.535 UMR___1_1000_0_S6_S3 0 65.535
 /begin AXIS_DESCR STD_AXIS zff_atsys._.iSignale._.obj.sig_n_ab UMR_U_MIN_1_1_0_S6_S3 8 0 8160 DEPOSIT ABSOLUTE MONOTONY MON_INCREASE /end AXIS_DESCR
/end CHARACTERISTIC
/begin CHARACTERISTIC ND_TOBUWIG_GE_8 "Obergrenze Differenzdrehzahl waehrend Gangeinlegen bei kleinem n_ab" VALUE 0x26DFD8 kw_si16_S6_S3 5000 UMR_U_MIN_1_1_0_S6_S3 0 5000 /end CHARACTERISTIC
/begin CHARACTERISTIC ND_TUNUWIG_GE_8 "Untergrenze Differenzdrehzahl waehrend Gangeinlegen bei kleinem n_ab" VALUE 0x26DFDA kw_si16_S6_S3 5000 UMR_U_MIN_1_1_0_S6_S3 -5000 0 /end CHARACTERISTIC
/begin CHARACTERISTIC T_VUWIG_8 "Verzoegerungszeit nach Reglerstart bei GE" VALUE 0x26EA2D kw_ui8_S6_S3 2540 UMR_MSEC__10_1_0_S6_S3 0 2540 /end CHARACTERISTIC
/begin CHARACTERISTIC MIN_ERFOLG_SYMIO_A "Grenzwert ab dem eine Symptomheilung erfolgreich war" VALUE 0x26EA2E kw_ui8_S6_S3 255 UMR___1_1_0_S6_S3 0 255 /end CHARACTERISTIC
/begin CHARACTERISTIC MIN_ERFOLG_SYMIO_B "Grenzwert ab dem eine Symptomheilung erfolgreich war" VALUE 0x26EA2F kw_ui8_S6_S3 255 UMR___1_1_0_S6_S3 0 255 /end CHARACTERISTIC
/begin CHARACTERISTIC MIN_ERFOLG_SYMIO_C "Grenzwert ab dem eine Symptomheilung erfolgreich war" VALUE 0x26EA30 kw_ui8_S6_S3 255 UMR___1_1_0_S6_S3 0 255 /end CHARACTERISTIC
/begin CHARACTERISTIC MIN_ERFOLG_SYMIO_D "Grenzwert ab dem eine Symptomheilung erfolgreich war" VALUE 0x26EA31 kw_ui8_S6_S3 255 UMR___1_1_0_S6_S3 0 255 /end CHARACTERISTIC
/begin CHARACTERISTIC MIN_ERFOLG_SYMIO_E "Grenzwert ab dem eine Symptomheilung erfolgreich war" VALUE 0x26EA32 kw_ui8_S6_S3 255 UMR___1_1_0_S6_S3 0 255 /end CHARACTERISTIC
/begin CHARACTERISTIC KL_IGOUWIGOB12 "Offset auf obere Uebersetzungschwelle bei Schaltung" CURVE 0x261294 kl_ui16_S6_S3 65.535 UMR___1_1000_0_S6_S3 0 65.535
 /begin AXIS_DESCR STD_AXIS zff_atsys._.iSignale._.obj.sig_n_ab UMR_U_MIN_1_1_0_S6_S3 8 0 8160 DEPOSIT ABSOLUTE MONOTONY MON_INCREASE /end AXIS_DESCR
/end CHARACTERISTIC
/begin CHARACTERISTIC KL_IGOUWIGUN12 "Offset auf untere Uebersetzungschwelle bei Schaltung" CURVE 0x2612B8 kl_ui16_S6_S3 65.535 UMR___1_1000_0_S6_S3 0 65.535
 /begin AXIS_DESCR STD_AXIS zff_atsys._.iSignale._.obj.sig_n_ab UMR_U_MIN_1_1_0_S6_S3 8 0 8160 DEPOSIT ABSOLUTE MONOTONY MON_INCREASE /end AXIS_DESCR
/end CHARACTERISTIC
/begin CHARACTERISTIC MAX_STOER_OFFSET12 "Offset fuer Anz. Stoerungen bis ein Symptom ausgeloest wird, wenn bei Schltg. ein Sollmomentgradient unterschritten wird" VALUE 0x26EA33 kw_ui8_S6_S3 255 UMR___1_1_0_S6_S3 0 255 /end CHARACTERISTIC
/begin CHARACTERISTIC MAX_SYM_UWIG_SCHALT12 "Maximale Anzahl Symptome fuer Schaltung in der UWIG" VALUE 0x26EA34 kw_ui8_S6_S3 254 UMR___1_1_0_S6_S3 1 255 /end CHARACTERISTIC
/begin CHARACTERISTIC NGS_ABUWIG12 "n_ab-Gradientenschwelle fuer Symptomerkennung waehrend Schaltung" VALUE 0x26DFDC kw_si16_S6_S3 25000 UMR_U_MINSEC_1_1_0_S6_S3 -20000 5000 /end CHARACTERISTIC
/begin CHARACTERISTIC T_VNGABUWIG12 "Verzoegerungszeit nach Ueberschreiten NGS_ABUWIGxy-Schwelle waehrend Schaltung" VALUE 0x26EA35 kw_ui8_S6_S3 1000 UMR_MSEC__10_1_0_S6_S3 0 1000 /end CHARACTERISTIC
/begin CHARACTERISTIC T_VUWIG12 "Verzoegerungszeit nach Reglerstart bei Schaltung" VALUE 0x26EA36 kw_ui8_S6_S3 2540 UMR_MSEC__10_1_0_S6_S3 0 2540 /end CHARACTERISTIC
/begin CHARACTERISTIC KL_IGOUWIGOB23 "Offset auf obere Uebersetzungschwelle bei Schaltung" CURVE 0x2612DC kl_ui16_S6_S3 65.535 UMR___1_1000_0_S6_S3 0 65.535
 /begin AXIS_DESCR STD_AXIS zff_atsys._.iSignale._.obj.sig_n_ab UMR_U_MIN_1_1_0_S6_S3 8 0 8160 DEPOSIT ABSOLUTE MONOTONY MON_INCREASE /end AXIS_DESCR
/end CHARACTERISTIC
/begin CHARACTERISTIC KL_IGOUWIGUN23 "Offset auf untere Uebersetzungschwelle bei Schaltung" CURVE 0x261300 kl_ui16_S6_S3 65.535 UMR___1_1000_0_S6_S3 0 65.535
 /begin AXIS_DESCR STD_AXIS zff_atsys._.iSignale._.obj.sig_n_ab UMR_U_MIN_1_1_0_S6_S3 8 0 8160 DEPOSIT ABSOLUTE MONOTONY MON_INCREASE /end AXIS_DESCR
/end CHARACTERISTIC
/begin CHARACTERISTIC MAX_STOER_OFFSET23 "Offset fuer Anz. Stoerungen bis ein Symptom ausgeloest wird, wenn bei Schltg. ein Sollmomentgradient unterschritten wird" VALUE 0x26EA37 kw_ui8_S6_S3 255 UMR___1_1_0_S6_S3 0 255 /end CHARACTERISTIC
/begin CHARACTERISTIC MAX_SYM_UWIG_SCHALT23 "Maximale Anzahl Symptome fuer Schaltung in der UWIG" VALUE 0x26EA38 kw_ui8_S6_S3 254 UMR___1_1_0_S6_S3 1 255 /end CHARACTERISTIC
/begin CHARACTERISTIC NGS_ABUWIG23 "n_ab-Gradientenschwelle fuer Symptomerkennung waehrend Schaltung" VALUE 0x26DFDE kw_si16_S6_S3 25000 UMR_U_MINSEC_1_1_0_S6_S3 -20000 5000 /end CHARACTERISTIC
/begin CHARACTERISTIC T_VNGABUWIG23 "Verzoegerungszeit nach Ueberschreiten NGS_ABUWIGxy-Schwelle waehrend Schaltung" VALUE 0x26EA39 kw_ui8_S6_S3 1000 UMR_MSEC__10_1_0_S6_S3 0 1000 /end CHARACTERISTIC
/begin CHARACTERISTIC T_VUWIG23 "Verzoegerungszeit nach Reglerstart bei Schaltung" VALUE 0x26EA3A kw_ui8_S6_S3 2540 UMR_MSEC__10_1_0_S6_S3 0 2540 /end CHARACTERISTIC
/begin CHARACTERISTIC KL_IGOUWIGOB34 "Offset auf obere Uebersetzungschwelle bei Schaltung" CURVE 0x261324 kl_ui16_S6_S3 65.535 UMR___1_1000_0_S6_S3 0 65.535
 /begin AXIS_DESCR STD_AXIS zff_atsys._.iSignale._.obj.sig_n_ab UMR_U_MIN_1_1_0_S6_S3 8 0 8160 DEPOSIT ABSOLUTE MONOTONY MON_INCREASE /end AXIS_DESCR
/end CHARACTERISTIC
/begin CHARACTERISTIC KL_IGOUWIGUN34 "Offset auf untere Uebersetzungschwelle bei Schaltung" CURVE 0x261348 kl_ui16_S6_S3 65.535 UMR___1_1000_0_S6_S3 0 65.535
 /begin AXIS_DESCR STD_AXIS zff_atsys._.iSignale._.obj.sig_n_ab UMR_U_MIN_1_1_0_S6_S3 8 0 8160 DEPOSIT ABSOLUTE MONOTONY MON_INCREASE /end AXIS_DESCR
/end CHARACTERISTIC
/begin CHARACTERISTIC MAX_STOER_OFFSET34 "Offset fuer Anz. Stoerungen bis ein Symptom ausgeloest wird, wenn bei Schltg. ein Sollmomentgradient unterschritten wird" VALUE 0x26EA3B kw_ui8_S6_S3 255 UMR___1_1_0_S6_S3 0 255 /end CHARACTERISTIC
/begin CHARACTERISTIC MAX_SYM_UWIG_SCHALT34 "Maximale Anzahl Symptome fuer Schaltung in der UWIG" VALUE 0x26EA3C kw_ui8_S6_S3 254 UMR___1_1_0_S6_S3 1 255 /end CHARACTERISTIC
/begin CHARACTERISTIC NGS_ABUWIG34 "n_ab-Gradientenschwelle fuer Symptomerkennung waehrend Schaltung" VALUE 0x26DFE0 kw_si16_S6_S3 25000 UMR_U_MINSEC_1_1_0_S6_S3 -20000 5000 /end CHARACTERISTIC
/begin CHARACTERISTIC T_VNGABUWIG34 "Verzoegerungszeit nach Ueberschreiten NGS_ABUWIGxy-Schwelle waehrend Schaltung" VALUE 0x26EA3D kw_ui8_S6_S3 1000 UMR_MSEC__10_1_0_S6_S3 0 1000 /end CHARACTERISTIC
/begin CHARACTERISTIC T_VUWIG34 "Verzoegerungszeit nach Reglerstart bei Schaltung" VALUE 0x26EA3E kw_ui8_S6_S3 2540 UMR_MSEC__10_1_0_S6_S3 0 2540 /end CHARACTERISTIC
/begin CHARACTERISTIC KL_IGOUWIGOB45 "Offset auf obere Uebersetzungschwelle bei Schaltung" CURVE 0x26136C kl_ui16_S6_S3 65.535 UMR___1_1000_0_S6_S3 0 65.535
 /begin AXIS_DESCR STD_AXIS zff_atsys._.iSignale._.obj.sig_n_ab UMR_U_MIN_1_1_0_S6_S3 8 0 8160 DEPOSIT ABSOLUTE MONOTONY MON_INCREASE /end AXIS_DESCR
/end CHARACTERISTIC
/begin CHARACTERISTIC KL_IGOUWIGUN45 "Offset auf untere Uebersetzungschwelle bei Schaltung" CURVE 0x261390 kl_ui16_S6_S3 65.535 UMR___1_1000_0_S6_S3 0 65.535
 /begin AXIS_DESCR STD_AXIS zff_atsys._.iSignale._.obj.sig_n_ab UMR_U_MIN_1_1_0_S6_S3 8 0 8160 DEPOSIT ABSOLUTE MONOTONY MON_INCREASE /end AXIS_DESCR
/end CHARACTERISTIC
/begin CHARACTERISTIC MAX_STOER_OFFSET45 "Offset fuer Anz. Stoerungen bis ein Symptom ausgeloest wird, wenn bei Schltg. ein Sollmomentgradient unterschritten wird" VALUE 0x26EA3F kw_ui8_S6_S3 255 UMR___1_1_0_S6_S3 0 255 /end CHARACTERISTIC
/begin CHARACTERISTIC MAX_SYM_UWIG_SCHALT45 "Maximale Anzahl Symptome fuer Schaltung in der UWIG" VALUE 0x26EA40 kw_ui8_S6_S3 254 UMR___1_1_0_S6_S3 1 255 /end CHARACTERISTIC
/begin CHARACTERISTIC NGS_ABUWIG45 "n_ab-Gradientenschwelle fuer Symptomerkennung waehrend Schaltung" VALUE 0x26DFE2 kw_si16_S6_S3 25000 UMR_U_MINSEC_1_1_0_S6_S3 -20000 5000 /end CHARACTERISTIC
/begin CHARACTERISTIC T_VNGABUWIG45 "Verzoegerungszeit nach Ueberschreiten NGS_ABUWIGxy-Schwelle waehrend Schaltung" VALUE 0x26EA41 kw_ui8_S6_S3 1000 UMR_MSEC__10_1_0_S6_S3 0 1000 /end CHARACTERISTIC
/begin CHARACTERISTIC T_VUWIG45 "Verzoegerungszeit nach Reglerstart bei Schaltung" VALUE 0x26EA42 kw_ui8_S6_S3 2540 UMR_MSEC__10_1_0_S6_S3 0 2540 /end CHARACTERISTIC
/begin CHARACTERISTIC KL_IGOUWIGOB56 "Offset auf obere Uebersetzungschwelle bei Schaltung" CURVE 0x2613B4 kl_ui16_S6_S3 65.535 UMR___1_1000_0_S6_S3 0 65.535
 /begin AXIS_DESCR STD_AXIS zff_atsys._.iSignale._.obj.sig_n_ab UMR_U_MIN_1_1_0_S6_S3 8 0 8160 DEPOSIT ABSOLUTE MONOTONY MON_INCREASE /end AXIS_DESCR
/end CHARACTERISTIC
/begin CHARACTERISTIC KL_IGOUWIGUN56 "Offset auf untere Uebersetzungschwelle bei Schaltung" CURVE 0x2613D8 kl_ui16_S6_S3 65.535 UMR___1_1000_0_S6_S3 0 65.535
 /begin AXIS_DESCR STD_AXIS zff_atsys._.iSignale._.obj.sig_n_ab UMR_U_MIN_1_1_0_S6_S3 8 0 8160 DEPOSIT ABSOLUTE MONOTONY MON_INCREASE /end AXIS_DESCR
/end CHARACTERISTIC
/begin CHARACTERISTIC MAX_STOER_OFFSET56 "Offset fuer Anz. Stoerungen bis ein Symptom ausgeloest wird, wenn bei Schltg. ein Sollmomentgradient unterschritten wird" VALUE 0x26EA43 kw_ui8_S6_S3 255 UMR___1_1_0_S6_S3 0 255 /end CHARACTERISTIC
/begin CHARACTERISTIC MAX_SYM_UWIG_SCHALT56 "Maximale Anzahl Symptome fuer Schaltung in der UWIG" VALUE 0x26EA44 kw_ui8_S6_S3 254 UMR___1_1_0_S6_S3 1 255 /end CHARACTERISTIC
/begin CHARACTERISTIC NGS_ABUWIG56 "n_ab-Gradientenschwelle fuer Symptomerkennung waehrend Schaltung" VALUE 0x26DFE4 kw_si16_S6_S3 25000 UMR_U_MINSEC_1_1_0_S6_S3 -20000 5000 /end CHARACTERISTIC
/begin CHARACTERISTIC T_VNGABUWIG56 "Verzoegerungszeit nach Ueberschreiten NGS_ABUWIGxy-Schwelle waehrend Schaltung" VALUE 0x26EA45 kw_ui8_S6_S3 1000 UMR_MSEC__10_1_0_S6_S3 0 1000 /end CHARACTERISTIC
/begin CHARACTERISTIC T_VUWIG56 "Verzoegerungszeit nach Reglerstart bei Schaltung" VALUE 0x26EA46 kw_ui8_S6_S3 2540 UMR_MSEC__10_1_0_S6_S3 0 2540 /end CHARACTERISTIC
/begin CHARACTERISTIC KL_IGOUWIGOB67 "Offset auf obere Uebersetzungschwelle bei Schaltung" CURVE 0x2613FC kl_ui16_S6_S3 65.535 UMR___1_1000_0_S6_S3 0 65.535
 /begin AXIS_DESCR STD_AXIS zff_atsys._.iSignale._.obj.sig_n_ab UMR_U_MIN_1_1_0_S6_S3 8 0 8160 DEPOSIT ABSOLUTE MONOTONY MON_INCREASE /end AXIS_DESCR
/end CHARACTERISTIC
/begin CHARACTERISTIC KL_IGOUWIGUN67 "Offset auf untere Uebersetzungschwelle bei Schaltung" CURVE 0x261420 kl_ui16_S6_S3 65.535 UMR___1_1000_0_S6_S3 0 65.535
 /begin AXIS_DESCR STD_AXIS zff_atsys._.iSignale._.obj.sig_n_ab UMR_U_MIN_1_1_0_S6_S3 8 0 8160 DEPOSIT ABSOLUTE MONOTONY MON_INCREASE /end AXIS_DESCR
/end CHARACTERISTIC
/begin CHARACTERISTIC MAX_STOER_OFFSET67 "Offset fuer Anz. Stoerungen bis ein Symptom ausgeloest wird, wenn bei Schltg. ein Sollmomentgradient unterschritten wird" VALUE 0x26EA47 kw_ui8_S6_S3 255 UMR___1_1_0_S6_S3 0 255 /end CHARACTERISTIC
/begin CHARACTERISTIC MAX_SYM_UWIG_SCHALT67 "Maximale Anzahl Symptome fuer Schaltung in der UWIG" VALUE 0x26EA48 kw_ui8_S6_S3 254 UMR___1_1_0_S6_S3 1 255 /end CHARACTERISTIC
/begin CHARACTERISTIC NGS_ABUWIG67 "n_ab-Gradientenschwelle fuer Symptomerkennung waehrend Schaltung" VALUE 0x26DFE6 kw_si16_S6_S3 25000 UMR_U_MINSEC_1_1_0_S6_S3 -20000 5000 /end CHARACTERISTIC
/begin CHARACTERISTIC T_VNGABUWIG67 "Verzoegerungszeit nach Ueberschreiten NGS_ABUWIGxy-Schwelle waehrend Schaltung" VALUE 0x26EA49 kw_ui8_S6_S3 1000 UMR_MSEC__10_1_0_S6_S3 0 1000 /end CHARACTERISTIC
/begin CHARACTERISTIC T_VUWIG67 "Verzoegerungszeit nach Reglerstart bei Schaltung" VALUE 0x26EA4A kw_ui8_S6_S3 2540 UMR_MSEC__10_1_0_S6_S3 0 2540 /end CHARACTERISTIC
/begin CHARACTERISTIC KL_IGOUWIGOB78 "Offset auf obere Uebersetzungschwelle bei Schaltung" CURVE 0x261444 kl_ui16_S6_S3 65.535 UMR___1_1000_0_S6_S3 0 65.535
 /begin AXIS_DESCR STD_AXIS zff_atsys._.iSignale._.obj.sig_n_ab UMR_U_MIN_1_1_0_S6_S3 8 0 8160 DEPOSIT ABSOLUTE MONOTONY MON_INCREASE /end AXIS_DESCR
/end CHARACTERISTIC
/begin CHARACTERISTIC KL_IGOUWIGUN78 "Offset auf untere Uebersetzungschwelle bei Schaltung" CURVE 0x261468 kl_ui16_S6_S3 65.535 UMR___1_1000_0_S6_S3 0 65.535
 /begin AXIS_DESCR STD_AXIS zff_atsys._.iSignale._.obj.sig_n_ab UMR_U_MIN_1_1_0_S6_S3 8 0 8160 DEPOSIT ABSOLUTE MONOTONY MON_INCREASE /end AXIS_DESCR
/end CHARACTERISTIC
/begin CHARACTERISTIC MAX_STOER_OFFSET78 "Offset fuer Anz. Stoerungen bis ein Symptom ausgeloest wird, wenn bei Schltg. ein Sollmomentgradient unterschritten wird" VALUE 0x26EA4B kw_ui8_S6_S3 255 UMR___1_1_0_S6_S3 0 255 /end CHARACTERISTIC
/begin CHARACTERISTIC MAX_SYM_UWIG_SCHALT78 "Maximale Anzahl Symptome fuer Schaltung in der UWIG" VALUE 0x26EA4C kw_ui8_S6_S3 254 UMR___1_1_0_S6_S3 1 255 /end CHARACTERISTIC
/begin CHARACTERISTIC NGS_ABUWIG78 "n_ab-Gradientenschwelle fuer Symptomerkennung waehrend Schaltung" VALUE 0x26DFE8 kw_si16_S6_S3 25000 UMR_U_MINSEC_1_1_0_S6_S3 -20000 5000 /end CHARACTERISTIC
/begin CHARACTERISTIC T_VNGABUWIG78 "Verzoegerungszeit nach Ueberschreiten NGS_ABUWIGxy-Schwelle waehrend Schaltung" VALUE 0x26EA4D kw_ui8_S6_S3 1000 UMR_MSEC__10_1_0_S6_S3 0 1000 /end CHARACTERISTIC
/begin CHARACTERISTIC T_VUWIG78 "Verzoegerungszeit nach Reglerstart bei Schaltung" VALUE 0x26EA4E kw_ui8_S6_S3 2540 UMR_MSEC__10_1_0_S6_S3 0 2540 /end CHARACTERISTIC
/begin CHARACTERISTIC KL_IGOUWIGOB13 "Offset auf obere Uebersetzungschwelle bei Schaltung" CURVE 0x26148C kl_ui16_S6_S3 65.535 UMR___1_1000_0_S6_S3 0 65.535
 /begin AXIS_DESCR STD_AXIS zff_atsys._.iSignale._.obj.sig_n_ab UMR_U_MIN_1_1_0_S6_S3 8 0 8160 DEPOSIT ABSOLUTE MONOTONY MON_INCREASE /end AXIS_DESCR
/end CHARACTERISTIC
/begin CHARACTERISTIC KL_IGOUWIGUN13 "Offset auf untere Uebersetzungschwelle bei Schaltung" CURVE 0x2614B0 kl_ui16_S6_S3 65.535 UMR___1_1000_0_S6_S3 0 65.535
 /begin AXIS_DESCR STD_AXIS zff_atsys._.iSignale._.obj.sig_n_ab UMR_U_MIN_1_1_0_S6_S3 8 0 8160 DEPOSIT ABSOLUTE MONOTONY MON_INCREASE /end AXIS_DESCR
/end CHARACTERISTIC
/begin CHARACTERISTIC MAX_STOER_OFFSET13 "Offset fuer Anz. Stoerungen bis ein Symptom ausgeloest wird, wenn bei Schltg. ein Sollmomentgradient unterschritten wird" VALUE 0x26EA4F kw_ui8_S6_S3 255 UMR___1_1_0_S6_S3 0 255 /end CHARACTERISTIC
/begin CHARACTERISTIC MAX_SYM_UWIG_SCHALT13 "Maximale Anzahl Symptome fuer Schaltung in der UWIG" VALUE 0x26EA50 kw_ui8_S6_S3 254 UMR___1_1_0_S6_S3 1 255 /end CHARACTERISTIC
/begin CHARACTERISTIC NGS_ABUWIG13 "n_ab-Gradientenschwelle fuer Symptomerkennung waehrend Schaltung" VALUE 0x26DFEA kw_si16_S6_S3 25000 UMR_U_MINSEC_1_1_0_S6_S3 -20000 5000 /end CHARACTERISTIC
/begin CHARACTERISTIC T_VNGABUWIG13 "Verzoegerungszeit nach Ueberschreiten NGS_ABUWIGxy-Schwelle waehrend Schaltung" VALUE 0x26EA51 kw_ui8_S6_S3 1000 UMR_MSEC__10_1_0_S6_S3 0 1000 /end CHARACTERISTIC
/begin CHARACTERISTIC T_VUWIG13 "Verzoegerungszeit nach Reglerstart bei Schaltung" VALUE 0x26EA52 kw_ui8_S6_S3 2540 UMR_MSEC__10_1_0_S6_S3 0 2540 /end CHARACTERISTIC
/begin CHARACTERISTIC KL_IGOUWIGOB24 "Offset auf obere Uebersetzungschwelle bei Schaltung" CURVE 0x2614D4 kl_ui16_S6_S3 65.535 UMR___1_1000_0_S6_S3 0 65.535
 /begin AXIS_DESCR STD_AXIS zff_atsys._.iSignale._.obj.sig_n_ab UMR_U_MIN_1_1_0_S6_S3 8 0 8160 DEPOSIT ABSOLUTE MONOTONY MON_INCREASE /end AXIS_DESCR
/end CHARACTERISTIC
/begin CHARACTERISTIC KL_IGOUWIGUN24 "Offset auf untere Uebersetzungschwelle bei Schaltung" CURVE 0x2614F8 kl_ui16_S6_S3 65.535 UMR___1_1000_0_S6_S3 0 65.535
 /begin AXIS_DESCR STD_AXIS zff_atsys._.iSignale._.obj.sig_n_ab UMR_U_MIN_1_1_0_S6_S3 8 0 8160 DEPOSIT ABSOLUTE MONOTONY MON_INCREASE /end AXIS_DESCR
/end CHARACTERISTIC
/begin CHARACTERISTIC MAX_STOER_OFFSET24 "Offset fuer Anz. Stoerungen bis ein Symptom ausgeloest wird, wenn bei Schltg. ein Sollmomentgradient unterschritten wird" VALUE 0x26EA53 kw_ui8_S6_S3 255 UMR___1_1_0_S6_S3 0 255 /end CHARACTERISTIC
/begin CHARACTERISTIC MAX_SYM_UWIG_SCHALT24 "Maximale Anzahl Symptome fuer Schaltung in der UWIG" VALUE 0x26EA54 kw_ui8_S6_S3 254 UMR___1_1_0_S6_S3 1 255 /end CHARACTERISTIC
/begin CHARACTERISTIC NGS_ABUWIG24 "n_ab-Gradientenschwelle fuer Symptomerkennung waehrend Schaltung" VALUE 0x26DFEC kw_si16_S6_S3 25000 UMR_U_MINSEC_1_1_0_S6_S3 -20000 5000 /end CHARACTERISTIC
/begin CHARACTERISTIC T_VNGABUWIG24 "Verzoegerungszeit nach Ueberschreiten NGS_ABUWIGxy-Schwelle waehrend Schaltung" VALUE 0x26EA55 kw_ui8_S6_S3 1000 UMR_MSEC__10_1_0_S6_S3 0 1000 /end CHARACTERISTIC
/begin CHARACTERISTIC T_VUWIG24 "Verzoegerungszeit nach Reglerstart bei Schaltung" VALUE 0x26EA56 kw_ui8_S6_S3 2540 UMR_MSEC__10_1_0_S6_S3 0 2540 /end CHARACTERISTIC
/begin CHARACTERISTIC KL_IGOUWIGOB35 "Offset auf obere Uebersetzungschwelle bei Schaltung" CURVE 0x26151C kl_ui16_S6_S3 65.535 UMR___1_1000_0_S6_S3 0 65.535
 /begin AXIS_DESCR STD_AXIS zff_atsys._.iSignale._.obj.sig_n_ab UMR_U_MIN_1_1_0_S6_S3 8 0 8160 DEPOSIT ABSOLUTE MONOTONY MON_INCREASE /end AXIS_DESCR
/end CHARACTERISTIC
/begin CHARACTERISTIC KL_IGOUWIGUN35 "Offset auf untere Uebersetzungschwelle bei Schaltung" CURVE 0x261540 kl_ui16_S6_S3 65.535 UMR___1_1000_0_S6_S3 0 65.535
 /begin AXIS_DESCR STD_AXIS zff_atsys._.iSignale._.obj.sig_n_ab UMR_U_MIN_1_1_0_S6_S3 8 0 8160 DEPOSIT ABSOLUTE MONOTONY MON_INCREASE /end AXIS_DESCR
/end CHARACTERISTIC
/begin CHARACTERISTIC MAX_STOER_OFFSET35 "Offset fuer Anz. Stoerungen bis ein Symptom ausgeloest wird, wenn bei Schltg. ein Sollmomentgradient unterschritten wird" VALUE 0x26EA57 kw_ui8_S6_S3 255 UMR___1_1_0_S6_S3 0 255 /end CHARACTERISTIC
/begin CHARACTERISTIC MAX_SYM_UWIG_SCHALT35 "Maximale Anzahl Symptome fuer Schaltung in der UWIG" VALUE 0x26EA58 kw_ui8_S6_S3 254 UMR___1_1_0_S6_S3 1 255 /end CHARACTERISTIC
/begin CHARACTERISTIC NGS_ABUWIG35 "n_ab-Gradientenschwelle fuer Symptomerkennung waehrend Schaltung" VALUE 0x26DFEE kw_si16_S6_S3 25000 UMR_U_MINSEC_1_1_0_S6_S3 -20000 5000 /end CHARACTERISTIC
/begin CHARACTERISTIC T_VNGABUWIG35 "Verzoegerungszeit nach Ueberschreiten NGS_ABUWIGxy-Schwelle waehrend Schaltung" VALUE 0x26EA59 kw_ui8_S6_S3 1000 UMR_MSEC__10_1_0_S6_S3 0 1000 /end CHARACTERISTIC
/begin CHARACTERISTIC T_VUWIG35 "Verzoegerungszeit nach Reglerstart bei Schaltung" VALUE 0x26EA5A kw_ui8_S6_S3 2540 UMR_MSEC__10_1_0_S6_S3 0 2540 /end CHARACTERISTIC
/begin CHARACTERISTIC KL_IGOUWIGOB46 "Offset auf obere Uebersetzungschwelle bei Schaltung" CURVE 0x261564 kl_ui16_S6_S3 65.535 UMR___1_1000_0_S6_S3 0 65.535
 /begin AXIS_DESCR STD_AXIS zff_atsys._.iSignale._.obj.sig_n_ab UMR_U_MIN_1_1_0_S6_S3 8 0 8160 DEPOSIT ABSOLUTE MONOTONY MON_INCREASE /end AXIS_DESCR
/end CHARACTERISTIC
/begin CHARACTERISTIC KL_IGOUWIGUN46 "Offset auf untere Uebersetzungschwelle bei Schaltung" CURVE 0x261588 kl_ui16_S6_S3 65.535 UMR___1_1000_0_S6_S3 0 65.535
 /begin AXIS_DESCR STD_AXIS zff_atsys._.iSignale._.obj.sig_n_ab UMR_U_MIN_1_1_0_S6_S3 8 0 8160 DEPOSIT ABSOLUTE MONOTONY MON_INCREASE /end AXIS_DESCR
/end CHARACTERISTIC
/begin CHARACTERISTIC MAX_STOER_OFFSET46 "Offset fuer Anz. Stoerungen bis ein Symptom ausgeloest wird, wenn bei Schltg. ein Sollmomentgradient unterschritten wird" VALUE 0x26EA5B kw_ui8_S6_S3 255 UMR___1_1_0_S6_S3 0 255 /end CHARACTERISTIC
/begin CHARACTERISTIC MAX_SYM_UWIG_SCHALT46 "Maximale Anzahl Symptome fuer Schaltung in der UWIG" VALUE 0x26EA5C kw_ui8_S6_S3 254 UMR___1_1_0_S6_S3 1 255 /end CHARACTERISTIC
/begin CHARACTERISTIC NGS_ABUWIG46 "n_ab-Gradientenschwelle fuer Symptomerkennung waehrend Schaltung" VALUE 0x26DFF0 kw_si16_S6_S3 25000 UMR_U_MINSEC_1_1_0_S6_S3 -20000 5000 /end CHARACTERISTIC
/begin CHARACTERISTIC T_VNGABUWIG46 "Verzoegerungszeit nach Ueberschreiten NGS_ABUWIGxy-Schwelle waehrend Schaltung" VALUE 0x26EA5D kw_ui8_S6_S3 1000 UMR_MSEC__10_1_0_S6_S3 0 1000 /end CHARACTERISTIC
/begin CHARACTERISTIC T_VUWIG46 "Verzoegerungszeit nach Reglerstart bei Schaltung" VALUE 0x26EA5E kw_ui8_S6_S3 2540 UMR_MSEC__10_1_0_S6_S3 0 2540 /end CHARACTERISTIC
/begin CHARACTERISTIC KL_IGOUWIGOB57 "Offset auf obere Uebersetzungschwelle bei Schaltung" CURVE 0x2615AC kl_ui16_S6_S3 65.535 UMR___1_1000_0_S6_S3 0 65.535
 /begin AXIS_DESCR STD_AXIS zff_atsys._.iSignale._.obj.sig_n_ab UMR_U_MIN_1_1_0_S6_S3 8 0 8160 DEPOSIT ABSOLUTE MONOTONY MON_INCREASE /end AXIS_DESCR
/end CHARACTERISTIC
/begin CHARACTERISTIC KL_IGOUWIGUN57 "Offset auf untere Uebersetzungschwelle bei Schaltung" CURVE 0x2615D0 kl_ui16_S6_S3 65.535 UMR___1_1000_0_S6_S3 0 65.535
 /begin AXIS_DESCR STD_AXIS zff_atsys._.iSignale._.obj.sig_n_ab UMR_U_MIN_1_1_0_S6_S3 8 0 8160 DEPOSIT ABSOLUTE MONOTONY MON_INCREASE /end AXIS_DESCR
/end CHARACTERISTIC
/begin CHARACTERISTIC MAX_STOER_OFFSET57 "Offset fuer Anz. Stoerungen bis ein Symptom ausgeloest wird, wenn bei Schltg. ein Sollmomentgradient unterschritten wird" VALUE 0x26EA5F kw_ui8_S6_S3 255 UMR___1_1_0_S6_S3 0 255 /end CHARACTERISTIC
/begin CHARACTERISTIC MAX_SYM_UWIG_SCHALT57 "Maximale Anzahl Symptome fuer Schaltung in der UWIG" VALUE 0x26EA60 kw_ui8_S6_S3 254 UMR___1_1_0_S6_S3 1 255 /end CHARACTERISTIC
/begin CHARACTERISTIC NGS_ABUWIG57 "n_ab-Gradientenschwelle fuer Symptomerkennung waehrend Schaltung" VALUE 0x26DFF2 kw_si16_S6_S3 25000 UMR_U_MINSEC_1_1_0_S6_S3 -20000 5000 /end CHARACTERISTIC
/begin CHARACTERISTIC T_VNGABUWIG57 "Verzoegerungszeit nach Ueberschreiten NGS_ABUWIGxy-Schwelle waehrend Schaltung" VALUE 0x26EA61 kw_ui8_S6_S3 1000 UMR_MSEC__10_1_0_S6_S3 0 1000 /end CHARACTERISTIC
/begin CHARACTERISTIC T_VUWIG57 "Verzoegerungszeit nach Reglerstart bei Schaltung" VALUE 0x26EA62 kw_ui8_S6_S3 2540 UMR_MSEC__10_1_0_S6_S3 0 2540 /end CHARACTERISTIC
/begin CHARACTERISTIC KL_IGOUWIGOB68 "Offset auf obere Uebersetzungschwelle bei Schaltung" CURVE 0x2615F4 kl_ui16_S6_S3 65.535 UMR___1_1000_0_S6_S3 0 65.535
 /begin AXIS_DESCR STD_AXIS zff_atsys._.iSignale._.obj.sig_n_ab UMR_U_MIN_1_1_0_S6_S3 8 0 8160 DEPOSIT ABSOLUTE MONOTONY MON_INCREASE /end AXIS_DESCR
/end CHARACTERISTIC
/begin CHARACTERISTIC KL_IGOUWIGUN68 "Offset auf untere Uebersetzungschwelle bei Schaltung" CURVE 0x261618 kl_ui16_S6_S3 65.535 UMR___1_1000_0_S6_S3 0 65.535
 /begin AXIS_DESCR STD_AXIS zff_atsys._.iSignale._.obj.sig_n_ab UMR_U_MIN_1_1_0_S6_S3 8 0 8160 DEPOSIT ABSOLUTE MONOTONY MON_INCREASE /end AXIS_DESCR
/end CHARACTERISTIC
/begin CHARACTERISTIC MAX_STOER_OFFSET68 "Offset fuer Anz. Stoerungen bis ein Symptom ausgeloest wird, wenn bei Schltg. ein Sollmomentgradient unterschritten wird" VALUE 0x26EA63 kw_ui8_S6_S3 255 UMR___1_1_0_S6_S3 0 255 /end CHARACTERISTIC
/begin CHARACTERISTIC MAX_SYM_UWIG_SCHALT68 "Maximale Anzahl Symptome fuer Schaltung in der UWIG" VALUE 0x26EA64 kw_ui8_S6_S3 254 UMR___1_1_0_S6_S3 1 255 /end CHARACTERISTIC
/begin CHARACTERISTIC NGS_ABUWIG68 "n_ab-Gradientenschwelle fuer Symptomerkennung waehrend Schaltung" VALUE 0x26DFF4 kw_si16_S6_S3 25000 UMR_U_MINSEC_1_1_0_S6_S3 -20000 5000 /end CHARACTERISTIC
/begin CHARACTERISTIC T_VNGABUWIG68 "Verzoegerungszeit nach Ueberschreiten NGS_ABUWIGxy-Schwelle waehrend Schaltung" VALUE 0x26EA65 kw_ui8_S6_S3 1000 UMR_MSEC__10_1_0_S6_S3 0 1000 /end CHARACTERISTIC
/begin CHARACTERISTIC T_VUWIG68 "Verzoegerungszeit nach Reglerstart bei Schaltung" VALUE 0x26EA66 kw_ui8_S6_S3 2540 UMR_MSEC__10_1_0_S6_S3 0 2540 /end CHARACTERISTIC
/begin CHARACTERISTIC KL_IGOUWIGOB21 "Offset auf obere Uebersetzungschwelle bei Schaltung" CURVE 0x26163C kl_ui16_S6_S3 65.535 UMR___1_1000_0_S6_S3 0 65.535
 /begin AXIS_DESCR STD_AXIS zff_atsys._.iSignale._.obj.sig_n_ab UMR_U_MIN_1_1_0_S6_S3 8 0 8160 DEPOSIT ABSOLUTE MONOTONY MON_INCREASE /end AXIS_DESCR
/end CHARACTERISTIC
/begin CHARACTERISTIC KL_IGOUWIGUN21 "Offset auf untere Uebersetzungschwelle bei Schaltung" CURVE 0x261660 kl_ui16_S6_S3 65.535 UMR___1_1000_0_S6_S3 0 65.535
 /begin AXIS_DESCR STD_AXIS zff_atsys._.iSignale._.obj.sig_n_ab UMR_U_MIN_1_1_0_S6_S3 8 0 8160 DEPOSIT ABSOLUTE MONOTONY MON_INCREASE /end AXIS_DESCR
/end CHARACTERISTIC
/begin CHARACTERISTIC MAX_STOER_OFFSET21 "Offset fuer Anz. Stoerungen bis ein Symptom ausgeloest wird, wenn bei Schltg. ein Sollmomentgradient unterschritten wird" VALUE 0x26EA67 kw_ui8_S6_S3 255 UMR___1_1_0_S6_S3 0 255 /end CHARACTERISTIC
/begin CHARACTERISTIC MAX_SYM_UWIG_SCHALT21 "Maximale Anzahl Symptome fuer Schaltung in der UWIG" VALUE 0x26EA68 kw_ui8_S6_S3 254 UMR___1_1_0_S6_S3 1 255 /end CHARACTERISTIC
/begin CHARACTERISTIC NGS_ABUWIG21 "n_ab-Gradientenschwelle fuer Symptomerkennung waehrend Schaltung" VALUE 0x26DFF6 kw_si16_S6_S3 25000 UMR_U_MINSEC_1_1_0_S6_S3 -20000 5000 /end CHARACTERISTIC
/begin CHARACTERISTIC T_VNGABUWIG21 "Verzoegerungszeit nach Ueberschreiten NGS_ABUWIGxy-Schwelle waehrend Schaltung" VALUE 0x26EA69 kw_ui8_S6_S3 1000 UMR_MSEC__10_1_0_S6_S3 0 1000 /end CHARACTERISTIC
/begin CHARACTERISTIC T_VUWIG21 "Verzoegerungszeit nach Reglerstart bei Schaltung" VALUE 0x26EA6A kw_ui8_S6_S3 2540 UMR_MSEC__10_1_0_S6_S3 0 2540 /end CHARACTERISTIC
/begin CHARACTERISTIC KL_IGOUWIGOB32 "Offset auf obere Uebersetzungschwelle bei Schaltung" CURVE 0x261684 kl_ui16_S6_S3 65.535 UMR___1_1000_0_S6_S3 0 65.535
 /begin AXIS_DESCR STD_AXIS zff_atsys._.iSignale._.obj.sig_n_ab UMR_U_MIN_1_1_0_S6_S3 8 0 8160 DEPOSIT ABSOLUTE MONOTONY MON_INCREASE /end AXIS_DESCR
/end CHARACTERISTIC
/begin CHARACTERISTIC KL_IGOUWIGUN32 "Offset auf untere Uebersetzungschwelle bei Schaltung" CURVE 0x2616A8 kl_ui16_S6_S3 65.535 UMR___1_1000_0_S6_S3 0 65.535
 /begin AXIS_DESCR STD_AXIS zff_atsys._.iSignale._.obj.sig_n_ab UMR_U_MIN_1_1_0_S6_S3 8 0 8160 DEPOSIT ABSOLUTE MONOTONY MON_INCREASE /end AXIS_DESCR
/end CHARACTERISTIC
/begin CHARACTERISTIC MAX_STOER_OFFSET32 "Offset fuer Anz. Stoerungen bis ein Symptom ausgeloest wird, wenn bei Schltg. ein Sollmomentgradient unterschritten wird" VALUE 0x26EA6B kw_ui8_S6_S3 255 UMR___1_1_0_S6_S3 0 255 /end CHARACTERISTIC
/begin CHARACTERISTIC MAX_SYM_UWIG_SCHALT32 "Maximale Anzahl Symptome fuer Schaltung in der UWIG" VALUE 0x26EA6C kw_ui8_S6_S3 254 UMR___1_1_0_S6_S3 1 255 /end CHARACTERISTIC
/begin CHARACTERISTIC NGS_ABUWIG32 "n_ab-Gradientenschwelle fuer Symptomerkennung waehrend Schaltung" VALUE 0x26DFF8 kw_si16_S6_S3 25000 UMR_U_MINSEC_1_1_0_S6_S3 -20000 5000 /end CHARACTERISTIC
/begin CHARACTERISTIC T_VNGABUWIG32 "Verzoegerungszeit nach Ueberschreiten NGS_ABUWIGxy-Schwelle waehrend Schaltung" VALUE 0x26EA6D kw_ui8_S6_S3 1000 UMR_MSEC__10_1_0_S6_S3 0 1000 /end CHARACTERISTIC
/begin CHARACTERISTIC T_VUWIG32 "Verzoegerungszeit nach Reglerstart bei Schaltung" VALUE 0x26EA6E kw_ui8_S6_S3 2540 UMR_MSEC__10_1_0_S6_S3 0 2540 /end CHARACTERISTIC
/begin CHARACTERISTIC KL_IGOUWIGOB43 "Offset auf obere Uebersetzungschwelle bei Schaltung" CURVE 0x2616CC kl_ui16_S6_S3 65.535 UMR___1_1000_0_S6_S3 0 65.535
 /begin AXIS_DESCR STD_AXIS zff_atsys._.iSignale._.obj.sig_n_ab UMR_U_MIN_1_1_0_S6_S3 8 0 8160 DEPOSIT ABSOLUTE MONOTONY MON_INCREASE /end AXIS_DESCR
/end CHARACTERISTIC
/begin CHARACTERISTIC KL_IGOUWIGUN43 "Offset auf untere Uebersetzungschwelle bei Schaltung" CURVE 0x2616F0 kl_ui16_S6_S3 65.535 UMR___1_1000_0_S6_S3 0 65.535
 /begin AXIS_DESCR STD_AXIS zff_atsys._.iSignale._.obj.sig_n_ab UMR_U_MIN_1_1_0_S6_S3 8 0 8160 DEPOSIT ABSOLUTE MONOTONY MON_INCREASE /end AXIS_DESCR
/end CHARACTERISTIC
/begin CHARACTERISTIC MAX_STOER_OFFSET43 "Offset fuer Anz. Stoerungen bis ein Symptom ausgeloest wird, wenn bei Schltg. ein Sollmomentgradient unterschritten wird" VALUE 0x26EA6F kw_ui8_S6_S3 255 UMR___1_1_0_S6_S3 0 255 /end CHARACTERISTIC
/begin CHARACTERISTIC MAX_SYM_UWIG_SCHALT43 "Maximale Anzahl Symptome fuer Schaltung in der UWIG" VALUE 0x26EA70 kw_ui8_S6_S3 254 UMR___1_1_0_S6_S3 1 255 /end CHARACTERISTIC
/begin CHARACTERISTIC NGS_ABUWIG43 "n_ab-Gradientenschwelle fuer Symptomerkennung waehrend Schaltung" VALUE 0x26DFFA kw_si16_S6_S3 25000 UMR_U_MINSEC_1_1_0_S6_S3 -20000 5000 /end CHARACTERISTIC
/begin CHARACTERISTIC T_VNGABUWIG43 "Verzoegerungszeit nach Ueberschreiten NGS_ABUWIGxy-Schwelle waehrend Schaltung" VALUE 0x26EA71 kw_ui8_S6_S3 1000 UMR_MSEC__10_1_0_S6_S3 0 1000 /end CHARACTERISTIC
/begin CHARACTERISTIC T_VUWIG43 "Verzoegerungszeit nach Reglerstart bei Schaltung" VALUE 0x26EA72 kw_ui8_S6_S3 2540 UMR_MSEC__10_1_0_S6_S3 0 2540 /end CHARACTERISTIC
/begin CHARACTERISTIC KL_IGOUWIGOB54 "Offset auf obere Uebersetzungschwelle bei Schaltung" CURVE 0x261714 kl_ui16_S6_S3 65.535 UMR___1_1000_0_S6_S3 0 65.535
 /begin AXIS_DESCR STD_AXIS zff_atsys._.iSignale._.obj.sig_n_ab UMR_U_MIN_1_1_0_S6_S3 8 0 8160 DEPOSIT ABSOLUTE MONOTONY MON_INCREASE /end AXIS_DESCR
/end CHARACTERISTIC
/begin CHARACTERISTIC KL_IGOUWIGUN54 "Offset auf untere Uebersetzungschwelle bei Schaltung" CURVE 0x261738 kl_ui16_S6_S3 65.535 UMR___1_1000_0_S6_S3 0 65.535
 /begin AXIS_DESCR STD_AXIS zff_atsys._.iSignale._.obj.sig_n_ab UMR_U_MIN_1_1_0_S6_S3 8 0 8160 DEPOSIT ABSOLUTE MONOTONY MON_INCREASE /end AXIS_DESCR
/end CHARACTERISTIC
/begin CHARACTERISTIC MAX_STOER_OFFSET54 "Offset fuer Anz. Stoerungen bis ein Symptom ausgeloest wird, wenn bei Schltg. ein Sollmomentgradient unterschritten wird" VALUE 0x26EA73 kw_ui8_S6_S3 255 UMR___1_1_0_S6_S3 0 255 /end CHARACTERISTIC
/begin CHARACTERISTIC MAX_SYM_UWIG_SCHALT54 "Maximale Anzahl Symptome fuer Schaltung in der UWIG" VALUE 0x26EA74 kw_ui8_S6_S3 254 UMR___1_1_0_S6_S3 1 255 /end CHARACTERISTIC
/begin CHARACTERISTIC NGS_ABUWIG54 "n_ab-Gradientenschwelle fuer Symptomerkennung waehrend Schaltung" VALUE 0x26DFFC kw_si16_S6_S3 25000 UMR_U_MINSEC_1_1_0_S6_S3 -20000 5000 /end CHARACTERISTIC
/begin CHARACTERISTIC T_VNGABUWIG54 "Verzoegerungszeit nach Ueberschreiten NGS_ABUWIGxy-Schwelle waehrend Schaltung" VALUE 0x26EA75 kw_ui8_S6_S3 1000 UMR_MSEC__10_1_0_S6_S3 0 1000 /end CHARACTERISTIC
/begin CHARACTERISTIC T_VUWIG54 "Verzoegerungszeit nach Reglerstart bei Schaltung" VALUE 0x26EA76 kw_ui8_S6_S3 2540 UMR_MSEC__10_1_0_S6_S3 0 2540 /end CHARACTERISTIC
/begin CHARACTERISTIC KL_IGOUWIGOB65 "Offset auf obere Uebersetzungschwelle bei Schaltung" CURVE 0x26175C kl_ui16_S6_S3 65.535 UMR___1_1000_0_S6_S3 0 65.535
 /begin AXIS_DESCR STD_AXIS zff_atsys._.iSignale._.obj.sig_n_ab UMR_U_MIN_1_1_0_S6_S3 8 0 8160 DEPOSIT ABSOLUTE MONOTONY MON_INCREASE /end AXIS_DESCR
/end CHARACTERISTIC
/begin CHARACTERISTIC KL_IGOUWIGUN65 "Offset auf untere Uebersetzungschwelle bei Schaltung" CURVE 0x261780 kl_ui16_S6_S3 65.535 UMR___1_1000_0_S6_S3 0 65.535
 /begin AXIS_DESCR STD_AXIS zff_atsys._.iSignale._.obj.sig_n_ab UMR_U_MIN_1_1_0_S6_S3 8 0 8160 DEPOSIT ABSOLUTE MONOTONY MON_INCREASE /end AXIS_DESCR
/end CHARACTERISTIC
/begin CHARACTERISTIC MAX_STOER_OFFSET65 "Offset fuer Anz. Stoerungen bis ein Symptom ausgeloest wird, wenn bei Schltg. ein Sollmomentgradient unterschritten wird" VALUE 0x26EA77 kw_ui8_S6_S3 255 UMR___1_1_0_S6_S3 0 255 /end CHARACTERISTIC
/begin CHARACTERISTIC MAX_SYM_UWIG_SCHALT65 "Maximale Anzahl Symptome fuer Schaltung in der UWIG" VALUE 0x26EA78 kw_ui8_S6_S3 254 UMR___1_1_0_S6_S3 1 255 /end CHARACTERISTIC
/begin CHARACTERISTIC NGS_ABUWIG65 "n_ab-Gradientenschwelle fuer Symptomerkennung waehrend Schaltung" VALUE 0x26DFFE kw_si16_S6_S3 25000 UMR_U_MINSEC_1_1_0_S6_S3 -20000 5000 /end CHARACTERISTIC
/begin CHARACTERISTIC T_VNGABUWIG65 "Verzoegerungszeit nach Ueberschreiten NGS_ABUWIGxy-Schwelle waehrend Schaltung" VALUE 0x26EA79 kw_ui8_S6_S3 1000 UMR_MSEC__10_1_0_S6_S3 0 1000 /end CHARACTERISTIC
/begin CHARACTERISTIC T_VUWIG65 "Verzoegerungszeit nach Reglerstart bei Schaltung" VALUE 0x26EA7A kw_ui8_S6_S3 2540 UMR_MSEC__10_1_0_S6_S3 0 2540 /end CHARACTERISTIC
/begin CHARACTERISTIC KL_IGOUWIGOB76 "Offset auf obere Uebersetzungschwelle bei Schaltung" CURVE 0x2617A4 kl_ui16_S6_S3 65.535 UMR___1_1000_0_S6_S3 0 65.535
 /begin AXIS_DESCR STD_AXIS zff_atsys._.iSignale._.obj.sig_n_ab UMR_U_MIN_1_1_0_S6_S3 8 0 8160 DEPOSIT ABSOLUTE MONOTONY MON_INCREASE /end AXIS_DESCR
/end CHARACTERISTIC
/begin CHARACTERISTIC KL_IGOUWIGUN76 "Offset auf untere Uebersetzungschwelle bei Schaltung" CURVE 0x2617C8 kl_ui16_S6_S3 65.535 UMR___1_1000_0_S6_S3 0 65.535
 /begin AXIS_DESCR STD_AXIS zff_atsys._.iSignale._.obj.sig_n_ab UMR_U_MIN_1_1_0_S6_S3 8 0 8160 DEPOSIT ABSOLUTE MONOTONY MON_INCREASE /end AXIS_DESCR
/end CHARACTERISTIC
/begin CHARACTERISTIC MAX_STOER_OFFSET76 "Offset fuer Anz. Stoerungen bis ein Symptom ausgeloest wird, wenn bei Schltg. ein Sollmomentgradient unterschritten wird" VALUE 0x26EA7B kw_ui8_S6_S3 255 UMR___1_1_0_S6_S3 0 255 /end CHARACTERISTIC
/begin CHARACTERISTIC MAX_SYM_UWIG_SCHALT76 "Maximale Anzahl Symptome fuer Schaltung in der UWIG" VALUE 0x26EA7C kw_ui8_S6_S3 254 UMR___1_1_0_S6_S3 1 255 /end CHARACTERISTIC
/begin CHARACTERISTIC NGS_ABUWIG76 "n_ab-Gradientenschwelle fuer Symptomerkennung waehrend Schaltung" VALUE 0x26E000 kw_si16_S6_S3 25000 UMR_U_MINSEC_1_1_0_S6_S3 -20000 5000 /end CHARACTERISTIC
/begin CHARACTERISTIC T_VNGABUWIG76 "Verzoegerungszeit nach Ueberschreiten NGS_ABUWIGxy-Schwelle waehrend Schaltung" VALUE 0x26EA7D kw_ui8_S6_S3 1000 UMR_MSEC__10_1_0_S6_S3 0 1000 /end CHARACTERISTIC
/begin CHARACTERISTIC T_VUWIG76 "Verzoegerungszeit nach Reglerstart bei Schaltung" VALUE 0x26EA7E kw_ui8_S6_S3 2540 UMR_MSEC__10_1_0_S6_S3 0 2540 /end CHARACTERISTIC
/begin CHARACTERISTIC KL_IGOUWIGOB87 "Offset auf obere Uebersetzungschwelle bei Schaltung" CURVE 0x2617EC kl_ui16_S6_S3 65.535 UMR___1_1000_0_S6_S3 0 65.535
 /begin AXIS_DESCR STD_AXIS zff_atsys._.iSignale._.obj.sig_n_ab UMR_U_MIN_1_1_0_S6_S3 8 0 8160 DEPOSIT ABSOLUTE MONOTONY MON_INCREASE /end AXIS_DESCR
/end CHARACTERISTIC
/begin CHARACTERISTIC KL_IGOUWIGUN87 "Offset auf untere Uebersetzungschwelle bei Schaltung" CURVE 0x261810 kl_ui16_S6_S3 65.535 UMR___1_1000_0_S6_S3 0 65.535
 /begin AXIS_DESCR STD_AXIS zff_atsys._.iSignale._.obj.sig_n_ab UMR_U_MIN_1_1_0_S6_S3 8 0 8160 DEPOSIT ABSOLUTE MONOTONY MON_INCREASE /end AXIS_DESCR
/end CHARACTERISTIC
/begin CHARACTERISTIC MAX_STOER_OFFSET87 "Offset fuer Anz. Stoerungen bis ein Symptom ausgeloest wird, wenn bei Schltg. ein Sollmomentgradient unterschritten wird" VALUE 0x26EA7F kw_ui8_S6_S3 255 UMR___1_1_0_S6_S3 0 255 /end CHARACTERISTIC
/begin CHARACTERISTIC MAX_SYM_UWIG_SCHALT87 "Maximale Anzahl Symptome fuer Schaltung in der UWIG" VALUE 0x26EA80 kw_ui8_S6_S3 254 UMR___1_1_0_S6_S3 1 255 /end CHARACTERISTIC
/begin CHARACTERISTIC NGS_ABUWIG87 "n_ab-Gradientenschwelle fuer Symptomerkennung waehrend Schaltung" VALUE 0x26E002 kw_si16_S6_S3 25000 UMR_U_MINSEC_1_1_0_S6_S3 -20000 5000 /end CHARACTERISTIC
/begin CHARACTERISTIC T_VNGABUWIG87 "Verzoegerungszeit nach Ueberschreiten NGS_ABUWIGxy-Schwelle waehrend Schaltung" VALUE 0x26EA81 kw_ui8_S6_S3 1000 UMR_MSEC__10_1_0_S6_S3 0 1000 /end CHARACTERISTIC
/begin CHARACTERISTIC T_VUWIG87 "Verzoegerungszeit nach Reglerstart bei Schaltung" VALUE 0x26EA82 kw_ui8_S6_S3 2540 UMR_MSEC__10_1_0_S6_S3 0 2540 /end CHARACTERISTIC
/begin CHARACTERISTIC KL_IGOUWIGOB31 "Offset auf obere Uebersetzungschwelle bei Schaltung" CURVE 0x261834 kl_ui16_S6_S3 65.535 UMR___1_1000_0_S6_S3 0 65.535
 /begin AXIS_DESCR STD_AXIS zff_atsys._.iSignale._.obj.sig_n_ab UMR_U_MIN_1_1_0_S6_S3 8 0 8160 DEPOSIT ABSOLUTE MONOTONY MON_INCREASE /end AXIS_DESCR
/end CHARACTERISTIC
/begin CHARACTERISTIC KL_IGOUWIGUN31 "Offset auf untere Uebersetzungschwelle bei Schaltung" CURVE 0x261858 kl_ui16_S6_S3 65.535 UMR___1_1000_0_S6_S3 0 65.535
 /begin AXIS_DESCR STD_AXIS zff_atsys._.iSignale._.obj.sig_n_ab UMR_U_MIN_1_1_0_S6_S3 8 0 8160 DEPOSIT ABSOLUTE MONOTONY MON_INCREASE /end AXIS_DESCR
/end CHARACTERISTIC
/begin CHARACTERISTIC MAX_STOER_OFFSET31 "Offset fuer Anz. Stoerungen bis ein Symptom ausgeloest wird, wenn bei Schltg. ein Sollmomentgradient unterschritten wird" VALUE 0x26EA83 kw_ui8_S6_S3 255 UMR___1_1_0_S6_S3 0 255 /end CHARACTERISTIC
/begin CHARACTERISTIC MAX_SYM_UWIG_SCHALT31 "Maximale Anzahl Symptome fuer Schaltung in der UWIG" VALUE 0x26EA84 kw_ui8_S6_S3 254 UMR___1_1_0_S6_S3 1 255 /end CHARACTERISTIC
/begin CHARACTERISTIC NGS_ABUWIG31 "n_ab-Gradientenschwelle fuer Symptomerkennung waehrend Schaltung" VALUE 0x26E004 kw_si16_S6_S3 25000 UMR_U_MINSEC_1_1_0_S6_S3 -20000 5000 /end CHARACTERISTIC
/begin CHARACTERISTIC T_VNGABUWIG31 "Verzoegerungszeit nach Ueberschreiten NGS_ABUWIGxy-Schwelle waehrend Schaltung" VALUE 0x26EA85 kw_ui8_S6_S3 1000 UMR_MSEC__10_1_0_S6_S3 0 1000 /end CHARACTERISTIC
/begin CHARACTERISTIC T_VUWIG31 "Verzoegerungszeit nach Reglerstart bei Schaltung" VALUE 0x26EA86 kw_ui8_S6_S3 2540 UMR_MSEC__10_1_0_S6_S3 0 2540 /end CHARACTERISTIC
/begin CHARACTERISTIC KL_IGOUWIGOB42 "Offset auf obere Uebersetzungschwelle bei Schaltung" CURVE 0x26187C kl_ui16_S6_S3 65.535 UMR___1_1000_0_S6_S3 0 65.535
 /begin AXIS_DESCR STD_AXIS zff_atsys._.iSignale._.obj.sig_n_ab UMR_U_MIN_1_1_0_S6_S3 8 0 8160 DEPOSIT ABSOLUTE MONOTONY MON_INCREASE /end AXIS_DESCR
/end CHARACTERISTIC
/begin CHARACTERISTIC KL_IGOUWIGUN42 "Offset auf untere Uebersetzungschwelle bei Schaltung" CURVE 0x2618A0 kl_ui16_S6_S3 65.535 UMR___1_1000_0_S6_S3 0 65.535
 /begin AXIS_DESCR STD_AXIS zff_atsys._.iSignale._.obj.sig_n_ab UMR_U_MIN_1_1_0_S6_S3 8 0 8160 DEPOSIT ABSOLUTE MONOTONY MON_INCREASE /end AXIS_DESCR
/end CHARACTERISTIC
/begin CHARACTERISTIC MAX_STOER_OFFSET42 "Offset fuer Anz. Stoerungen bis ein Symptom ausgeloest wird, wenn bei Schltg. ein Sollmomentgradient unterschritten wird" VALUE 0x26EA87 kw_ui8_S6_S3 255 UMR___1_1_0_S6_S3 0 255 /end CHARACTERISTIC
/begin CHARACTERISTIC MAX_SYM_UWIG_SCHALT42 "Maximale Anzahl Symptome fuer Schaltung in der UWIG" VALUE 0x26EA88 kw_ui8_S6_S3 254 UMR___1_1_0_S6_S3 1 255 /end CHARACTERISTIC
/begin CHARACTERISTIC NGS_ABUWIG42 "n_ab-Gradientenschwelle fuer Symptomerkennung waehrend Schaltung" VALUE 0x26E006 kw_si16_S6_S3 25000 UMR_U_MINSEC_1_1_0_S6_S3 -20000 5000 /end CHARACTERISTIC
/begin CHARACTERISTIC T_VNGABUWIG42 "Verzoegerungszeit nach Ueberschreiten NGS_ABUWIGxy-Schwelle waehrend Schaltung" VALUE 0x26EA89 kw_ui8_S6_S3 1000 UMR_MSEC__10_1_0_S6_S3 0 1000 /end CHARACTERISTIC
/begin CHARACTERISTIC T_VUWIG42 "Verzoegerungszeit nach Reglerstart bei Schaltung" VALUE 0x26EA8A kw_ui8_S6_S3 2540 UMR_MSEC__10_1_0_S6_S3 0 2540 /end CHARACTERISTIC
/begin CHARACTERISTIC KL_IGOUWIGOB51 "Offset auf obere Uebersetzungschwelle bei Schaltung" CURVE 0x2618C4 kl_ui16_S6_S3 65.535 UMR___1_1000_0_S6_S3 0 65.535
 /begin AXIS_DESCR STD_AXIS zff_atsys._.iSignale._.obj.sig_n_ab UMR_U_MIN_1_1_0_S6_S3 8 0 8160 DEPOSIT ABSOLUTE MONOTONY MON_INCREASE /end AXIS_DESCR
/end CHARACTERISTIC
/begin CHARACTERISTIC KL_IGOUWIGUN51 "Offset auf untere Uebersetzungschwelle bei Schaltung" CURVE 0x2618E8 kl_ui16_S6_S3 65.535 UMR___1_1000_0_S6_S3 0 65.535
 /begin AXIS_DESCR STD_AXIS zff_atsys._.iSignale._.obj.sig_n_ab UMR_U_MIN_1_1_0_S6_S3 8 0 8160 DEPOSIT ABSOLUTE MONOTONY MON_INCREASE /end AXIS_DESCR
/end CHARACTERISTIC
/begin CHARACTERISTIC MAX_STOER_OFFSET51 "Offset fuer Anz. Stoerungen bis ein Symptom ausgeloest wird, wenn bei Schltg. ein Sollmomentgradient unterschritten wird" VALUE 0x26EA8B kw_ui8_S6_S3 255 UMR___1_1_0_S6_S3 0 255 /end CHARACTERISTIC
/begin CHARACTERISTIC MAX_SYM_UWIG_SCHALT51 "Maximale Anzahl Symptome fuer Schaltung in der UWIG" VALUE 0x26EA8C kw_ui8_S6_S3 254 UMR___1_1_0_S6_S3 1 255 /end CHARACTERISTIC
/begin CHARACTERISTIC NGS_ABUWIG51 "n_ab-Gradientenschwelle fuer Symptomerkennung waehrend Schaltung" VALUE 0x26E008 kw_si16_S6_S3 25000 UMR_U_MINSEC_1_1_0_S6_S3 -20000 5000 /end CHARACTERISTIC
/begin CHARACTERISTIC T_VNGABUWIG51 "Verzoegerungszeit nach Ueberschreiten NGS_ABUWIGxy-Schwelle waehrend Schaltung" VALUE 0x26EA8D kw_ui8_S6_S3 1000 UMR_MSEC__10_1_0_S6_S3 0 1000 /end CHARACTERISTIC
/begin CHARACTERISTIC T_VUWIG51 "Verzoegerungszeit nach Reglerstart bei Schaltung" VALUE 0x26EA8E kw_ui8_S6_S3 2540 UMR_MSEC__10_1_0_S6_S3 0 2540 /end CHARACTERISTIC
/begin CHARACTERISTIC KL_IGOUWIGOB53 "Offset auf obere Uebersetzungschwelle bei Schaltung" CURVE 0x26190C kl_ui16_S6_S3 65.535 UMR___1_1000_0_S6_S3 0 65.535
 /begin AXIS_DESCR STD_AXIS zff_atsys._.iSignale._.obj.sig_n_ab UMR_U_MIN_1_1_0_S6_S3 8 0 8160 DEPOSIT ABSOLUTE MONOTONY MON_INCREASE /end AXIS_DESCR
/end CHARACTERISTIC
/begin CHARACTERISTIC KL_IGOUWIGUN53 "Offset auf untere Uebersetzungschwelle bei Schaltung" CURVE 0x261930 kl_ui16_S6_S3 65.535 UMR___1_1000_0_S6_S3 0 65.535
 /begin AXIS_DESCR STD_AXIS zff_atsys._.iSignale._.obj.sig_n_ab UMR_U_MIN_1_1_0_S6_S3 8 0 8160 DEPOSIT ABSOLUTE MONOTONY MON_INCREASE /end AXIS_DESCR
/end CHARACTERISTIC
/begin CHARACTERISTIC MAX_STOER_OFFSET53 "Offset fuer Anz. Stoerungen bis ein Symptom ausgeloest wird, wenn bei Schltg. ein Sollmomentgradient unterschritten wird" VALUE 0x26EA8F kw_ui8_S6_S3 255 UMR___1_1_0_S6_S3 0 255 /end CHARACTERISTIC
/begin CHARACTERISTIC MAX_SYM_UWIG_SCHALT53 "Maximale Anzahl Symptome fuer Schaltung in der UWIG" VALUE 0x26EA90 kw_ui8_S6_S3 254 UMR___1_1_0_S6_S3 1 255 /end CHARACTERISTIC
/begin CHARACTERISTIC NGS_ABUWIG53 "n_ab-Gradientenschwelle fuer Symptomerkennung waehrend Schaltung" VALUE 0x26E00A kw_si16_S6_S3 25000 UMR_U_MINSEC_1_1_0_S6_S3 -20000 5000 /end CHARACTERISTIC
/begin CHARACTERISTIC T_VNGABUWIG53 "Verzoegerungszeit nach Ueberschreiten NGS_ABUWIGxy-Schwelle waehrend Schaltung" VALUE 0x26EA91 kw_ui8_S6_S3 1000 UMR_MSEC__10_1_0_S6_S3 0 1000 /end CHARACTERISTIC
/begin CHARACTERISTIC T_VUWIG53 "Verzoegerungszeit nach Reglerstart bei Schaltung" VALUE 0x26EA92 kw_ui8_S6_S3 2540 UMR_MSEC__10_1_0_S6_S3 0 2540 /end CHARACTERISTIC
/begin CHARACTERISTIC KL_IGOUWIGOB63 "Offset auf obere Uebersetzungschwelle bei Schaltung" CURVE 0x261954 kl_ui16_S6_S3 65.535 UMR___1_1000_0_S6_S3 0 65.535
 /begin AXIS_DESCR STD_AXIS zff_atsys._.iSignale._.obj.sig_n_ab UMR_U_MIN_1_1_0_S6_S3 8 0 8160 DEPOSIT ABSOLUTE MONOTONY MON_INCREASE /end AXIS_DESCR
/end CHARACTERISTIC
/begin CHARACTERISTIC KL_IGOUWIGUN63 "Offset auf untere Uebersetzungschwelle bei Schaltung" CURVE 0x261978 kl_ui16_S6_S3 65.535 UMR___1_1000_0_S6_S3 0 65.535
 /begin AXIS_DESCR STD_AXIS zff_atsys._.iSignale._.obj.sig_n_ab UMR_U_MIN_1_1_0_S6_S3 8 0 8160 DEPOSIT ABSOLUTE MONOTONY MON_INCREASE /end AXIS_DESCR
/end CHARACTERISTIC
/begin CHARACTERISTIC MAX_STOER_OFFSET63 "Offset fuer Anz. Stoerungen bis ein Symptom ausgeloest wird, wenn bei Schltg. ein Sollmomentgradient unterschritten wird" VALUE 0x26EA93 kw_ui8_S6_S3 255 UMR___1_1_0_S6_S3 0 255 /end CHARACTERISTIC
/begin CHARACTERISTIC MAX_SYM_UWIG_SCHALT63 "Maximale Anzahl Symptome fuer Schaltung in der UWIG" VALUE 0x26EA94 kw_ui8_S6_S3 254 UMR___1_1_0_S6_S3 1 255 /end CHARACTERISTIC
/begin CHARACTERISTIC NGS_ABUWIG63 "n_ab-Gradientenschwelle fuer Symptomerkennung waehrend Schaltung" VALUE 0x26E00C kw_si16_S6_S3 25000 UMR_U_MINSEC_1_1_0_S6_S3 -20000 5000 /end CHARACTERISTIC
/begin CHARACTERISTIC T_VNGABUWIG63 "Verzoegerungszeit nach Ueberschreiten NGS_ABUWIGxy-Schwelle waehrend Schaltung" VALUE 0x26EA95 kw_ui8_S6_S3 1000 UMR_MSEC__10_1_0_S6_S3 0 1000 /end CHARACTERISTIC
/begin CHARACTERISTIC T_VUWIG63 "Verzoegerungszeit nach Reglerstart bei Schaltung" VALUE 0x26EA96 kw_ui8_S6_S3 2540 UMR_MSEC__10_1_0_S6_S3 0 2540 /end CHARACTERISTIC
/begin CHARACTERISTIC KL_IGOUWIGOB64 "Offset auf obere Uebersetzungschwelle bei Schaltung" CURVE 0x26199C kl_ui16_S6_S3 65.535 UMR___1_1000_0_S6_S3 0 65.535
 /begin AXIS_DESCR STD_AXIS zff_atsys._.iSignale._.obj.sig_n_ab UMR_U_MIN_1_1_0_S6_S3 8 0 8160 DEPOSIT ABSOLUTE MONOTONY MON_INCREASE /end AXIS_DESCR
/end CHARACTERISTIC
/begin CHARACTERISTIC KL_IGOUWIGUN64 "Offset auf untere Uebersetzungschwelle bei Schaltung" CURVE 0x2619C0 kl_ui16_S6_S3 65.535 UMR___1_1000_0_S6_S3 0 65.535
 /begin AXIS_DESCR STD_AXIS zff_atsys._.iSignale._.obj.sig_n_ab UMR_U_MIN_1_1_0_S6_S3 8 0 8160 DEPOSIT ABSOLUTE MONOTONY MON_INCREASE /end AXIS_DESCR
/end CHARACTERISTIC
/begin CHARACTERISTIC MAX_STOER_OFFSET64 "Offset fuer Anz. Stoerungen bis ein Symptom ausgeloest wird, wenn bei Schltg. ein Sollmomentgradient unterschritten wird" VALUE 0x26EA97 kw_ui8_S6_S3 255 UMR___1_1_0_S6_S3 0 255 /end CHARACTERISTIC
/begin CHARACTERISTIC MAX_SYM_UWIG_SCHALT64 "Maximale Anzahl Symptome fuer Schaltung in der UWIG" VALUE 0x26EA98 kw_ui8_S6_S3 254 UMR___1_1_0_S6_S3 1 255 /end CHARACTERISTIC
/begin CHARACTERISTIC NGS_ABUWIG64 "n_ab-Gradientenschwelle fuer Symptomerkennung waehrend Schaltung" VALUE 0x26E00E kw_si16_S6_S3 25000 UMR_U_MINSEC_1_1_0_S6_S3 -20000 5000 /end CHARACTERISTIC
/begin CHARACTERISTIC T_VNGABUWIG64 "Verzoegerungszeit nach Ueberschreiten NGS_ABUWIGxy-Schwelle waehrend Schaltung" VALUE 0x26EA99 kw_ui8_S6_S3 1000 UMR_MSEC__10_1_0_S6_S3 0 1000 /end CHARACTERISTIC
/begin CHARACTERISTIC T_VUWIG64 "Verzoegerungszeit nach Reglerstart bei Schaltung" VALUE 0x26EA9A kw_ui8_S6_S3 2540 UMR_MSEC__10_1_0_S6_S3 0 2540 /end CHARACTERISTIC
/begin CHARACTERISTIC KL_IGOUWIGOB71 "Offset auf obere Uebersetzungschwelle bei Schaltung" CURVE 0x2619E4 kl_ui16_S6_S3 65.535 UMR___1_1000_0_S6_S3 0 65.535
 /begin AXIS_DESCR STD_AXIS zff_atsys._.iSignale._.obj.sig_n_ab UMR_U_MIN_1_1_0_S6_S3 8 0 8160 DEPOSIT ABSOLUTE MONOTONY MON_INCREASE /end AXIS_DESCR
/end CHARACTERISTIC
/begin CHARACTERISTIC KL_IGOUWIGUN71 "Offset auf untere Uebersetzungschwelle bei Schaltung" CURVE 0x261A08 kl_ui16_S6_S3 65.535 UMR___1_1000_0_S6_S3 0 65.535
 /begin AXIS_DESCR STD_AXIS zff_atsys._.iSignale._.obj.sig_n_ab UMR_U_MIN_1_1_0_S6_S3 8 0 8160 DEPOSIT ABSOLUTE MONOTONY MON_INCREASE /end AXIS_DESCR
/end CHARACTERISTIC
/begin CHARACTERISTIC MAX_STOER_OFFSET71 "Offset fuer Anz. Stoerungen bis ein Symptom ausgeloest wird, wenn bei Schltg. ein Sollmomentgradient unterschritten wird" VALUE 0x26EA9B kw_ui8_S6_S3 255 UMR___1_1_0_S6_S3 0 255 /end CHARACTERISTIC
/begin CHARACTERISTIC MAX_SYM_UWIG_SCHALT71 "Maximale Anzahl Symptome fuer Schaltung in der UWIG" VALUE 0x26EA9C kw_ui8_S6_S3 254 UMR___1_1_0_S6_S3 1 255 /end CHARACTERISTIC
/begin CHARACTERISTIC NGS_ABUWIG71 "n_ab-Gradientenschwelle fuer Symptomerkennung waehrend Schaltung" VALUE 0x26E010 kw_si16_S6_S3 25000 UMR_U_MINSEC_1_1_0_S6_S3 -20000 5000 /end CHARACTERISTIC
/begin CHARACTERISTIC T_VNGABUWIG71 "Verzoegerungszeit nach Ueberschreiten NGS_ABUWIGxy-Schwelle waehrend Schaltung" VALUE 0x26EA9D kw_ui8_S6_S3 1000 UMR_MSEC__10_1_0_S6_S3 0 1000 /end CHARACTERISTIC
/begin CHARACTERISTIC T_VUWIG71 "Verzoegerungszeit nach Reglerstart bei Schaltung" VALUE 0x26EA9E kw_ui8_S6_S3 2540 UMR_MSEC__10_1_0_S6_S3 0 2540 /end CHARACTERISTIC
/begin CHARACTERISTIC KL_IGOUWIGOB75 "Offset auf obere Uebersetzungschwelle bei Schaltung" CURVE 0x261A2C kl_ui16_S6_S3 65.535 UMR___1_1000_0_S6_S3 0 65.535
 /begin AXIS_DESCR STD_AXIS zff_atsys._.iSignale._.obj.sig_n_ab UMR_U_MIN_1_1_0_S6_S3 8 0 8160 DEPOSIT ABSOLUTE MONOTONY MON_INCREASE /end AXIS_DESCR
/end CHARACTERISTIC
/begin CHARACTERISTIC KL_IGOUWIGUN75 "Offset auf untere Uebersetzungschwelle bei Schaltung" CURVE 0x261A50 kl_ui16_S6_S3 65.535 UMR___1_1000_0_S6_S3 0 65.535
 /begin AXIS_DESCR STD_AXIS zff_atsys._.iSignale._.obj.sig_n_ab UMR_U_MIN_1_1_0_S6_S3 8 0 8160 DEPOSIT ABSOLUTE MONOTONY MON_INCREASE /end AXIS_DESCR
/end CHARACTERISTIC
/begin CHARACTERISTIC MAX_STOER_OFFSET75 "Offset fuer Anz. Stoerungen bis ein Symptom ausgeloest wird, wenn bei Schltg. ein Sollmomentgradient unterschritten wird" VALUE 0x26EA9F kw_ui8_S6_S3 255 UMR___1_1_0_S6_S3 0 255 /end CHARACTERISTIC
/begin CHARACTERISTIC MAX_SYM_UWIG_SCHALT75 "Maximale Anzahl Symptome fuer Schaltung in der UWIG" VALUE 0x26EAA0 kw_ui8_S6_S3 254 UMR___1_1_0_S6_S3 1 255 /end CHARACTERISTIC
/begin CHARACTERISTIC NGS_ABUWIG75 "n_ab-Gradientenschwelle fuer Symptomerkennung waehrend Schaltung" VALUE 0x26E012 kw_si16_S6_S3 25000 UMR_U_MINSEC_1_1_0_S6_S3 -20000 5000 /end CHARACTERISTIC
/begin CHARACTERISTIC T_VNGABUWIG75 "Verzoegerungszeit nach Ueberschreiten NGS_ABUWIGxy-Schwelle waehrend Schaltung" VALUE 0x26EAA1 kw_ui8_S6_S3 1000 UMR_MSEC__10_1_0_S6_S3 0 1000 /end CHARACTERISTIC
/begin CHARACTERISTIC T_VUWIG75 "Verzoegerungszeit nach Reglerstart bei Schaltung" VALUE 0x26EAA2 kw_ui8_S6_S3 2540 UMR_MSEC__10_1_0_S6_S3 0 2540 /end CHARACTERISTIC
/begin CHARACTERISTIC KL_IGOUWIGOB82 "Offset auf obere Uebersetzungschwelle bei Schaltung" CURVE 0x261A74 kl_ui16_S6_S3 65.535 UMR___1_1000_0_S6_S3 0 65.535
 /begin AXIS_DESCR STD_AXIS zff_atsys._.iSignale._.obj.sig_n_ab UMR_U_MIN_1_1_0_S6_S3 8 0 8160 DEPOSIT ABSOLUTE MONOTONY MON_INCREASE /end AXIS_DESCR
/end CHARACTERISTIC
/begin CHARACTERISTIC KL_IGOUWIGUN82 "Offset auf untere Uebersetzungschwelle bei Schaltung" CURVE 0x261A98 kl_ui16_S6_S3 65.535 UMR___1_1000_0_S6_S3 0 65.535
 /begin AXIS_DESCR STD_AXIS zff_atsys._.iSignale._.obj.sig_n_ab UMR_U_MIN_1_1_0_S6_S3 8 0 8160 DEPOSIT ABSOLUTE MONOTONY MON_INCREASE /end AXIS_DESCR
/end CHARACTERISTIC
/begin CHARACTERISTIC MAX_STOER_OFFSET82 "Offset fuer Anz. Stoerungen bis ein Symptom ausgeloest wird, wenn bei Schltg. ein Sollmomentgradient unterschritten wird" VALUE 0x26EAA3 kw_ui8_S6_S3 255 UMR___1_1_0_S6_S3 0 255 /end CHARACTERISTIC
/begin CHARACTERISTIC MAX_SYM_UWIG_SCHALT82 "Maximale Anzahl Symptome fuer Schaltung in der UWIG" VALUE 0x26EAA4 kw_ui8_S6_S3 254 UMR___1_1_0_S6_S3 1 255 /end CHARACTERISTIC
/begin CHARACTERISTIC NGS_ABUWIG82 "n_ab-Gradientenschwelle fuer Symptomerkennung waehrend Schaltung" VALUE 0x26E014 kw_si16_S6_S3 25000 UMR_U_MINSEC_1_1_0_S6_S3 -20000 5000 /end CHARACTERISTIC
/begin CHARACTERISTIC T_VNGABUWIG82 "Verzoegerungszeit nach Ueberschreiten NGS_ABUWIGxy-Schwelle waehrend Schaltung" VALUE 0x26EAA5 kw_ui8_S6_S3 1000 UMR_MSEC__10_1_0_S6_S3 0 1000 /end CHARACTERISTIC
/begin CHARACTERISTIC T_VUWIG82 "Verzoegerungszeit nach Reglerstart bei Schaltung" VALUE 0x26EAA6 kw_ui8_S6_S3 2540 UMR_MSEC__10_1_0_S6_S3 0 2540 /end CHARACTERISTIC
/begin CHARACTERISTIC KL_IGOUWIGOB84 "Offset auf obere Uebersetzungschwelle bei Schaltung" CURVE 0x261ABC kl_ui16_S6_S3 65.535 UMR___1_1000_0_S6_S3 0 65.535
 /begin AXIS_DESCR STD_AXIS zff_atsys._.iSignale._.obj.sig_n_ab UMR_U_MIN_1_1_0_S6_S3 8 0 8160 DEPOSIT ABSOLUTE MONOTONY MON_INCREASE /end AXIS_DESCR
/end CHARACTERISTIC
/begin CHARACTERISTIC KL_IGOUWIGUN84 "Offset auf untere Uebersetzungschwelle bei Schaltung" CURVE 0x261AE0 kl_ui16_S6_S3 65.535 UMR___1_1000_0_S6_S3 0 65.535
 /begin AXIS_DESCR STD_AXIS zff_atsys._.iSignale._.obj.sig_n_ab UMR_U_MIN_1_1_0_S6_S3 8 0 8160 DEPOSIT ABSOLUTE MONOTONY MON_INCREASE /end AXIS_DESCR
/end CHARACTERISTIC
/begin CHARACTERISTIC MAX_STOER_OFFSET84 "Offset fuer Anz. Stoerungen bis ein Symptom ausgeloest wird, wenn bei Schltg. ein Sollmomentgradient unterschritten wird" VALUE 0x26EAA7 kw_ui8_S6_S3 255 UMR___1_1_0_S6_S3 0 255 /end CHARACTERISTIC
/begin CHARACTERISTIC MAX_SYM_UWIG_SCHALT84 "Maximale Anzahl Symptome fuer Schaltung in der UWIG" VALUE 0x26EAA8 kw_ui8_S6_S3 254 UMR___1_1_0_S6_S3 1 255 /end CHARACTERISTIC
/begin CHARACTERISTIC NGS_ABUWIG84 "n_ab-Gradientenschwelle fuer Symptomerkennung waehrend Schaltung" VALUE 0x26E016 kw_si16_S6_S3 25000 UMR_U_MINSEC_1_1_0_S6_S3 -20000 5000 /end CHARACTERISTIC
/begin CHARACTERISTIC T_VNGABUWIG84 "Verzoegerungszeit nach Ueberschreiten NGS_ABUWIGxy-Schwelle waehrend Schaltung" VALUE 0x26EAA9 kw_ui8_S6_S3 1000 UMR_MSEC__10_1_0_S6_S3 0 1000 /end CHARACTERISTIC
/begin CHARACTERISTIC T_VUWIG84 "Verzoegerungszeit nach Reglerstart bei Schaltung" VALUE 0x26EAAA kw_ui8_S6_S3 2540 UMR_MSEC__10_1_0_S6_S3 0 2540 /end CHARACTERISTIC
/begin CHARACTERISTIC KL_IGOUWIGOB86 "Offset auf obere Uebersetzungschwelle bei Schaltung" CURVE 0x261B04 kl_ui16_S6_S3 65.535 UMR___1_1000_0_S6_S3 0 65.535
 /begin AXIS_DESCR STD_AXIS zff_atsys._.iSignale._.obj.sig_n_ab UMR_U_MIN_1_1_0_S6_S3 8 0 8160 DEPOSIT ABSOLUTE MONOTONY MON_INCREASE /end AXIS_DESCR
/end CHARACTERISTIC
/begin CHARACTERISTIC KL_IGOUWIGUN86 "Offset auf untere Uebersetzungschwelle bei Schaltung" CURVE 0x261B28 kl_ui16_S6_S3 65.535 UMR___1_1000_0_S6_S3 0 65.535
 /begin AXIS_DESCR STD_AXIS zff_atsys._.iSignale._.obj.sig_n_ab UMR_U_MIN_1_1_0_S6_S3 8 0 8160 DEPOSIT ABSOLUTE MONOTONY MON_INCREASE /end AXIS_DESCR
/end CHARACTERISTIC
/begin CHARACTERISTIC MAX_STOER_OFFSET86 "Offset fuer Anz. Stoerungen bis ein Symptom ausgeloest wird, wenn bei Schltg. ein Sollmomentgradient unterschritten wird" VALUE 0x26EAAB kw_ui8_S6_S3 255 UMR___1_1_0_S6_S3 0 255 /end CHARACTERISTIC
/begin CHARACTERISTIC MAX_SYM_UWIG_SCHALT86 "Maximale Anzahl Symptome fuer Schaltung in der UWIG" VALUE 0x26EAAC kw_ui8_S6_S3 254 UMR___1_1_0_S6_S3 1 255 /end CHARACTERISTIC
/begin CHARACTERISTIC NGS_ABUWIG86 "n_ab-Gradientenschwelle fuer Symptomerkennung waehrend Schaltung" VALUE 0x26E018 kw_si16_S6_S3 25000 UMR_U_MINSEC_1_1_0_S6_S3 -20000 5000 /end CHARACTERISTIC
/begin CHARACTERISTIC T_VNGABUWIG86 "Verzoegerungszeit nach Ueberschreiten NGS_ABUWIGxy-Schwelle waehrend Schaltung" VALUE 0x26EAAD kw_ui8_S6_S3 1000 UMR_MSEC__10_1_0_S6_S3 0 1000 /end CHARACTERISTIC
/begin CHARACTERISTIC T_VUWIG86 "Verzoegerungszeit nach Reglerstart bei Schaltung" VALUE 0x26EAAE kw_ui8_S6_S3 2540 UMR_MSEC__10_1_0_S6_S3 0 2540 /end CHARACTERISTIC
/begin CHARACTERISTIC T_PMUEBDEF "Prüfdauer" VALUE 0x26EAAF kw_ui8_S6_S3 2540 UMR_MSEC__10_1_0_S6_S3 0 2540 /end CHARACTERISTIC
/begin CHARACTERISTIC TVERZ_PMUEB "Verzögerungszeit zur Systemberuhigung" VALUE 0x26E01A kw_ui16_S6_S3 5000 UMR_MSEC__10_1_0_S6_S3 0 5000 /end CHARACTERISTIC
/begin CHARACTERISTIC TMAX_PMUEB "Zeitdauer nach der eine Prüfung des Magenten erfolgen soll" VALUE 0x261B4C kw_ui32_S6_S3 1E+008 UMR_MSEC__10_1_0_S6_S3 0 100000000 /end CHARACTERISTIC
/begin CHARACTERISTIC V_PMUEB_UN "untere Geschwindigkeitsschwelle" VALUE 0x26E01C kw_ui16_S6_S3 400 UMR_KM_H_1_1_0_S6_S3 0 400 /end CHARACTERISTIC
/begin CHARACTERISTIC V_PMUEB_OB "obere Geschwindigkeitsschwelle" VALUE 0x26E01E kw_ui16_S6_S3 400 UMR_KM_H_1_1_0_S6_S3 0 400 /end CHARACTERISTIC
/begin CHARACTERISTIC IEDSPOS_PMUEB "Prüfwert für Bestromung des EDS-POS" VALUE 0x26E020 kw_ui16_S6_S3 850 UMR_MA__1_10_0_S6_S3 0 850 /end CHARACTERISTIC
/begin CHARACTERISTIC C_PMUEB "Temperaturschwelle zum Einstieg in die Funktion" VALUE 0x26EAB0 kw_ui8_S6_S3 254 UMR_GRADC__1_1_M40_S6_S3 -40 214 /end CHARACTERISTIC
/begin CHARACTERISTIC MAX_STOER_PMUEB "Störzähler für die Fehlererkennung" VALUE 0x26EAB1 kw_ui8_S6_S3 254 UMR___1_1_0_S6_S3 0 254 /end CHARACTERISTIC
/begin CHARACTERISTIC PSYS_PMUEB "Systemdruckschwelle zum Einstieg in die Funktion" VALUE 0x26E022 kw_si16_S6_S3 20 UMR_BAR__1_100_0_S6_S3 0 20 /end CHARACTERISTIC
/begin CHARACTERISTIC N_ABKODERA "Drehzahlschwelle Korrektur fehlerspezifischer Denominator UWIG" VALUE 0x26D520 kw_ui16_S6_S3 8000 UMR_U_MIN_1_1_0_S6_S3 0 8000 /end CHARACTERISTIC
/begin CHARACTERISTIC N_MITTELWERT_EDSLOGIK_A "ASIL-C: Anzahl der Stromwerte über die Mittelwertbildung erfolgen soll" VALUE 0x26EAC7 kw_ui8_S6_S3 9 UMR___1_1_0_S6_S3 1 10 /end CHARACTERISTIC
/begin CHARACTERISTIC N_MITTELWERT_EDSLOGIK_B "ASIL-C: Anzahl der Stromwerte über die Mittelwertbildung erfolgen soll" VALUE 0x26EAC8 kw_ui8_S6_S3 9 UMR___1_1_0_S6_S3 1 10 /end CHARACTERISTIC
/begin CHARACTERISTIC N_MITTELWERT_EDSLOGIK_C "ASIL-C: Anzahl der Stromwerte über die Mittelwertbildung erfolgen soll" VALUE 0x26EAC9 kw_ui8_S6_S3 9 UMR___1_1_0_S6_S3 1 10 /end CHARACTERISTIC
/begin CHARACTERISTIC N_MITTELWERT_EDSLOGIK_D "ASIL-C: Anzahl der Stromwerte über die Mittelwertbildung erfolgen soll" VALUE 0x26EACA kw_ui8_S6_S3 9 UMR___1_1_0_S6_S3 1 10 /end CHARACTERISTIC
/begin CHARACTERISTIC N_MITTELWERT_EDSLOGIK_E "ASIL-C: Anzahl der Stromwerte über die Mittelwertbildung erfolgen soll" VALUE 0x26EACB kw_ui8_S6_S3 9 UMR___1_1_0_S6_S3 1 10 /end CHARACTERISTIC
/begin CHARACTERISTIC KF_IEDSIGANGLEV2MMOTCG_R1A "Minimale bedarfgerechte Bestromungsschwelle fuer EDS" MAP 0x261B84 kf_si16_S6_S3 1200 UMR_MA__1_10_0_S6_S3 0 1200
 /begin AXIS_DESCR STD_AXIS NO_INPUT_QUANTITY UMR_NM__1_1_0_S6_S3 8 -300 1640 DEPOSIT ABSOLUTE MONOTONY MON_INCREASE /end AXIS_DESCR
 /begin AXIS_DESCR STD_AXIS iUl2ItfipInt.c_getr_l2 UMR_GRADC__1_1_M40_S6_S3 4 -40 215 DEPOSIT ABSOLUTE MONOTONY MON_INCREASE /end AXIS_DESCR
/end CHARACTERISTIC
/begin CHARACTERISTIC KF_IEDSIGANGLEV2MMOTCG_R1B "Minimale bedarfgerechte Bestromungsschwelle fuer EDS" MAP 0x261BE4 kf_si16_S6_S3 1200 UMR_MA__1_10_0_S6_S3 0 1200
 /begin AXIS_DESCR STD_AXIS NO_INPUT_QUANTITY UMR_NM__1_1_0_S6_S3 8 -300 1640 DEPOSIT ABSOLUTE MONOTONY MON_INCREASE /end AXIS_DESCR
 /begin AXIS_DESCR STD_AXIS iUl2ItfipInt.c_getr_l2 UMR_GRADC__1_1_M40_S6_S3 4 -40 215 DEPOSIT ABSOLUTE MONOTONY MON_INCREASE /end AXIS_DESCR
/end CHARACTERISTIC
/begin CHARACTERISTIC KF_IEDSIGANGLEV2MMOTCG_R1D "Minimale bedarfgerechte Bestromungsschwelle fuer EDS" MAP 0x261C44 kf_si16_S6_S3 1200 UMR_MA__1_10_0_S6_S3 0 1200
 /begin AXIS_DESCR STD_AXIS NO_INPUT_QUANTITY UMR_NM__1_1_0_S6_S3 8 -300 1640 DEPOSIT ABSOLUTE MONOTONY MON_INCREASE /end AXIS_DESCR
 /begin AXIS_DESCR STD_AXIS iUl2ItfipInt.c_getr_l2 UMR_GRADC__1_1_M40_S6_S3 4 -40 215 DEPOSIT ABSOLUTE MONOTONY MON_INCREASE /end AXIS_DESCR
/end CHARACTERISTIC
/begin CHARACTERISTIC KF_IEDSIGANGLEV2MMOTCG_1A "Minimale bedarfgerechte Bestromungsschwelle fuer EDS" MAP 0x261CA4 kf_si16_S6_S3 1200 UMR_MA__1_10_0_S6_S3 0 1200
 /begin AXIS_DESCR STD_AXIS NO_INPUT_QUANTITY UMR_NM__1_1_0_S6_S3 8 -300 1640 DEPOSIT ABSOLUTE MONOTONY MON_INCREASE /end AXIS_DESCR
 /begin AXIS_DESCR STD_AXIS iUl2ItfipInt.c_getr_l2 UMR_GRADC__1_1_M40_S6_S3 4 -40 215 DEPOSIT ABSOLUTE MONOTONY MON_INCREASE /end AXIS_DESCR
/end CHARACTERISTIC
/begin CHARACTERISTIC KF_IEDSIGANGLEV2MMOTCG_1B "Minimale bedarfgerechte Bestromungsschwelle fuer EDS" MAP 0x261D04 kf_si16_S6_S3 1200 UMR_MA__1_10_0_S6_S3 0 1200
 /begin AXIS_DESCR STD_AXIS NO_INPUT_QUANTITY UMR_NM__1_1_0_S6_S3 8 -300 1640 DEPOSIT ABSOLUTE MONOTONY MON_INCREASE /end AXIS_DESCR
 /begin AXIS_DESCR STD_AXIS iUl2ItfipInt.c_getr_l2 UMR_GRADC__1_1_M40_S6_S3 4 -40 215 DEPOSIT ABSOLUTE MONOTONY MON_INCREASE /end AXIS_DESCR
/end CHARACTERISTIC
/begin CHARACTERISTIC KF_IEDSIGANGLEV2MMOTCG_1C "Minimale bedarfgerechte Bestromungsschwelle fuer EDS" MAP 0x261D64 kf_si16_S6_S3 1200 UMR_MA__1_10_0_S6_S3 0 1200
 /begin AXIS_DESCR STD_AXIS NO_INPUT_QUANTITY UMR_NM__1_1_0_S6_S3 8 -300 1640 DEPOSIT ABSOLUTE MONOTONY MON_INCREASE /end AXIS_DESCR
 /begin AXIS_DESCR STD_AXIS iUl2ItfipInt.c_getr_l2 UMR_GRADC__1_1_M40_S6_S3 4 -40 215 DEPOSIT ABSOLUTE MONOTONY MON_INCREASE /end AXIS_DESCR
/end CHARACTERISTIC
/begin CHARACTERISTIC KF_IEDSIGANGLEV2MMOTCG_2A "Minimale bedarfgerechte Bestromungsschwelle fuer EDS" MAP 0x261DC4 kf_si16_S6_S3 1200 UMR_MA__1_10_0_S6_S3 0 1200
 /begin AXIS_DESCR STD_AXIS NO_INPUT_QUANTITY UMR_NM__1_1_0_S6_S3 8 -300 1640 DEPOSIT ABSOLUTE MONOTONY MON_INCREASE /end AXIS_DESCR
 /begin AXIS_DESCR STD_AXIS iUl2ItfipInt.c_getr_l2 UMR_GRADC__1_1_M40_S6_S3 4 -40 215 DEPOSIT ABSOLUTE MONOTONY MON_INCREASE /end AXIS_DESCR
/end CHARACTERISTIC
/begin CHARACTERISTIC KF_IEDSIGANGLEV2MMOTCG_2B "Minimale bedarfgerechte Bestromungsschwelle fuer EDS" MAP 0x261E24 kf_si16_S6_S3 1200 UMR_MA__1_10_0_S6_S3 0 1200
 /begin AXIS_DESCR STD_AXIS NO_INPUT_QUANTITY UMR_NM__1_1_0_S6_S3 8 -300 1640 DEPOSIT ABSOLUTE MONOTONY MON_INCREASE /end AXIS_DESCR
 /begin AXIS_DESCR STD_AXIS iUl2ItfipInt.c_getr_l2 UMR_GRADC__1_1_M40_S6_S3 4 -40 215 DEPOSIT ABSOLUTE MONOTONY MON_INCREASE /end AXIS_DESCR
/end CHARACTERISTIC
/begin CHARACTERISTIC KF_IEDSIGANGLEV2MMOTCG_2E "Minimale bedarfgerechte Bestromungsschwelle fuer EDS" MAP 0x261E84 kf_si16_S6_S3 1200 UMR_MA__1_10_0_S6_S3 0 1200
 /begin AXIS_DESCR STD_AXIS NO_INPUT_QUANTITY UMR_NM__1_1_0_S6_S3 8 -300 1640 DEPOSIT ABSOLUTE MONOTONY MON_INCREASE /end AXIS_DESCR
 /begin AXIS_DESCR STD_AXIS iUl2ItfipInt.c_getr_l2 UMR_GRADC__1_1_M40_S6_S3 4 -40 215 DEPOSIT ABSOLUTE MONOTONY MON_INCREASE /end AXIS_DESCR
/end CHARACTERISTIC
/begin CHARACTERISTIC KF_IEDSIGANGLEV2MMOTCG_3B "Minimale bedarfgerechte Bestromungsschwelle fuer EDS" MAP 0x261EE4 kf_si16_S6_S3 1200 UMR_MA__1_10_0_S6_S3 0 1200
 /begin AXIS_DESCR STD_AXIS NO_INPUT_QUANTITY UMR_NM__1_1_0_S6_S3 8 -300 1640 DEPOSIT ABSOLUTE MONOTONY MON_INCREASE /end AXIS_DESCR
 /begin AXIS_DESCR STD_AXIS iUl2ItfipInt.c_getr_l2 UMR_GRADC__1_1_M40_S6_S3 4 -40 215 DEPOSIT ABSOLUTE MONOTONY MON_INCREASE /end AXIS_DESCR
/end CHARACTERISTIC
/begin CHARACTERISTIC KF_IEDSIGANGLEV2MMOTCG_3C "Minimale bedarfgerechte Bestromungsschwelle fuer EDS" MAP 0x261F44 kf_si16_S6_S3 1200 UMR_MA__1_10_0_S6_S3 0 1200
 /begin AXIS_DESCR STD_AXIS NO_INPUT_QUANTITY UMR_NM__1_1_0_S6_S3 8 -300 1640 DEPOSIT ABSOLUTE MONOTONY MON_INCREASE /end AXIS_DESCR
 /begin AXIS_DESCR STD_AXIS iUl2ItfipInt.c_getr_l2 UMR_GRADC__1_1_M40_S6_S3 4 -40 215 DEPOSIT ABSOLUTE MONOTONY MON_INCREASE /end AXIS_DESCR
/end CHARACTERISTIC
/begin CHARACTERISTIC KF_IEDSIGANGLEV2MMOTCG_3E "Minimale bedarfgerechte Bestromungsschwelle fuer EDS" MAP 0x261FA4 kf_si16_S6_S3 1200 UMR_MA__1_10_0_S6_S3 0 1200
 /begin AXIS_DESCR STD_AXIS NO_INPUT_QUANTITY UMR_NM__1_1_0_S6_S3 8 -300 1640 DEPOSIT ABSOLUTE MONOTONY MON_INCREASE /end AXIS_DESCR
 /begin AXIS_DESCR STD_AXIS iUl2ItfipInt.c_getr_l2 UMR_GRADC__1_1_M40_S6_S3 4 -40 215 DEPOSIT ABSOLUTE MONOTONY MON_INCREASE /end AXIS_DESCR
/end CHARACTERISTIC
/begin CHARACTERISTIC KF_IEDSIGANGLEV2MMOTCG_4B "Minimale bedarfgerechte Bestromungsschwelle fuer EDS" MAP 0x262004 kf_si16_S6_S3 1200 UMR_MA__1_10_0_S6_S3 0 1200
 /begin AXIS_DESCR STD_AXIS NO_INPUT_QUANTITY UMR_NM__1_1_0_S6_S3 8 -300 1640 DEPOSIT ABSOLUTE MONOTONY MON_INCREASE /end AXIS_DESCR
 /begin AXIS_DESCR STD_AXIS iUl2ItfipInt.c_getr_l2 UMR_GRADC__1_1_M40_S6_S3 4 -40 215 DEPOSIT ABSOLUTE MONOTONY MON_INCREASE /end AXIS_DESCR
/end CHARACTERISTIC
/begin CHARACTERISTIC KF_IEDSIGANGLEV2MMOTCG_4D "Minimale bedarfgerechte Bestromungsschwelle fuer EDS" MAP 0x262064 kf_si16_S6_S3 1200 UMR_MA__1_10_0_S6_S3 0 1200
 /begin AXIS_DESCR STD_AXIS NO_INPUT_QUANTITY UMR_NM__1_1_0_S6_S3 8 -300 1640 DEPOSIT ABSOLUTE MONOTONY MON_INCREASE /end AXIS_DESCR
 /begin AXIS_DESCR STD_AXIS iUl2ItfipInt.c_getr_l2 UMR_GRADC__1_1_M40_S6_S3 4 -40 215 DEPOSIT ABSOLUTE MONOTONY MON_INCREASE /end AXIS_DESCR
/end CHARACTERISTIC
/begin CHARACTERISTIC KF_IEDSIGANGLEV2MMOTCG_4E "Minimale bedarfgerechte Bestromungsschwelle fuer EDS" MAP 0x2620C4 kf_si16_S6_S3 1200 UMR_MA__1_10_0_S6_S3 0 1200
 /begin AXIS_DESCR STD_AXIS NO_INPUT_QUANTITY UMR_NM__1_1_0_S6_S3 8 -300 1640 DEPOSIT ABSOLUTE MONOTONY MON_INCREASE /end AXIS_DESCR
 /begin AXIS_DESCR STD_AXIS iUl2ItfipInt.c_getr_l2 UMR_GRADC__1_1_M40_S6_S3 4 -40 215 DEPOSIT ABSOLUTE MONOTONY MON_INCREASE /end AXIS_DESCR
/end CHARACTERISTIC
/begin CHARACTERISTIC KF_IEDSIGANGLEV2MMOTCG_5B "Minimale bedarfgerechte Bestromungsschwelle fuer EDS" MAP 0x262124 kf_si16_S6_S3 1200 UMR_MA__1_10_0_S6_S3 0 1200
 /begin AXIS_DESCR STD_AXIS NO_INPUT_QUANTITY UMR_NM__1_1_0_S6_S3 8 -300 1640 DEPOSIT ABSOLUTE MONOTONY MON_INCREASE /end AXIS_DESCR
 /begin AXIS_DESCR STD_AXIS iUl2ItfipInt.c_getr_l2 UMR_GRADC__1_1_M40_S6_S3 4 -40 215 DEPOSIT ABSOLUTE MONOTONY MON_INCREASE /end AXIS_DESCR
/end CHARACTERISTIC
/begin CHARACTERISTIC KF_IEDSIGANGLEV2MMOTCG_5C "Minimale bedarfgerechte Bestromungsschwelle fuer EDS" MAP 0x262184 kf_si16_S6_S3 1200 UMR_MA__1_10_0_S6_S3 0 1200
 /begin AXIS_DESCR STD_AXIS NO_INPUT_QUANTITY UMR_NM__1_1_0_S6_S3 8 -300 1640 DEPOSIT ABSOLUTE MONOTONY MON_INCREASE /end AXIS_DESCR
 /begin AXIS_DESCR STD_AXIS iUl2ItfipInt.c_getr_l2 UMR_GRADC__1_1_M40_S6_S3 4 -40 215 DEPOSIT ABSOLUTE MONOTONY MON_INCREASE /end AXIS_DESCR
/end CHARACTERISTIC
/begin CHARACTERISTIC KF_IEDSIGANGLEV2MMOTCG_5D "Minimale bedarfgerechte Bestromungsschwelle fuer EDS" MAP 0x2621E4 kf_si16_S6_S3 1200 UMR_MA__1_10_0_S6_S3 0 1200
 /begin AXIS_DESCR STD_AXIS NO_INPUT_QUANTITY UMR_NM__1_1_0_S6_S3 8 -300 1640 DEPOSIT ABSOLUTE MONOTONY MON_INCREASE /end AXIS_DESCR
 /begin AXIS_DESCR STD_AXIS iUl2ItfipInt.c_getr_l2 UMR_GRADC__1_1_M40_S6_S3 4 -40 215 DEPOSIT ABSOLUTE MONOTONY MON_INCREASE /end AXIS_DESCR
/end CHARACTERISTIC
/begin CHARACTERISTIC KF_IEDSIGANGLEV2MMOTCG_6C "Minimale bedarfgerechte Bestromungsschwelle fuer EDS" MAP 0x262244 kf_si16_S6_S3 1200 UMR_MA__1_10_0_S6_S3 0 1200
 /begin AXIS_DESCR STD_AXIS NO_INPUT_QUANTITY UMR_NM__1_1_0_S6_S3 8 -300 1640 DEPOSIT ABSOLUTE MONOTONY MON_INCREASE /end AXIS_DESCR
 /begin AXIS_DESCR STD_AXIS iUl2ItfipInt.c_getr_l2 UMR_GRADC__1_1_M40_S6_S3 4 -40 215 DEPOSIT ABSOLUTE MONOTONY MON_INCREASE /end AXIS_DESCR
/end CHARACTERISTIC
/begin CHARACTERISTIC KF_IEDSIGANGLEV2MMOTCG_6D "Minimale bedarfgerechte Bestromungsschwelle fuer EDS" MAP 0x2622A4 kf_si16_S6_S3 1200 UMR_MA__1_10_0_S6_S3 0 1200
 /begin AXIS_DESCR STD_AXIS NO_INPUT_QUANTITY UMR_NM__1_1_0_S6_S3 8 -300 1640 DEPOSIT ABSOLUTE MONOTONY MON_INCREASE /end AXIS_DESCR
 /begin AXIS_DESCR STD_AXIS iUl2ItfipInt.c_getr_l2 UMR_GRADC__1_1_M40_S6_S3 4 -40 215 DEPOSIT ABSOLUTE MONOTONY MON_INCREASE /end AXIS_DESCR
/end CHARACTERISTIC
/begin CHARACTERISTIC KF_IEDSIGANGLEV2MMOTCG_6E "Minimale bedarfgerechte Bestromungsschwelle fuer EDS" MAP 0x262304 kf_si16_S6_S3 1200 UMR_MA__1_10_0_S6_S3 0 1200
 /begin AXIS_DESCR STD_AXIS NO_INPUT_QUANTITY UMR_NM__1_1_0_S6_S3 8 -300 1640 DEPOSIT ABSOLUTE MONOTONY MON_INCREASE /end AXIS_DESCR
 /begin AXIS_DESCR STD_AXIS iUl2ItfipInt.c_getr_l2 UMR_GRADC__1_1_M40_S6_S3 4 -40 215 DEPOSIT ABSOLUTE MONOTONY MON_INCREASE /end AXIS_DESCR
/end CHARACTERISTIC
/begin CHARACTERISTIC KF_IEDSIGANGLEV2MMOTCG_7A "Minimale bedarfgerechte Bestromungsschwelle fuer EDS" MAP 0x262364 kf_si16_S6_S3 1200 UMR_MA__1_10_0_S6_S3 0 1200
 /begin AXIS_DESCR STD_AXIS NO_INPUT_QUANTITY UMR_NM__1_1_0_S6_S3 8 -300 1640 DEPOSIT ABSOLUTE MONOTONY MON_INCREASE /end AXIS_DESCR
 /begin AXIS_DESCR STD_AXIS iUl2ItfipInt.c_getr_l2 UMR_GRADC__1_1_M40_S6_S3 4 -40 215 DEPOSIT ABSOLUTE MONOTONY MON_INCREASE /end AXIS_DESCR
/end CHARACTERISTIC
/begin CHARACTERISTIC KF_IEDSIGANGLEV2MMOTCG_7C "Minimale bedarfgerechte Bestromungsschwelle fuer EDS" MAP 0x2623C4 kf_si16_S6_S3 1200 UMR_MA__1_10_0_S6_S3 0 1200
 /begin AXIS_DESCR STD_AXIS NO_INPUT_QUANTITY UMR_NM__1_1_0_S6_S3 8 -300 1640 DEPOSIT ABSOLUTE MONOTONY MON_INCREASE /end AXIS_DESCR
 /begin AXIS_DESCR STD_AXIS iUl2ItfipInt.c_getr_l2 UMR_GRADC__1_1_M40_S6_S3 4 -40 215 DEPOSIT ABSOLUTE MONOTONY MON_INCREASE /end AXIS_DESCR
/end CHARACTERISTIC
/begin CHARACTERISTIC KF_IEDSIGANGLEV2MMOTCG_7D "Minimale bedarfgerechte Bestromungsschwelle fuer EDS" MAP 0x262424 kf_si16_S6_S3 1200 UMR_MA__1_10_0_S6_S3 0 1200
 /begin AXIS_DESCR STD_AXIS NO_INPUT_QUANTITY UMR_NM__1_1_0_S6_S3 8 -300 1640 DEPOSIT ABSOLUTE MONOTONY MON_INCREASE /end AXIS_DESCR
 /begin AXIS_DESCR STD_AXIS iUl2ItfipInt.c_getr_l2 UMR_GRADC__1_1_M40_S6_S3 4 -40 215 DEPOSIT ABSOLUTE MONOTONY MON_INCREASE /end AXIS_DESCR
/end CHARACTERISTIC
/begin CHARACTERISTIC KF_IEDSIGANGLEV2MMOTCG_8A "Minimale bedarfgerechte Bestromungsschwelle fuer EDS" MAP 0x262484 kf_si16_S6_S3 1200 UMR_MA__1_10_0_S6_S3 0 1200
 /begin AXIS_DESCR STD_AXIS NO_INPUT_QUANTITY UMR_NM__1_1_0_S6_S3 8 -300 1640 DEPOSIT ABSOLUTE MONOTONY MON_INCREASE /end AXIS_DESCR
 /begin AXIS_DESCR STD_AXIS iUl2ItfipInt.c_getr_l2 UMR_GRADC__1_1_M40_S6_S3 4 -40 215 DEPOSIT ABSOLUTE MONOTONY MON_INCREASE /end AXIS_DESCR
/end CHARACTERISTIC
/begin CHARACTERISTIC KF_IEDSIGANGLEV2MMOTCG_8D "Minimale bedarfgerechte Bestromungsschwelle fuer EDS" MAP 0x2624E4 kf_si16_S6_S3 1200 UMR_MA__1_10_0_S6_S3 0 1200
 /begin AXIS_DESCR STD_AXIS NO_INPUT_QUANTITY UMR_NM__1_1_0_S6_S3 8 -300 1640 DEPOSIT ABSOLUTE MONOTONY MON_INCREASE /end AXIS_DESCR
 /begin AXIS_DESCR STD_AXIS iUl2ItfipInt.c_getr_l2 UMR_GRADC__1_1_M40_S6_S3 4 -40 215 DEPOSIT ABSOLUTE MONOTONY MON_INCREASE /end AXIS_DESCR
/end CHARACTERISTIC
/begin CHARACTERISTIC KF_IEDSIGANGLEV2MMOTCG_8E "Minimale bedarfgerechte Bestromungsschwelle fuer EDS" MAP 0x262544 kf_si16_S6_S3 1200 UMR_MA__1_10_0_S6_S3 0 1200
 /begin AXIS_DESCR STD_AXIS NO_INPUT_QUANTITY UMR_NM__1_1_0_S6_S3 8 -300 1640 DEPOSIT ABSOLUTE MONOTONY MON_INCREASE /end AXIS_DESCR
 /begin AXIS_DESCR STD_AXIS iUl2ItfipInt.c_getr_l2 UMR_GRADC__1_1_M40_S6_S3 4 -40 215 DEPOSIT ABSOLUTE MONOTONY MON_INCREASE /end AXIS_DESCR
/end CHARACTERISTIC
/begin CHARACTERISTIC N_MAX_IGANG "IGANG" VALUE 0x26EAB3 kw_ui8_S6_S3 255 UMR___1_1_0_S6_S3 0 255 /end CHARACTERISTIC
/begin CHARACTERISTIC SWI_BEDGBESTR "bedarfsgerechte Bestromung aktiv" VALUE 0x26EAB4 kw_ui8_S6_S3 1 UMR___1_1_0_S6_S3 0 1 /end CHARACTERISTIC
/begin CHARACTERISTIC N_MAX_VERZ_POWERFLOW "ASIL-B: Schwellwert fuer die Verzoegerung der D oder R Erkennung" VALUE 0x26EAB5 kw_ui8_S6_S3 255 UMR___1_1_0_S6_S3 0 255 /end CHARACTERISTIC
/begin CHARACTERISTIC I_EDSPOWERFLOWUEBMAX_A "ASIL-C: Stromschwelle zur Erkennung ob Kupplung druckbeaufschlagt ist" VALUE 0x26E028 kw_ui16_S6_S3 1200 UMR_MA__1_10_0_S6_S3 0 1200 /end CHARACTERISTIC
/begin CHARACTERISTIC I_EDSPOWERFLOWUEBMAX_B "ASIL-C: Stromschwelle zur Erkennung ob Kupplung druckbeaufschlagt ist" VALUE 0x26E02A kw_ui16_S6_S3 1200 UMR_MA__1_10_0_S6_S3 0 1200 /end CHARACTERISTIC
/begin CHARACTERISTIC I_EDSPOWERFLOWUEBMIN_C "ASIL-C: Stromschwelle zur Erkennung ob Kupplung druckbeaufschlagt ist" VALUE 0x26E02C kw_ui16_S6_S3 1200 UMR_MA__1_10_0_S6_S3 0 1200 /end CHARACTERISTIC
/begin CHARACTERISTIC I_EDSPOWERFLOWUEBMIN_D "ASIL-C: Stromschwelle zur Erkennung ob Kupplung druckbeaufschlagt ist" VALUE 0x26E02E kw_ui16_S6_S3 1200 UMR_MA__1_10_0_S6_S3 0 1200 /end CHARACTERISTIC
/begin CHARACTERISTIC I_EDSPOWERFLOWUEBMIN_E "ASIL-C: Stromschwelle zur Erkennung ob Kupplung druckbeaufschlagt ist" VALUE 0x26E030 kw_ui16_S6_S3 1200 UMR_MA__1_10_0_S6_S3 0 1200 /end CHARACTERISTIC
/begin CHARACTERISTIC N_VERZ_ISETPLAUSIBLE "ASIL C: Schwelle fuer die Störung im Fest Gang" VALUE 0x26EACC kw_ui8_S6_S3 255 UMR___1_1_0_S6_S3 0 255 /end CHARACTERISTIC
/begin CHARACTERISTIC SWI_VERSCH_ISETPLAUSIBLE "ASIL C: Aktivierung der Verschachtelung 4 Kupplungen beteiligt" VALUE 0x26EACD kw_ui8_S6_S3 2 UMR___1_1_0_S6_S3 0 2 /end CHARACTERISTIC
/begin CHARACTERISTIC N_VERZ_REV_ISETPLAUSIBLE "ASIL-C: Verzögerungszähler fuer Reversieren" VALUE 0x26EACE kw_ui8_S6_S3 255 UMR___1_1_0_S6_S3 0 255 /end CHARACTERISTIC
/begin CHARACTERISTIC N_VERZ_REVN_ISETPLAUSIBLE "ASIL-C: Verzögerungszähler fuer Reversieren ueber N P" VALUE 0x26EACF kw_ui8_S6_S3 255 UMR___1_1_0_S6_S3 0 255 /end CHARACTERISTIC
/begin CHARACTERISTIC I_KUPB_ISETPLAUSIBLE "ASIL-C: Stromschwelle fuer die IAE Kupplung" VALUE 0x26E050 kw_ui16_S6_S3 1200 UMR_MA__1_10_0_S6_S3 0 1200 /end CHARACTERISTIC
/begin CHARACTERISTIC SWI_NAB_BEW "LEVEL2: Aktivierungsschalter fuer Teilfunktion Bewertung ueber Ringspeicher n_ab-Signal fuer Ueberwachung max Verzoegerung" VALUE 0x26EADA kw_ui8_S6_S3 1 UMR___1_1_0_S6_S3 0 1 /end CHARACTERISTIC
/begin CHARACTERISTIC N_ZAEHLERVERZMAXAKTIV "LEVEL2: Zaehler zur Aktivierung der Ueberwachung max Verzoegerung" VALUE 0x26E068 kw_ui16_S6_S3 1000 UMR___1_1_0_S6_S3 0 1000 /end CHARACTERISTIC
/begin CHARACTERISTIC AQ_VERZMAX "LEVEL2: Pruefbedingung Beschleunigungsschwelle fuer Ueberwachung max Verzoegerung" VALUE 0x26E06A kw_ui16_S6_S3 20 UMR_M_SEC2_1_32_0_S6_S3 0 20 /end CHARACTERISTIC
/begin CHARACTERISTIC PS_BRVERZMAX "LEVEL2: Pruefbedingung Bremsdruck fuer Ueberwachung max Verzoegerung" VALUE 0x26E06C kw_ui16_S6_S3 100 UMR_BAR__1_100_0_S6_S3 0 100 /end CHARACTERISTIC
/begin CHARACTERISTIC N_SIGREFVERZMAX "LEVEL2: Anzahl Abtastwerte fuer Bestimmung Zugriff auf gespeicherten n_ab-Wert fuer Teilfunktion Bewertung ueber Ringspeicher n_ab-Signal fuer Ueberwachung max Verzoegerung" VALUE 0x26EADB kw_ui8_S6_S3 49 UMR___1_1_0_S6_S3 1 50 /end CHARACTERISTIC
/begin CHARACTERISTIC NS_ABVERZMAX "LEVEL2: Abtriebsdrehzahlschwellle fuer Teilfunktion Bewertung ueber Ringspeicher n_ab-Signal fuer Ueberwachung max Verzoegerung" VALUE 0x26E06E kw_ui16_S6_S3 8000 UMR_U_MIN_1_1_0_S6_S3 0 8000 /end CHARACTERISTIC
/begin CHARACTERISTIC NS_ABDIFVERZMAXAKTIV "LEVEL2: Pruefbedingung Abtriebsdrehzahlschwelle fuer Ueberwachung max Verzoegerung" VALUE 0x26E070 kw_si16_S6_S3 6000 UMR_U_MIN_1_1_0_S6_S3 -5000 1000 /end CHARACTERISTIC
/begin CHARACTERISTIC SWI_MAXVERZ "LEVEL2: Aktivierungsschalter für zusätzliche Einstiegsbedingung" VALUE 0x26EADC kw_ui8_S6_S3 1 UMR___1_1_0_S6_S3 0 1 /end CHARACTERISTIC
/begin CHARACTERISTIC N_MAX_NAB_MAXVERZ "LEVEL2: Zählerschwelle Überwachung max. verzögerung" VALUE 0x26E072 kw_ui16_S6_S3 1000 UMR___1_1_0_S6_S3 0 1000 /end CHARACTERISTIC
/begin CHARACTERISTIC NAB_MAXVERZ "LEVEL2: Abtriebsdrehzahlschwelle Überwachung max. verzögerung" VALUE 0x26EADD kw_ui8_S6_S3 2550 UMR_U_MIN_10_1_0_S6_S3 0 2550 /end CHARACTERISTIC
/begin CHARACTERISTIC TS_VERZMAX_BRAKE "LEVEL2: Fahrerwunschbremsmomentschwelle" VALUE 0x26EADE kw_ui8_S6_S3 25500 UMR_NM__100_1_M255_S6_S3 -25500 0 /end CHARACTERISTIC
/begin CHARACTERISTIC SWI_PBRAKE_MAXVERZ "LEVEL2: Aktivierungsschalter Überwachung der Parkbremse" VALUE 0x26EADF kw_ui8_S6_S3 1 UMR___1_1_0_S6_S3 0 1 /end CHARACTERISTIC
/begin CHARACTERISTIC N_VERZ_MAXVERZ "LEVEL2: Zählerschwelle Überwachung max. verzögerung Parkbremse" VALUE 0x26E074 kw_ui16_S6_S3 2550 UMR___1_1_0_S6_S3 0 2550 /end CHARACTERISTIC
/begin CHARACTERISTIC SWI_NABSTATUS_MAXVERZ "LEVEL2: Aktivierungsschalter Verzoegerung wegen Nab Status" VALUE 0x26EAE0 kw_ui8_S6_S3 1 UMR___1_1_0_S6_S3 0 1 /end CHARACTERISTIC
/begin CHARACTERISTIC TS_BRVERZMAX "LEVEL2: Bremsmoment fuer Ueberwachung max Verzoegerung" VALUE 0x26EAE1 kw_ui8_S6_S3 25500 UMR_NM__100_1_M255_S6_S3 -25500 0 /end CHARACTERISTIC
/begin CHARACTERISTIC IEDSC_MAX_POSVC "ASIL-C: Stromschwelle zur Erkennung ob Kupplung C geschaltet ist" VALUE 0x26E032 kw_ui16_S6_S3 1200 UMR_MA__1_10_0_S6_S3 0 1200 /end CHARACTERISTIC
/begin CHARACTERISTIC CS_EDSLOGIK "ASIL-C: Temperaturschwelle zur Aktivierung der Funktion" VALUE 0x26EAB6 kw_ui8_S6_S3 190 UMR_GRADC__1_1_M40_S6_S3 -40 150 /end CHARACTERISTIC
/begin CHARACTERISTIC VS_EDSLOGIK "ASIL-C: Geschwindigkeitsschwelle zum Einstieg in die Funktion" VALUE 0x26EAB7 kw_ui8_S6_S3 255 UMR_KM_H_1_1_0_S6_S3 0 255 /end CHARACTERISTIC
/begin CHARACTERISTIC N_MAX_FAHRTR "ASIL-C: Timer zur Erkennung eines Fahrtrichtungverwechslers bei Wechsel pos_l2 von (D nach R) oder (R nach D)" VALUE 0x26EAB8 kw_ui8_S6_S3 255 UMR___1_1_0_S6_S3 0 255 /end CHARACTERISTIC
/begin CHARACTERISTIC N_MAX_POSFAHRTR "ASIL-C: Zaehler zur Erkennung einer Diskrepanz pos_l1 zu pos_l2" VALUE 0x26E034 kw_ui16_S6_S3 1000 UMR___1_1_0_S6_S3 0 1000 /end CHARACTERISTIC
/begin CHARACTERISTIC N_MAXKABPOS_C "ASIL-C: Zähler zur erweiterten Erkennungn Kupplung C nicht geschaltet bei Teilfunktion Plausibilisierung Aktuatoransteuerung/ Sollposition eines Kraftschlusswechsels" VALUE 0x26EAB9 kw_ui8_S6_S3 255 UMR___1_1_0_S6_S3 0 255 /end CHARACTERISTIC
/begin CHARACTERISTIC N_MAXKABPOS_E "ASIL-C: Zähler zur erweiterten Erkennungn Kupplung E nicht geschaltet bei Teilfunktion Plausibilisierung Aktuatoransteuerung/ Sollposition eines Kraftschlusswechsels" VALUE 0x26EABA kw_ui8_S6_S3 255 UMR___1_1_0_S6_S3 0 255 /end CHARACTERISTIC
/begin CHARACTERISTIC VS_FZG_R "ASIL-C: Fahrzeuggeschwindigkeitsschwelle fuer R-Gang" VALUE 0x26E036 kw_ui16_S6_S3 400 UMR_KM_H_1_1_0_S6_S3 0 400 /end CHARACTERISTIC
/begin CHARACTERISTIC VS_FZG_RSICH_LEV2 "ASIL-C: Fahrzeuggeschwindigkeitsschwelle fuer R-Gang" VALUE 0x26E038 kw_ui16_S6_S3 400 UMR_KM_H_1_1_0_S6_S3 0 400 /end CHARACTERISTIC
/begin CHARACTERISTIC N_MAXKFLWECHSEL "ASIL-C: Zähler zur Erkennung eines Kraftschlusswechsels" VALUE 0x26EABB kw_ui8_S6_S3 255 UMR___1_1_0_S6_S3 0 255 /end CHARACTERISTIC
/begin CHARACTERISTIC SWI_EDSLOGIK_POSUEB "ASIL-B: Schalter zum Aktivieren der Diagnose für die Erkennung eines Fahrtrichtungsverwechslers bei gefährlichen Kombinationen von pos und pos_l2" VALUE 0x26EABC kw_ui8_S6_S3 1 UMR___1_1_0_S6_S3 0 1 /end CHARACTERISTIC
/begin CHARACTERISTIC MAX_STOER_FAHRTR_POS "ASIL-B: Störzählerschwelle für gefährliche Kombinationen von pos und pos_l2" VALUE 0x26EABD kw_ui8_S6_S3 255 UMR___1_1_0_S6_S3 0 255 /end CHARACTERISTIC
/begin CHARACTERISTIC I_EDSMAXPOSPUEB_POS "Stromschwelle für EDS_POS für Überwachung unzulässiges Auslegen Position P" VALUE 0x26E03A kw_ui16_S6_S3 1200 UMR_MA__1_10_0_S6_S3 0 1200 /end CHARACTERISTIC
/begin CHARACTERISTIC I_EDSMINPOSPUEB_C "ASIL-C: Stromschwelle für Kupplung C für Überwachung unzulässiges Auslegen Position P" VALUE 0x26E03C kw_ui16_S6_S3 1200 UMR_MA__1_10_0_S6_S3 0 1200 /end CHARACTERISTIC
/begin CHARACTERISTIC N_MAXSTOERPOS_P "Störzähler für Überwachung unzulässiges Auslegen Position P" VALUE 0x26EABE kw_ui8_S6_S3 255 UMR___1_1_0_S6_S3 0 255 /end CHARACTERISTIC
/begin CHARACTERISTIC N_MAXSTOERVPLAUSIPOS_P "ASIL-C: Stoerzaehler fuer Ueberwachung unzulaessiges Einlegen Position P" VALUE 0x26EABF kw_ui8_S6_S3 255 UMR___1_1_0_S6_S3 0 255 /end CHARACTERISTIC
/begin CHARACTERISTIC I_EDSPOS "Stromschwelle für i_eds_pos für Überwachung unzulässiges Einlegen Position P" VALUE 0x26E03E kw_ui16_S6_S3 1200 UMR_MA__1_10_0_S6_S3 0 1200 /end CHARACTERISTIC
/begin CHARACTERISTIC N_VPOSPUEB "ASIL-C: Verzögerungszähler für Einstieg in Überwachung (Degradation)" VALUE 0x26E040 kw_ui16_S6_S3 400 UMR___1_1_0_S6_S3 0 400 /end CHARACTERISTIC
/begin CHARACTERISTIC SWI_K0UEB "ASIL-B: zum Umschalten des Berechnungsverfahrens der Fehlererkennung" VALUE 0x26EAC0 kw_ui8_S6_S3 3 UMR___1_1_0_S6_S3 0 3 /end CHARACTERISTIC
/begin CHARACTERISTIC KL_I_MAXK0 "ASIL-B: Stromschwelle für KO-Erkennung" CURVE 0x2625A4 kl_ui16_S6_S3 1200 UMR_MA__1_10_0_S6_S3 0 1200
 /begin AXIS_DESCR STD_AXIS NO_INPUT_QUANTITY UMR___1_1000_0_S6_S3 8 0 65.535 DEPOSIT ABSOLUTE MONOTONY MON_INCREASE /end AXIS_DESCR
/end CHARACTERISTIC
/begin CHARACTERISTIC N_DIFF_EM_MAX "ASIL-B: Maximal zulässige Differenzdrehzahl an der EM" VALUE 0x26E042 kw_ui16_S6_S3 1200 UMR_U_MIN_1_1_0_S6_S3 0 1200 /end CHARACTERISTIC
/begin CHARACTERISTIC J_VM_K0 "ASIL-B: Massenträgheit des Motors" VALUE 0x26E044 kw_ui16_S6_S3 1 UMR_KGM2__1_1000_0_S6_S3 0 1 /end CHARACTERISTIC
/begin CHARACTERISTIC KL_M_REIB_K0 "ASIL-B: Abstützendes Moment an der Strasse" CURVE 0x2625C8 kl_ui16_S6_S3 1200 UMR_NM__1_1_0_S6_S3 0 1200
 /begin AXIS_DESCR STD_AXIS NO_INPUT_QUANTITY UMR___1_1000_0_S6_S3 8 0 65.535 DEPOSIT ABSOLUTE MONOTONY MON_INCREASE /end AXIS_DESCR
/end CHARACTERISTIC
/begin CHARACTERISTIC KL_MAXSTOER_EDSLOGIK_K0 "ASIL-C: Störzähler zur Fehlererkennung der K0" CURVE 0x2625EC kl_ui16_S6_S3 255 UMR___1_1_0_S6_S3 0 255
 /begin AXIS_DESCR STD_AXIS NO_INPUT_QUANTITY UMR_MA__1_10_0_S6_S3 6 0 1200 DEPOSIT ABSOLUTE MONOTONY MON_INCREASE /end AXIS_DESCR
/end CHARACTERISTIC
/begin CHARACTERISTIC KL_N_DIFF_K0_MIN "ASIL-C: minimale Differenzdrehzahl an der K0" CURVE 0x262608 kl_ui16_S6_S3 4000 UMR_U_MIN_1_1_0_S6_S3 0 4000
 /begin AXIS_DESCR STD_AXIS NO_INPUT_QUANTITY UMR___1_1000_0_S6_S3 8 0 65.535 DEPOSIT ABSOLUTE MONOTONY MON_INCREASE /end AXIS_DESCR
/end CHARACTERISTIC
/begin CHARACTERISTIC N_K0_TASKS "ASIL-B: Anzahl der Tasks bis bei Unterschreiten der K0-Stromschwelle aus der Funktion ausgestiegen wird." VALUE 0x26EAC1 kw_ui8_S6_S3 255 UMR___1_1_0_S6_S3 0 255 /end CHARACTERISTIC
/begin CHARACTERISTIC I_MAXSTATUSK0 "ASIL-B: Stromschwelle für K0-Statusüberwachung" VALUE 0x26E046 kw_ui16_S6_S3 1200 UMR_MA__1_10_0_S6_S3 0 1200 /end CHARACTERISTIC
/begin CHARACTERISTIC MAXSTOER1_K0_SCHLIESSEN_STATUS "ASIL-B: Störzählerschwelle für ungewolltes schließen" VALUE 0x26EAC2 kw_ui8_S6_S3 255 UMR___1_1_0_S6_S3 0 255 /end CHARACTERISTIC
/begin CHARACTERISTIC MAXSTOER2_K0_SCHLIESSEN_STATUS "ASIL-B: Störzählerschwelle für öffnen erfolgt nicht" VALUE 0x26EAC3 kw_ui8_S6_S3 255 UMR___1_1_0_S6_S3 0 255 /end CHARACTERISTIC
/begin CHARACTERISTIC I_KUPD_MAX_EDSLOGIK "ASIL-B: Stromschwelle zur Erkennung ob Kupplung D geschaltet ist" VALUE 0x26E048 kw_ui16_S6_S3 1200 UMR_MA__1_10_0_S6_S3 0 1200 /end CHARACTERISTIC
/begin CHARACTERISTIC I_KUPB_MIN_EDSLOGIK "ASIL-B: Stromschwelle zur Erkennung ob Kupplung B geschaltet ist" VALUE 0x26E04A kw_ui16_S6_S3 1200 UMR_MA__1_10_0_S6_S3 0 1200 /end CHARACTERISTIC
/begin CHARACTERISTIC I_KUPA_MIN_EDSLOGIK "ASIL-B: Stromschwelle zur Erkennung ob Kupplung A geschaltet ist" VALUE 0x26E04C kw_ui16_S6_S3 1200 UMR_MA__1_10_0_S6_S3 0 1200 /end CHARACTERISTIC
/begin CHARACTERISTIC N_VERZ_EDSLOGIK "ASIL-B: Entprellzeit für RGang-Erkennung" VALUE 0x26EAC4 kw_ui8_S6_S3 255 UMR___1_1_0_S6_S3 0 255 /end CHARACTERISTIC
/begin CHARACTERISTIC N_STOER_MAX_FAHRTR_EDSLOGIK "ASIL-B: Störzählerschwelle zur Anfilterung des KFC1_POSLEV2" VALUE 0x26EAC5 kw_ui8_S6_S3 255 UMR___1_1_0_S6_S3 0 255 /end CHARACTERISTIC
/begin CHARACTERISTIC SWI_EDSLOGIK_TOGGELN "Schalter für Toggelerkennung" VALUE 0x26EAC6 kw_ui8_S6_S3 1 UMR___1_1_0_S6_S3 0 1 /end CHARACTERISTIC
/begin CHARACTERISTIC SWI_MMOT_EDSLOGIK "Umschaltung zwischen dem Motormoment ohne mit Eingriffe" VALUE 0x26EAD2 kw_ui8_S6_S3 1 UMR___1_1_0_S6_S3 0 1 /end CHARACTERISTIC
/begin CHARACTERISTIC N_KUP_OFFEN "ASIL-C: Zähler zur Verzögerung der Erkennung - Schaltelement nicht geschaltet" VALUE 0x26EAD3 kw_ui8_S6_S3 5 UMR___1_1_0_S6_S3 0 5 /end CHARACTERISTIC
/begin CHARACTERISTIC N_KUP_OFFEN_STROMLOS "ASIL-C: Zähler zur Verzögerung der Stromlos-Erkennung - Schaltelement nicht geschaltet" VALUE 0x26EAD4 kw_ui8_S6_S3 5 UMR___1_1_0_S6_S3 0 5 /end CHARACTERISTIC
/begin CHARACTERISTIC KF_IEDSMAXMMOTCGLOGIKUEB_A "Maximale Druckreglerstromschwelle fuer EDS" MAP 0x262748 kf_si16_S6_S3 1200 UMR_MA__1_10_0_S6_S3 0 1200
 /begin AXIS_DESCR STD_AXIS NO_INPUT_QUANTITY UMR_NM__1_1_0_S6_S3 8 -300 1640 DEPOSIT ABSOLUTE MONOTONY MON_INCREASE /end AXIS_DESCR
 /begin AXIS_DESCR STD_AXIS iUl2ItfipInt.c_getr_l2 UMR_GRADC__1_1_M40_S6_S3 4 -40 215 DEPOSIT ABSOLUTE MONOTONY MON_INCREASE /end AXIS_DESCR
/end CHARACTERISTIC
/begin CHARACTERISTIC KF_IEDSMAXOFFMMOTCGLOGIKUEB_A "Minimale Druckreglerstromschwelle fuer EDS" MAP 0x2627A8 kf_si16_S6_S3 1200 UMR_MA__1_10_0_S6_S3 0 1200
 /begin AXIS_DESCR STD_AXIS NO_INPUT_QUANTITY UMR_NM__1_1_0_S6_S3 4 -400 1640 DEPOSIT ABSOLUTE MONOTONY MON_INCREASE /end AXIS_DESCR
 /begin AXIS_DESCR STD_AXIS iUl2ItfipInt.c_getr_l2 UMR_GRADC__1_1_M40_S6_S3 4 -40 215 DEPOSIT ABSOLUTE MONOTONY MON_INCREASE /end AXIS_DESCR
/end CHARACTERISTIC
/begin CHARACTERISTIC KL_IEDSMAXOFFCG_BEF1_A "Offset auf Stromschwelle zur Erkennung eines EDS-Logik-Fehlers bei 1. Befüllung" CURVE 0x2627E0 kl_si16_S6_S3 1200 UMR_MA__1_10_0_S6_S3 0 1200
 /begin AXIS_DESCR STD_AXIS iUl2ItfipInt.c_getr_l2 UMR_GRADC__1_1_M40_S6_S3 6 -40 215 DEPOSIT ABSOLUTE MONOTONY MON_INCREASE /end AXIS_DESCR
/end CHARACTERISTIC
/begin CHARACTERISTIC KF_MAXSTOERCGDELTAI_EDSLOGIK_A "Minimale Druckreglerstromschwelle fuer EDS" MAP 0x2627FC kf_si16_S6_S3 255 UMR___1_1_0_S6_S3 0 255
 /begin AXIS_DESCR STD_AXIS iUl2ItfipInt.c_getr_l2 UMR_GRADC__1_1_M40_S6_S3 6 -40 215 DEPOSIT ABSOLUTE MONOTONY MON_INCREASE /end AXIS_DESCR
 /begin AXIS_DESCR STD_AXIS NO_INPUT_QUANTITY UMR_MA__1_10_0_S6_S3 6 0 1000 DEPOSIT ABSOLUTE MONOTONY MON_INCREASE /end AXIS_DESCR
/end CHARACTERISTIC
/begin CHARACTERISTIC KL_MAX_STOEROFFCG_BEF1_A "Minimale Druckreglerstromschwelle fuer EDS" CURVE 0x262864 kl_ui8_S6_S3 255 UMR___1_1_0_S6_S3 0 255
 /begin AXIS_DESCR STD_AXIS iUl2ItfipInt.c_getr_l2 UMR_GRADC__1_1_M40_S6_S3 6 -40 215 DEPOSIT ABSOLUTE MONOTONY MON_INCREASE /end AXIS_DESCR
/end CHARACTERISTIC
/begin CHARACTERISTIC IEDS_STOER_VUNPLAUSI_A "ASIL-C: Stromschwellen für GE mit 4 Kupplungen" VALUE 0x26E05E kw_ui16_S6_S3 1200 UMR_MA__1_10_0_S6_S3 0 1200 /end CHARACTERISTIC
/begin CHARACTERISTIC KL_NVERZMIN_DEKREMENT_EDSLOGIK_A "ASIL-C: Verzögerungsschwelle fürs Dekrementieren" CURVE 0x262874 kl_ui8_S6_S3 254 UMR___1_1_0_S6_S3 0 254
 /begin AXIS_DESCR STD_AXIS iUl2ItfipInt.c_getr_l2 UMR_GRADC__1_1_M40_S6_S3 4 -40 215 DEPOSIT ABSOLUTE MONOTONY MON_INCREASE /end AXIS_DESCR
/end CHARACTERISTIC
/begin CHARACTERISTIC KF_IEDSMAXMMOTCGLOGIKUEB_B "Maximale Druckreglerstromschwelle fuer EDS" MAP 0x262880 kf_si16_S6_S3 1200 UMR_MA__1_10_0_S6_S3 0 1200
 /begin AXIS_DESCR STD_AXIS NO_INPUT_QUANTITY UMR_NM__1_1_0_S6_S3 8 -300 1640 DEPOSIT ABSOLUTE MONOTONY MON_INCREASE /end AXIS_DESCR
 /begin AXIS_DESCR STD_AXIS iUl2ItfipInt.c_getr_l2 UMR_GRADC__1_1_M40_S6_S3 4 -40 215 DEPOSIT ABSOLUTE MONOTONY MON_INCREASE /end AXIS_DESCR
/end CHARACTERISTIC
/begin CHARACTERISTIC KF_IEDSMAXOFFMMOTCGLOGIKUEB_B "Minimale Druckreglerstromschwelle fuer EDS" MAP 0x2628E0 kf_si16_S6_S3 1200 UMR_MA__1_10_0_S6_S3 0 1200
 /begin AXIS_DESCR STD_AXIS NO_INPUT_QUANTITY UMR_NM__1_1_0_S6_S3 4 -400 1640 DEPOSIT ABSOLUTE MONOTONY MON_INCREASE /end AXIS_DESCR
 /begin AXIS_DESCR STD_AXIS iUl2ItfipInt.c_getr_l2 UMR_GRADC__1_1_M40_S6_S3 4 -40 215 DEPOSIT ABSOLUTE MONOTONY MON_INCREASE /end AXIS_DESCR
/end CHARACTERISTIC
/begin CHARACTERISTIC KL_IEDSMAXOFFCG_BEF1_B "Offset auf Stromschwelle zur Erkennung eines EDS-Logik-Fehlers bei 1. Befüllung" CURVE 0x262918 kl_si16_S6_S3 1200 UMR_MA__1_10_0_S6_S3 0 1200
 /begin AXIS_DESCR STD_AXIS iUl2ItfipInt.c_getr_l2 UMR_GRADC__1_1_M40_S6_S3 6 -40 215 DEPOSIT ABSOLUTE MONOTONY MON_INCREASE /end AXIS_DESCR
/end CHARACTERISTIC
/begin CHARACTERISTIC KF_MAXSTOERCGDELTAI_EDSLOGIK_B "Minimale Druckreglerstromschwelle fuer EDS" MAP 0x262934 kf_si16_S6_S3 255 UMR___1_1_0_S6_S3 0 255
 /begin AXIS_DESCR STD_AXIS iUl2ItfipInt.c_getr_l2 UMR_GRADC__1_1_M40_S6_S3 6 -40 215 DEPOSIT ABSOLUTE MONOTONY MON_INCREASE /end AXIS_DESCR
 /begin AXIS_DESCR STD_AXIS NO_INPUT_QUANTITY UMR_MA__1_10_0_S6_S3 6 0 1000 DEPOSIT ABSOLUTE MONOTONY MON_INCREASE /end AXIS_DESCR
/end CHARACTERISTIC
/begin CHARACTERISTIC KL_MAX_STOEROFFCG_BEF1_B "Minimale Druckreglerstromschwelle fuer EDS" CURVE 0x26299C kl_ui8_S6_S3 255 UMR___1_1_0_S6_S3 0 255
 /begin AXIS_DESCR STD_AXIS iUl2ItfipInt.c_getr_l2 UMR_GRADC__1_1_M40_S6_S3 6 -40 215 DEPOSIT ABSOLUTE MONOTONY MON_INCREASE /end AXIS_DESCR
/end CHARACTERISTIC
/begin CHARACTERISTIC IEDS_STOER_VUNPLAUSI_B "ASIL-C: Stromschwellen für GE mit 4 Kupplungen" VALUE 0x26E060 kw_ui16_S6_S3 1200 UMR_MA__1_10_0_S6_S3 0 1200 /end CHARACTERISTIC
/begin CHARACTERISTIC KL_NVERZMIN_DEKREMENT_EDSLOGIK_B "ASIL-C: Verzögerungsschwelle fürs Dekrementieren" CURVE 0x2629AC kl_ui8_S6_S3 254 UMR___1_1_0_S6_S3 0 254
 /begin AXIS_DESCR STD_AXIS iUl2ItfipInt.c_getr_l2 UMR_GRADC__1_1_M40_S6_S3 4 -40 215 DEPOSIT ABSOLUTE MONOTONY MON_INCREASE /end AXIS_DESCR
/end CHARACTERISTIC
/begin CHARACTERISTIC KF_IEDSMINMMOTCGLOGIKUEB_C "Minimale Druckreglerstromschwelle fuer EDS" MAP 0x2629B8 kf_si16_S6_S3 1200 UMR_MA__1_10_0_S6_S3 0 1200
 /begin AXIS_DESCR STD_AXIS NO_INPUT_QUANTITY UMR_NM__1_1_0_S6_S3 8 -300 1640 DEPOSIT ABSOLUTE MONOTONY MON_INCREASE /end AXIS_DESCR
 /begin AXIS_DESCR STD_AXIS iUl2ItfipInt.c_getr_l2 UMR_GRADC__1_1_M40_S6_S3 4 -40 215 DEPOSIT ABSOLUTE MONOTONY MON_INCREASE /end AXIS_DESCR
/end CHARACTERISTIC
/begin CHARACTERISTIC KF_IEDSMINOFFMMOTCGLOGIKUEB_C "Minimale Druckreglerstromschwelle fuer EDS" MAP 0x262A18 kf_si16_S6_S3 1200 UMR_MA__1_10_0_S6_S3 0 1200
 /begin AXIS_DESCR STD_AXIS NO_INPUT_QUANTITY UMR_NM__1_1_0_S6_S3 4 -400 1640 DEPOSIT ABSOLUTE MONOTONY MON_INCREASE /end AXIS_DESCR
 /begin AXIS_DESCR STD_AXIS iUl2ItfipInt.c_getr_l2 UMR_GRADC__1_1_M40_S6_S3 4 -40 215 DEPOSIT ABSOLUTE MONOTONY MON_INCREASE /end AXIS_DESCR
/end CHARACTERISTIC
/begin CHARACTERISTIC KL_IEDSMINOFFCG_BEF1_C "Offset auf Stromschwelle zur Erkennung eines EDS-Logik-Fehlers bei 1. Befüllung" CURVE 0x262A50 kl_si16_S6_S3 1200 UMR_MA__1_10_0_S6_S3 0 1200
 /begin AXIS_DESCR STD_AXIS iUl2ItfipInt.c_getr_l2 UMR_GRADC__1_1_M40_S6_S3 6 -40 215 DEPOSIT ABSOLUTE MONOTONY MON_INCREASE /end AXIS_DESCR
/end CHARACTERISTIC
/begin CHARACTERISTIC KF_MAXSTOERCGDELTAI_EDSLOGIK_C "Minimale Druckreglerstromschwelle fuer EDS" MAP 0x262A6C kf_si16_S6_S3 255 UMR___1_1_0_S6_S3 0 255
 /begin AXIS_DESCR STD_AXIS iUl2ItfipInt.c_getr_l2 UMR_GRADC__1_1_M40_S6_S3 6 -40 215 DEPOSIT ABSOLUTE MONOTONY MON_INCREASE /end AXIS_DESCR
 /begin AXIS_DESCR STD_AXIS NO_INPUT_QUANTITY UMR_MA__1_10_0_S6_S3 6 0 1000 DEPOSIT ABSOLUTE MONOTONY MON_INCREASE /end AXIS_DESCR
/end CHARACTERISTIC
/begin CHARACTERISTIC KL_MAX_STOEROFFCG_BEF1_C "Minimale Druckreglerstromschwelle fuer EDS" CURVE 0x262AD4 kl_ui8_S6_S3 255 UMR___1_1_0_S6_S3 0 255
 /begin AXIS_DESCR STD_AXIS iUl2ItfipInt.c_getr_l2 UMR_GRADC__1_1_M40_S6_S3 6 -40 215 DEPOSIT ABSOLUTE MONOTONY MON_INCREASE /end AXIS_DESCR
/end CHARACTERISTIC
/begin CHARACTERISTIC IEDS_STOER_VUNPLAUSI_C "ASIL-C: Stromschwellen für GE mit 4 Kupplungen" VALUE 0x26E062 kw_ui16_S6_S3 1200 UMR_MA__1_10_0_S6_S3 0 1200 /end CHARACTERISTIC
/begin CHARACTERISTIC KL_NVERZMIN_DEKREMENT_EDSLOGIK_C "ASIL-C: Verzögerungsschwelle fürs Dekrementieren" CURVE 0x262AE4 kl_ui8_S6_S3 254 UMR___1_1_0_S6_S3 0 254
 /begin AXIS_DESCR STD_AXIS iUl2ItfipInt.c_getr_l2 UMR_GRADC__1_1_M40_S6_S3 4 -40 215 DEPOSIT ABSOLUTE MONOTONY MON_INCREASE /end AXIS_DESCR
/end CHARACTERISTIC
/begin CHARACTERISTIC KF_IEDSMINMMOTCGLOGIKUEB_D "Minimale Druckreglerstromschwelle fuer EDS" MAP 0x262AF0 kf_si16_S6_S3 1200 UMR_MA__1_10_0_S6_S3 0 1200
 /begin AXIS_DESCR STD_AXIS NO_INPUT_QUANTITY UMR_NM__1_1_0_S6_S3 8 -300 1640 DEPOSIT ABSOLUTE MONOTONY MON_INCREASE /end AXIS_DESCR
 /begin AXIS_DESCR STD_AXIS iUl2ItfipInt.c_getr_l2 UMR_GRADC__1_1_M40_S6_S3 4 -40 215 DEPOSIT ABSOLUTE MONOTONY MON_INCREASE /end AXIS_DESCR
/end CHARACTERISTIC
/begin CHARACTERISTIC KF_IEDSMINOFFMMOTCGLOGIKUEB_D "Minimale Druckreglerstromschwelle fuer EDS" MAP 0x262B50 kf_si16_S6_S3 1200 UMR_MA__1_10_0_S6_S3 0 1200
 /begin AXIS_DESCR STD_AXIS NO_INPUT_QUANTITY UMR_NM__1_1_0_S6_S3 4 -400 1640 DEPOSIT ABSOLUTE MONOTONY MON_INCREASE /end AXIS_DESCR
 /begin AXIS_DESCR STD_AXIS iUl2ItfipInt.c_getr_l2 UMR_GRADC__1_1_M40_S6_S3 4 -40 215 DEPOSIT ABSOLUTE MONOTONY MON_INCREASE /end AXIS_DESCR
/end CHARACTERISTIC
/begin CHARACTERISTIC KL_IEDSMINOFFCG_BEF1_D "Offset auf Stromschwelle zur Erkennung eines EDS-Logik-Fehlers bei 1. Befüllung" CURVE 0x262B88 kl_si16_S6_S3 1200 UMR_MA__1_10_0_S6_S3 0 1200
 /begin AXIS_DESCR STD_AXIS iUl2ItfipInt.c_getr_l2 UMR_GRADC__1_1_M40_S6_S3 6 -40 215 DEPOSIT ABSOLUTE MONOTONY MON_INCREASE /end AXIS_DESCR
/end CHARACTERISTIC
/begin CHARACTERISTIC KF_MAXSTOERCGDELTAI_EDSLOGIK_D "Minimale Druckreglerstromschwelle fuer EDS" MAP 0x262BA4 kf_si16_S6_S3 255 UMR___1_1_0_S6_S3 0 255
 /begin AXIS_DESCR STD_AXIS iUl2ItfipInt.c_getr_l2 UMR_GRADC__1_1_M40_S6_S3 6 -40 215 DEPOSIT ABSOLUTE MONOTONY MON_INCREASE /end AXIS_DESCR
 /begin AXIS_DESCR STD_AXIS NO_INPUT_QUANTITY UMR_MA__1_10_0_S6_S3 6 0 1000 DEPOSIT ABSOLUTE MONOTONY MON_INCREASE /end AXIS_DESCR
/end CHARACTERISTIC
/begin CHARACTERISTIC KL_MAX_STOEROFFCG_BEF1_D "Minimale Druckreglerstromschwelle fuer EDS" CURVE 0x262C0C kl_ui8_S6_S3 255 UMR___1_1_0_S6_S3 0 255
 /begin AXIS_DESCR STD_AXIS iUl2ItfipInt.c_getr_l2 UMR_GRADC__1_1_M40_S6_S3 6 -40 215 DEPOSIT ABSOLUTE MONOTONY MON_INCREASE /end AXIS_DESCR
/end CHARACTERISTIC
/begin CHARACTERISTIC IEDS_STOER_VUNPLAUSI_D "ASIL-C: Stromschwellen für GE mit 4 Kupplungen" VALUE 0x26E064 kw_ui16_S6_S3 1200 UMR_MA__1_10_0_S6_S3 0 1200 /end CHARACTERISTIC
/begin CHARACTERISTIC KL_NVERZMIN_DEKREMENT_EDSLOGIK_D "ASIL-C: Verzögerungsschwelle fürs Dekrementieren" CURVE 0x262C1C kl_ui8_S6_S3 254 UMR___1_1_0_S6_S3 0 254
 /begin AXIS_DESCR STD_AXIS iUl2ItfipInt.c_getr_l2 UMR_GRADC__1_1_M40_S6_S3 4 -40 215 DEPOSIT ABSOLUTE MONOTONY MON_INCREASE /end AXIS_DESCR
/end CHARACTERISTIC
/begin CHARACTERISTIC KF_IEDSMINMMOTCGLOGIKUEB_E "Minimale Druckreglerstromschwelle fuer EDS" MAP 0x262C28 kf_si16_S6_S3 1200 UMR_MA__1_10_0_S6_S3 0 1200
 /begin AXIS_DESCR STD_AXIS NO_INPUT_QUANTITY UMR_NM__1_1_0_S6_S3 8 -300 1640 DEPOSIT ABSOLUTE MONOTONY MON_INCREASE /end AXIS_DESCR
 /begin AXIS_DESCR STD_AXIS iUl2ItfipInt.c_getr_l2 UMR_GRADC__1_1_M40_S6_S3 4 -40 215 DEPOSIT ABSOLUTE MONOTONY MON_INCREASE /end AXIS_DESCR
/end CHARACTERISTIC
/begin CHARACTERISTIC KF_IEDSMINOFFMMOTCGLOGIKUEB_E "Minimale Druckreglerstromschwelle fuer EDS" MAP 0x262C88 kf_si16_S6_S3 1200 UMR_MA__1_10_0_S6_S3 0 1200
 /begin AXIS_DESCR STD_AXIS NO_INPUT_QUANTITY UMR_NM__1_1_0_S6_S3 4 -400 1640 DEPOSIT ABSOLUTE MONOTONY MON_INCREASE /end AXIS_DESCR
 /begin AXIS_DESCR STD_AXIS iUl2ItfipInt.c_getr_l2 UMR_GRADC__1_1_M40_S6_S3 4 -40 215 DEPOSIT ABSOLUTE MONOTONY MON_INCREASE /end AXIS_DESCR
/end CHARACTERISTIC
/begin CHARACTERISTIC KL_IEDSMINOFFCG_BEF1_E "Offset auf Stromschwelle zur Erkennung eines EDS-Logik-Fehlers bei 1. Befüllung" CURVE 0x262CC0 kl_si16_S6_S3 1200 UMR_MA__1_10_0_S6_S3 0 1200
 /begin AXIS_DESCR STD_AXIS iUl2ItfipInt.c_getr_l2 UMR_GRADC__1_1_M40_S6_S3 6 -40 215 DEPOSIT ABSOLUTE MONOTONY MON_INCREASE /end AXIS_DESCR
/end CHARACTERISTIC
/begin CHARACTERISTIC KF_MAXSTOERCGDELTAI_EDSLOGIK_E "Minimale Druckreglerstromschwelle fuer EDS" MAP 0x262CDC kf_si16_S6_S3 255 UMR___1_1_0_S6_S3 0 255
 /begin AXIS_DESCR STD_AXIS iUl2ItfipInt.c_getr_l2 UMR_GRADC__1_1_M40_S6_S3 6 -40 215 DEPOSIT ABSOLUTE MONOTONY MON_INCREASE /end AXIS_DESCR
 /begin AXIS_DESCR STD_AXIS NO_INPUT_QUANTITY UMR_MA__1_10_0_S6_S3 6 0 1000 DEPOSIT ABSOLUTE MONOTONY MON_INCREASE /end AXIS_DESCR
/end CHARACTERISTIC
/begin CHARACTERISTIC KL_MAX_STOEROFFCG_BEF1_E "Minimale Druckreglerstromschwelle fuer EDS" CURVE 0x262D44 kl_ui8_S6_S3 255 UMR___1_1_0_S6_S3 0 255
 /begin AXIS_DESCR STD_AXIS iUl2ItfipInt.c_getr_l2 UMR_GRADC__1_1_M40_S6_S3 6 -40 215 DEPOSIT ABSOLUTE MONOTONY MON_INCREASE /end AXIS_DESCR
/end CHARACTERISTIC
/begin CHARACTERISTIC IEDS_STOER_VUNPLAUSI_E "ASIL-C: Stromschwellen für GE mit 4 Kupplungen" VALUE 0x26E066 kw_ui16_S6_S3 1200 UMR_MA__1_10_0_S6_S3 0 1200 /end CHARACTERISTIC
/begin CHARACTERISTIC KL_NVERZMIN_DEKREMENT_EDSLOGIK_E "ASIL-C: Verzögerungsschwelle fürs Dekrementieren" CURVE 0x262D54 kl_ui8_S6_S3 254 UMR___1_1_0_S6_S3 0 254
 /begin AXIS_DESCR STD_AXIS iUl2ItfipInt.c_getr_l2 UMR_GRADC__1_1_M40_S6_S3 4 -40 215 DEPOSIT ABSOLUTE MONOTONY MON_INCREASE /end AXIS_DESCR
/end CHARACTERISTIC
/begin CHARACTERISTIC KL_IEDSMAXCG_K0 "Stromschwelle K0" CURVE 0x262D60 kl_ui16_S6_S3 1200 UMR_MA__1_10_0_S6_S3 0 1200
 /begin AXIS_DESCR STD_AXIS iUl2ItfipInt.c_getr_l2 UMR_GRADC__1_1_M40_S6_S3 6 -40 215 DEPOSIT ABSOLUTE MONOTONY MON_INCREASE /end AXIS_DESCR
/end CHARACTERISTIC
/begin CHARACTERISTIC KL_IEDSMAXOFFCG_BEF1_K0 "Offset für erste Befüllung K0" CURVE 0x262D7C kl_ui16_S6_S3 1200 UMR_MA__1_10_0_S6_S3 0 1200
 /begin AXIS_DESCR STD_AXIS iUl2ItfipInt.c_getr_l2 UMR_GRADC__1_1_M40_S6_S3 6 -40 215 DEPOSIT ABSOLUTE MONOTONY MON_INCREASE /end AXIS_DESCR
/end CHARACTERISTIC
/begin CHARACTERISTIC KL_IEDSMAXOFFCG_K0 "Offset auf Druckreglerstromschwelle für EDSz" CURVE 0x262D98 kl_ui16_S6_S3 1200 UMR_MA__1_10_0_S6_S3 0 1200
 /begin AXIS_DESCR STD_AXIS iUl2ItfipInt.c_getr_l2 UMR_GRADC__1_1_M40_S6_S3 6 -40 215 DEPOSIT ABSOLUTE MONOTONY MON_INCREASE /end AXIS_DESCR
/end CHARACTERISTIC
/begin CHARACTERISTIC KF_MAXSTOERCGDELTAI_EDSLOGIK_K0 "Minimale Druckreglerstromschwelle fuer EDS" MAP 0x262DB4 kf_ui16_S6_S3 255 UMR___1_1_0_S6_S3 0 255
 /begin AXIS_DESCR STD_AXIS iUl2ItfipInt.c_getr_l2 UMR_GRADC__1_1_M40_S6_S3 6 -40 215 DEPOSIT ABSOLUTE MONOTONY MON_INCREASE /end AXIS_DESCR
 /begin AXIS_DESCR STD_AXIS NO_INPUT_QUANTITY UMR_MA__1_10_0_S6_S3 6 0 1000 DEPOSIT ABSOLUTE MONOTONY MON_INCREASE /end AXIS_DESCR
/end CHARACTERISTIC
/begin CHARACTERISTIC KL_IEDS_KUP_TOGGEL_UNTEN_A "untere Toggleschwelle" CURVE 0x262E1C kl_ui16_S6_S3 1200 UMR_MA__1_10_0_S6_S3 0 1200
 /begin AXIS_DESCR STD_AXIS iUl2ItfipInt.c_getr_l2 UMR_GRADC__1_1_M40_S6_S3 6 -40 215 DEPOSIT ABSOLUTE MONOTONY MON_INCREASE /end AXIS_DESCR
/end CHARACTERISTIC
/begin CHARACTERISTIC KL_IEDS_KUP_TOGGEL_OBEN_A "obere Toggleschwelle" CURVE 0x262E38 kl_ui16_S6_S3 1200 UMR_MA__1_10_0_S6_S3 0 1200
 /begin AXIS_DESCR STD_AXIS iUl2ItfipInt.c_getr_l2 UMR_GRADC__1_1_M40_S6_S3 6 -40 215 DEPOSIT ABSOLUTE MONOTONY MON_INCREASE /end AXIS_DESCR
/end CHARACTERISTIC
/begin CHARACTERISTIC KL_IEDS_TOGGELN_DELTA_A "Differenzwert für Toggeln" CURVE 0x262E54 kl_si16_S6_S3 1200 UMR_MA__1_10_0_S6_S3 0 1200
 /begin AXIS_DESCR STD_AXIS iUl2ItfipInt.c_getr_l2 UMR_GRADC__1_1_M40_S6_S3 6 -40 215 DEPOSIT ABSOLUTE MONOTONY MON_INCREASE /end AXIS_DESCR
/end CHARACTERISTIC
/begin CHARACTERISTIC KF_NGUTMAX_EDSLOGIK_TOGGEL_A "Erfolgszähler" MAP 0x262E70 kf_ui16_S6_S3 255 UMR___1_1_0_S6_S3 0 255
 /begin AXIS_DESCR STD_AXIS iUl2ItfipInt.c_getr_l2 UMR_GRADC__1_1_M40_S6_S3 6 -40 215 DEPOSIT ABSOLUTE MONOTONY MON_INCREASE /end AXIS_DESCR
 /begin AXIS_DESCR STD_AXIS NO_INPUT_QUANTITY UMR___1_1_0_S6_S3 6 0 256 DEPOSIT ABSOLUTE MONOTONY MON_INCREASE /end AXIS_DESCR
/end CHARACTERISTIC
/begin CHARACTERISTIC N_STOERMAX_EDSLOGIK_TOGGEL_A "Störzähler" VALUE 0x26EAD5 kw_ui8_S6_S3 255 UMR___1_1_0_S6_S3 0 255 /end CHARACTERISTIC
/begin CHARACTERISTIC KL_IEDS_KUP_TOGGEL_UNTEN_B "untere Toggleschwelle" CURVE 0x262ED8 kl_ui16_S6_S3 1200 UMR_MA__1_10_0_S6_S3 0 1200
 /begin AXIS_DESCR STD_AXIS iUl2ItfipInt.c_getr_l2 UMR_GRADC__1_1_M40_S6_S3 6 -40 215 DEPOSIT ABSOLUTE MONOTONY MON_INCREASE /end AXIS_DESCR
/end CHARACTERISTIC
/begin CHARACTERISTIC KL_IEDS_KUP_TOGGEL_OBEN_B "obere Toggleschwelle" CURVE 0x262EF4 kl_ui16_S6_S3 1200 UMR_MA__1_10_0_S6_S3 0 1200
 /begin AXIS_DESCR STD_AXIS iUl2ItfipInt.c_getr_l2 UMR_GRADC__1_1_M40_S6_S3 6 -40 215 DEPOSIT ABSOLUTE MONOTONY MON_INCREASE /end AXIS_DESCR
/end CHARACTERISTIC
/begin CHARACTERISTIC KL_IEDS_TOGGELN_DELTA_B "Differenzwert für Toggeln" CURVE 0x262F10 kl_si16_S6_S3 1200 UMR_MA__1_10_0_S6_S3 0 1200
 /begin AXIS_DESCR STD_AXIS iUl2ItfipInt.c_getr_l2 UMR_GRADC__1_1_M40_S6_S3 6 -40 215 DEPOSIT ABSOLUTE MONOTONY MON_INCREASE /end AXIS_DESCR
/end CHARACTERISTIC
/begin CHARACTERISTIC KF_NGUTMAX_EDSLOGIK_TOGGEL_B "Erfolgszähler" MAP 0x262F2C kf_ui16_S6_S3 255 UMR___1_1_0_S6_S3 0 255
 /begin AXIS_DESCR STD_AXIS iUl2ItfipInt.c_getr_l2 UMR_GRADC__1_1_M40_S6_S3 6 -40 215 DEPOSIT ABSOLUTE MONOTONY MON_INCREASE /end AXIS_DESCR
 /begin AXIS_DESCR STD_AXIS NO_INPUT_QUANTITY UMR___1_1_0_S6_S3 6 0 256 DEPOSIT ABSOLUTE MONOTONY MON_INCREASE /end AXIS_DESCR
/end CHARACTERISTIC
/begin CHARACTERISTIC N_STOERMAX_EDSLOGIK_TOGGEL_B "Störzähler" VALUE 0x26EAD6 kw_ui8_S6_S3 255 UMR___1_1_0_S6_S3 0 255 /end CHARACTERISTIC
/begin CHARACTERISTIC KL_IEDS_KUP_TOGGEL_UNTEN_C "untere Toggleschwelle" CURVE 0x262F94 kl_ui16_S6_S3 1200 UMR_MA__1_10_0_S6_S3 0 1200
 /begin AXIS_DESCR STD_AXIS iUl2ItfipInt.c_getr_l2 UMR_GRADC__1_1_M40_S6_S3 6 -40 215 DEPOSIT ABSOLUTE MONOTONY MON_INCREASE /end AXIS_DESCR
/end CHARACTERISTIC
/begin CHARACTERISTIC KL_IEDS_KUP_TOGGEL_OBEN_C "obere Toggleschwelle" CURVE 0x262FB0 kl_ui16_S6_S3 1200 UMR_MA__1_10_0_S6_S3 0 1200
 /begin AXIS_DESCR STD_AXIS iUl2ItfipInt.c_getr_l2 UMR_GRADC__1_1_M40_S6_S3 6 -40 215 DEPOSIT ABSOLUTE MONOTONY MON_INCREASE /end AXIS_DESCR
/end CHARACTERISTIC
/begin CHARACTERISTIC KL_IEDS_TOGGELN_DELTA_C "Differenzwert für Toggeln" CURVE 0x262FCC kl_si16_S6_S3 1200 UMR_MA__1_10_0_S6_S3 0 1200
 /begin AXIS_DESCR STD_AXIS iUl2ItfipInt.c_getr_l2 UMR_GRADC__1_1_M40_S6_S3 6 -40 215 DEPOSIT ABSOLUTE MONOTONY MON_INCREASE /end AXIS_DESCR
/end CHARACTERISTIC
/begin CHARACTERISTIC KF_NGUTMAX_EDSLOGIK_TOGGEL_C "Erfolgszähler" MAP 0x262FE8 kf_ui16_S6_S3 255 UMR___1_1_0_S6_S3 0 255
 /begin AXIS_DESCR STD_AXIS iUl2ItfipInt.c_getr_l2 UMR_GRADC__1_1_M40_S6_S3 6 -40 215 DEPOSIT ABSOLUTE MONOTONY MON_INCREASE /end AXIS_DESCR
 /begin AXIS_DESCR STD_AXIS NO_INPUT_QUANTITY UMR___1_1_0_S6_S3 6 0 256 DEPOSIT ABSOLUTE MONOTONY MON_INCREASE /end AXIS_DESCR
/end CHARACTERISTIC
/begin CHARACTERISTIC N_STOERMAX_EDSLOGIK_TOGGEL_C "Störzähler" VALUE 0x26EAD7 kw_ui8_S6_S3 255 UMR___1_1_0_S6_S3 0 255 /end CHARACTERISTIC
/begin CHARACTERISTIC KL_IEDS_KUP_TOGGEL_UNTEN_D "untere Toggleschwelle" CURVE 0x263050 kl_ui16_S6_S3 1200 UMR_MA__1_10_0_S6_S3 0 1200
 /begin AXIS_DESCR STD_AXIS iUl2ItfipInt.c_getr_l2 UMR_GRADC__1_1_M40_S6_S3 6 -40 215 DEPOSIT ABSOLUTE MONOTONY MON_INCREASE /end AXIS_DESCR
/end CHARACTERISTIC
/begin CHARACTERISTIC KL_IEDS_KUP_TOGGEL_OBEN_D "obere Toggleschwelle" CURVE 0x26306C kl_ui16_S6_S3 1200 UMR_MA__1_10_0_S6_S3 0 1200
 /begin AXIS_DESCR STD_AXIS iUl2ItfipInt.c_getr_l2 UMR_GRADC__1_1_M40_S6_S3 6 -40 215 DEPOSIT ABSOLUTE MONOTONY MON_INCREASE /end AXIS_DESCR
/end CHARACTERISTIC
/begin CHARACTERISTIC KL_IEDS_TOGGELN_DELTA_D "Differenzwert für Toggeln" CURVE 0x263088 kl_si16_S6_S3 1200 UMR_MA__1_10_0_S6_S3 0 1200
 /begin AXIS_DESCR STD_AXIS iUl2ItfipInt.c_getr_l2 UMR_GRADC__1_1_M40_S6_S3 6 -40 215 DEPOSIT ABSOLUTE MONOTONY MON_INCREASE /end AXIS_DESCR
/end CHARACTERISTIC
/begin CHARACTERISTIC KF_NGUTMAX_EDSLOGIK_TOGGEL_D "Erfolgszähler" MAP 0x2630A4 kf_ui16_S6_S3 255 UMR___1_1_0_S6_S3 0 255
 /begin AXIS_DESCR STD_AXIS iUl2ItfipInt.c_getr_l2 UMR_GRADC__1_1_M40_S6_S3 6 -40 215 DEPOSIT ABSOLUTE MONOTONY MON_INCREASE /end AXIS_DESCR
 /begin AXIS_DESCR STD_AXIS NO_INPUT_QUANTITY UMR___1_1_0_S6_S3 6 0 256 DEPOSIT ABSOLUTE MONOTONY MON_INCREASE /end AXIS_DESCR
/end CHARACTERISTIC
/begin CHARACTERISTIC N_STOERMAX_EDSLOGIK_TOGGEL_D "Störzähler" VALUE 0x26EAD8 kw_ui8_S6_S3 255 UMR___1_1_0_S6_S3 0 255 /end CHARACTERISTIC
/begin CHARACTERISTIC KL_IEDS_KUP_TOGGEL_UNTEN_E "untere Toggleschwelle" CURVE 0x26310C kl_ui16_S6_S3 1200 UMR_MA__1_10_0_S6_S3 0 1200
 /begin AXIS_DESCR STD_AXIS iUl2ItfipInt.c_getr_l2 UMR_GRADC__1_1_M40_S6_S3 6 -40 215 DEPOSIT ABSOLUTE MONOTONY MON_INCREASE /end AXIS_DESCR
/end CHARACTERISTIC
/begin CHARACTERISTIC KL_IEDS_KUP_TOGGEL_OBEN_E "obere Toggleschwelle" CURVE 0x263128 kl_ui16_S6_S3 1200 UMR_MA__1_10_0_S6_S3 0 1200
 /begin AXIS_DESCR STD_AXIS iUl2ItfipInt.c_getr_l2 UMR_GRADC__1_1_M40_S6_S3 6 -40 215 DEPOSIT ABSOLUTE MONOTONY MON_INCREASE /end AXIS_DESCR
/end CHARACTERISTIC
/begin CHARACTERISTIC KL_IEDS_TOGGELN_DELTA_E "Differenzwert für Toggeln" CURVE 0x263144 kl_si16_S6_S3 1200 UMR_MA__1_10_0_S6_S3 0 1200
 /begin AXIS_DESCR STD_AXIS iUl2ItfipInt.c_getr_l2 UMR_GRADC__1_1_M40_S6_S3 6 -40 215 DEPOSIT ABSOLUTE MONOTONY MON_INCREASE /end AXIS_DESCR
/end CHARACTERISTIC
/begin CHARACTERISTIC KF_NGUTMAX_EDSLOGIK_TOGGEL_E "Erfolgszähler" MAP 0x263160 kf_ui16_S6_S3 255 UMR___1_1_0_S6_S3 0 255
 /begin AXIS_DESCR STD_AXIS iUl2ItfipInt.c_getr_l2 UMR_GRADC__1_1_M40_S6_S3 6 -40 215 DEPOSIT ABSOLUTE MONOTONY MON_INCREASE /end AXIS_DESCR
 /begin AXIS_DESCR STD_AXIS NO_INPUT_QUANTITY UMR___1_1_0_S6_S3 6 0 256 DEPOSIT ABSOLUTE MONOTONY MON_INCREASE /end AXIS_DESCR
/end CHARACTERISTIC
/begin CHARACTERISTIC N_STOERMAX_EDSLOGIK_TOGGEL_E "Störzähler" VALUE 0x26EAD9 kw_ui8_S6_S3 255 UMR___1_1_0_S6_S3 0 255 /end CHARACTERISTIC
/begin CHARACTERISTIC SWI_FLAGOFFPOSME "Schalter fuer internes Prüfflag immer auf 0" VALUE 0x26EAE4 kw_ui8_S6_S3 1 UMR___1_1_0_S6_S3 0 1 /end CHARACTERISTIC
/begin CHARACTERISTIC KL_MMOTUEBPOSME1 "Schwellwert 1 fuer nicht zul. Ausgabe POSME in Abh. von der Uebersetzung" CURVE 0x2631E0 kl_ui16_S6_S3 1640 UMR_NM__1_1_0_S6_S3 0 1640
 /begin AXIS_DESCR STD_AXIS NO_INPUT_QUANTITY UMR___1_1000_0_S6_S3 8 0 65.535 DEPOSIT ABSOLUTE MONOTONY MON_INCREASE /end AXIS_DESCR
/end CHARACTERISTIC
/begin CHARACTERISTIC KL_MMOTUEBPOSME2 "Schwellwert 2 fuer nicht zul. Ausgabe POSME in Abh. von der Uebersetzung" CURVE 0x263204 kl_ui16_S6_S3 1640 UMR_NM__1_1_0_S6_S3 0 1640
 /begin AXIS_DESCR STD_AXIS NO_INPUT_QUANTITY UMR___1_1000_0_S6_S3 8 0 65.535 DEPOSIT ABSOLUTE MONOTONY MON_INCREASE /end AXIS_DESCR
/end CHARACTERISTIC
/begin CHARACTERISTIC N_MAXSTOERPOSMEAUS "Schwellwert für die Fehlerreaktion (unerlaubter POSME)" VALUE 0x26E07A kw_ui16_S6_S3 2000 UMR___1_1_0_S6_S3 0 2000 /end CHARACTERISTIC
/begin CHARACTERISTIC KL_NMAXSTOERPOSMEINT1 "Schwellwert 1 für die Fehlerreaktion (Intensitaet POSME)" CURVE 0x263228 kl_ui16_S6_S3 1000 UMR_NM__1_1_0_S6_S3 0 1000
 /begin AXIS_DESCR STD_AXIS NO_INPUT_QUANTITY UMR_NM__1_1_0_S6_S3 4 0 65535 DEPOSIT ABSOLUTE MONOTONY MON_INCREASE /end AXIS_DESCR
/end CHARACTERISTIC
/begin CHARACTERISTIC KL_NMAXSTOERPOSMEINT2 "Schwellwert 2 für die Fehlerreaktion (Intensitaet POSME)" CURVE 0x26323C kl_ui16_S6_S3 1000 UMR_NM__1_1_0_S6_S3 0 1000
 /begin AXIS_DESCR STD_AXIS NO_INPUT_QUANTITY UMR_NM__1_1_0_S6_S3 4 0 65535 DEPOSIT ABSOLUTE MONOTONY MON_INCREASE /end AXIS_DESCR
/end CHARACTERISTIC
/begin CHARACTERISTIC TAB_N_OFFSET_ME "Offset zw. gem. Turbinendrehzahl und errechneter zur Schaltungserkennung Posme Überw." CURVE 0x263250 tab_ui16_S6_S3 1000 UMR_U_MIN_1_1_0_S6_S3 0 1000
 /begin AXIS_DESCR FIX_AXIS zff_atsys._.iSignale._.obj.sig_zielgang UMR___1_1_0_S6_S3 10 -1 8 FIX_AXIS_PAR_DIST -1 1 10 /end AXIS_DESCR
/end CHARACTERISTIC
/begin CHARACTERISTIC KL_NMAXSTOERPOSMEGRADIENT "Schwellwert für Fehlerreaktion Gradient POSME" CURVE 0x263268 kl_ui16_S6_S3 1000 UMR_NM__1_1_0_S6_S3 0 1000
 /begin AXIS_DESCR STD_AXIS NO_INPUT_QUANTITY UMR_NM__1_1_0_S6_S3 4 0 65535 DEPOSIT ABSOLUTE MONOTONY MON_INCREASE /end AXIS_DESCR
/end CHARACTERISTIC
/begin CHARACTERISTIC N_FNGTMEUEB "Filterzähler für Turbinendrehzahlgradient Überwachung posME" VALUE 0x26EAE5 kw_ui8_S6_S3 255 UMR___1_1_0_S6_S3 0 255 /end CHARACTERISTIC
/begin CHARACTERISTIC N_FNGABMEUEB "Filterzähler für Abtriebsdrehzahlgradient Überwachung posME" VALUE 0x26EAE6 kw_ui8_S6_S3 255 UMR___1_1_0_S6_S3 0 255 /end CHARACTERISTIC
/begin CHARACTERISTIC KF_NGPOSMEUEB "Schwellwert für zulässigen Gradient bei posME bei Übersetzungswechsel" MAP 0x26327C kf_ui16_S6_S3 100 UMR_U_MINTASK_1_100_0_S6_S3 0 100
 /begin AXIS_DESCR STD_AXIS NO_INPUT_QUANTITY UMR___1_1000_0_S6_S3 8 0 65.535 DEPOSIT ABSOLUTE MONOTONY MON_INCREASE /end AXIS_DESCR
 /begin AXIS_DESCR STD_AXIS NO_INPUT_QUANTITY UMR_NM__1_1_0_S6_S3 4 0 65535 DEPOSIT ABSOLUTE MONOTONY MON_INCREASE /end AXIS_DESCR
/end CHARACTERISTIC
/begin CHARACTERISTIC M_MOTMININT "Mindestmotormoment zum Einstieg in die Ueberwachung" VALUE 0x26E07C kw_si16_S6_S3 510 UMR_NM__1_1_0_S6_S3 -255 255 /end CHARACTERISTIC
/begin CHARACTERISTIC N_DIFFMAXINT "Differenzdrehzahlschwelle zum Einstieg in die Funktion" VALUE 0x26E07E kw_si16_S6_S3 10000 UMR_U_MIN_1_1_0_S6_S3 -5000 5000 /end CHARACTERISTIC
/begin CHARACTERISTIC M_MOTMAXNEGINT "Deckelung des negativen Motoristmoments" VALUE 0x26E080 kw_si16_S6_S3 255 UMR_NM__1_1_0_S6_S3 -255 0 /end CHARACTERISTIC
/begin CHARACTERISTIC KL_NMAXSTOERPOSMEINTIGANG "Schwellwert für die Fehlerreaktion (Intensitaet POSME IGang)" CURVE 0x2632DC kl_ui16_S6_S3 1000 UMR___1_1_0_S6_S3 0 1000
 /begin AXIS_DESCR STD_AXIS NO_INPUT_QUANTITY UMR___1_1_0_S6_S3 4 0 65535 DEPOSIT ABSOLUTE MONOTONY MON_INCREASE /end AXIS_DESCR
/end CHARACTERISTIC
/begin CHARACTERISTIC TAB_MMOTUEBPOSMEIGANG "Schwellwert fuer nicht zul. Ausgabe POSME I Gang in Abh. von der Ansteuerung" CURVE 0x2632F0 tab_ui16_S6_S3 1300 UMR_NM__1_1_0_S6_S3 0 1300
 /begin AXIS_DESCR FIX_AXIS NO_INPUT_QUANTITY UMR_NM__1_1_0_S6_S3 10 -1 8 FIX_AXIS_PAR_DIST -1 1 10 /end AXIS_DESCR
/end CHARACTERISTIC
/begin CHARACTERISTIC KL_NMAXSTOERNEGMEINT1 "Schwellwert 1 für die Fehlerreaktion (Intensitaet NEGME)" CURVE 0x263308 kl_ui16_S6_S3 1000 UMR_NM__1_1_0_S6_S3 0 1000
 /begin AXIS_DESCR STD_AXIS NO_INPUT_QUANTITY UMR_NM__1_1_0_S6_S3 4 0 65535 DEPOSIT ABSOLUTE MONOTONY MON_INCREASE /end AXIS_DESCR
/end CHARACTERISTIC
/begin CHARACTERISTIC KL_MMOTUEBNEGME1 "Schwellwert 1 fuer nicht zul. Ausgabe NEGME in Abh. von der Uebersetzung" CURVE 0x26331C kl_ui16_S6_S3 1640 UMR_NM__1_1_0_S6_S3 0 1640
 /begin AXIS_DESCR STD_AXIS NO_INPUT_QUANTITY UMR___1_1000_0_S6_S3 8 0 65.535 DEPOSIT ABSOLUTE MONOTONY MON_INCREASE /end AXIS_DESCR
/end CHARACTERISTIC
/begin CHARACTERISTIC KL_MMOTUEBNEGME2 "Schwellwert 2 fuer nicht zul. Ausgabe NEGME in Abh. von der Uebersetzung" CURVE 0x263340 kl_si16_S6_S3 1640 UMR_NM__1_1_0_S6_S3 -1640 0
 /begin AXIS_DESCR STD_AXIS NO_INPUT_QUANTITY UMR___1_1000_0_S6_S3 8 -32.768 32.767 DEPOSIT ABSOLUTE MONOTONY MON_INCREASE /end AXIS_DESCR
/end CHARACTERISTIC
/begin CHARACTERISTIC N_MAXSTOERNEGMEAUS "Schwellwert für die Fehlerreaktion (unerlaubter NEGME)" VALUE 0x26E082 kw_ui16_S6_S3 2000 UMR___1_1_0_S6_S3 0 2000 /end CHARACTERISTIC
/begin CHARACTERISTIC M_MERED_MIN "Überwachungsschwelle für die Statusüberwachung des negativen Motoreingriffs" VALUE 0x26E084 kw_ui16_S6_S3 1000 UMR_NM__1_1_0_S6_S3 0 1000 /end CHARACTERISTIC
/begin CHARACTERISTIC I_EDSNULLPOSNUEB "ASIL-B: Stromschwelle fuer Nullbestromung in der PosN-Plausi" VALUE 0x26E052 kw_ui16_S6_S3 1200 UMR_MA__1_10_0_S6_S3 0 1200 /end CHARACTERISTIC
/begin CHARACTERISTIC MAX_STOERPOSNEDS "ASIL-B: Schwellwert fuer den Ereigniszaehler Phase A der PosN-Plausi" VALUE 0x26EAD0 kw_ui8_S6_S3 255 UMR___1_1_0_S6_S3 0 255 /end CHARACTERISTIC
/begin CHARACTERISTIC MAX_STOERPOSNEDS14 "ASIL-B: Schwellwert fuer den Ereigniszaehler Phase B der PosN-Plausi" VALUE 0x26EAD1 kw_ui8_S6_S3 255 UMR___1_1_0_S6_S3 0 255 /end CHARACTERISTIC
/begin CHARACTERISTIC I_EDSMAXPOSNUEB_A "ASIL-B: Druckreglerstromschwelle fuer die PosN-Plausi" VALUE 0x26E054 kw_ui16_S6_S3 1200 UMR_MA__1_10_0_S6_S3 0 1200 /end CHARACTERISTIC
/begin CHARACTERISTIC I_EDSMAXPOSNUEB_B "ASIL-B: Druckreglerstromschwelle fuer die PosN-Plausi" VALUE 0x26E056 kw_ui16_S6_S3 1200 UMR_MA__1_10_0_S6_S3 0 1200 /end CHARACTERISTIC
/begin CHARACTERISTIC I_EDSMINPOSNUEB_C "ASIL-B: Druckreglerstromschwelle fuer die PosN-Plausi" VALUE 0x26E058 kw_ui16_S6_S3 1200 UMR_MA__1_10_0_S6_S3 0 1200 /end CHARACTERISTIC
/begin CHARACTERISTIC I_EDSMINPOSNUEB_D "ASIL-B: Druckreglerstromschwelle fuer die PosN-Plausi" VALUE 0x26E05A kw_ui16_S6_S3 1200 UMR_MA__1_10_0_S6_S3 0 1200 /end CHARACTERISTIC
/begin CHARACTERISTIC I_EDSMINPOSNUEB_E "ASIL-B: Druckreglerstromschwelle fuer die PosN-Plausi" VALUE 0x26E05C kw_ui16_S6_S3 1200 UMR_MA__1_10_0_S6_S3 0 1200 /end CHARACTERISTIC
/begin CHARACTERISTIC F_NMOTUEB "LEVEL2: Faktor Abregeldrehzahl für die Motordrehzahlueberwachung" VALUE 0x26EAE2 kw_ui8_S6_S3 0.1 UMR___1_100_0_S6_S3 1 1.1 /end CHARACTERISTIC
/begin CHARACTERISTIC N_NMOTABREGEL_VORGABE "LEVEL2: Zählerschwelle für Absenkung der Abregeldrehzahlschwelle nach einer Reduzierung der Vorgabe" VALUE 0x26E076 kw_ui16_S6_S3 999 UMR___1_1_0_S6_S3 1 1000 /end CHARACTERISTIC
/begin CHARACTERISTIC N_MOTABREGEL_OFFSET "LEVEL2: Drehzahloffset auf Motordrehzahlminimum für die Abregeldrehzahlnachführung bei Reduzierung der Vorgabe" VALUE 0x26E078 kw_ui16_S6_S3 2000 UMR_U_MIN_1_1_0_S6_S3 0 2000 /end CHARACTERISTIC
/begin CHARACTERISTIC TAB_NMOTUEBDSCOFF "gangabhängige Tab. für die Vorgabe der Maxi.drehzahl bei DSC-Ausfall" CURVE 0x2631C8 tab_ui16_S6_S3 10000 UMR_U_MIN_1_1_0_S6_S3 0 10000
 /begin AXIS_DESCR FIX_AXIS zff_atsys._.iSignale._.obj.sig_zielgang UMR___1_1_0_S6_S3 10 -1 8 FIX_AXIS_PAR_DIST -1 1 10 /end AXIS_DESCR
/end CHARACTERISTIC
/begin CHARACTERISTIC MAX_STOER_NMOTUEB "LEVEL2: Maximaler Grenzwert des Störzählers fuer NMOT-Uew." VALUE 0x26EAE3 kw_ui8_S6_S3 99 UMR___1_1_0_S6_S3 1 100 /end CHARACTERISTIC
/begin CHARACTERISTIC KF_MMOTGETRAUF "Zulässiges Getriebeaufnahmemoment in Abh. von der Uebersetzung und die Getriebetemperatur" MAP 0x26262C kf_ui16_S6_S3 1000 UMR_NM__1_1_0_S6_S3 0 1000
 /begin AXIS_DESCR STD_AXIS NO_INPUT_QUANTITY UMR___1_1000_0_S6_S3 8 0 65.535 DEPOSIT ABSOLUTE MONOTONY MON_INCREASE /end AXIS_DESCR
 /begin AXIS_DESCR STD_AXIS iUl2ItfipInt.c_getr_l2 UMR_GRADC__1_1_M40_S6_S3 6 -40 215 DEPOSIT ABSOLUTE MONOTONY MON_INCREASE /end AXIS_DESCR
/end CHARACTERISTIC
/begin CHARACTERISTIC KF_OFFSETMMOTGETRAUF "Offsetkennfeld" MAP 0x2626B0 kf_ui16_S6_S3 1000 UMR_NM__1_1_0_S6_S3 0 1000
 /begin AXIS_DESCR STD_AXIS NO_INPUT_QUANTITY UMR___1_1000_0_S6_S3 8 0 65.535 DEPOSIT ABSOLUTE MONOTONY MON_INCREASE /end AXIS_DESCR
 /begin AXIS_DESCR STD_AXIS iUl2ItfipInt.c_getr_l2 UMR_GRADC__1_1_M40_S6_S3 6 -40 215 DEPOSIT ABSOLUTE MONOTONY MON_INCREASE /end AXIS_DESCR
/end CHARACTERISTIC
/begin CHARACTERISTIC KL_F_VGETRAUF "Faktorisierungskennfeld" CURVE 0x262734 kl_ui16_S6_S3 1 UMR___1_100_0_S6_S3 0 1
 /begin AXIS_DESCR STD_AXIS NO_INPUT_QUANTITY UMR_KM_H_1_1_0_S6_S3 4 0 400 DEPOSIT ABSOLUTE MONOTONY MON_INCREASE /end AXIS_DESCR
/end CHARACTERISTIC
/begin CHARACTERISTIC N_MAXSTOERMGETRAUF "Schwellwert für den Störzähler" VALUE 0x26E04E kw_ui16_S6_S3 255 UMR___1_1_0_S6_S3 0 255 /end CHARACTERISTIC
/begin CHARACTERISTIC KL_CGVERZPOSVUEB "Verzoegerungszeit vor Start der Ueberwachung POSV" CURVE 0x261B50 kl_ui16_S6_S3 655350 UMR_MSEC__10_1_0_S6_S3 0 655350
 /begin AXIS_DESCR STD_AXIS zff_atsys._.iSignale._.obj.sig_c_getr UMR_GRADC__1_1_M40_S6_S3 4 -40 160 DEPOSIT ABSOLUTE MONOTONY MON_INCREASE /end AXIS_DESCR
/end CHARACTERISTIC
/begin CHARACTERISTIC KL_TMINVERZCG_POSVUEB "Ausblendzeit der POSV nach Zündung aus über Neuestart" CURVE 0x261B64 kl_ui16_S6_S3 655350 UMR_MSEC__10_1_0_S6_S3 0 655350
 /begin AXIS_DESCR STD_AXIS zff_atsys._.iSignale._.obj.sig_c_getr UMR_GRADC__1_1_M40_S6_S3 4 -40 215 DEPOSIT ABSOLUTE MONOTONY MON_INCREASE /end AXIS_DESCR
/end CHARACTERISTIC
/begin CHARACTERISTIC NMOTMAX_POSVUEB "NMot Drehzahlschwelle, ab der der Timer für Zündung aus über Neustart, startet" VALUE 0x26E024 kw_ui16_S6_S3 8160 UMR_U_MIN_1_1_0_S6_S3 0 8160 /end CHARACTERISTIC
/begin CHARACTERISTIC T_VERZNMOTMAX_POSVUEB "Verzögerungszeit zur Erkennung ob Motor ausgeht" VALUE 0x26E026 kw_ui16_S6_S3 655350 UMR_MSEC__10_1_0_S6_S3 0 655350 /end CHARACTERISTIC
/begin CHARACTERISTIC KL_TUEBCGPOSVMECHDEF "Ueberwachungszeit schlafender POSV Fehler" CURVE 0x261B78 kl_ui8_S6_S3 2550 UMR_MSEC__10_1_0_S6_S3 0 2550
 /begin AXIS_DESCR STD_AXIS zff_atsys._.iSignale._.obj.sig_c_getr UMR_GRADC__1_1_M40_S6_S3 4 -40 160 DEPOSIT ABSOLUTE MONOTONY MON_INCREASE /end AXIS_DESCR
/end CHARACTERISTIC
/begin CHARACTERISTIC MAX_STOERPOSVMECHDEF "Anzahl von Stoerungen bis zum Ausloesen eines POSV Fehlers" VALUE 0x26EAB2 kw_ui8_S6_S3 20 UMR___1_1_0_S6_S3 0 20 /end CHARACTERISTIC
/begin COMPU_METHOD SAB_C_1K_S2_S3 "int = ((phys * 1) / 1) - (0) Kelvin" RAT_FUNC "%2.0" "Kelvin" COEFFS 0 1 -0 0 0 1 /end COMPU_METHOD
/begin COMPU_METHOD SAB_C_1K100_S2_S3 "int = ((phys * 100) / 1) - (0) Kelvin" RAT_FUNC "%5.3" "Kelvin" COEFFS 0 100 -0 0 0 1 /end COMPU_METHOD
/begin COMPU_METHOD SAB_C_1K1000_S2_S3 "int = ((phys * 1000) / 1) - (0) Kelvin" RAT_FUNC "%5.3" "Kelvin" COEFFS 0 1000 -0 0 0 1 /end COMPU_METHOD
/begin COMPU_METHOD SAB_M_20NM_S2_S3 "int = ((phys * 1) / 20) - (0) Nm" RAT_FUNC "%5.3" "Nm" COEFFS 0 1 -0 0 0 20 /end COMPU_METHOD
/begin COMPU_METHOD SAB_M_40NM_S2_S3 "int = ((phys * 1) / 40) - (0) Nm" RAT_FUNC "%5.3" "Nm" COEFFS 0 1 -0 0 0 40 /end COMPU_METHOD
/begin COMPU_METHOD SAB_M_1NM_KOMP_S2_S3 "int = ((phys * 1) / 1) - (0) Nm" RAT_FUNC "%2.0" "Nm" COEFFS 0 1 -0 0 0 1 /end COMPU_METHOD
/begin COMPU_METHOD SAB_M_NM4_S2_S3 "int = ((phys * 4) / 1) - (0) Nm" RAT_FUNC "%5.3" "Nm" COEFFS 0 4 -0 0 0 1 /end COMPU_METHOD
/begin COMPU_METHOD SAB_M_NM4_M500_S2_S3 "int = ((phys * 4) / 1) - (-2000) Nm" RAT_FUNC "%5.3" "Nm" COEFFS 0 4 2000 0 0 1 /end COMPU_METHOD
/begin COMPU_METHOD SAB_M_5NM_S2_S3 "int = ((phys * 5) / 1) - (0) Nm" RAT_FUNC "%5.3" "Nm" COEFFS 0 5 -0 0 0 1 /end COMPU_METHOD
/begin COMPU_METHOD SAB_M_NM50_S2_S3 "int = ((phys * 50) / 1) - (0) Nm" RAT_FUNC "%5.3" "Nm" COEFFS 0 50 -0 0 0 1 /end COMPU_METHOD
/begin COMPU_METHOD SAB_M_NM10_S2_S3 "int = ((phys * 10) / 1) - (0) Nm" RAT_FUNC "%5.3" "Nm" COEFFS 0 10 -0 0 0 1 /end COMPU_METHOD
/begin COMPU_METHOD SAB_M_2NM10_S2_S3 "int = ((phys * 10) / 2) - (0) Nm" RAT_FUNC "%5.3" "Nm" COEFFS 0 10 -0 0 0 2 /end COMPU_METHOD
/begin COMPU_METHOD SAB_M_5NM10_M400_S2_S3 "int = ((phys * 10) / 5) - (-800) Nm" RAT_FUNC "%5.3" "Nm" COEFFS 0 10 4000 0 0 5 /end COMPU_METHOD
/begin COMPU_METHOD SAB_M_5NM10_M6400_S2_S3 "int = ((phys * 10) / 5) - (-12800) Nm" RAT_FUNC "%5.3" "Nm" COEFFS 0 10 64000 0 0 5 /end COMPU_METHOD
/begin COMPU_METHOD SAB_M_5NM10_M16384_S2_S3 "int = ((phys * 10) / 5) - (-32768) Nm" RAT_FUNC "%5.3" "Nm" COEFFS 0 10 163840 0 0 5 /end COMPU_METHOD
/begin COMPU_METHOD SAB_M_5NM10_10235M10_S2_S3 "int = ((phys * 10) / 5) - (-2047) Nm" RAT_FUNC "%5.3" "Nm" COEFFS 0 10 10235 0 0 5 /end COMPU_METHOD
/begin COMPU_METHOD SAB_M_5NM10_S2_S3 "int = ((phys * 10) / 5) - (0) Nm" RAT_FUNC "%5.3" "Nm" COEFFS 0 10 -0 0 0 5 /end COMPU_METHOD
/begin COMPU_METHOD SAB_M_0245NM10000_S2_S3 "int = ((phys * 10000) / 245) - (0) Nm" RAT_FUNC "%6.4" "Nm" COEFFS 0 10000 -0 0 0 245 /end COMPU_METHOD
/begin COMPU_METHOD SAB_M_78NM10000_S2_S3 "int = ((phys * 10000) / 78) - (0) Nm" RAT_FUNC "%6.4" "Nm" COEFFS 0 10000 -0 0 0 78 /end COMPU_METHOD
/begin COMPU_METHOD SAB_MG_10NMS_S2_S3 "int = ((phys * 1) / 10) - (0) Nm/s" RAT_FUNC "%5.3" "Nm/s" COEFFS 0 1 -0 0 0 10 /end COMPU_METHOD
/begin COMPU_METHOD SAB_P_2HPA_P600_S2_S3 "int = ((phys * 1) / 2) - (300) hPa" RAT_FUNC "%2.0" "hPa" COEFFS 0 1 -600 0 0 2 /end COMPU_METHOD
/begin COMPU_METHOD SAB_P_15HPA_P685_S2_S3 "int = ((phys * 1) / 15) - (45) hPa" RAT_FUNC "%5.3" "hPa" COEFFS 0 1 -675 0 0 15 /end COMPU_METHOD
/begin COMPU_METHOD SAB_P_BARO_10HPA_P50_S2_S3 "int = ((phys * 1) / 10) - (50) hPa" RAT_FUNC "%5.3" "hPa" COEFFS 0 1 -500 0 0 10 /end COMPU_METHOD
/begin COMPU_METHOD SAB_P_BARO_5MBAR_S2_S3 "int = ((phys * 1) / 5) - (0) mbar" RAT_FUNC "%5.3" "mbar" COEFFS 0 1 -0 0 0 5 /end COMPU_METHOD
/begin COMPU_METHOD SAB_P_BARO_1MBAR_S2_S3 "int = ((phys * 1) / 1) - (0) mbar" RAT_FUNC "%2.0" "mbar" COEFFS 0 1 -0 0 0 1 /end COMPU_METHOD
/begin COMPU_METHOD SAB_P_BARO_5HPA_S2_S3 "int = ((phys * 1) / 5) - (0) hPa" RAT_FUNC "%5.3" "hPa" COEFFS 0 1 -0 0 0 5 /end COMPU_METHOD
/begin COMPU_METHOD SAB_P_BAR_1KPA_S2_S3 "int = ((phys * 1) / 1) - (0) kPa" RAT_FUNC "%2.0" "kPa" COEFFS 0 1 -0 0 0 1 /end COMPU_METHOD
/begin COMPU_METHOD UMR___1_1000_0_S6_S3 "int = ((phys * 1000) / 1) - (0) [-]" RAT_FUNC "%5.3" "[-]" COEFFS 0 1000 -0 0 0 1 /end COMPU_METHOD
/begin COMPU_METHOD UMR___1_100_0_S6_S3 "int = ((phys * 100) / 1) - (0) [-]" RAT_FUNC "%4.2" "[-]" COEFFS 0 100 -0 0 0 1 /end COMPU_METHOD
/begin COMPU_METHOD UMR___1_1_0_S6_S3 "int = ((phys * 1) / 1) - (0) [-]" RAT_FUNC "%2.0" "[-]" COEFFS 0 1 -0 0 0 1 /end COMPU_METHOD
/begin COMPU_METHOD UMR_MA__1_10_0_S6_S3 "int = ((phys * 10) / 1) - (0) [mA]" RAT_FUNC "%3.1" "[mA]" COEFFS 0 10 -0 0 0 1 /end COMPU_METHOD
/begin COMPU_METHOD UMR_NM__1_1_0_S6_S3 "int = ((phys * 1) / 1) - (0) [Nm]" RAT_FUNC "%2.0" "[Nm]" COEFFS 0 1 -0 0 0 1 /end COMPU_METHOD
/begin COMPU_METHOD UMR_NM__100_1_M255_S6_S3 "int = ((phys * 1) / 100) - (-255) [Nm]" RAT_FUNC "%2.0" "[Nm]" COEFFS 0 1 25500 0 0 100 /end COMPU_METHOD
/begin COMPU_METHOD UMR_BAR__1_100_0_S6_S3 "int = ((phys * 100) / 1) - (0) [bar]" RAT_FUNC "%4.2" "[bar]" COEFFS 0 100 -0 0 0 1 /end COMPU_METHOD
/begin COMPU_METHOD UMR_U_MIN_1_1_0_S6_S3 "int = ((phys * 1) / 1) - (0) [U/min]" RAT_FUNC "%2.0" "[U/min]" COEFFS 0 1 -0 0 0 1 /end COMPU_METHOD
/begin COMPU_METHOD UMR_U_MIN_10_1_0_S6_S3 "int = ((phys * 1) / 10) - (0) [U/min]" RAT_FUNC "%2.0" "[U/min]" COEFFS 0 1 -0 0 0 10 /end COMPU_METHOD
/begin COMPU_METHOD UMR_U_MINSEC_1_1_0_S6_S3 "int = ((phys * 1) / 1) - (0) [U/(min*s)]" RAT_FUNC "%2.0" "[U/(min*s)]" COEFFS 0 1 -0 0 0 1 /end COMPU_METHOD
/begin COMPU_METHOD UMR_U_MINTASK_1_100_0_S6_S3 "int = ((phys * 100) / 1) - (0) [U/(min*task)]" RAT_FUNC "%4.2" "[U/(min*task)]" COEFFS 0 100 -0 0 0 1 /end COMPU_METHOD
/begin COMPU_METHOD UMR_MSEC__10_1_0_S6_S3 "int = ((phys * 1) / 10) - (0) [ms]" RAT_FUNC "%2.0" "[ms]" COEFFS 0 1 -0 0 0 10 /end COMPU_METHOD
/begin COMPU_METHOD UMR_GRADC__1_1_M40_S6_S3 "int = ((phys * 1) / 1) - (-40) [°C]" RAT_FUNC "%2.0" "[°C]" COEFFS 0 1 40 0 0 1 /end COMPU_METHOD
/begin COMPU_METHOD UMR_KGM2__1_1000_0_S6_S3 "int = ((phys * 1000) / 1) - (0) [kg*m^2]" RAT_FUNC "%5.3" "[kg*m^2]" COEFFS 0 1000 -0 0 0 1 /end COMPU_METHOD
/begin COMPU_METHOD UMR_KM_H_1_1_0_S6_S3 "int = ((phys * 1) / 1) - (0) [km/h]" RAT_FUNC "%2.0" "[km/h]" COEFFS 0 1 -0 0 0 1 /end COMPU_METHOD
/begin COMPU_METHOD UMR_M_SEC2_1_32_0_S6_S3 "int = ((phys * 32) / 1) - (0) [m/s^2]" RAT_FUNC "%4.2" "[m/s^2]" COEFFS 0 32 -0 0 0 1 /end COMPU_METHOD
/begin FUNCTION jUewIgetrGR_Fktn "Applikationesgroessen Instanz jUewIgetrGR"
 /begin DEF_CHARACTERISTIC KF_IGOUWIGNGTOB_R KF_IGOUWIGNGTUN_R KL_UWIGOBERS_R KL_UWIGOB_R KL_UWIGUNERS_R KL_UWIGUN_R ND_TOBUWIG_GE_R ND_TUNUWIG_GE_R T_VUWIG_R /end DEF_CHARACTERISTIC
/end FUNCTION
/begin FUNCTION jUewIgetrG1_Fktn "Applikationesgroessen Instanz jUewIgetrG1"
 /begin DEF_CHARACTERISTIC KF_IGOUWIGNGTOB_1 KF_IGOUWIGNGTUN_1 KL_UWIGOBERS_1 KL_UWIGOB_1 KL_UWIGUNERS_1 KL_UWIGUN_1 ND_TOBUWIG_GE_1 ND_TUNUWIG_GE_1 T_VUWIG_1 /end DEF_CHARACTERISTIC
/end FUNCTION
/begin FUNCTION jUewIgetrG2_Fktn "Applikationesgroessen Instanz jUewIgetrG2"
 /begin DEF_CHARACTERISTIC KF_IGOUWIGNGTOB_2 KF_IGOUWIGNGTUN_2 KL_UWIGOBERS_2 KL_UWIGOB_2 KL_UWIGUNERS_2 KL_UWIGUN_2 ND_TOBUWIG_GE_2 ND_TUNUWIG_GE_2 T_VUWIG_2 /end DEF_CHARACTERISTIC
/end FUNCTION
/begin FUNCTION jUewIgetrG3_Fktn "Applikationesgroessen Instanz jUewIgetrG3"
 /begin DEF_CHARACTERISTIC KF_IGOUWIGNGTOB_3 KF_IGOUWIGNGTUN_3 KL_UWIGOBERS_3 KL_UWIGOB_3 KL_UWIGUNERS_3 KL_UWIGUN_3 ND_TOBUWIG_GE_3 ND_TUNUWIG_GE_3 T_VUWIG_3 /end DEF_CHARACTERISTIC
/end FUNCTION
/begin FUNCTION jUewIgetrG4_Fktn "Applikationesgroessen Instanz jUewIgetrG4"
 /begin DEF_CHARACTERISTIC KF_IGOUWIGNGTOB_4 KF_IGOUWIGNGTUN_4 KL_UWIGOBERS_4 KL_UWIGOB_4 KL_UWIGUNERS_4 KL_UWIGUN_4 ND_TOBUWIG_GE_4 ND_TUNUWIG_GE_4 T_VUWIG_4 /end DEF_CHARACTERISTIC
/end FUNCTION
/begin FUNCTION jUewIgetrG5_Fktn "Applikationesgroessen Instanz jUewIgetrG5"
 /begin DEF_CHARACTERISTIC KF_IGOUWIGNGTOB_5 KF_IGOUWIGNGTUN_5 KL_UWIGOBERS_5 KL_UWIGOB_5 KL_UWIGUNERS_5 KL_UWIGUN_5 ND_TOBUWIG_GE_5 ND_TUNUWIG_GE_5 T_VUWIG_5 /end DEF_CHARACTERISTIC
/end FUNCTION
/begin FUNCTION jUewIgetrG6_Fktn "Applikationesgroessen Instanz jUewIgetrG6"
 /begin DEF_CHARACTERISTIC KF_IGOUWIGNGTOB_6 KF_IGOUWIGNGTUN_6 KL_UWIGOBERS_6 KL_UWIGOB_6 KL_UWIGUNERS_6 KL_UWIGUN_6 ND_TOBUWIG_GE_6 ND_TUNUWIG_GE_6 T_VUWIG_6 /end DEF_CHARACTERISTIC
/end FUNCTION
/begin FUNCTION jUewIgetrG7_Fktn "Applikationesgroessen Instanz jUewIgetrG7"
 /begin DEF_CHARACTERISTIC KF_IGOUWIGNGTOB_7 KF_IGOUWIGNGTUN_7 KL_UWIGOBERS_7 KL_UWIGOB_7 KL_UWIGUNERS_7 KL_UWIGUN_7 ND_TOBUWIG_GE_7 ND_TUNUWIG_GE_7 T_VUWIG_7 /end DEF_CHARACTERISTIC
/end FUNCTION
/begin FUNCTION jUewIgetrG8_Fktn "Applikationesgroessen Instanz jUewIgetrG8"
 /begin DEF_CHARACTERISTIC KF_IGOUWIGNGTOB_8 KF_IGOUWIGNGTUN_8 KL_UWIGOBERS_8 KL_UWIGOB_8 KL_UWIGUNERS_8 KL_UWIGUN_8 ND_TOBUWIG_GE_8 ND_TUNUWIG_GE_8 T_VUWIG_8 /end DEF_CHARACTERISTIC
/end FUNCTION
/begin FUNCTION dUewIgetrK_Fktn "Applikationesgroessen der Komponente dUewIgetrK"
 /begin SUB_FUNCTION jUewIgetrKA_Fktn jUewIgetrKB_Fktn jUewIgetrKC_Fktn jUewIgetrKD_Fktn jUewIgetrKE_Fktn /end SUB_FUNCTION
/end FUNCTION
/begin FUNCTION jUewIgetrKA_Fktn "Applikationesgroessen Instanz jUewIgetrKA" /begin DEF_CHARACTERISTIC MIN_ERFOLG_SYMIO_A /end DEF_CHARACTERISTIC /end FUNCTION
/begin FUNCTION jUewIgetrKB_Fktn "Applikationesgroessen Instanz jUewIgetrKB" /begin DEF_CHARACTERISTIC MIN_ERFOLG_SYMIO_B /end DEF_CHARACTERISTIC /end FUNCTION
/begin FUNCTION jUewIgetrKC_Fktn "Applikationesgroessen Instanz jUewIgetrKC" /begin DEF_CHARACTERISTIC MIN_ERFOLG_SYMIO_C /end DEF_CHARACTERISTIC /end FUNCTION
/begin FUNCTION jUewIgetrKD_Fktn "Applikationesgroessen Instanz jUewIgetrKD" /begin DEF_CHARACTERISTIC MIN_ERFOLG_SYMIO_D /end DEF_CHARACTERISTIC /end FUNCTION
/begin FUNCTION jUewIgetrKE_Fktn "Applikationesgroessen Instanz jUewIgetrKE" /begin DEF_CHARACTERISTIC MIN_ERFOLG_SYMIO_E /end DEF_CHARACTERISTIC /end FUNCTION
/begin FUNCTION dUewIgetrS_Fktn "Applikationesgroessen der Komponente dUewIgetrS"
 /begin SUB_FUNCTION jUewIgetrS12_Fktn jUewIgetrS23_Fktn jUewIgetrS34_Fktn jUewIgetrS45_Fktn jUewIgetrS56_Fktn jUewIgetrS67_Fktn jUewIgetrS78_Fktn jUewIgetrS13_Fktn jUewIgetrS24_Fktn jUewIgetrS35_Fktn jUewIgetrS46_Fktn jUewIgetrS57_Fktn jUewIgetrS68_Fktn jUewIgetrS21_Fktn jUewIgetrS32_Fktn jUewIgetrS43_Fktn jUewIgetrS54_Fktn jUewIgetrS65_Fktn jUewIgetrS76_Fktn jUewIgetrS87_Fktn jUewIgetrS31_Fktn jUewIgetrS42_Fktn jUewIgetrS51_Fktn jUewIgetrS53_Fktn jUewIgetrS63_Fktn jUewIgetrS64_Fktn jUewIgetrS71_Fktn jUewIgetrS75_Fktn jUewIgetrS82_Fktn jUewIgetrS84_Fktn jUewIgetrS86_Fktn /end SUB_FUNCTION
/end FUNCTION
/begin FUNCTION jUewIgetrS12_Fktn "Applikationesgroessen Instanz jUewIgetrS12"
 /begin DEF_CHARACTERISTIC KL_IGOUWIGOB12 KL_IGOUWIGUN12 MAX_STOER_OFFSET12 MAX_SYM_UWIG_SCHALT12 NGS_ABUWIG12 T_VNGABUWIG12 T_VUWIG12 /end DEF_CHARACTERISTIC
/end FUNCTION
/begin FUNCTION jUewIgetrS23_Fktn "Applikationesgroessen Instanz jUewIgetrS23"
 /begin DEF_CHARACTERISTIC KL_IGOUWIGOB23 KL_IGOUWIGUN23 MAX_STOER_OFFSET23 MAX_SYM_UWIG_SCHALT23 NGS_ABUWIG23 T_VNGABUWIG23 T_VUWIG23 /end DEF_CHARACTERISTIC
/end FUNCTION
/begin FUNCTION jUewIgetrS34_Fktn "Applikationesgroessen Instanz jUewIgetrS34"
 /begin DEF_CHARACTERISTIC KL_IGOUWIGOB34 KL_IGOUWIGUN34 MAX_STOER_OFFSET34 MAX_SYM_UWIG_SCHALT34 NGS_ABUWIG34 T_VNGABUWIG34 T_VUWIG34 /end DEF_CHARACTERISTIC
/end FUNCTION
/begin FUNCTION jUewIgetrS45_Fktn "Applikationesgroessen Instanz jUewIgetrS45"
 /begin DEF_CHARACTERISTIC KL_IGOUWIGOB45 KL_IGOUWIGUN45 MAX_STOER_OFFSET45 MAX_SYM_UWIG_SCHALT45 NGS_ABUWIG45 T_VNGABUWIG45 T_VUWIG45 /end DEF_CHARACTERISTIC
/end FUNCTION
/begin FUNCTION jUewIgetrS56_Fktn "Applikationesgroessen Instanz jUewIgetrS56"
 /begin DEF_CHARACTERISTIC KL_IGOUWIGOB56 KL_IGOUWIGUN56 MAX_STOER_OFFSET56 MAX_SYM_UWIG_SCHALT56 NGS_ABUWIG56 T_VNGABUWIG56 T_VUWIG56 /end DEF_CHARACTERISTIC
/end FUNCTION
/begin FUNCTION jUewIgetrS67_Fktn "Applikationesgroessen Instanz jUewIgetrS67"
 /begin DEF_CHARACTERISTIC KL_IGOUWIGOB67 KL_IGOUWIGUN67 MAX_STOER_OFFSET67 MAX_SYM_UWIG_SCHALT67 NGS_ABUWIG67 T_VNGABUWIG67 T_VUWIG67 /end DEF_CHARACTERISTIC
/end FUNCTION
/begin FUNCTION jUewIgetrS78_Fktn "Applikationesgroessen Instanz jUewIgetrS78"
 /begin DEF_CHARACTERISTIC KL_IGOUWIGOB78 KL_IGOUWIGUN78 MAX_STOER_OFFSET78 MAX_SYM_UWIG_SCHALT78 NGS_ABUWIG78 T_VNGABUWIG78 T_VUWIG78 /end DEF_CHARACTERISTIC
/end FUNCTION
/begin FUNCTION jUewIgetrS13_Fktn "Applikationesgroessen Instanz jUewIgetrS13"
 /begin DEF_CHARACTERISTIC KL_IGOUWIGOB13 KL_IGOUWIGUN13 MAX_STOER_OFFSET13 MAX_SYM_UWIG_SCHALT13 NGS_ABUWIG13 T_VNGABUWIG13 T_VUWIG13 /end DEF_CHARACTERISTIC
/end FUNCTION
/begin FUNCTION jUewIgetrS24_Fktn "Applikationesgroessen Instanz jUewIgetrS24"
 /begin DEF_CHARACTERISTIC KL_IGOUWIGOB24 KL_IGOUWIGUN24 MAX_STOER_OFFSET24 MAX_SYM_UWIG_SCHALT24 NGS_ABUWIG24 T_VNGABUWIG24 T_VUWIG24 /end DEF_CHARACTERISTIC
/end FUNCTION
/begin FUNCTION jUewIgetrS35_Fktn "Applikationesgroessen Instanz jUewIgetrS35"
 /begin DEF_CHARACTERISTIC KL_IGOUWIGOB35 KL_IGOUWIGUN35 MAX_STOER_OFFSET35 MAX_SYM_UWIG_SCHALT35 NGS_ABUWIG35 T_VNGABUWIG35 T_VUWIG35 /end DEF_CHARACTERISTIC
/end FUNCTION
/begin FUNCTION jUewIgetrS46_Fktn "Applikationesgroessen Instanz jUewIgetrS46"
 /begin DEF_CHARACTERISTIC KL_IGOUWIGOB46 KL_IGOUWIGUN46 MAX_STOER_OFFSET46 MAX_SYM_UWIG_SCHALT46 NGS_ABUWIG46 T_VNGABUWIG46 T_VUWIG46 /end DEF_CHARACTERISTIC
/end FUNCTION
/begin FUNCTION jUewIgetrS57_Fktn "Applikationesgroessen Instanz jUewIgetrS57"
 /begin DEF_CHARACTERISTIC KL_IGOUWIGOB57 KL_IGOUWIGUN57 MAX_STOER_OFFSET57 MAX_SYM_UWIG_SCHALT57 NGS_ABUWIG57 T_VNGABUWIG57 T_VUWIG57 /end DEF_CHARACTERISTIC
/end FUNCTION
/begin FUNCTION jUewIgetrS68_Fktn "Applikationesgroessen Instanz jUewIgetrS68"
 /begin DEF_CHARACTERISTIC KL_IGOUWIGOB68 KL_IGOUWIGUN68 MAX_STOER_OFFSET68 MAX_SYM_UWIG_SCHALT68 NGS_ABUWIG68 T_VNGABUWIG68 T_VUWIG68 /end DEF_CHARACTERISTIC
/end FUNCTION
/begin FUNCTION jUewIgetrS21_Fktn "Applikationesgroessen Instanz jUewIgetrS21"
 /begin DEF_CHARACTERISTIC KL_IGOUWIGOB21 KL_IGOUWIGUN21 MAX_STOER_OFFSET21 MAX_SYM_UWIG_SCHALT21 NGS_ABUWIG21 T_VNGABUWIG21 T_VUWIG21 /end DEF_CHARACTERISTIC
/end FUNCTION
/begin FUNCTION jUewIgetrS32_Fktn "Applikationesgroessen Instanz jUewIgetrS32"
 /begin DEF_CHARACTERISTIC KL_IGOUWIGOB32 KL_IGOUWIGUN32 MAX_STOER_OFFSET32 MAX_SYM_UWIG_SCHALT32 NGS_ABUWIG32 T_VNGABUWIG32 T_VUWIG32 /end DEF_CHARACTERISTIC
/end FUNCTION
/begin FUNCTION jUewIgetrS43_Fktn "Applikationesgroessen Instanz jUewIgetrS43"
 /begin DEF_CHARACTERISTIC KL_IGOUWIGOB43 KL_IGOUWIGUN43 MAX_STOER_OFFSET43 MAX_SYM_UWIG_SCHALT43 NGS_ABUWIG43 T_VNGABUWIG43 T_VUWIG43 /end DEF_CHARACTERISTIC
/end FUNCTION
/begin FUNCTION jUewIgetrS54_Fktn "Applikationesgroessen Instanz jUewIgetrS54"
 /begin DEF_CHARACTERISTIC KL_IGOUWIGOB54 KL_IGOUWIGUN54 MAX_STOER_OFFSET54 MAX_SYM_UWIG_SCHALT54 NGS_ABUWIG54 T_VNGABUWIG54 T_VUWIG54 /end DEF_CHARACTERISTIC
/end FUNCTION
/begin FUNCTION jUewIgetrS65_Fktn "Applikationesgroessen Instanz jUewIgetrS65"
 /begin DEF_CHARACTERISTIC KL_IGOUWIGOB65 KL_IGOUWIGUN65 MAX_STOER_OFFSET65 MAX_SYM_UWIG_SCHALT65 NGS_ABUWIG65 T_VNGABUWIG65 T_VUWIG65 /end DEF_CHARACTERISTIC
/end FUNCTION
/begin FUNCTION jUewIgetrS76_Fktn "Applikationesgroessen Instanz jUewIgetrS76"
 /begin DEF_CHARACTERISTIC KL_IGOUWIGOB76 KL_IGOUWIGUN76 MAX_STOER_OFFSET76 MAX_SYM_UWIG_SCHALT76 NGS_ABUWIG76 T_VNGABUWIG76 T_VUWIG76 /end DEF_CHARACTERISTIC
/end FUNCTION
/begin FUNCTION jUewIgetrS87_Fktn "Applikationesgroessen Instanz jUewIgetrS87"
 /begin DEF_CHARACTERISTIC KL_IGOUWIGOB87 KL_IGOUWIGUN87 MAX_STOER_OFFSET87 MAX_SYM_UWIG_SCHALT87 NGS_ABUWIG87 T_VNGABUWIG87 T_VUWIG87 /end DEF_CHARACTERISTIC
/end FUNCTION
/begin FUNCTION jUewIgetrS31_Fktn "Applikationesgroessen Instanz jUewIgetrS31"
 /begin DEF_CHARACTERISTIC KL_IGOUWIGOB31 KL_IGOUWIGUN31 MAX_STOER_OFFSET31 MAX_SYM_UWIG_SCHALT31 NGS_ABUWIG31 T_VNGABUWIG31 T_VUWIG31 /end DEF_CHARACTERISTIC
/end FUNCTION
/begin FUNCTION jUewIgetrS42_Fktn "Applikationesgroessen Instanz jUewIgetrS42"
 /begin DEF_CHARACTERISTIC KL_IGOUWIGOB42 KL_IGOUWIGUN42 MAX_STOER_OFFSET42 MAX_SYM_UWIG_SCHALT42 NGS_ABUWIG42 T_VNGABUWIG42 T_VUWIG42 /end DEF_CHARACTERISTIC
/end FUNCTION
/begin FUNCTION jUewIgetrS51_Fktn "Applikationesgroessen Instanz jUewIgetrS51"
 /begin DEF_CHARACTERISTIC KL_IGOUWIGOB51 KL_IGOUWIGUN51 MAX_STOER_OFFSET51 MAX_SYM_UWIG_SCHALT51 NGS_ABUWIG51 T_VNGABUWIG51 T_VUWIG51 /end DEF_CHARACTERISTIC
/end FUNCTION
/begin FUNCTION jUewIgetrS53_Fktn "Applikationesgroessen Instanz jUewIgetrS53"
 /begin DEF_CHARACTERISTIC KL_IGOUWIGOB53 KL_IGOUWIGUN53 MAX_STOER_OFFSET53 MAX_SYM_UWIG_SCHALT53 NGS_ABUWIG53 T_VNGABUWIG53 T_VUWIG53 /end DEF_CHARACTERISTIC
/end FUNCTION
/begin FUNCTION jUewIgetrS63_Fktn "Applikationesgroessen Instanz jUewIgetrS63"
 /begin DEF_CHARACTERISTIC KL_IGOUWIGOB63 KL_IGOUWIGUN63 MAX_STOER_OFFSET63 MAX_SYM_UWIG_SCHALT63 NGS_ABUWIG63 T_VNGABUWIG63 T_VUWIG63 /end DEF_CHARACTERISTIC
/end FUNCTION
/begin FUNCTION jUewIgetrS64_Fktn "Applikationesgroessen Instanz jUewIgetrS64"
 /begin DEF_CHARACTERISTIC KL_IGOUWIGOB64 KL_IGOUWIGUN64 MAX_STOER_OFFSET64 MAX_SYM_UWIG_SCHALT64 NGS_ABUWIG64 T_VNGABUWIG64 T_VUWIG64 /end DEF_CHARACTERISTIC
/end FUNCTION
/begin FUNCTION jUewIgetrS71_Fktn "Applikationesgroessen Instanz jUewIgetrS71"
 /begin DEF_CHARACTERISTIC KL_IGOUWIGOB71 KL_IGOUWIGUN71 MAX_STOER_OFFSET71 MAX_SYM_UWIG_SCHALT71 NGS_ABUWIG71 T_VNGABUWIG71 T_VUWIG71 /end DEF_CHARACTERISTIC
/end FUNCTION
/begin FUNCTION jUewIgetrS75_Fktn "Applikationesgroessen Instanz jUewIgetrS75"
 /begin DEF_CHARACTERISTIC KL_IGOUWIGOB75 KL_IGOUWIGUN75 MAX_STOER_OFFSET75 MAX_SYM_UWIG_SCHALT75 NGS_ABUWIG75 T_VNGABUWIG75 T_VUWIG75 /end DEF_CHARACTERISTIC
/end FUNCTION
/begin FUNCTION jUewIgetrS82_Fktn "Applikationesgroessen Instanz jUewIgetrS82"
 /begin DEF_CHARACTERISTIC KL_IGOUWIGOB82 KL_IGOUWIGUN82 MAX_STOER_OFFSET82 MAX_SYM_UWIG_SCHALT82 NGS_ABUWIG82 T_VNGABUWIG82 T_VUWIG82 /end DEF_CHARACTERISTIC
/end FUNCTION
/begin FUNCTION jUewIgetrS84_Fktn "Applikationesgroessen Instanz jUewIgetrS84"
 /begin DEF_CHARACTERISTIC KL_IGOUWIGOB84 KL_IGOUWIGUN84 MAX_STOER_OFFSET84 MAX_SYM_UWIG_SCHALT84 NGS_ABUWIG84 T_VNGABUWIG84 T_VUWIG84 /end DEF_CHARACTERISTIC
/end FUNCTION
/begin FUNCTION jUewIgetrS86_Fktn "Applikationesgroessen Instanz jUewIgetrS86"
 /begin DEF_CHARACTERISTIC KL_IGOUWIGOB86 KL_IGOUWIGUN86 MAX_STOER_OFFSET86 MAX_SYM_UWIG_SCHALT86 NGS_ABUWIG86 T_VNGABUWIG86 T_VUWIG86 /end DEF_CHARACTERISTIC
/end FUNCTION
/begin FUNCTION dUewParksperrenmagnet_Fktn "Applikationesgroessen der Komponente dUewParksperrenmagnet" /begin SUB_FUNCTION jUewParksperrenmagnet_Fktn /end SUB_FUNCTION /end FUNCTION
/begin FUNCTION jUewParksperrenmagnet_Fktn "Applikationesgroessen Instanz jUewParksperrenmagnet"
 /begin DEF_CHARACTERISTIC C_PMUEB IEDSPOS_PMUEB MAX_STOER_PMUEB PSYS_PMUEB TMAX_PMUEB TVERZ_PMUEB T_PMUEBDEF V_PMUEB_OB V_PMUEB_UN /end DEF_CHARACTERISTIC
/end FUNCTION
/begin FUNCTION dDiaRbmif_Fktn "Applikationesgroessen der Komponente dDiaRbmif" /begin SUB_FUNCTION jDiaRbmif_Fktn /end SUB_FUNCTION /end FUNCTION
/begin FUNCTION jDiaRbmif_Fktn "Applikationesgroessen Instanz jDiaRbmif" /begin DEF_CHARACTERISTIC N_ABKODERA /end DEF_CHARACTERISTIC /end FUNCTION
/begin FUNCTION dUl2Hydraulik_Fktn "Applikationesgroessen der Komponente dUl2Hydraulik" /begin SUB_FUNCTION jUl2Hydraulik_Fktn /end SUB_FUNCTION /end FUNCTION
/begin FUNCTION jUl2Hydraulik_Fktn "Applikationesgroessen Instanz jUl2Hydraulik"
 /begin DEF_CHARACTERISTIC N_MITTELWERT_EDSLOGIK_A N_MITTELWERT_EDSLOGIK_B N_MITTELWERT_EDSLOGIK_C N_MITTELWERT_EDSLOGIK_D N_MITTELWERT_EDSLOGIK_E /end DEF_CHARACTERISTIC
/end FUNCTION
/begin FUNCTION dUl2EdsGangInfoK_Fktn "Applikationesgroessen der Komponente dUl2EdsGangInfoK"
 /begin SUB_FUNCTION jUl2EdsGangInfoKR1A_Fktn jUl2EdsGangInfoKR1B_Fktn jUl2EdsGangInfoKR1D_Fktn jUl2EdsGangInfoK1A_Fktn jUl2EdsGangInfoK1B_Fktn jUl2EdsGangInfoK1C_Fktn jUl2EdsGangInfoK2A_Fktn jUl2EdsGangInfoK2B_Fktn jUl2EdsGangInfoK2E_Fktn jUl2EdsGangInfoK3B_Fktn jUl2EdsGangInfoK3C_Fktn jUl2EdsGangInfoK3E_Fktn jUl2EdsGangInfoK4B_Fktn jUl2EdsGangInfoK4D_Fktn jUl2EdsGangInfoK4E_Fktn jUl2EdsGangInfoK5B_Fktn jUl2EdsGangInfoK5C_Fktn jUl2EdsGangInfoK5D_Fktn jUl2EdsGangInfoK6C_Fktn jUl2EdsGangInfoK6D_Fktn jUl2EdsGangInfoK6E_Fktn jUl2EdsGangInfoK7A_Fktn jUl2EdsGangInfoK7C_Fktn jUl2EdsGangInfoK7D_Fktn jUl2EdsGangInfoK8A_Fktn jUl2EdsGangInfoK8D_Fktn jUl2EdsGangInfoK8E_Fktn /end SUB_FUNCTION
/end FUNCTION
/begin FUNCTION jUl2EdsGangInfoKR1A_Fktn "Applikationesgroessen Instanz jUl2EdsGangInfoKR1A" /begin DEF_CHARACTERISTIC KF_IEDSIGANGLEV2MMOTCG_R1A /end DEF_CHARACTERISTIC /end FUNCTION
/begin FUNCTION jUl2EdsGangInfoKR1B_Fktn "Applikationesgroessen Instanz jUl2EdsGangInfoKR1B" /begin DEF_CHARACTERISTIC KF_IEDSIGANGLEV2MMOTCG_R1B /end DEF_CHARACTERISTIC /end FUNCTION
/begin FUNCTION jUl2EdsGangInfoKR1D_Fktn "Applikationesgroessen Instanz jUl2EdsGangInfoKR1D" /begin DEF_CHARACTERISTIC KF_IEDSIGANGLEV2MMOTCG_R1D /end DEF_CHARACTERISTIC /end FUNCTION
/begin FUNCTION jUl2EdsGangInfoK1A_Fktn "Applikationesgroessen Instanz jUl2EdsGangInfoK1A" /begin DEF_CHARACTERISTIC KF_IEDSIGANGLEV2MMOTCG_1A /end DEF_CHARACTERISTIC /end FUNCTION
/begin FUNCTION jUl2EdsGangInfoK1B_Fktn "Applikationesgroessen Instanz jUl2EdsGangInfoK1B" /begin DEF_CHARACTERISTIC KF_IEDSIGANGLEV2MMOTCG_1B /end DEF_CHARACTERISTIC /end FUNCTION
/begin FUNCTION jUl2EdsGangInfoK1C_Fktn "Applikationesgroessen Instanz jUl2EdsGangInfoK1C" /begin DEF_CHARACTERISTIC KF_IEDSIGANGLEV2MMOTCG_1C /end DEF_CHARACTERISTIC /end FUNCTION
/begin FUNCTION jUl2EdsGangInfoK2A_Fktn "Applikationesgroessen Instanz jUl2EdsGangInfoK2A" /begin DEF_CHARACTERISTIC KF_IEDSIGANGLEV2MMOTCG_2A /end DEF_CHARACTERISTIC /end FUNCTION
/begin FUNCTION jUl2EdsGangInfoK2B_Fktn "Applikationesgroessen Instanz jUl2EdsGangInfoK2B" /begin DEF_CHARACTERISTIC KF_IEDSIGANGLEV2MMOTCG_2B /end DEF_CHARACTERISTIC /end FUNCTION
/begin FUNCTION jUl2EdsGangInfoK2E_Fktn "Applikationesgroessen Instanz jUl2EdsGangInfoK2E" /begin DEF_CHARACTERISTIC KF_IEDSIGANGLEV2MMOTCG_2E /end DEF_CHARACTERISTIC /end FUNCTION
/begin FUNCTION jUl2EdsGangInfoK3B_Fktn "Applikationesgroessen Instanz jUl2EdsGangInfoK3B" /begin DEF_CHARACTERISTIC KF_IEDSIGANGLEV2MMOTCG_3B /end DEF_CHARACTERISTIC /end FUNCTION
/begin FUNCTION jUl2EdsGangInfoK3C_Fktn "Applikationesgroessen Instanz jUl2EdsGangInfoK3C" /begin DEF_CHARACTERISTIC KF_IEDSIGANGLEV2MMOTCG_3C /end DEF_CHARACTERISTIC /end FUNCTION
/begin FUNCTION jUl2EdsGangInfoK3E_Fktn "Applikationesgroessen Instanz jUl2EdsGangInfoK3E" /begin DEF_CHARACTERISTIC KF_IEDSIGANGLEV2MMOTCG_3E /end DEF_CHARACTERISTIC /end FUNCTION
/begin FUNCTION jUl2EdsGangInfoK4B_Fktn "Applikationesgroessen Instanz jUl2EdsGangInfoK4B" /begin DEF_CHARACTERISTIC KF_IEDSIGANGLEV2MMOTCG_4B /end DEF_CHARACTERISTIC /end FUNCTION
/begin FUNCTION jUl2EdsGangInfoK4D_Fktn "Applikationesgroessen Instanz jUl2EdsGangInfoK4D" /begin DEF_CHARACTERISTIC KF_IEDSIGANGLEV2MMOTCG_4D /end DEF_CHARACTERISTIC /end FUNCTION
/begin FUNCTION jUl2EdsGangInfoK4E_Fktn "Applikationesgroessen Instanz jUl2EdsGangInfoK4E" /begin DEF_CHARACTERISTIC KF_IEDSIGANGLEV2MMOTCG_4E /end DEF_CHARACTERISTIC /end FUNCTION
/begin FUNCTION jUl2EdsGangInfoK5B_Fktn "Applikationesgroessen Instanz jUl2EdsGangInfoK5B" /begin DEF_CHARACTERISTIC KF_IEDSIGANGLEV2MMOTCG_5B /end DEF_CHARACTERISTIC /end FUNCTION
/begin FUNCTION jUl2EdsGangInfoK5C_Fktn "Applikationesgroessen Instanz jUl2EdsGangInfoK5C" /begin DEF_CHARACTERISTIC KF_IEDSIGANGLEV2MMOTCG_5C /end DEF_CHARACTERISTIC /end FUNCTION
/begin FUNCTION jUl2EdsGangInfoK5D_Fktn "Applikationesgroessen Instanz jUl2EdsGangInfoK5D" /begin DEF_CHARACTERISTIC KF_IEDSIGANGLEV2MMOTCG_5D /end DEF_CHARACTERISTIC /end FUNCTION
/begin FUNCTION jUl2EdsGangInfoK6C_Fktn "Applikationesgroessen Instanz jUl2EdsGangInfoK6C" /begin DEF_CHARACTERISTIC KF_IEDSIGANGLEV2MMOTCG_6C /end DEF_CHARACTERISTIC /end FUNCTION
/begin FUNCTION jUl2EdsGangInfoK6D_Fktn "Applikationesgroessen Instanz jUl2EdsGangInfoK6D" /begin DEF_CHARACTERISTIC KF_IEDSIGANGLEV2MMOTCG_6D /end DEF_CHARACTERISTIC /end FUNCTION
/begin FUNCTION jUl2EdsGangInfoK6E_Fktn "Applikationesgroessen Instanz jUl2EdsGangInfoK6E" /begin DEF_CHARACTERISTIC KF_IEDSIGANGLEV2MMOTCG_6E /end DEF_CHARACTERISTIC /end FUNCTION
/begin FUNCTION jUl2EdsGangInfoK7A_Fktn "Applikationesgroessen Instanz jUl2EdsGangInfoK7A" /begin DEF_CHARACTERISTIC KF_IEDSIGANGLEV2MMOTCG_7A /end DEF_CHARACTERISTIC /end FUNCTION
/begin FUNCTION jUl2EdsGangInfoK7C_Fktn "Applikationesgroessen Instanz jUl2EdsGangInfoK7C" /begin DEF_CHARACTERISTIC KF_IEDSIGANGLEV2MMOTCG_7C /end DEF_CHARACTERISTIC /end FUNCTION
/begin FUNCTION jUl2EdsGangInfoK7D_Fktn "Applikationesgroessen Instanz jUl2EdsGangInfoK7D" /begin DEF_CHARACTERISTIC KF_IEDSIGANGLEV2MMOTCG_7D /end DEF_CHARACTERISTIC /end FUNCTION
/begin FUNCTION jUl2EdsGangInfoK8A_Fktn "Applikationesgroessen Instanz jUl2EdsGangInfoK8A" /begin DEF_CHARACTERISTIC KF_IEDSIGANGLEV2MMOTCG_8A /end DEF_CHARACTERISTIC /end FUNCTION
/begin FUNCTION jUl2EdsGangInfoK8D_Fktn "Applikationesgroessen Instanz jUl2EdsGangInfoK8D" /begin DEF_CHARACTERISTIC KF_IEDSIGANGLEV2MMOTCG_8D /end DEF_CHARACTERISTIC /end FUNCTION
/begin FUNCTION jUl2EdsGangInfoK8E_Fktn "Applikationesgroessen Instanz jUl2EdsGangInfoK8E" /begin DEF_CHARACTERISTIC KF_IEDSIGANGLEV2MMOTCG_8E /end DEF_CHARACTERISTIC /end FUNCTION
/begin FUNCTION dUl2EdsGangInfo_Fktn "Applikationesgroessen der Komponente dUl2EdsGangInfo" /begin SUB_FUNCTION jUl2EdsGangInfo_Fktn /end SUB_FUNCTION /end FUNCTION
/begin FUNCTION jUl2EdsGangInfo_Fktn "Applikationesgroessen Instanz jUl2EdsGangInfo" /begin DEF_CHARACTERISTIC N_MAX_IGANG SWI_BEDGBESTR /end DEF_CHARACTERISTIC /end FUNCTION
/begin FUNCTION dUl2EdsKfl_Fktn "Applikationesgroessen der Komponente dUl2EdsKfl" /begin SUB_FUNCTION jUl2EdsKfl_Fktn /end SUB_FUNCTION /end FUNCTION
/begin FUNCTION jUl2EdsKfl_Fktn "Applikationesgroessen Instanz jUl2EdsKfl" /begin DEF_CHARACTERISTIC N_MAX_VERZ_POWERFLOW /end DEF_CHARACTERISTIC /end FUNCTION
/begin FUNCTION dUl2EdsKupKfl_Fktn "Applikationesgroessen der Komponente dUl2EdsKupKfl"
 /begin SUB_FUNCTION jUl2EdsKupKflA_Fktn jUl2EdsKupKflB_Fktn jUl2EdsKupKflC_Fktn jUl2EdsKupKflD_Fktn jUl2EdsKupKflE_Fktn /end SUB_FUNCTION
/end FUNCTION
/begin FUNCTION jUl2EdsKupKflA_Fktn "Applikationesgroessen Instanz jUl2EdsKupKflA" /begin DEF_CHARACTERISTIC I_EDSPOWERFLOWUEBMAX_A /end DEF_CHARACTERISTIC /end FUNCTION
/begin FUNCTION jUl2EdsKupKflB_Fktn "Applikationesgroessen Instanz jUl2EdsKupKflB" /begin DEF_CHARACTERISTIC I_EDSPOWERFLOWUEBMAX_B /end DEF_CHARACTERISTIC /end FUNCTION
/begin FUNCTION jUl2EdsKupKflC_Fktn "Applikationesgroessen Instanz jUl2EdsKupKflC" /begin DEF_CHARACTERISTIC I_EDSPOWERFLOWUEBMIN_C /end DEF_CHARACTERISTIC /end FUNCTION
/begin FUNCTION jUl2EdsKupKflD_Fktn "Applikationesgroessen Instanz jUl2EdsKupKflD" /begin DEF_CHARACTERISTIC I_EDSPOWERFLOWUEBMIN_D /end DEF_CHARACTERISTIC /end FUNCTION
/begin FUNCTION jUl2EdsKupKflE_Fktn "Applikationesgroessen Instanz jUl2EdsKupKflE" /begin DEF_CHARACTERISTIC I_EDSPOWERFLOWUEBMIN_E /end DEF_CHARACTERISTIC /end FUNCTION
/begin FUNCTION dUl2ISetPlausibel_Fktn "Applikationesgroessen der Komponente dUl2ISetPlausibel" /begin SUB_FUNCTION jUl2ISetPlausibel_Fktn /end SUB_FUNCTION /end FUNCTION
/begin FUNCTION jUl2ISetPlausibel_Fktn "Applikationesgroessen Instanz jUl2ISetPlausibel"
 /begin DEF_CHARACTERISTIC I_KUPB_ISETPLAUSIBLE N_VERZ_ISETPLAUSIBLE N_VERZ_REVN_ISETPLAUSIBLE N_VERZ_REV_ISETPLAUSIBLE SWI_VERSCH_ISETPLAUSIBLE /end DEF_CHARACTERISTIC
/end FUNCTION
/begin FUNCTION dUl2MaxVerz_Fktn "Applikationesgroessen der Komponente dUl2MaxVerz" /begin SUB_FUNCTION jUl2MaxVerz_Fktn /end SUB_FUNCTION /end FUNCTION
/begin FUNCTION jUl2MaxVerz_Fktn "Applikationesgroessen Instanz jUl2MaxVerz"
 /begin DEF_CHARACTERISTIC AQ_VERZMAX NAB_MAXVERZ NS_ABDIFVERZMAXAKTIV NS_ABVERZMAX N_MAX_NAB_MAXVERZ N_SIGREFVERZMAX N_VERZ_MAXVERZ N_ZAEHLERVERZMAXAKTIV PS_BRVERZMAX SWI_MAXVERZ SWI_NABSTATUS_MAXVERZ SWI_NAB_BEW SWI_PBRAKE_MAXVERZ TS_BRVERZMAX TS_VERZMAX_BRAKE /end DEF_CHARACTERISTIC
/end FUNCTION
/begin FUNCTION dUl2EdsLg_Fktn "Applikationesgroessen der Komponente dUl2EdsLg" /begin SUB_FUNCTION jUl2EdsLg_Fktn /end SUB_FUNCTION /end FUNCTION
/begin FUNCTION jUl2EdsLg_Fktn "Applikationesgroessen Instanz jUl2EdsLg"
 /begin DEF_CHARACTERISTIC CS_EDSLOGIK IEDSC_MAX_POSVC I_EDSMAXPOSPUEB_POS I_EDSMINPOSPUEB_C I_EDSPOS I_KUPA_MIN_EDSLOGIK I_KUPB_MIN_EDSLOGIK I_KUPD_MAX_EDSLOGIK I_MAXSTATUSK0 J_VM_K0 KL_I_MAXK0 KL_MAXSTOER_EDSLOGIK_K0 KL_M_REIB_K0 KL_N_DIFF_K0_MIN MAXSTOER1_K0_SCHLIESSEN_STATUS MAXSTOER2_K0_SCHLIESSEN_STATUS MAX_STOER_FAHRTR_POS N_DIFF_EM_MAX N_K0_TASKS N_MAXKABPOS_C N_MAXKABPOS_E N_MAXKFLWECHSEL N_MAXSTOERPOS_P N_MAXSTOERVPLAUSIPOS_P N_MAX_FAHRTR N_MAX_POSFAHRTR N_STOER_MAX_FAHRTR_EDSLOGIK N_VERZ_EDSLOGIK N_VPOSPUEB SWI_EDSLOGIK_POSUEB SWI_EDSLOGIK_TOGGELN SWI_K0UEB VS_EDSLOGIK VS_FZG_R VS_FZG_RSICH_LEV2 /end DEF_CHARACTERISTIC
/end FUNCTION
/begin FUNCTION dUl2Kuppl_Fktn "Applikationesgroessen der Komponente dUl2Kuppl" /begin SUB_FUNCTION jUl2Kuppl_Fktn /end SUB_FUNCTION /end FUNCTION
/begin FUNCTION jUl2Kuppl_Fktn "Applikationesgroessen Instanz jUl2Kuppl" /begin DEF_CHARACTERISTIC N_KUP_OFFEN N_KUP_OFFEN_STROMLOS SWI_MMOT_EDSLOGIK /end DEF_CHARACTERISTIC /end FUNCTION
/begin FUNCTION dUl2KupplK_Fktn "Applikationesgroessen der Komponente dUl2KupplK"
 /begin SUB_FUNCTION jUl2KupplKA_Fktn jUl2KupplKB_Fktn jUl2KupplKC_Fktn jUl2KupplKD_Fktn jUl2KupplKE_Fktn /end SUB_FUNCTION
/end FUNCTION
/begin FUNCTION jUl2KupplKA_Fktn "Applikationesgroessen Instanz jUl2KupplKA"
 /begin DEF_CHARACTERISTIC IEDS_STOER_VUNPLAUSI_A KF_IEDSMAXMMOTCGLOGIKUEB_A KF_IEDSMAXOFFMMOTCGLOGIKUEB_A KF_MAXSTOERCGDELTAI_EDSLOGIK_A KL_IEDSMAXOFFCG_BEF1_A KL_MAX_STOEROFFCG_BEF1_A KL_NVERZMIN_DEKREMENT_EDSLOGIK_A /end DEF_CHARACTERISTIC
/end FUNCTION
/begin FUNCTION jUl2KupplKB_Fktn "Applikationesgroessen Instanz jUl2KupplKB"
 /begin DEF_CHARACTERISTIC IEDS_STOER_VUNPLAUSI_B KF_IEDSMAXMMOTCGLOGIKUEB_B KF_IEDSMAXOFFMMOTCGLOGIKUEB_B KF_MAXSTOERCGDELTAI_EDSLOGIK_B KL_IEDSMAXOFFCG_BEF1_B KL_MAX_STOEROFFCG_BEF1_B KL_NVERZMIN_DEKREMENT_EDSLOGIK_B /end DEF_CHARACTERISTIC
/end FUNCTION
/begin FUNCTION jUl2KupplKC_Fktn "Applikationesgroessen Instanz jUl2KupplKC"
 /begin DEF_CHARACTERISTIC IEDS_STOER_VUNPLAUSI_C KF_IEDSMINMMOTCGLOGIKUEB_C KF_IEDSMINOFFMMOTCGLOGIKUEB_C KF_MAXSTOERCGDELTAI_EDSLOGIK_C KL_IEDSMINOFFCG_BEF1_C KL_MAX_STOEROFFCG_BEF1_C KL_NVERZMIN_DEKREMENT_EDSLOGIK_C /end DEF_CHARACTERISTIC
/end FUNCTION
/begin FUNCTION jUl2KupplKD_Fktn "Applikationesgroessen Instanz jUl2KupplKD"
 /begin DEF_CHARACTERISTIC IEDS_STOER_VUNPLAUSI_D KF_IEDSMINMMOTCGLOGIKUEB_D KF_IEDSMINOFFMMOTCGLOGIKUEB_D KF_MAXSTOERCGDELTAI_EDSLOGIK_D KL_IEDSMINOFFCG_BEF1_D KL_MAX_STOEROFFCG_BEF1_D KL_NVERZMIN_DEKREMENT_EDSLOGIK_D /end DEF_CHARACTERISTIC
/end FUNCTION
/begin FUNCTION jUl2KupplKE_Fktn "Applikationesgroessen Instanz jUl2KupplKE"
 /begin DEF_CHARACTERISTIC IEDS_STOER_VUNPLAUSI_E KF_IEDSMINMMOTCGLOGIKUEB_E KF_IEDSMINOFFMMOTCGLOGIKUEB_E KF_MAXSTOERCGDELTAI_EDSLOGIK_E KL_IEDSMINOFFCG_BEF1_E KL_MAX_STOEROFFCG_BEF1_E KL_NVERZMIN_DEKREMENT_EDSLOGIK_E /end DEF_CHARACTERISTIC
/end FUNCTION
/begin FUNCTION dUl2KupplK0_Fktn "Applikationesgroessen der Komponente dUl2KupplK0" /begin SUB_FUNCTION jUl2KupplK0_Fktn /end SUB_FUNCTION /end FUNCTION
/begin FUNCTION jUl2KupplK0_Fktn "Applikationesgroessen Instanz jUl2KupplK0"
 /begin DEF_CHARACTERISTIC KF_MAXSTOERCGDELTAI_EDSLOGIK_K0 KL_IEDSMAXCG_K0 KL_IEDSMAXOFFCG_BEF1_K0 KL_IEDSMAXOFFCG_K0 /end DEF_CHARACTERISTIC
/end FUNCTION
/begin FUNCTION dUl2KupplToggle_Fktn "Applikationesgroessen der Komponente dUl2KupplToggle"
 /begin SUB_FUNCTION jUl2KupplToggleKA_Fktn jUl2KupplToggleKB_Fktn jUl2KupplToggleKC_Fktn jUl2KupplToggleKD_Fktn jUl2KupplToggleKE_Fktn /end SUB_FUNCTION
/end FUNCTION
/begin FUNCTION jUl2KupplToggleKA_Fktn "Applikationesgroessen Instanz jUl2KupplToggleKA"
 /begin DEF_CHARACTERISTIC KF_NGUTMAX_EDSLOGIK_TOGGEL_A KL_IEDS_KUP_TOGGEL_OBEN_A KL_IEDS_KUP_TOGGEL_UNTEN_A KL_IEDS_TOGGELN_DELTA_A N_STOERMAX_EDSLOGIK_TOGGEL_A /end DEF_CHARACTERISTIC
/end FUNCTION
/begin FUNCTION jUl2KupplToggleKB_Fktn "Applikationesgroessen Instanz jUl2KupplToggleKB"
 /begin DEF_CHARACTERISTIC KF_NGUTMAX_EDSLOGIK_TOGGEL_B KL_IEDS_KUP_TOGGEL_OBEN_B KL_IEDS_KUP_TOGGEL_UNTEN_B KL_IEDS_TOGGELN_DELTA_B N_STOERMAX_EDSLOGIK_TOGGEL_B /end DEF_CHARACTERISTIC
/end FUNCTION
/begin FUNCTION jUl2KupplToggleKC_Fktn "Applikationesgroessen Instanz jUl2KupplToggleKC"
 /begin DEF_CHARACTERISTIC KF_NGUTMAX_EDSLOGIK_TOGGEL_C KL_IEDS_KUP_TOGGEL_OBEN_C KL_IEDS_KUP_TOGGEL_UNTEN_C KL_IEDS_TOGGELN_DELTA_C N_STOERMAX_EDSLOGIK_TOGGEL_C /end DEF_CHARACTERISTIC
/end FUNCTION
/begin FUNCTION jUl2KupplToggleKD_Fktn "Applikationesgroessen Instanz jUl2KupplToggleKD"
 /begin DEF_CHARACTERISTIC KF_NGUTMAX_EDSLOGIK_TOGGEL_D KL_IEDS_KUP_TOGGEL_OBEN_D KL_IEDS_KUP_TOGGEL_UNTEN_D KL_IEDS_TOGGELN_DELTA_D N_STOERMAX_EDSLOGIK_TOGGEL_D /end DEF_CHARACTERISTIC
/end FUNCTION
/begin FUNCTION jUl2KupplToggleKE_Fktn "Applikationesgroessen Instanz jUl2KupplToggleKE"
 /begin DEF_CHARACTERISTIC KF_NGUTMAX_EDSLOGIK_TOGGEL_E KL_IEDS_KUP_TOGGEL_OBEN_E KL_IEDS_KUP_TOGGEL_UNTEN_E KL_IEDS_TOGGELN_DELTA_E N_STOERMAX_EDSLOGIK_TOGGEL_E /end DEF_CHARACTERISTIC
/end FUNCTION
/begin FUNCTION dUl2Posme_Fktn "Applikationesgroessen der Komponente dUl2Posme" /begin SUB_FUNCTION jUl2Posme_Fktn /end SUB_FUNCTION /end FUNCTION
/begin FUNCTION jUl2Posme_Fktn "Applikationesgroessen Instanz jUl2Posme"
 /begin DEF_CHARACTERISTIC KF_NGPOSMEUEB KL_MMOTUEBNEGME1 KL_MMOTUEBNEGME2 KL_MMOTUEBPOSME1 KL_MMOTUEBPOSME2 KL_NMAXSTOERNEGMEINT1 KL_NMAXSTOERPOSMEGRADIENT KL_NMAXSTOERPOSMEINT1 KL_NMAXSTOERPOSMEINT2 KL_NMAXSTOERPOSMEINTIGANG M_MERED_MIN M_MOTMAXNEGINT M_MOTMININT N_DIFFMAXINT N_FNGABMEUEB N_FNGTMEUEB N_MAXSTOERNEGMEAUS N_MAXSTOERPOSMEAUS SWI_FLAGOFFPOSME TAB_MMOTUEBPOSMEIGANG TAB_N_OFFSET_ME /end DEF_CHARACTERISTIC
/end FUNCTION
/begin FUNCTION dUl2Kflpl_Fktn "Applikationesgroessen der Komponente dUl2Kflpl" /begin SUB_FUNCTION jUl2Kflpl_Fktn /end SUB_FUNCTION /end FUNCTION
/begin FUNCTION jUl2Kflpl_Fktn "Applikationesgroessen Instanz jUl2Kflpl" /begin DEF_CHARACTERISTIC I_EDSNULLPOSNUEB MAX_STOERPOSNEDS MAX_STOERPOSNEDS14 /end DEF_CHARACTERISTIC /end FUNCTION
/begin FUNCTION dUl2KflplK_Fktn "Applikationesgroessen der Komponente dUl2KflplK"
 /begin SUB_FUNCTION jUl2KflplKA_Fktn jUl2KflplKB_Fktn jUl2KflplKC_Fktn jUl2KflplKD_Fktn jUl2KflplKE_Fktn /end SUB_FUNCTION
/end FUNCTION
/begin FUNCTION jUl2KflplKA_Fktn "Applikationesgroessen Instanz jUl2KflplKA" /begin DEF_CHARACTERISTIC I_EDSMAXPOSNUEB_A /end DEF_CHARACTERISTIC /end FUNCTION
/begin FUNCTION jUl2KflplKB_Fktn "Applikationesgroessen Instanz jUl2KflplKB" /begin DEF_CHARACTERISTIC I_EDSMAXPOSNUEB_B /end DEF_CHARACTERISTIC /end FUNCTION
/begin FUNCTION jUl2KflplKC_Fktn "Applikationesgroessen Instanz jUl2KflplKC" /begin DEF_CHARACTERISTIC I_EDSMINPOSNUEB_C /end DEF_CHARACTERISTIC /end FUNCTION
/begin FUNCTION jUl2KflplKD_Fktn "Applikationesgroessen Instanz jUl2KflplKD" /begin DEF_CHARACTERISTIC I_EDSMINPOSNUEB_D /end DEF_CHARACTERISTIC /end FUNCTION
/begin FUNCTION jUl2KflplKE_Fktn "Applikationesgroessen Instanz jUl2KflplKE" /begin DEF_CHARACTERISTIC I_EDSMINPOSNUEB_E /end DEF_CHARACTERISTIC /end FUNCTION
/begin FUNCTION dUl2Nmotu_Fktn "Applikationesgroessen der Komponente dUl2Nmotu" /begin SUB_FUNCTION jUl2Nmotu_Fktn /end SUB_FUNCTION /end FUNCTION
/begin FUNCTION jUl2Nmotu_Fktn "Applikationesgroessen Instanz jUl2Nmotu"
 /begin DEF_CHARACTERISTIC F_NMOTUEB MAX_STOER_NMOTUEB N_MOTABREGEL_OFFSET N_NMOTABREGEL_VORGABE TAB_NMOTUEBDSCOFF /end DEF_CHARACTERISTIC
/end FUNCTION
/begin FUNCTION dUl2GetrMAuf_Fktn "Applikationesgroessen der Komponente dUl2GetrMAuf" /begin SUB_FUNCTION jUl2GetrMAuf_Fktn /end SUB_FUNCTION /end FUNCTION
/begin FUNCTION jUl2GetrMAuf_Fktn "Applikationesgroessen Instanz jUl2GetrMAuf"
 /begin DEF_CHARACTERISTIC KF_MMOTGETRAUF KF_OFFSETMMOTGETRAUF KL_F_VGETRAUF N_MAXSTOERMGETRAUF /end DEF_CHARACTERISTIC
/end FUNCTION
/begin FUNCTION dUewSgetf_Fktn "Applikationesgroessen der Komponente dUewSgetf" /begin SUB_FUNCTION jUewSgetf_Fktn /end SUB_FUNCTION /end FUNCTION
/begin FUNCTION jUewSgetf_Fktn "Applikationesgroessen Instanz jUewSgetf"
 /begin DEF_CHARACTERISTIC KL_CGVERZPOSVUEB KL_TMINVERZCG_POSVUEB KL_TUEBCGPOSVMECHDEF MAX_STOERPOSVMECHDEF NMOTMAX_POSVUEB T_VERZNMOTMAX_POSVUEB /end DEF_CHARACTERISTIC
/end FUNCTION
/begin FUNCTION zf_ATSYS_Applikationsgroessen.Asil "Asil-relevante Applikationsgroessen (Asil)"
 /begin REF_CHARACTERISTIC AQ_VERZMAX CS_EDSLOGIK F_NMOTUEB IEDSC_MAX_POSVC IEDS_STOER_VUNPLAUSI_A IEDS_STOER_VUNPLAUSI_B IEDS_STOER_VUNPLAUSI_C IEDS_STOER_VUNPLAUSI_D IEDS_STOER_VUNPLAUSI_E I_EDSMAXPOSNUEB_A I_EDSMAXPOSNUEB_B I_EDSMAXPOSPUEB_POS I_EDSMINPOSNUEB_C I_EDSMINPOSNUEB_D I_EDSMINPOSNUEB_E I_EDSMINPOSPUEB_C I_EDSNULLPOSNUEB I_EDSPOS I_EDSPOWERFLOWUEBMAX_A I_EDSPOWERFLOWUEBMAX_B I_EDSPOWERFLOWUEBMIN_C I_EDSPOWERFLOWUEBMIN_D I_EDSPOWERFLOWUEBMIN_E I_KUPA_MIN_EDSLOGIK I_KUPB_ISETPLAUSIBLE I_KUPB_MIN_EDSLOGIK I_KUPD_MAX_EDSLOGIK I_MAXSTATUSK0 J_VM_K0 KF_IEDSIGANGLEV2MMOTCG_1A KF_IEDSIGANGLEV2MMOTCG_1B KF_IEDSIGANGLEV2MMOTCG_1C KF_IEDSIGANGLEV2MMOTCG_2A KF_IEDSIGANGLEV2MMOTCG_2B KF_IEDSIGANGLEV2MMOTCG_2E KF_IEDSIGANGLEV2MMOTCG_3B KF_IEDSIGANGLEV2MMOTCG_3C KF_IEDSIGANGLEV2MMOTCG_3E KF_IEDSIGANGLEV2MMOTCG_4B KF_IEDSIGANGLEV2MMOTCG_4D KF_IEDSIGANGLEV2MMOTCG_4E KF_IEDSIGANGLEV2MMOTCG_5B KF_IEDSIGANGLEV2MMOTCG_5C KF_IEDSIGANGLEV2MMOTCG_5D KF_IEDSIGANGLEV2MMOTCG_6C KF_IEDSIGANGLEV2MMOTCG_6D KF_IEDSIGANGLEV2MMOTCG_6E KF_IEDSIGANGLEV2MMOTCG_7A KF_IEDSIGANGLEV2MMOTCG_7C KF_IEDSIGANGLEV2MMOTCG_7D KF_IEDSIGANGLEV2MMOTCG_8A KF_IEDSIGANGLEV2MMOTCG_8D KF_IEDSIGANGLEV2MMOTCG_8E KF_IEDSIGANGLEV2MMOTCG_R1A KF_IEDSIGANGLEV2MMOTCG_R1B KF_IEDSIGANGLEV2MMOTCG_R1D KF_IEDSMAXMMOTCGLOGIKUEB_A KF_IEDSMAXMMOTCGLOGIKUEB_B KF_IEDSMAXOFFMMOTCGLOGIKUEB_A KF_IEDSMAXOFFMMOTCGLOGIKUEB_B KF_IEDSMINMMOTCGLOGIKUEB_C KF_IEDSMINMMOTCGLOGIKUEB_D KF_IEDSMINMMOTCGLOGIKUEB_E KF_IEDSMINOFFMMOTCGLOGIKUEB_C KF_IEDSMINOFFMMOTCGLOGIKUEB_D KF_IEDSMINOFFMMOTCGLOGIKUEB_E KF_MAXSTOERCGDELTAI_EDSLOGIK_A KF_MAXSTOERCGDELTAI_EDSLOGIK_B KF_MAXSTOERCGDELTAI_EDSLOGIK_C KF_MAXSTOERCGDELTAI_EDSLOGIK_D KF_MAXSTOERCGDELTAI_EDSLOGIK_E KF_MAXSTOERCGDELTAI_EDSLOGIK_K0 KF_MMOTGETRAUF KF_NGPOSMEUEB KF_NGUTMAX_EDSLOGIK_TOGGEL_A KF_NGUTMAX_EDSLOGIK_TOGGEL_B KF_NGUTMAX_EDSLOGIK_TOGGEL_C KF_NGUTMAX_EDSLOGIK_TOGGEL_D KF_NGUTMAX_EDSLOGIK_TOGGEL_E KF_OFFSETMMOTGETRAUF KL_F_VGETRAUF KL_IEDSMAXCG_K0 KL_IEDSMAXOFFCG_BEF1_A KL_IEDSMAXOFFCG_BEF1_B KL_IEDSMAXOFFCG_BEF1_K0 KL_IEDSMAXOFFCG_K0 KL_IEDSMINOFFCG_BEF1_C KL_IEDSMINOFFCG_BEF1_D KL_IEDSMINOFFCG_BEF1_E KL_IEDS_KUP_TOGGEL_OBEN_A KL_IEDS_KUP_TOGGEL_OBEN_B KL_IEDS_KUP_TOGGEL_OBEN_C KL_IEDS_KUP_TOGGEL_OBEN_D KL_IEDS_KUP_TOGGEL_OBEN_E KL_IEDS_KUP_TOGGEL_UNTEN_A KL_IEDS_KUP_TOGGEL_UNTEN_B KL_IEDS_KUP_TOGGEL_UNTEN_C KL_IEDS_KUP_TOGGEL_UNTEN_D KL_IEDS_KUP_TOGGEL_UNTEN_E KL_IEDS_TOGGELN_DELTA_A KL_IEDS_TOGGELN_DELTA_B KL_IEDS_TOGGELN_DELTA_C KL_IEDS_TOGGELN_DELTA_D KL_IEDS_TOGGELN_DELTA_E KL_I_MAXK0 KL_MAXSTOER_EDSLOGIK_K0 KL_MAX_STOEROFFCG_BEF1_A KL_MAX_STOEROFFCG_BEF1_B KL_MAX_STOEROFFCG_BEF1_C KL_MAX_STOEROFFCG_BEF1_D KL_MAX_STOEROFFCG_BEF1_E KL_MMOTUEBNEGME1 KL_MMOTUEBNEGME2 KL_MMOTUEBPOSME1 KL_MMOTUEBPOSME2 KL_M_REIB_K0 KL_NMAXSTOERNEGMEINT1 KL_NMAXSTOERPOSMEGRADIENT KL_NMAXSTOERPOSMEINT1 KL_NMAXSTOERPOSMEINT2 KL_NMAXSTOERPOSMEINTIGANG KL_NVERZMIN_DEKREMENT_EDSLOGIK_A KL_NVERZMIN_DEKREMENT_EDSLOGIK_B KL_NVERZMIN_DEKREMENT_EDSLOGIK_C KL_NVERZMIN_DEKREMENT_EDSLOGIK_D KL_NVERZMIN_DEKREMENT_EDSLOGIK_E KL_N_DIFF_K0_MIN MAXSTOER1_K0_SCHLIESSEN_STATUS MAXSTOER2_K0_SCHLIESSEN_STATUS MAX_STOERPOSNEDS MAX_STOERPOSNEDS14 MAX_STOER_FAHRTR_POS MAX_STOER_NMOTUEB M_MERED_MIN M_MOTMAXNEGINT M_MOTMININT NAB_MAXVERZ NS_ABDIFVERZMAXAKTIV NS_ABVERZMAX N_DIFFMAXINT N_DIFF_EM_MAX N_FNGABMEUEB N_FNGTMEUEB N_K0_TASKS N_KUP_OFFEN N_KUP_OFFEN_STROMLOS N_MAXKABPOS_C N_MAXKABPOS_E N_MAXKFLWECHSEL N_MAXSTOERMGETRAUF N_MAXSTOERNEGMEAUS N_MAXSTOERPOSMEAUS N_MAXSTOERPOS_P N_MAXSTOERVPLAUSIPOS_P N_MAX_FAHRTR N_MAX_IGANG N_MAX_NAB_MAXVERZ N_MAX_POSFAHRTR N_MAX_VERZ_POWERFLOW N_MITTELWERT_EDSLOGIK_A N_MITTELWERT_EDSLOGIK_B N_MITTELWERT_EDSLOGIK_C N_MITTELWERT_EDSLOGIK_D N_MITTELWERT_EDSLOGIK_E N_MOTABREGEL_OFFSET N_NMOTABREGEL_VORGABE N_SIGREFVERZMAX N_STOERMAX_EDSLOGIK_TOGGEL_A N_STOERMAX_EDSLOGIK_TOGGEL_B N_STOERMAX_EDSLOGIK_TOGGEL_C N_STOERMAX_EDSLOGIK_TOGGEL_D N_STOERMAX_EDSLOGIK_TOGGEL_E N_STOER_MAX_FAHRTR_EDSLOGIK N_VERZ_EDSLOGIK N_VERZ_ISETPLAUSIBLE N_VERZ_MAXVERZ N_VERZ_REVN_ISETPLAUSIBLE N_VERZ_REV_ISETPLAUSIBLE N_VPOSPUEB N_ZAEHLERVERZMAXAKTIV PS_BRVERZMAX SWI_BEDGBESTR SWI_EDSLOGIK_POSUEB SWI_EDSLOGIK_TOGGELN SWI_FLAGOFFPOSME SWI_K0UEB SWI_MAXVERZ SWI_MMOT_EDSLOGIK SWI_NABSTATUS_MAXVERZ SWI_NAB_BEW SWI_PBRAKE_MAXVERZ SWI_VERSCH_ISETPLAUSIBLE TAB_MMOTUEBPOSMEIGANG TAB_NMOTUEBDSCOFF TAB_N_OFFSET_ME TS_BRVERZMAX TS_VERZMAX_BRAKE VS_EDSLOGIK VS_FZG_R VS_FZG_RSICH_LEV2 /end REF_CHARACTERISTIC
/end FUNCTION
/begin FUNCTION zf_ATSYS_Anforderungen "Anforderungen ATSYS"
 /begin SUB_FUNCTION AT_ARS.doc AT_ATSYS.doc AT_Algad.doc AT_BEFM.doc AT_BYP.doc AT_CSC.doc AT_Daten.doc AT_EDS.doc AT_EDSLOGIK.doc AT_ERSTZ.doc AT_ESig.doc AT_Esch.doc AT_GEFD.doc AT_GEGA.doc AT_GEGA_EP.doc AT_GESTZ.doc AT_GLS.doc AT_GLSA.DOC AT_GLU.doc AT_HISPlausi.doc AT_HOTM.doc AT_HS.doc AT_HSGLU.doc AT_HSad.doc AT_HYSKOMP.doc AT_IAE.doc AT_IAE_ADA.doc AT_IAE_DIAG.doc AT_IAE_TPADA.doc AT_KFL_UEB.doc AT_KLAUENUEB.doc AT_KPLBP.doc AT_KUPBEL.doc AT_LCCADA.doc AT_LHMVUEB.doc AT_MABDYN.doc AT_MAUF.doc AT_MAUFUEB.doc AT_MAXVERZ.doc AT_MESAS.doc AT_MEueb.doc AT_Mv.doc AT_MvG.doc AT_NABGRADUEB.doc AT_NMOTUEB.doc AT_OS_Modeumschaltung.doc AT_PAK.doc AT_PARUMSCH.doc AT_PFA.doc AT_PKF.doc AT_PMUEB.doc AT_POSUEB.doc AT_POSVUEB.doc AT_PRSENSUEB.doc AT_PSVUEB.doc AT_RS.doc AT_RSad.doc AT_SAC.doc AT_SBAK.doc AT_SCHA.doc AT_SCHST.doc AT_SEGELN.doc AT_SFKT.doc AT_SLTSF.doc AT_SLTSP.doc AT_SSCHR.doc AT_STADA.doc AT_STRVUeb.doc AT_Sltal.doc AT_Sltg.doc AT_TEST.doc AT_TSENS.doc AT_TSFA.doc AT_TUNINGueb.doc AT_UWIG.doc AT_VERS.doc AT_ZZS.doc /end SUB_FUNCTION
/end FUNCTION
/begin FUNCTION AT_Algad.doc "Adaption allgemein" /begin SUB_FUNCTION ADA ADA_GLOBAL NVR /end SUB_FUNCTION /end FUNCTION
/begin FUNCTION AT_ARS.doc "Ausrollschaltung" /begin SUB_FUNCTION SAS /end SUB_FUNCTION /end FUNCTION
/begin FUNCTION AT_ATSYS.doc "ATSYS allgemein" /begin SUB_FUNCTION AZS BIBLIO BIH /end SUB_FUNCTION /end FUNCTION
/begin FUNCTION AT_BEFM.doc "Befuellmodell" /begin SUB_FUNCTION HYD /end SUB_FUNCTION /end FUNCTION
/begin FUNCTION AT_BYP.doc "ETK-Bypass" /begin SUB_FUNCTION BIH /end SUB_FUNCTION /end FUNCTION
/begin FUNCTION AT_CSC.doc "Clutch Slip Control" /begin SUB_FUNCTION ADA KAS NVR /end SUB_FUNCTION /end FUNCTION
/begin FUNCTION AT_Daten.doc "Getriebedaten" /begin SUB_FUNCTION HYD /end SUB_FUNCTION /end FUNCTION
/begin FUNCTION AT_EDS.doc "EDS- und Systemdruckansteuerung" /begin SUB_FUNCTION SAS /end SUB_FUNCTION /end FUNCTION
/begin FUNCTION AT_EDSLOGIK.doc "Überwachung EDS-Logik" /begin SUB_FUNCTION BIH UL2 UL2_UEW_EDSLOGIK /end SUB_FUNCTION /end FUNCTION
/begin FUNCTION AT_ERSTZ.doc "Ersatzprogramme" /begin SUB_FUNCTION BIH UEW /end SUB_FUNCTION /end FUNCTION
/begin FUNCTION AT_Esch.doc "E-Schaltung" /begin SUB_FUNCTION ADA AZS BIH KAS SAS UEW /end SUB_FUNCTION /end FUNCTION
/begin FUNCTION AT_ESig.doc "Signalbeschreibung" /begin SUB_FUNCTION BIH SAS /end SUB_FUNCTION /end FUNCTION
/begin FUNCTION AT_GEFD.doc "Fuelldruckadaption GE" /begin SUB_FUNCTION ADA ADA_SAS /end SUB_FUNCTION /end FUNCTION
/begin FUNCTION AT_GEGA.doc "Gangeinlegen / -auslegen" /begin SUB_FUNCTION SAS /end SUB_FUNCTION /end FUNCTION
/begin FUNCTION AT_GEGA_EP.doc "Gangeinlegen/ Gangauslegen MBGEA" /begin SUB_FUNCTION SAS_GEA /end SUB_FUNCTION /end FUNCTION
/begin FUNCTION AT_GESTZ.doc "Getriebeschutz" /begin SUB_FUNCTION BIH /end SUB_FUNCTION /end FUNCTION
/begin FUNCTION AT_GLS.doc "GLS" /begin SUB_FUNCTION SAS /end SUB_FUNCTION /end FUNCTION
/begin FUNCTION AT_GLSA.DOC "GLS-Adaption" /begin SUB_FUNCTION ADA ADA_SAS /end SUB_FUNCTION /end FUNCTION
/begin FUNCTION AT_GLU.doc "GLUE" /begin SUB_FUNCTION SAS /end SUB_FUNCTION /end FUNCTION
/begin FUNCTION AT_HISPlausi.doc "HIS Plausibilisierung" /begin SUB_FUNCTION UL2 /end SUB_FUNCTION /end FUNCTION
/begin FUNCTION AT_HOTM.doc "Getriebeuebertemperatur- funktion" /begin SUB_FUNCTION BIH /end SUB_FUNCTION /end FUNCTION
/begin FUNCTION AT_HS.doc "Hochschaltung" /begin SUB_FUNCTION SAS /end SUB_FUNCTION /end FUNCTION
/begin FUNCTION AT_HSad.doc "Fuelldruckadaption HS" /begin SUB_FUNCTION ADA ADA_PFUSF /end SUB_FUNCTION /end FUNCTION
/begin FUNCTION AT_HSGLU.doc "Hochschaltung mit GLU" /begin SUB_FUNCTION SAS /end SUB_FUNCTION /end FUNCTION
/begin FUNCTION AT_HYSKOMP.doc "Hysteresekompensation" /begin SUB_FUNCTION HYD /end SUB_FUNCTION /end FUNCTION
/begin FUNCTION AT_IAE.doc "Integriertes AnfahrElement (IAE)" /begin SUB_FUNCTION IAE KAS /end SUB_FUNCTION /end FUNCTION
/begin FUNCTION AT_IAE_ADA.doc "Integriertes AnfahrElement (IAE) UF Adaptionen" /begin SUB_FUNCTION ADA ADA_IAE /end SUB_FUNCTION /end FUNCTION
/begin FUNCTION AT_IAE_DIAG.doc "Integriertes AnfahrElement (IAE) Diagnose" /begin SUB_FUNCTION IAE /end SUB_FUNCTION /end FUNCTION
/begin FUNCTION AT_IAE_TPADA.doc "Integriertes AnfahrElement (IAE) TP Adaptionen" /begin SUB_FUNCTION ADA ADA_IAE /end SUB_FUNCTION /end FUNCTION
/begin FUNCTION AT_KFL_UEB.doc "Überwachung Kraftschluss in Neutral und ungewollter Fahrtrichtungswechsel" /begin SUB_FUNCTION UEW /end SUB_FUNCTION /end FUNCTION
/begin FUNCTION AT_KLAUENUEB.doc "Klauenüberwachung" /begin SUB_FUNCTION UEW UL2 /end SUB_FUNCTION /end FUNCTION
/begin FUNCTION AT_KPLBP.doc "Kupplungsbefuellpruefung" /begin SUB_FUNCTION ADA ADA_GLOKU ADA_URLUFT /end SUB_FUNCTION /end FUNCTION
/begin FUNCTION AT_KUPBEL.doc "Berechnung Kupplungsbelastung" /begin SUB_FUNCTION SAS /end SUB_FUNCTION /end FUNCTION
/begin FUNCTION AT_LCCADA.doc "LCC-Adaption/ Fusspunktadaption" /begin SUB_FUNCTION ADA /end SUB_FUNCTION /end FUNCTION
/begin FUNCTION AT_LHMVUEB.doc "Notlaufventilüberwachung/ LHMV-Überwachung" /begin SUB_FUNCTION UEW /end SUB_FUNCTION /end FUNCTION
/begin FUNCTION AT_MABDYN.doc "Dynamisches Abtriebsmodell" /begin SUB_FUNCTION BIH /end SUB_FUNCTION /end FUNCTION
/begin FUNCTION AT_MAUF.doc "Getriebeaufnahmemoment" /begin SUB_FUNCTION BIH /end SUB_FUNCTION /end FUNCTION
/begin FUNCTION AT_MAUFUEB.doc "Überwachung Getriebeaufnahmemoment" /begin SUB_FUNCTION BIH UL2 UL2_UEW_GETR_M_AUF /end SUB_FUNCTION /end FUNCTION
/begin FUNCTION AT_MAXVERZ.doc "Überwachung auf maximale Verzögerung" /begin SUB_FUNCTION UL2 UL2_UEW_MAX_VERZ /end SUB_FUNCTION /end FUNCTION
/begin FUNCTION AT_MESAS.doc "Motoreingriff" /begin SUB_FUNCTION SAS /end SUB_FUNCTION /end FUNCTION
/begin FUNCTION AT_MEueb.doc "Motoreingriffsueberwachung" /begin SUB_FUNCTION BIH UL2 UL2_UEW_MOTOREINGRIFF /end SUB_FUNCTION /end FUNCTION
/begin FUNCTION AT_Mv.doc "MV-Ansteuerung" /begin SUB_FUNCTION HYD /end SUB_FUNCTION /end FUNCTION
/begin FUNCTION AT_MvG.doc "Monitoring von Getriebegroessen" /begin SUB_FUNCTION MON /end SUB_FUNCTION /end FUNCTION
/begin FUNCTION AT_NABGRADUEB.doc "Abtriebsdrehzahlgradientenüberwachung" /begin SUB_FUNCTION UEW /end SUB_FUNCTION /end FUNCTION
/begin FUNCTION AT_NMOTUEB.doc "Ueberdrehzahlueberwachung" /begin SUB_FUNCTION UL2 UL2_UEW_NMOT /end SUB_FUNCTION /end FUNCTION
/begin FUNCTION AT_OS_Modeumschaltung.doc "OS Mode Nachbildung" /begin SUB_FUNCTION BIH /end SUB_FUNCTION /end FUNCTION
/begin FUNCTION AT_PAK.doc "Programmablaufkontrolle" /begin SUB_FUNCTION BIH /end SUB_FUNCTION /end FUNCTION
/begin FUNCTION AT_PARUMSCH.doc "Parameterumschaltung" /begin SUB_FUNCTION BIH /end SUB_FUNCTION /end FUNCTION
/begin FUNCTION AT_PFA.doc "Fuelldruckpulsadaption" /begin SUB_FUNCTION ADA ADA_PULS /end SUB_FUNCTION /end FUNCTION
/begin FUNCTION AT_PKF.doc "Parksperrenkomfortfunktion" /begin SUB_FUNCTION KAS /end SUB_FUNCTION /end FUNCTION
/begin FUNCTION AT_PMUEB.doc "Parksperrenmagnetüberwachung" /begin SUB_FUNCTION UEW UEW_PARKSPERRENMAGNET /end SUB_FUNCTION /end FUNCTION
/begin FUNCTION AT_POSUEB.doc "Überwachung der Positionsvorgabe" /begin SUB_FUNCTION BIH UL2 UL2_UEW_KFLPL /end SUB_FUNCTION /end FUNCTION
/begin FUNCTION AT_POSVUEB.doc "Positionsventilueberwachung" /begin SUB_FUNCTION BIH PSA_UEW_POSV UEW /end SUB_FUNCTION /end FUNCTION
/begin FUNCTION AT_PRSENSUEB.doc "Klauensensierung" /begin SUB_FUNCTION UEW UL2 /end SUB_FUNCTION /end FUNCTION
/begin FUNCTION AT_PSVUEB.doc "PSV-Überwachung" /begin SUB_FUNCTION UEW /end SUB_FUNCTION /end FUNCTION
/begin FUNCTION AT_RS.doc "Rueckschaltung" /begin SUB_FUNCTION SAS /end SUB_FUNCTION /end FUNCTION
/begin FUNCTION AT_RSad.doc "Fuelldruckadaption RS" /begin SUB_FUNCTION ADA ADA_PFUSF /end SUB_FUNCTION /end FUNCTION
/begin FUNCTION AT_SAC.doc "Rueckrollverhinderung" /begin SUB_FUNCTION KAS /end SUB_FUNCTION /end FUNCTION
/begin FUNCTION AT_SBAK.doc "Schnelle Adaption" /begin SUB_FUNCTION ADA ADA_IAE ADA_SAS /end SUB_FUNCTION /end FUNCTION
/begin FUNCTION AT_SCHA.doc "Schlupfadaption" /begin SUB_FUNCTION ADA /end SUB_FUNCTION /end FUNCTION
/begin FUNCTION AT_SCHST.doc "Schnittstellen allgemein" /begin SUB_FUNCTION BIH /end SUB_FUNCTION /end FUNCTION
/begin FUNCTION AT_SEGELN.doc "Sonderfunktion Segeln" /begin SUB_FUNCTION SAS UEW /end SUB_FUNCTION /end FUNCTION
/begin FUNCTION AT_SFKT.doc "Schutzfunktion" /begin SUB_FUNCTION AZS BIH /end SUB_FUNCTION /end FUNCTION
/begin FUNCTION AT_Sltal.doc "Schaltung allgemein" /begin SUB_FUNCTION ADA SAS /end SUB_FUNCTION /end FUNCTION
/begin FUNCTION AT_Sltg.doc "Grundfunktionen Schaltung" /begin SUB_FUNCTION SAS /end SUB_FUNCTION /end FUNCTION
/begin FUNCTION AT_SLTSF.doc "Sonderfunktion Schaltung" /begin SUB_FUNCTION SAS /end SUB_FUNCTION /end FUNCTION
/begin FUNCTION AT_SLTSP.doc "Spontane Schaltung" /begin SUB_FUNCTION SAS /end SUB_FUNCTION /end FUNCTION
/begin FUNCTION AT_SSCHR.doc "Schrittschaltung" /begin SUB_FUNCTION SAS /end SUB_FUNCTION /end FUNCTION
/begin FUNCTION AT_STADA.doc "Stillstandsadaption" /begin SUB_FUNCTION ADA ADA_KUP ADA_STADA /end SUB_FUNCTION /end FUNCTION
/begin FUNCTION AT_STRVUeb.doc "Ueberwachung Getriebestrangverstaerkung" /begin SUB_FUNCTION BIH /end SUB_FUNCTION /end FUNCTION
/begin FUNCTION AT_TEST.doc "Testfunktion Rolle" /begin SUB_FUNCTION BIH /end SUB_FUNCTION /end FUNCTION
/begin FUNCTION AT_TSENS.doc "Drehmomenten Sensor" /begin SUB_FUNCTION BIH /end SUB_FUNCTION /end FUNCTION
/begin FUNCTION AT_TSFA.doc "Schnellfuellzeitpulsadaption" /begin SUB_FUNCTION ADA ADA_PULS /end SUB_FUNCTION /end FUNCTION
/begin FUNCTION AT_TUNINGueb.doc "Chip Tuning Erkennung" /begin SUB_FUNCTION ADA BIH NVR /end SUB_FUNCTION /end FUNCTION
/begin FUNCTION AT_UWIG.doc "Übersetzungsueberwachung" /begin SUB_FUNCTION BIH UEW UEW_UWIG UEW_UWIG_ALT /end SUB_FUNCTION /end FUNCTION
/begin FUNCTION AT_VERS.doc "Verschachtelte Schaltung" /begin SUB_FUNCTION SAS /end SUB_FUNCTION /end FUNCTION
/begin FUNCTION AT_ZZS.doc "Zentrale Zustandssteuerung" /begin SUB_FUNCTION AZS /end SUB_FUNCTION /end FUNCTION
/begin RECORD_LAYOUT kw_ui8_S6_S3 FNC_VALUES 1 UBYTE COLUMN_DIR DIRECT /end RECORD_LAYOUT
/begin RECORD_LAYOUT kw_ui16_S6_S3 FNC_VALUES 1 UWORD COLUMN_DIR DIRECT /end RECORD_LAYOUT
/begin RECORD_LAYOUT kw_ui32_S6_S3 FNC_VALUES 1 ULONG COLUMN_DIR DIRECT /end RECORD_LAYOUT
/begin RECORD_LAYOUT kw_si16_S6_S3 FNC_VALUES 1 SWORD COLUMN_DIR DIRECT /end RECORD_LAYOUT
/begin RECORD_LAYOUT tab_ui16_S6_S3 FNC_VALUES 2 UWORD COLUMN_DIR DIRECT NO_AXIS_PTS_X 1 ULONG /end RECORD_LAYOUT
/begin RECORD_LAYOUT kl_ui8_S6_S3 FNC_VALUES 3 UBYTE COLUMN_DIR DIRECT AXIS_PTS_X 2 UBYTE INDEX_INCR DIRECT NO_AXIS_PTS_X 1 ULONG /end RECORD_LAYOUT
/begin RECORD_LAYOUT kl_ui16_S6_S3 FNC_VALUES 3 UWORD COLUMN_DIR DIRECT AXIS_PTS_X 2 UWORD INDEX_INCR DIRECT NO_AXIS_PTS_X 1 ULONG /end RECORD_LAYOUT
/begin RECORD_LAYOUT kl_si16_S6_S3 FNC_VALUES 3 SWORD COLUMN_DIR DIRECT AXIS_PTS_X 2 SWORD INDEX_INCR DIRECT NO_AXIS_PTS_X 1 ULONG /end RECORD_LAYOUT
/begin RECORD_LAYOUT kf_ui16_S6_S3 FNC_VALUES 5 UWORD ROW_DIR DIRECT AXIS_PTS_X 3 UWORD INDEX_INCR DIRECT AXIS_PTS_Y 4 UWORD INDEX_INCR DIRECT NO_AXIS_PTS_X 1 ULONG NO_AXIS_PTS_Y 2 ULONG /end RECORD_LAYOUT
/begin RECORD_LAYOUT kf_si16_S6_S3 FNC_VALUES 5 SWORD ROW_DIR DIRECT AXIS_PTS_X 3 SWORD INDEX_INCR DIRECT AXIS_PTS_Y 4 SWORD INDEX_INCR DIRECT NO_AXIS_PTS_X 1 ULONG NO_AXIS_PTS_Y 2 ULONG /end RECORD_LAYOUT
/end MODULE
/end PROJECT
