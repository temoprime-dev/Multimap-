ASAP2_VERSION 1 51
/begin PROJECT _929_929 "Gen2_BMW_System_Supplier_Lib"
/begin HEADER "" VERSION "C_03_03" PROJECT_NO _929_929 /end HEADER
/begin MODULE DIM ""
/begin MOD_COMMON "" BYTE_ORDER MSB_FIRST ALIGNMENT_BYTE 1 ALIGNMENT_WORD 2 ALIGNMENT_LONG 4 ALIGNMENT_FLOAT32_IEEE 4 /end MOD_COMMON
/begin MEASUREMENT iUl2ItfipInt.iv_nmotl2 "Inputgroesse Level2 für Motordrehzahl" UWORD UMR_U_MIN_1_1_0_S6_S3 1 100 0 8160 DISPLAY_IDENTIFIER iv_nmotl2.iUl2ItfipInt ECU_ADDRESS 0xFFF8A1DA /end MEASUREMENT
/begin MEASUREMENT iUl2ItfipInt.n_mot_l2 "Motordrehzahl für Level2" UWORD UMR_U_MIN_1_1_0_S6_S3 1 100 0 8160 DISPLAY_IDENTIFIER n_mot_l2.iUl2ItfipInt ECU_ADDRESS 0xFFF8A1DC /end MEASUREMENT
/begin MEASUREMENT iUl2ItfipInt.iv_nmotstatusl2 "Eingangsgroesse Statussignal Motordrehzahl für Level2" UBYTE Conv.cUl2ItfipInt._.iv_nmotstatusl2_S6_S3 1 100 0 2 DISPLAY_IDENTIFIER iv_nmotstatusl2.iUl2ItfipInt ECU_ADDRESS 0xFFF8A1DE /end MEASUREMENT
/begin MEASUREMENT iUl2ItfipInt.n_mot_status_l2 "Statussignal Motordrehzahl für Level2" UBYTE Conv.cUl2ItfipInt._.n_mot_status_l2_S6_S3 1 100 0 2 DISPLAY_IDENTIFIER n_mot_status_l2.iUl2ItfipInt ECU_ADDRESS 0xFFF8A1DF /end MEASUREMENT
/begin MEASUREMENT iUl2ItfipInt.iv_nmotabregell2 "Eingangsgroesse Motorabregeldrehzahl für Level2" UWORD UMR_U_MIN_1_1_0_S6_S3 1 100 0 10000 DISPLAY_IDENTIFIER iv_nmotabregell2.iUl2ItfipInt ECU_ADDRESS 0xFFF8A1E0 /end MEASUREMENT
/begin MEASUREMENT iUl2ItfipInt.n_motabregel_l2 "Motorabregeldrehzahl für Level2" UWORD UMR_U_MIN_1_1_0_S6_S3 1 100 0 10000 DISPLAY_IDENTIFIER n_motabregel_l2.iUl2ItfipInt ECU_ADDRESS 0xFFF8A1E2 /end MEASUREMENT
/begin MEASUREMENT iUl2ItfipInt.iv_dscfehlerl2 "Eingangssignal zu DSC (ESP)-Fehlerflag / DSC (ESP)-Inaktiv-Signal" UBYTE Conv.cUl2ItfipInt._.iv_dscfehlerl2_S6_S3 1 100 0 1 DISPLAY_IDENTIFIER iv_dscfehlerl2.iUl2ItfipInt ECU_ADDRESS 0xFFF8A1E4 /end MEASUREMENT
/begin MEASUREMENT iUl2ItfipInt.dsc_fehler_l2 "DSC (ESP)-Fehlerflag / DSC (ESP)-Inaktiv-Signal" UBYTE Conv.cUl2ItfipInt._.dsc_fehler_l2_S6_S3 1 100 0 1 DISPLAY_IDENTIFIER dsc_fehler_l2.iUl2ItfipInt ECU_ADDRESS 0xFFF8A1E5 /end MEASUREMENT
/begin MEASUREMENT iUl2ItfipInt.iv_n_ab_l2 "Inputgroesse Level2 fuer Abtriebsdrehzahl" UWORD UMR_U_MIN_1_1_0_S6_S3 1 100 0 8160 DISPLAY_IDENTIFIER iv_n_ab_l2.iUl2ItfipInt ECU_ADDRESS 0xFFF8A1E6 /end MEASUREMENT
/begin MEASUREMENT iUl2ItfipInt.n_ab_l2 "Abtriebsdrehzahl fuer Level2" UWORD UMR_U_MIN_1_1_0_S6_S3 1 100 0 8160 DISPLAY_IDENTIFIER n_ab_l2.iUl2ItfipInt ECU_ADDRESS 0xFFF8A1E8 /end MEASUREMENT
/begin MEASUREMENT iUl2ItfipInt.iv_ay_ref_l2 "Inputgroesse Level2 fuer Querbeschleunigung" SWORD UMR_M_SEC2_1_32_0_S6_S3 1 100 -1023.96875 1023.96875 DISPLAY_IDENTIFIER iv_ay_ref_l2.iUl2ItfipInt ECU_ADDRESS 0xFFF8A1EA /end MEASUREMENT
/begin MEASUREMENT iUl2ItfipInt.ay_ref_l2 "Querbeschleunigung fuer Level2" SWORD UMR_M_SEC2_1_32_0_S6_S3 1 100 -1023.96875 1023.96875 DISPLAY_IDENTIFIER ay_ref_l2.iUl2ItfipInt ECU_ADDRESS 0xFFF8A1EC /end MEASUREMENT
/begin MEASUREMENT iUl2ItfipInt.iv_ay_ref_status_l2 "Eingangsgroesse Status AY_REF Signal für Level 2" UBYTE UMR___1_1_0_S6_S3 1 100 0 2 DISPLAY_IDENTIFIER iv_ay_ref_status_l2.iUl2ItfipInt ECU_ADDRESS 0xFFF8A1EE /end MEASUREMENT
/begin MEASUREMENT iUl2ItfipInt.ay_ref_status_l2 "Status AY_REF Signal für Level 2" UBYTE UMR___1_1_0_S6_S3 1 100 0 2 DISPLAY_IDENTIFIER ay_ref_status_l2.iUl2ItfipInt ECU_ADDRESS 0xFFF8A1EF /end MEASUREMENT
/begin MEASUREMENT iUl2ItfipInt.iv_p_bremse_l2 "Inputgroesse Level2 fuer Bremsdruck" UWORD UMR_BAR__1_2_0_S6_S3 1 100 0 2500 DISPLAY_IDENTIFIER iv_p_bremse_l2.iUl2ItfipInt ECU_ADDRESS 0xFFF8A1F0 /end MEASUREMENT
/begin MEASUREMENT iUl2ItfipInt.p_bremse_l2 "Bremsdruck fuer Level2" UWORD UMR_BAR__1_2_0_S6_S3 1 100 0 2500 DISPLAY_IDENTIFIER p_bremse_l2.iUl2ItfipInt ECU_ADDRESS 0xFFF8A1F2 /end MEASUREMENT
/begin MEASUREMENT iUl2ItfipInt.iv_brp_status_l2 "Eingangsgroesse Status BRP Signal für Level 2" UBYTE UMR___1_1_0_S6_S3 1 100 0 2 DISPLAY_IDENTIFIER iv_brp_status_l2.iUl2ItfipInt ECU_ADDRESS 0xFFF8A1F4 /end MEASUREMENT
/begin MEASUREMENT iUl2ItfipInt.brp_status_l2 "Status BRP Signal für Level 2" UBYTE UMR___1_1_0_S6_S3 1 100 0 2 DISPLAY_IDENTIFIER brp_status_l2.iUl2ItfipInt ECU_ADDRESS 0xFFF8A1F5 /end MEASUREMENT
/begin MEASUREMENT iUl2ItfipInt.iv_brm_l2 "Inputgroesse Level2 fuer Bremsmoment" UWORD UMR_NM__1_1_M32000_S6_S3 1 100 -32000 0 DISPLAY_IDENTIFIER iv_brm_l2.iUl2ItfipInt ECU_ADDRESS 0xFFF8A1F6 /end MEASUREMENT
/begin MEASUREMENT iUl2ItfipInt.brm_l2 "Bremsmoment fuer Level2" SWORD UMR_NM__1_1_0_S6_S3 1 100 -32000 0 DISPLAY_IDENTIFIER brm_l2.iUl2ItfipInt ECU_ADDRESS 0xFFF8A1F8 /end MEASUREMENT
/begin MEASUREMENT iUl2ItfipInt.iv_brm_status_l2 "Eingangsgroesse Status BRM Signal für Level 2" UBYTE UMR___1_1_0_S6_S3 1 100 0 2 DISPLAY_IDENTIFIER iv_brm_status_l2.iUl2ItfipInt ECU_ADDRESS 0xFFF8A1FA /end MEASUREMENT
/begin MEASUREMENT iUl2ItfipInt.brm_status_l2 "Status BRM Signal für Level 2" UBYTE UMR___1_1_0_S6_S3 1 100 0 2 DISPLAY_IDENTIFIER brm_status_l2.iUl2ItfipInt ECU_ADDRESS 0xFFF8A1FB /end MEASUREMENT
/begin MEASUREMENT iUl2ItfipInt.iv_n_ab_max_l2 "Inputgroesse Level2 fuer max Abtriebsdrehzahl" UWORD UMR_U_MIN_1_1_0_S6_S3 1 100 0 8160 DISPLAY_IDENTIFIER iv_n_ab_max_l2.iUl2ItfipInt ECU_ADDRESS 0xFFF8A1FC /end MEASUREMENT
/begin MEASUREMENT iUl2ItfipInt.n_ab_max_l2 "Max Abtriebsdrehzahl fuer Level2" UWORD UMR_U_MIN_1_1_0_S6_S3 1 100 0 8160 DISPLAY_IDENTIFIER n_ab_max_l2.iUl2ItfipInt ECU_ADDRESS 0xFFF8A1FE /end MEASUREMENT
/begin MEASUREMENT iUl2ItfipInt.iv_pos_l2 "Inputgroesse Level2 fuer Waehlhebelposition" UBYTE Conv.cUl2ItfipInt._.iv_pos_l2_S6_S3 1 100 0 12 DISPLAY_IDENTIFIER iv_pos_l2.iUl2ItfipInt ECU_ADDRESS 0xFFF8A200 /end MEASUREMENT
/begin MEASUREMENT iUl2ItfipInt.pos_l2 "Waehlhebelposition fuer Level2" UBYTE Conv.cUl2ItfipInt._.pos_l2_S6_S3 1 100 0 12 DISPLAY_IDENTIFIER pos_l2.iUl2ItfipInt ECU_ADDRESS 0xFFF8A201 /end MEASUREMENT
/begin MEASUREMENT iUl2ItfipInt.iv_soll_brake_torq_driver_l2 "Inputgroesse Level2 fuer Soll Fahrerwunschbremsmoment" UWORD UMR_NM__1_1_M32000_S6_S3 1 100 -32000 0 DISPLAY_IDENTIFIER iv_soll_brake_torq_driver_l2.iUl2ItfipInt ECU_ADDRESS 0xFFF8A202 /end MEASUREMENT
/begin MEASUREMENT iUl2ItfipInt.soll_brake_torq_driver_l2 "Soll Fahrerwunschbremsmoment fuer Level2" SWORD UMR_NM__1_1_0_S6_S3 1 100 -32000 0 DISPLAY_IDENTIFIER soll_brake_torq_driver_l2.iUl2ItfipInt ECU_ADDRESS 0xFFF8A204 /end MEASUREMENT
/begin MEASUREMENT iUl2ItfipInt.soll_brake_torq_driver_status_l2 "Status L2_SS_SOLL_BRAKE_TORQ_DRIVER Signal für Level 2" UBYTE UMR___1_1_0_S6_S3 1 100 0 2 DISPLAY_IDENTIFIER soll_brake_torq_driver_status_l2.iUl2ItfipInt ECU_ADDRESS 0xFFF8A206 /end MEASUREMENT
/begin MEASUREMENT iUl2ItfipInt.iv_soll_brake_torq_driver_status_l2 "Status L2_SS_SOLL_BRAKE_TORQ_DRIVER Signal für Level 2" UBYTE UMR___1_1_0_S6_S3 1 100 0 2 DISPLAY_IDENTIFIER iv_soll_brake_torq_driver_status_l2.iUl2ItfipInt ECU_ADDRESS 0xFFF8A207 /end MEASUREMENT
/begin MEASUREMENT iUl2ItfipInt.iv_m_mot_l2 "Eingangsgroesse Motormoment für Level 2" SWORD UMR_NM__1_1_0_S6_S3 1 100 -400 1640 DISPLAY_IDENTIFIER iv_m_mot_l2.iUl2ItfipInt ECU_ADDRESS 0xFFF8A208 /end MEASUREMENT
/begin MEASUREMENT iUl2ItfipInt.m_mot_l2 "Motormoment für Level 2" SWORD UMR_NM__1_1_0_S6_S3 1 100 -400 1640 DISPLAY_IDENTIFIER m_mot_l2.iUl2ItfipInt ECU_ADDRESS 0xFFF8A20A /end MEASUREMENT
/begin MEASUREMENT iUl2ItfipInt.swi_m_mot_l2 "dient zum Verstellen des Signal u. seinem Komplement." SWORD UMR___1_1_0_S6_S3 1 100 -32768 32767 DISPLAY_IDENTIFIER swi_m_mot_l2.iUl2ItfipInt ECU_ADDRESS 0xFFF8A20C /end MEASUREMENT
/begin MEASUREMENT iUl2ItfipInt.iv_c_getr_l2 "Eingangsgroesse Getriebetemperatur für Level 2" UBYTE UMR_GRADC__1_1_M40_S6_S3 1 100 -40 215 DISPLAY_IDENTIFIER iv_c_getr_l2.iUl2ItfipInt ECU_ADDRESS 0xFFF8A20E /end MEASUREMENT
/begin MEASUREMENT iUl2ItfipInt.c_getr_l2 "Getriebetemperatur für Level 2" UBYTE UMR_GRADC__1_1_M40_S6_S3 1 100 -40 215 DISPLAY_IDENTIFIER c_getr_l2.iUl2ItfipInt ECU_ADDRESS 0xFFF8A20F /end MEASUREMENT
/begin MEASUREMENT iUl2ItfipInt.iv_n_turb_l2 "Eingangsgroesse Turbinendrehzahl für Level 2" UWORD UMR_U_MIN_1_1_0_S6_S3 1 100 0 8160 DISPLAY_IDENTIFIER iv_n_turb_l2.iUl2ItfipInt ECU_ADDRESS 0xFFF8A210 /end MEASUREMENT
/begin MEASUREMENT iUl2ItfipInt.n_turb_l2 "Turbinendrehzahl für Level 2" UWORD UMR_U_MIN_1_1_0_S6_S3 1 100 0 8160 DISPLAY_IDENTIFIER n_turb_l2.iUl2ItfipInt ECU_ADDRESS 0xFFF8A212 /end MEASUREMENT
/begin MEASUREMENT iUl2ItfipInt.iv_mmotist_l2 "Eingangsgroesse Motormoment ohne Motoreingriff Getriebe für Level 2" SWORD UMR_NM__1_1_0_S6_S3 1 100 -400 1640 DISPLAY_IDENTIFIER iv_mmotist_l2.iUl2ItfipInt ECU_ADDRESS 0xFFF8A214 /end MEASUREMENT
/begin MEASUREMENT iUl2ItfipInt.mmotist_l2 "Motormoment ohne Motoreingriff Getriebe für Level 2" SWORD UMR_NM__1_1_0_S6_S3 1 100 -400 1640 DISPLAY_IDENTIFIER mmotist_l2.iUl2ItfipInt ECU_ADDRESS 0xFFF8A216 /end MEASUREMENT
/begin MEASUREMENT iUl2ItfipInt.iv_m_ist_em_l2 "Moment an der E-Maschine" SWORD UMR_NM__1_1_0_S6_S3 1 100 -1024 1024 DISPLAY_IDENTIFIER iv_m_ist_em_l2.iUl2ItfipInt ECU_ADDRESS 0xFFF8A218 /end MEASUREMENT
/begin MEASUREMENT iUl2ItfipInt.m_ist_em_l2 "Moment an der E-Maschine" SWORD UMR_NM__1_1_0_S6_S3 1 100 -1024 1024 DISPLAY_IDENTIFIER m_ist_em_l2.iUl2ItfipInt ECU_ADDRESS 0xFFF8A21A /end MEASUREMENT
/begin MEASUREMENT iUl2ItfipInt.iv_m_ist_vm_l2 "Moment an dem Verbrennungsmotor" SWORD UMR_NM__1_1_0_S6_S3 1 100 -400 1640 DISPLAY_IDENTIFIER iv_m_ist_vm_l2.iUl2ItfipInt ECU_ADDRESS 0xFFF8A21C /end MEASUREMENT
/begin MEASUREMENT iUl2ItfipInt.m_ist_vm_l2 "Moment an dem Verbrennungsmotor" SWORD UMR_NM__1_1_0_S6_S3 1 100 -400 1640 DISPLAY_IDENTIFIER m_ist_vm_l2.iUl2ItfipInt ECU_ADDRESS 0xFFF8A21E /end MEASUREMENT
/begin MEASUREMENT iUl2ItfipInt.iv_nmo_vm_l2 "Verbrennungsmotordrehzahl" UWORD UMR_U_MIN_1_1_0_S6_S3 1 100 0 65535 DISPLAY_IDENTIFIER iv_nmo_vm_l2.iUl2ItfipInt ECU_ADDRESS 0xFFF8A220 /end MEASUREMENT
/begin MEASUREMENT iUl2ItfipInt.nmo_vm_l2 "Verbrennungsmotordrehzahl" UWORD UMR_U_MIN_1_1_0_S6_S3 1 100 0 65535 DISPLAY_IDENTIFIER nmo_vm_l2.iUl2ItfipInt ECU_ADDRESS 0xFFF8A222 /end MEASUREMENT
/begin MEASUREMENT iUl2ItfipInt.iv_nmo_vm_status_l2 "Statussignal zu iv_nmo_vm_l2 (Verbrennungsmotordrehzahl)" UBYTE Conv.cUl2ItfipInt._.iv_nmo_vm_status_l2_S6_S3 1 100 0 2 DISPLAY_IDENTIFIER iv_nmo_vm_status_l2.iUl2ItfipInt ECU_ADDRESS 0xFFF8A224 /end MEASUREMENT
/begin MEASUREMENT iUl2ItfipInt.nmo_vm_status_l2 "Statussignal zu iv_nmo_vm_l2 (Verbrennungsmotordrehzahl)" UBYTE Conv.cUl2ItfipInt._.nmo_vm_status_l2_S6_S3 1 100 0 2 DISPLAY_IDENTIFIER nmo_vm_status_l2.iUl2ItfipInt ECU_ADDRESS 0xFFF8A225 /end MEASUREMENT
/begin MEASUREMENT iUl2ItfipInt.iv_fzg_geschwindigkeit_max_l2 "Max. Fahrzeuggeschwindigkeit" UWORD UMR_KM_H_1_1_0_S6_S3 1 100 0 400 DISPLAY_IDENTIFIER iv_fzg_geschwindigkeit_max_l2.iUl2ItfipInt ECU_ADDRESS 0xFFF8A226 /end MEASUREMENT
/begin MEASUREMENT iUl2ItfipInt.fzg_geschwindigkeit_max_l2 "Max. Fahrzeuggeschwindigkeit" UWORD UMR_KM_H_1_1_0_S6_S3 1 100 0 400 DISPLAY_IDENTIFIER fzg_geschwindigkeit_max_l2.iUl2ItfipInt ECU_ADDRESS 0xFFF8A228 /end MEASUREMENT
/begin MEASUREMENT iUl2ItfipInt.iv_v_unplausibel_l2 "Fahrzeuggeschwindigkeit zur Abtriebsdrehzahl plausibel" UBYTE Conv.cUl2ItfipInt._.iv_v_unplausibel_l2_S6_S3 1 100 0 1 DISPLAY_IDENTIFIER iv_v_unplausibel_l2.iUl2ItfipInt ECU_ADDRESS 0xFFF8A22A /end MEASUREMENT
/begin MEASUREMENT iUl2ItfipInt.v_unplausibel_l2 "Fahrzeuggeschwindigkeit zur Abtriebsdrehzahl plausibel" UBYTE Conv.cUl2ItfipInt._.v_unplausibel_l2_S6_S3 1 100 0 1 DISPLAY_IDENTIFIER v_unplausibel_l2.iUl2ItfipInt ECU_ADDRESS 0xFFF8A22B /end MEASUREMENT
/begin MEASUREMENT iUl2ItfipInt.iv_ps_sensor_signal_l2 "Sensorsignal der Parksperre" UBYTE Conv.cUl2ItfipInt._.iv_ps_sensor_signal_l2_S6_S3 1 100 0 3 DISPLAY_IDENTIFIER iv_ps_sensor_signal_l2.iUl2ItfipInt ECU_ADDRESS 0xFFF8A22C /end MEASUREMENT
/begin MEASUREMENT iUl2ItfipInt.ps_sensor_signal_l2 "Sensorsignal der Parksperre" UBYTE Conv.cUl2ItfipInt._.ps_sensor_signal_l2_S6_S3 1 100 0 3 DISPLAY_IDENTIFIER ps_sensor_signal_l2.iUl2ItfipInt ECU_ADDRESS 0xFFF8A22D /end MEASUREMENT
/begin MEASUREMENT iUl2ItfipInt.iv_ps_sensor_status_l2 "Statussignal zu iv_ps_sensor_signal_l2" UBYTE Conv.cUl2ItfipInt._.iv_ps_sensor_status_l2_S6_S3 1 100 0 2 DISPLAY_IDENTIFIER iv_ps_sensor_status_l2.iUl2ItfipInt ECU_ADDRESS 0xFFF8A22E /end MEASUREMENT
/begin MEASUREMENT iUl2ItfipInt.ps_sensor_status_l2 "Statussignal zu iv_ps_sensor_signal_l2" UBYTE Conv.cUl2ItfipInt._.ps_sensor_status_l2_S6_S3 1 100 0 2 DISPLAY_IDENTIFIER ps_sensor_status_l2.iUl2ItfipInt ECU_ADDRESS 0xFFF8A22F /end MEASUREMENT
/begin MEASUREMENT iUl2ItfipInt.iv_n_ab_status_l2 "Eingangsgroesse Status NAB Signal für Level 2" UBYTE UMR___1_1_0_S6_S3 1 100 0 255 DISPLAY_IDENTIFIER iv_n_ab_status_l2.iUl2ItfipInt ECU_ADDRESS 0xFFF8A230 /end MEASUREMENT
/begin MEASUREMENT iUl2ItfipInt.n_ab_status_l2 "Status NAB Signal für Level 2" UBYTE UMR___1_1_0_S6_S3 1 100 0 255 DISPLAY_IDENTIFIER n_ab_status_l2.iUl2ItfipInt ECU_ADDRESS 0xFFF8A231 /end MEASUREMENT
/begin MEASUREMENT iUl2ItfipInt.iv_vehstabnsys_err_l2 "Eingangsgroesse Status Regelsysteme für Level 2" UBYTE Conv.cUl2ItfipInt._.iv_vehstabnsys_err_l2_S6_S3 1 100 0 1 DISPLAY_IDENTIFIER iv_vehstabnsys_err_l2.iUl2ItfipInt ECU_ADDRESS 0xFFF8A232 /end MEASUREMENT
/begin MEASUREMENT iUl2ItfipInt.vehstabnsys_err_l2 "Status Regelsysteme für Level 2" UBYTE Conv.cUl2ItfipInt._.vehstabnsys_err_l2_S6_S3 1 100 0 1 DISPLAY_IDENTIFIER vehstabnsys_err_l2.iUl2ItfipInt ECU_ADDRESS 0xFFF8A233 /end MEASUREMENT
/begin MEASUREMENT iUl2ItfipInt.iv_parking_brake_l2 "Eingangsgroesse für Level 2 für Handbremse" UBYTE Conv.cUl2ItfipInt._.iv_parking_brake_l2_S6_S3 1 100 0 1 DISPLAY_IDENTIFIER iv_parking_brake_l2.iUl2ItfipInt ECU_ADDRESS 0xFFF8A234 /end MEASUREMENT
/begin MEASUREMENT iUl2ItfipInt.parking_brake_l2 "Handbremse für Level 2" UBYTE Conv.cUl2ItfipInt._.parking_brake_l2_S6_S3 1 100 0 1 DISPLAY_IDENTIFIER parking_brake_l2.iUl2ItfipInt ECU_ADDRESS 0xFFF8A235 /end MEASUREMENT
/begin MEASUREMENT iUl2ItfipInt.iv_nab_direction "QM: iv-Größe Drehrichtung" UBYTE Conv.cUl2ItfipInt._.iv_nab_direction_S6_S3 1 100 0 2 DISPLAY_IDENTIFIER iv_nab_direction.iUl2ItfipInt ECU_ADDRESS 0xFFF8A236 /end MEASUREMENT
/begin MEASUREMENT iUl2ItfipInt.nab_direction "QM: Drehrichtung" SBYTE Conv.cUl2ItfipInt._.nab_direction_S6_S3 1 100 -1 1 DISPLAY_IDENTIFIER nab_direction.iUl2ItfipInt ECU_ADDRESS 0xFFF8A237 /end MEASUREMENT
/begin MEASUREMENT iUl2ItfipFl.iv_nmotl2komp "Komplementsignal zu Inputgroesse Level2 für Motordrehzahl" UWORD UMR_U_MIN_1_1_0_S6_S3 1 100 57375 65535 DISPLAY_IDENTIFIER iv_nmotl2komp.iUl2ItfipFl ECU_ADDRESS 0xFFF8E60C /end MEASUREMENT
/begin MEASUREMENT iUl2ItfipFl.n_mot_l2 "Komplementsignal zu Motordrehzahl für Level2" FLOAT32_IEEE UMR_U_MIN_1_1_0_S6_S3 1 100 0 8160 DISPLAY_IDENTIFIER n_mot_l2.iUl2ItfipFl ECU_ADDRESS 0xFFF8E610 /end MEASUREMENT
/begin MEASUREMENT iUl2ItfipFl.iv_nmotstatusl2komp "Komplementsignal zu Eingangsgroesse Statussignal Motordrehzahl für Level2" UBYTE UMR___1_1_0_S6_S3 1 100 253 255 DISPLAY_IDENTIFIER iv_nmotstatusl2komp.iUl2ItfipFl ECU_ADDRESS 0xFFF8E614 /end MEASUREMENT
/begin MEASUREMENT iUl2ItfipFl.n_mot_status_l2 "Komplementsignal zu Statussignal Motordrehzahl für Level2" FLOAT32_IEEE UMR___1_1_0_S6_S3 1 100 0 2 FORMAT "%4.2" DISPLAY_IDENTIFIER n_mot_status_l2.iUl2ItfipFl ECU_ADDRESS 0xFFF8E618 /end MEASUREMENT
/begin MEASUREMENT iUl2ItfipFl.iv_nmotabregell2komp "Komplementsignal zu Eingangsgroesse Motorabregeldrehzahl für Level2" UWORD UMR_U_MIN_1_1_0_S6_S3 1 100 58535 65535 DISPLAY_IDENTIFIER iv_nmotabregell2komp.iUl2ItfipFl ECU_ADDRESS 0xFFF8E61C /end MEASUREMENT
/begin MEASUREMENT iUl2ItfipFl.n_motabregel_l2 "Komplementsignal zu Motorabregeldrehzahl für Level2" FLOAT32_IEEE UMR_U_MIN_1_1_0_S6_S3 1 100 0 7000 DISPLAY_IDENTIFIER n_motabregel_l2.iUl2ItfipFl ECU_ADDRESS 0xFFF8E620 /end MEASUREMENT
/begin MEASUREMENT iUl2ItfipFl.iv_dscfehlerl2komp "Eingangssignal Komplement zu DSC (ESP)-Fehlerflag / DSC (ESP)-Inaktiv-Signal" UBYTE Conv.cUl2ItfipFl._.iv_dscfehlerl2komp_S6_S3 1 100 254 255 DISPLAY_IDENTIFIER iv_dscfehlerl2komp.iUl2ItfipFl ECU_ADDRESS 0xFFF8E624 /end MEASUREMENT
/begin MEASUREMENT iUl2ItfipFl.dsc_fehler_l2 "Komplement zu DSC (ESP)-Fehlerflag / DSC (ESP)-Inaktiv-Signal" FLOAT32_IEEE UMR___1_1_0_S6_S3 1 100 0 1 FORMAT "%4.2" DISPLAY_IDENTIFIER dsc_fehler_l2.iUl2ItfipFl ECU_ADDRESS 0xFFF8E628 /end MEASUREMENT
/begin MEASUREMENT iUl2ItfipFl.iv_n_ab_l2_komp "Komplementsignal zu Inputgroesse Level2 fuer Abtriebsdrehzahl" UWORD UMR_U_MIN_1_1_0_S6_S3 1 100 57375 65535 DISPLAY_IDENTIFIER iv_n_ab_l2_komp.iUl2ItfipFl ECU_ADDRESS 0xFFF8E62C /end MEASUREMENT
/begin MEASUREMENT iUl2ItfipFl.n_ab_l2 "Komplementsignal zu Abtriebsdrehzahl fuer Level2" FLOAT32_IEEE UMR_U_MIN_1_1_0_S6_S3 1 100 0 8160 DISPLAY_IDENTIFIER n_ab_l2.iUl2ItfipFl ECU_ADDRESS 0xFFF8E630 /end MEASUREMENT
/begin MEASUREMENT iUl2ItfipFl.iv_n_ab_max_l2_komp "Komplementsignal zu Inputgroesse Level2 fuer max Abtriebsdrehzahl" UWORD UMR_U_MIN_1_1_0_S6_S3 1 100 57375 65535 DISPLAY_IDENTIFIER iv_n_ab_max_l2_komp.iUl2ItfipFl ECU_ADDRESS 0xFFF8E634 /end MEASUREMENT
/begin MEASUREMENT iUl2ItfipFl.n_ab_max_l2 "Komplementsignal zu max Abtriebsdrehzahl fuer Level2" FLOAT32_IEEE UMR_U_MIN_1_1_0_S6_S3 1 100 0 8160 DISPLAY_IDENTIFIER n_ab_max_l2.iUl2ItfipFl ECU_ADDRESS 0xFFF8E638 /end MEASUREMENT
/begin MEASUREMENT iUl2ItfipFl.iv_ay_ref_l2_komp "Komplementsignal zu Inputgroesse Level2 fuer Querbeschleunigung" SWORD UMR___1_1_0_S6_S3 1 100 -32768 32767 DISPLAY_IDENTIFIER iv_ay_ref_l2_komp.iUl2ItfipFl ECU_ADDRESS 0xFFF8E63C /end MEASUREMENT
/begin MEASUREMENT iUl2ItfipFl.ay_ref_l2 "Querbeschleunigung fuer Level2" FLOAT32_IEEE UMR_M_SEC2_1_32_0_S6_S3 1 100 -1024 1023.96875 DISPLAY_IDENTIFIER ay_ref_l2.iUl2ItfipFl ECU_ADDRESS 0xFFF8E640 /end MEASUREMENT
/begin MEASUREMENT iUl2ItfipFl.iv_ay_ref_status_l2_komp "Komplementsignal zu Inputgroesse Status Signal AY_REF_STATUS fuer Level2" UBYTE UMR___1_1_0_S6_S3 1 100 253 255 DISPLAY_IDENTIFIER iv_ay_ref_status_l2_komp.iUl2ItfipFl ECU_ADDRESS 0xFFF8E644 /end MEASUREMENT
/begin MEASUREMENT iUl2ItfipFl.ay_ref_status_l2 "Status Signal von AY_REF fuer Level2" FLOAT32_IEEE UMR___1_1_0_S6_S3 1 100 0 2 FORMAT "%4.2" DISPLAY_IDENTIFIER ay_ref_status_l2.iUl2ItfipFl ECU_ADDRESS 0xFFF8E648 /end MEASUREMENT
/begin MEASUREMENT iUl2ItfipFl.iv_p_bremse_l2_komp "Komplementsignal zu Inputgroesse Level2 fuer Bremsdruck" UWORD UMR_BAR__1_2_0_S6_S3 1 100 30267.5 32767.5 DISPLAY_IDENTIFIER iv_p_bremse_l2_komp.iUl2ItfipFl ECU_ADDRESS 0xFFF8E64C /end MEASUREMENT
/begin MEASUREMENT iUl2ItfipFl.p_bremse_l2 "Bremsdruck fuer Level2" FLOAT32_IEEE UMR_BAR__1_2_0_S6_S3 1 100 0 2500 DISPLAY_IDENTIFIER p_bremse_l2.iUl2ItfipFl ECU_ADDRESS 0xFFF8E650 /end MEASUREMENT
/begin MEASUREMENT iUl2ItfipFl.brp_status_l2 "Status Signal von BRP fuer Level2" FLOAT32_IEEE UMR___1_1_0_S6_S3 1 100 0 2 FORMAT "%4.2" DISPLAY_IDENTIFIER brp_status_l2.iUl2ItfipFl ECU_ADDRESS 0xFFF8E654 /end MEASUREMENT
/begin MEASUREMENT iUl2ItfipFl.iv_brp_status_l2_komp "Komplementsignal zu Inputgroesse Status Signal BRP fuer Level2" UBYTE UMR___1_1_0_S6_S3 1 100 253 255 DISPLAY_IDENTIFIER iv_brp_status_l2_komp.iUl2ItfipFl ECU_ADDRESS 0xFFF8E658 /end MEASUREMENT
/begin MEASUREMENT iUl2ItfipFl.iv_brm_l2_komp "Komplementsignal zu Inputgroesse Level2 fuer Bremsmoment" UWORD UMR_NM__1_1_M32000_S6_S3 1 100 1535 33535 DISPLAY_IDENTIFIER iv_brm_l2_komp.iUl2ItfipFl ECU_ADDRESS 0xFFF8E65A /end MEASUREMENT
/begin MEASUREMENT iUl2ItfipFl.brm_l2 "Bremsmoment fuer Level2" FLOAT32_IEEE UMR_NM__1_1_0_S6_S3 1 100 0 5000 DISPLAY_IDENTIFIER brm_l2.iUl2ItfipFl ECU_ADDRESS 0xFFF8E65C /end MEASUREMENT
/begin MEASUREMENT iUl2ItfipFl.brm_status_l2 "Status Signal von BRM fuer Level2" FLOAT32_IEEE UMR___1_1_0_S6_S3 1 100 0 2 FORMAT "%4.2" DISPLAY_IDENTIFIER brm_status_l2.iUl2ItfipFl ECU_ADDRESS 0xFFF8E660 /end MEASUREMENT
/begin MEASUREMENT iUl2ItfipFl.iv_brm_status_l2_komp "Komplementsignal zu Inputgroesse Status Signal BRM fuer Level2" UBYTE UMR___1_1_0_S6_S3 1 100 253 255 DISPLAY_IDENTIFIER iv_brm_status_l2_komp.iUl2ItfipFl ECU_ADDRESS 0xFFF8E664 /end MEASUREMENT
/begin MEASUREMENT iUl2ItfipFl.iv_n_ab_status_l2_komp "Komplementsignal zu Inputgroesse Status Signal von NAB fuer Level2" UBYTE UMR___1_1_0_S6_S3 1 100 254 255 DISPLAY_IDENTIFIER iv_n_ab_status_l2_komp.iUl2ItfipFl ECU_ADDRESS 0xFFF8E665 /end MEASUREMENT
/begin MEASUREMENT iUl2ItfipFl.n_ab_status_l2 "Status Signal von NAB fuer Level2" FLOAT32_IEEE UMR___1_1_0_S6_S3 1 100 0 1 FORMAT "%4.2" DISPLAY_IDENTIFIER n_ab_status_l2.iUl2ItfipFl ECU_ADDRESS 0xFFF8E668 /end MEASUREMENT
/begin MEASUREMENT iUl2ItfipFl.iv_vehstabnsys_err_l2_komp "Komplementsignal zu Eingangsgroesse Status Regelsysteme für Level2" UBYTE UMR___1_1_0_S6_S3 1 100 254 255 DISPLAY_IDENTIFIER iv_vehstabnsys_err_l2_komp.iUl2ItfipFl ECU_ADDRESS 0xFFF8E66C /end MEASUREMENT
/begin MEASUREMENT iUl2ItfipFl.vehstabnsys_err_l2 "Status Regelsysteme für Level2" FLOAT32_IEEE UMR___1_1_0_S6_S3 1 100 0 1 FORMAT "%4.2" DISPLAY_IDENTIFIER vehstabnsys_err_l2.iUl2ItfipFl ECU_ADDRESS 0xFFF8E670 /end MEASUREMENT
/begin MEASUREMENT iUl2ItfipFl.iv_parking_brake_l2_komp "Komplementsignal zu Eingangsgroesse für Level2 für Handbremse" UBYTE UMR___1_1_0_S6_S3 1 100 254 255 DISPLAY_IDENTIFIER iv_parking_brake_l2_komp.iUl2ItfipFl ECU_ADDRESS 0xFFF8E674 /end MEASUREMENT
/begin MEASUREMENT iUl2ItfipFl.parking_brake_l2 "Komplementsignal zu Handbremse für Level2" FLOAT32_IEEE UMR___1_1_0_S6_S3 1 100 0 1 FORMAT "%4.2" DISPLAY_IDENTIFIER parking_brake_l2.iUl2ItfipFl ECU_ADDRESS 0xFFF8E678 /end MEASUREMENT
/begin MEASUREMENT iUl2ItfipFl.iv_pos_l2_komp "Komplementsignal zu Inputgroesse Level2 fuer Waehlhebelposition" UBYTE Conv.cUl2ItfipFl._.iv_pos_l2_komp_S6_S3 1 100 247 255 DISPLAY_IDENTIFIER iv_pos_l2_komp.iUl2ItfipFl ECU_ADDRESS 0xFFF8E67C /end MEASUREMENT
/begin MEASUREMENT iUl2ItfipFl.pos_l2 "Komplementsignal zu Waehlhebelposition fuer Level2" FLOAT32_IEEE UMR___1_1_0_S6_S3 1 100 0 8 FORMAT "%4.2" DISPLAY_IDENTIFIER pos_l2.iUl2ItfipFl ECU_ADDRESS 0xFFF8E680 /end MEASUREMENT
/begin MEASUREMENT iUl2ItfipFl.iv_soll_brake_torq_driver_l2_komp "Inputgroesse Level2 fuer Soll Fahrerwunschbremsmoment" UWORD UMR___1_1_0_S6_S3 1 100 33535 65535 DISPLAY_IDENTIFIER iv_soll_brake_torq_driver_l2_komp.iUl2ItfipFl ECU_ADDRESS 0xFFF8E684 /end MEASUREMENT
/begin MEASUREMENT iUl2ItfipFl.soll_brake_torq_driver_l2 "Soll Fahrerwunschbremsmoment fuer Level2" FLOAT32_IEEE UMR___1_1_0_S6_S3 1 100 -32000 0 FORMAT "%4.2" DISPLAY_IDENTIFIER soll_brake_torq_driver_l2.iUl2ItfipFl ECU_ADDRESS 0xFFF8E688 /end MEASUREMENT
/begin MEASUREMENT iUl2ItfipFl.soll_brake_torq_driver_status_l2 "Status SOLL_BRAKE_TORQ_DRIVER Signal für Level 2" FLOAT32_IEEE UMR___1_1_0_S6_S3 1 100 0 2 FORMAT "%4.2" DISPLAY_IDENTIFIER soll_brake_torq_driver_status_l2.iUl2ItfipFl ECU_ADDRESS 0xFFF8E68C /end MEASUREMENT
/begin MEASUREMENT iUl2ItfipFl.iv_soll_brake_torq_driver_status_l2_komp "Komplementsignal zu Inputgroesse Status Signal SOLL_BRAKE_TORQ_DRIVER fuer Level2" UBYTE UMR___1_1_0_S6_S3 1 100 253 255 DISPLAY_IDENTIFIER iv_soll_brake_torq_driver_status_l2_komp.iUl2ItfipFl ECU_ADDRESS 0xFFF8E690 /end MEASUREMENT
/begin MEASUREMENT iUl2ItfipFl.iv_c_getr_l2_komp "Komplementsignal zur Inputgroesse der Getriebetemperatur fuer Level2" UBYTE UMR_GRADC__1_1_M40_S6_S3 1 100 -40 215 DISPLAY_IDENTIFIER iv_c_getr_l2_komp.iUl2ItfipFl ECU_ADDRESS 0xFFF8E691 /end MEASUREMENT
/begin MEASUREMENT iUl2ItfipFl.c_getr_l2 "Komplementsignal zu Getriebetemperatur fuer Level 2" FLOAT32_IEEE UMR_GRADC__1_1_M40_S6_S3 1 100 -40 215 DISPLAY_IDENTIFIER c_getr_l2.iUl2ItfipFl ECU_ADDRESS 0xFFF8E694 /end MEASUREMENT
/begin MEASUREMENT iUl2ItfipFl.iv_m_mot_l2_komp "Komplementsignal zu Inputgroesse Level2 fuer Motormoment" SWORD UMR_NM__1_1_0_S6_S3 1 100 -1641 399 DISPLAY_IDENTIFIER iv_m_mot_l2_komp.iUl2ItfipFl ECU_ADDRESS 0xFFF8E698 /end MEASUREMENT
/begin MEASUREMENT iUl2ItfipFl.m_mot_l2 "Komplementsignal zu Motormoment für Level 2" FLOAT32_IEEE UMR_NM__1_1_0_S6_S3 1 100 -400 1640 DISPLAY_IDENTIFIER m_mot_l2.iUl2ItfipFl ECU_ADDRESS 0xFFF8E69C /end MEASUREMENT
/begin MEASUREMENT iUl2ItfipFl.iv_n_turb_l2_komp "Komplementsignal zu Inputgroesse Level2 fuer Turbinendrehzahl" UWORD UMR_U_MIN_1_1_0_S6_S3 1 100 57375 65535 DISPLAY_IDENTIFIER iv_n_turb_l2_komp.iUl2ItfipFl ECU_ADDRESS 0xFFF8E6A0 /end MEASUREMENT
/begin MEASUREMENT iUl2ItfipFl.n_turb_l2 "Komplementsignal fuer TurbinendrehzahlLevel2" FLOAT32_IEEE UMR_U_MIN_1_1_0_S6_S3 1 100 0 8160 DISPLAY_IDENTIFIER n_turb_l2.iUl2ItfipFl ECU_ADDRESS 0xFFF8E6A4 /end MEASUREMENT
/begin MEASUREMENT iUl2ItfipFl.iv_mmotist_l2_komp "Komplement Eingangsgroesse Motormoment ohne Motoreingriff Getriebe für Level 2" SWORD UMR_NM__1_1_0_S6_S3 1 100 -400 1640 DISPLAY_IDENTIFIER iv_mmotist_l2_komp.iUl2ItfipFl ECU_ADDRESS 0xFFF8E6A8 /end MEASUREMENT
/begin MEASUREMENT iUl2ItfipFl.mmotist_l2 "Komplement Motormoment ohne Motoreingriff Getriebe für Level 2" FLOAT32_IEEE UMR_NM__1_1_0_S6_S3 1 100 -400 1640 DISPLAY_IDENTIFIER mmotist_l2.iUl2ItfipFl ECU_ADDRESS 0xFFF8E6AC /end MEASUREMENT
/begin MEASUREMENT iUl2ItfipFl.iv_m_ist_em_l2_komp "Komplement: Moment an der E-Maschine" SWORD UMR_NM__1_1_0_S6_S3 1 100 -32768 32767 DISPLAY_IDENTIFIER iv_m_ist_em_l2_komp.iUl2ItfipFl ECU_ADDRESS 0xFFF8E6B0 /end MEASUREMENT
/begin MEASUREMENT iUl2ItfipFl.m_ist_em_l2 "Komplement: Moment an der E-Maschine" FLOAT32_IEEE UMR_NM__1_1_0_S6_S3 1 100 -1024 1024 DISPLAY_IDENTIFIER m_ist_em_l2.iUl2ItfipFl ECU_ADDRESS 0xFFF8E6B4 /end MEASUREMENT
/begin MEASUREMENT iUl2ItfipFl.iv_m_ist_vm_l2_komp "Komplement: Moment an dem Verbrennungsmotor" SWORD UMR_NM__1_1_0_S6_S3 1 100 -32768 32767 DISPLAY_IDENTIFIER iv_m_ist_vm_l2_komp.iUl2ItfipFl ECU_ADDRESS 0xFFF8E6B8 /end MEASUREMENT
/begin MEASUREMENT iUl2ItfipFl.m_ist_vm_l2 "Komplement: Moment an dem Verbrennungsmotor" FLOAT32_IEEE UMR_NM__1_1_0_S6_S3 1 100 -400 1640 DISPLAY_IDENTIFIER m_ist_vm_l2.iUl2ItfipFl ECU_ADDRESS 0xFFF8E6BC /end MEASUREMENT
/begin MEASUREMENT iUl2ItfipFl.iv_nmo_vm_l2_komp "Komplement: Verbrennungsmotordrehzahl" UWORD UMR_U_MIN_1_1_0_S6_S3 1 100 0 65535 DISPLAY_IDENTIFIER iv_nmo_vm_l2_komp.iUl2ItfipFl ECU_ADDRESS 0xFFF8E6C0 /end MEASUREMENT
/begin MEASUREMENT iUl2ItfipFl.nmo_vm_l2 "Komplement: Verbrennungsmotordrehzahl" FLOAT32_IEEE UMR_U_MIN_1_1_0_S6_S3 1 100 0 65535 DISPLAY_IDENTIFIER nmo_vm_l2.iUl2ItfipFl ECU_ADDRESS 0xFFF8E6C4 /end MEASUREMENT
/begin MEASUREMENT iUl2ItfipFl.iv_nmo_vm_status_l2_komp "Komplement Statussignal zu iv_nmo_vm_status_l2" UBYTE Conv.cUl2ItfipFl._.iv_nmo_vm_status_l2_komp_S6_S3 1 100 253 255 DISPLAY_IDENTIFIER iv_nmo_vm_status_l2_komp.iUl2ItfipFl ECU_ADDRESS 0xFFF8E6C8 /end MEASUREMENT
/begin MEASUREMENT iUl2ItfipFl.nmo_vm_status_l2 "Statussignal zu nmo_vm_status_l2 (Verbrennungsmotordrehzahl)" FLOAT32_IEEE UMR___1_1_0_S6_S3 1 100 0 2 FORMAT "%4.2" DISPLAY_IDENTIFIER nmo_vm_status_l2.iUl2ItfipFl ECU_ADDRESS 0xFFF8E6CC /end MEASUREMENT
/begin MEASUREMENT iUl2ItfipFl.iv_fzg_geschwindigkeit_max_l2_komp "Max. Fahrzeuggeschwindigkeit, Komplement" UWORD UMR___1_1_0_S6_S3 1 100 65135 65535 DISPLAY_IDENTIFIER iv_fzg_geschwindigkeit_max_l2_komp.iUl2ItfipFl ECU_ADDRESS 0xFFF8E6D0 /end MEASUREMENT
/begin MEASUREMENT iUl2ItfipFl.fzg_geschwindigkeit_max_l2 "Max. Fahrzeuggeschwindigkeit, Komplement" FLOAT32_IEEE UMR_KM_H_1_1_0_S6_S3 1 100 0 400 DISPLAY_IDENTIFIER fzg_geschwindigkeit_max_l2.iUl2ItfipFl ECU_ADDRESS 0xFFF8E6D4 /end MEASUREMENT
/begin MEASUREMENT iUl2ItfipFl.iv_v_unplausibel_l2_komp "Fahrzeuggeschwindigkeit zur Abtriebsdrehzahl plausibel, Komplement" UBYTE Conv.cUl2ItfipFl._.iv_v_unplausibel_l2_komp_S6_S3 1 100 254 255 DISPLAY_IDENTIFIER iv_v_unplausibel_l2_komp.iUl2ItfipFl ECU_ADDRESS 0xFFF8E6D8 /end MEASUREMENT
/begin MEASUREMENT iUl2ItfipFl.v_unplausibel_l2 "Fahrzeuggeschwindigkeit zur Abtriebsdrehzahl plausibel, Komplement" FLOAT32_IEEE UMR___1_1_0_S6_S3 1 100 0 1 FORMAT "%4.2" DISPLAY_IDENTIFIER v_unplausibel_l2.iUl2ItfipFl ECU_ADDRESS 0xFFF8E6DC /end MEASUREMENT
/begin MEASUREMENT iUl2ItfipFl.iv_ps_sensor_signal_l2_komp "Komplementsignal, Sensorsignal der Parksperre" UBYTE Conv.cUl2ItfipFl._.iv_ps_sensor_signal_l2_komp_S6_S3 1 100 252 255 DISPLAY_IDENTIFIER iv_ps_sensor_signal_l2_komp.iUl2ItfipFl ECU_ADDRESS 0xFFF8E6E0 /end MEASUREMENT
/begin MEASUREMENT iUl2ItfipFl.ps_sensor_signal_l2 "Komplementsignal, Sensorsignal der Parksperre" FLOAT32_IEEE UMR___1_1_0_S6_S3 1 100 0 3 FORMAT "%4.2" DISPLAY_IDENTIFIER ps_sensor_signal_l2.iUl2ItfipFl ECU_ADDRESS 0xFFF8E6E4 /end MEASUREMENT
/begin MEASUREMENT iUl2ItfipFl.iv_ps_sensor_status_l2_komp "Statussignal zu iv_ps_sensor_signal_l2" UBYTE Conv.cUl2ItfipFl._.iv_ps_sensor_status_l2_komp_S6_S3 1 100 253 255 DISPLAY_IDENTIFIER iv_ps_sensor_status_l2_komp.iUl2ItfipFl ECU_ADDRESS 0xFFF8E6E8 /end MEASUREMENT
/begin MEASUREMENT iUl2ItfipFl.ps_sensor_status_l2 "Statussignal zu iv_ps_sensor_signal_l2" FLOAT32_IEEE Conv.cUl2ItfipFl._.ps_sensor_status_l2_S6_S3 1 100 0 2 FORMAT "%4.2" DISPLAY_IDENTIFIER ps_sensor_status_l2.iUl2ItfipFl ECU_ADDRESS 0xFFF8E6EC /end MEASUREMENT
/begin MEASUREMENT iUl2ItfipFl.iv_nab_direction "QM: iv-Größe Drehrichtung" UBYTE UMR___1_1_0_S6_S3 1 100 253 255 DISPLAY_IDENTIFIER iv_nab_direction.iUl2ItfipFl ECU_ADDRESS 0xFFF8E6F0 /end MEASUREMENT
/begin MEASUREMENT iUl2ItfipFl.nab_direction "QM: Drehrichtung" FLOAT32_IEEE UMR___1_1_0_S6_S3 1 100 -1 1 FORMAT "%4.2" DISPLAY_IDENTIFIER nab_direction.iUl2ItfipFl ECU_ADDRESS 0xFFF8E6F4 /end MEASUREMENT
/begin MEASUREMENT iUl2ItfipUewInt.status_k0 "Level2: K0 Status" UBYTE Conv.cUl2ItfipUewInt._.status_k0_S6_S3 1 100 0 5 DISPLAY_IDENTIFIER status_k0.iUl2ItfipUewInt ECU_ADDRESS 0xFFF8E6F8 /end MEASUREMENT
/begin MEASUREMENT iUl2ItfipUewInt.me_red_abs "Level2: Liefert ausgegebene Motormoment als Absolutmoment" SWORD UMR_NM__1_1_0_S6_S3 1 100 -2000 2000 DISPLAY_IDENTIFIER me_red_abs.iUl2ItfipUewInt ECU_ADDRESS 0xFFF8E712 /end MEASUREMENT
/begin MEASUREMENT iUl2ItfipUewInt.me_red_status "Level2: Liefert Status Momentenvorgabe" UBYTE Conv.cUl2ItfipUewInt._.me_red_status_S6_S3 1 100 0 3 DISPLAY_IDENTIFIER me_red_status.iUl2ItfipUewInt ECU_ADDRESS 0xFFF8E714 /end MEASUREMENT
/begin MEASUREMENT iUl2ItfipUewInt.m_motmax "Level2: maximal zulaessiges Motormoment" SWORD UMR_NM__1_1_0_S6_S3 1 100 -400 1640 DISPLAY_IDENTIFIER m_motmax.iUl2ItfipUewInt ECU_ADDRESS 0xFFF8E716 /end MEASUREMENT
/begin MEASUREMENT iUl2ItfipUewInt.me_rel "Level2: relativer Motoreingriff" SWORD UMR_NM__1_1_0_S6_S3 1 100 -3000 3000 DISPLAY_IDENTIFIER me_rel.iUl2ItfipUewInt ECU_ADDRESS 0xFFF8E718 /end MEASUREMENT
/begin MEASUREMENT iUl2ItfipUewInt.zielgang_sas "Level2: Liefert das zu ueberwachende Eingangssignal von GET_ZIELGANG (zielgang_sas)" SBYTE Conv.cUl2ItfipUewInt._.zielgang_sas_S6_S3 1 100 -1 8 DISPLAY_IDENTIFIER zielgang_sas.iUl2ItfipUewInt ECU_ADDRESS 0xFFF8E71A /end MEASUREMENT
/begin MEASUREMENT iUl2ItfipUewInt.istgang "Level2: Liefert das zu ueberwachende Eingangssignal von GET_ISTGANG (istgang)" SBYTE Conv.cUl2ItfipUewInt._.istgang_S6_S3 1 100 -1 8 DISPLAY_IDENTIFIER istgang.iUl2ItfipUewInt ECU_ADDRESS 0xFFF8E71B /end MEASUREMENT
/begin MEASUREMENT iUl2ItfipUewInt.pos_atsys "Level2: Waehlhebelposition" UBYTE Conv.cUl2ItfipUewInt._.pos_atsys_S6_S3 1 100 0 12 DISPLAY_IDENTIFIER pos_atsys.iUl2ItfipUewInt ECU_ADDRESS 0xFFF8E71C /end MEASUREMENT
/begin MEASUREMENT iUl2ItfipUewInt.m_getrauf "Inputgroesse Level2 für Getriebeaufnahmemoment" SWORD UMR_NM__1_1_0_S6_S3 1 100 -400 1640 DISPLAY_IDENTIFIER m_getrauf.iUl2ItfipUewInt ECU_ADDRESS 0xFFF8E71E /end MEASUREMENT
/begin MEASUREMENT iUl2ItfipUewFl.status_k0 "Level2: K0 Status" FLOAT32_IEEE Conv.cUl2ItfipUewFl._.status_k0_S6_S3 1 100 0 5 FORMAT "%4.2" DISPLAY_IDENTIFIER status_k0.iUl2ItfipUewFl ECU_ADDRESS 0xFFF8E720 /end MEASUREMENT
/begin MEASUREMENT iUl2ItfipUewFl.me_red_abs "Level2: Liefert ausgegebene Motormoment als Absolutmoment" FLOAT32_IEEE UMR_NM__1_1_0_S6_S3 1 100 -2000 2000 DISPLAY_IDENTIFIER me_red_abs.iUl2ItfipUewFl ECU_ADDRESS 0xFFF8E754 /end MEASUREMENT
/begin MEASUREMENT iUl2ItfipUewFl.me_red_status "Level2: Liefert Status Momentenvorgabe" FLOAT32_IEEE Conv.cUl2ItfipUewFl._.me_red_status_S6_S3 1 100 0 3 FORMAT "%4.2" DISPLAY_IDENTIFIER me_red_status.iUl2ItfipUewFl ECU_ADDRESS 0xFFF8E758 /end MEASUREMENT
/begin MEASUREMENT iUl2ItfipUewFl.m_motmax "Level2: maximal zulaessiges Motormoment" FLOAT32_IEEE UMR_NM__1_1_0_S6_S3 1 100 -400 1640 DISPLAY_IDENTIFIER m_motmax.iUl2ItfipUewFl ECU_ADDRESS 0xFFF8E75C /end MEASUREMENT
/begin MEASUREMENT iUl2ItfipUewFl.me_rel "Level2: relativer Motoreingriff" FLOAT32_IEEE UMR_NM__1_1_0_S6_S3 1 100 -3000 3000 DISPLAY_IDENTIFIER me_rel.iUl2ItfipUewFl ECU_ADDRESS 0xFFF8E760 /end MEASUREMENT
/begin MEASUREMENT iUl2ItfipUewFl.zielgang_sas "Level2: Liefert das zu ueberwachende Eingangssignal von GET_ZIELGANG (zielgang_sas)" FLOAT32_IEEE Conv.cUl2ItfipUewFl._.zielgang_sas_S6_S3 1 100 -1 8 FORMAT "%4.2" DISPLAY_IDENTIFIER zielgang_sas.iUl2ItfipUewFl ECU_ADDRESS 0xFFF8E764 /end MEASUREMENT
/begin MEASUREMENT iUl2ItfipUewFl.istgang "Level2: Liefert das zu ueberwachende Eingangssignal von GET_ISTGANG (istgang)" FLOAT32_IEEE Conv.cUl2ItfipUewFl._.istgang_S6_S3 1 100 -1 8 FORMAT "%4.2" DISPLAY_IDENTIFIER istgang.iUl2ItfipUewFl ECU_ADDRESS 0xFFF8E768 /end MEASUREMENT
/begin MEASUREMENT iUl2ItfipUewFl.pos_atsys "Komplementsignal zu Waehlhebelposition fuer Level1" FLOAT32_IEEE UMR___1_1_0_S6_S3 1 100 0 8 FORMAT "%4.2" DISPLAY_IDENTIFIER pos_atsys.iUl2ItfipUewFl ECU_ADDRESS 0xFFF8E76C /end MEASUREMENT
/begin MEASUREMENT iUl2ItfipUewFl.m_getrauf "Inputgroesse Level2 für Getriebeaufnahmemoment" FLOAT32_IEEE UMR_NM__1_1_0_S6_S3 1 100 -400 1640 DISPLAY_IDENTIFIER m_getrauf.iUl2ItfipUewFl ECU_ADDRESS 0xFFF8E770 /end MEASUREMENT
/begin MEASUREMENT iUl2IMinKupInt.min_kup_bestr_gang_info "Die Messgröße wird gesetzt, wenn alle Druckregler u. Magnetventile, gleich 50mA sind" UBYTE Conv.cUl2IMinKupInt._.min_kup_bestr_gang_info_S6_S3 1 100 0 1 BIT_MASK 0x1 DISPLAY_IDENTIFIER min_kup_bestr_gang_info.iUl2IMinKupInt ECU_ADDRESS 0xFFF8A66B /end MEASUREMENT
/begin MEASUREMENT iUl2IMinKupFl.min_kup_bestr_gang_info "Die Messgröße wird gesetzt, wenn alle Druckregler u. Magnetventile, gleich 50mA sind" FLOAT32_IEEE Conv.cUl2IMinKupFl._.min_kup_bestr_gang_info_S6_S3 1 100 0 1 FORMAT "%4.2" DISPLAY_IDENTIFIER min_kup_bestr_gang_info.iUl2IMinKupFl ECU_ADDRESS 0xFFF8E84C /end MEASUREMENT
/begin MEASUREMENT iUl2StromlosAusserPsInt.stromlos_ausser_ps_edslg "Die Messgröße wird gesetzt, wenn alle Druckregler u. Magnetventile, außer dem Parksperrenmagnet u. MSA-MV kleiner, gleich 50mA sind" UBYTE Conv.cUl2StromlosAusserPsInt._.stromlos_ausser_ps_edslg_S6_S3 1 100 0 1 DISPLAY_IDENTIFIER stromlos_ausser_ps_edslg.iUl2StromlosAusserPsInt ECU_ADDRESS 0xFFF8A272 /end MEASUREMENT
/begin MEASUREMENT iUl2StromlosAusserPsInt.alt_stromlos_ausser_ps_edslg "Speichert den Wert von stromlos_ausser_ps_l2 des vorherigen Zyklus." UBYTE Conv.cUl2StromlosAusserPsInt._.alt_stromlos_ausser_ps_edslg_S6_S3 1 100 0 1 DISPLAY_IDENTIFIER alt_stromlos_ausser_ps_edslg.iUl2StromlosAusserPsInt ECU_ADDRESS 0xFFF8A273 /end MEASUREMENT
/begin MEASUREMENT iUl2StromlosAusserPsFl.stromlos_ausser_ps_edslg "Die Messgröße wird gesetzt, wenn alle Druckregler u. Magnetventile, außer dem Parksperrenmagnet u. MSA-MV kleiner, gleich 50mA sind" FLOAT32_IEEE Conv.cUl2StromlosAusserPsFl._.stromlos_ausser_ps_edslg_S6_S3 1 100 0 1 FORMAT "%4.2" DISPLAY_IDENTIFIER stromlos_ausser_ps_edslg.iUl2StromlosAusserPsFl ECU_ADDRESS 0xFFF8F348 /end MEASUREMENT
/begin MEASUREMENT iUl2StromlosAusserPsFl.alt_stromlos_ausser_ps_edslg "Speichert den Wert von stromlos_ausser_ps_l2 des vorherigen Zyklus." FLOAT32_IEEE Conv.cUl2StromlosAusserPsFl._.alt_stromlos_ausser_ps_edslg_S6_S3 1 100 0 1 FORMAT "%4.2" DISPLAY_IDENTIFIER alt_stromlos_ausser_ps_edslg.iUl2StromlosAusserPsFl ECU_ADDRESS 0xFFF8F34C /end MEASUREMENT
/begin MEASUREMENT iUl2EdsGangInfoInt.gang_aus_bestromung "Level 2: Kombination der Bestromung" SBYTE UMR___1_1_0_S6_S3 1 100 -1 8 DISPLAY_IDENTIFIER gang_aus_bestromung.iUl2EdsGangInfoInt ECU_ADDRESS 0xFFF8C2F4 /end MEASUREMENT
/begin MEASUREMENT iUl2EdsGangInfoInt.gang_aus_bestromung_alt "Level 2: Kombination der Bestromung letztes Zyklus" SBYTE UMR___1_1_0_S6_S3 1 100 -1 8 DISPLAY_IDENTIFIER gang_aus_bestromung_alt.iUl2EdsGangInfoInt ECU_ADDRESS 0xFFF8C2F5 /end MEASUREMENT
/begin MEASUREMENT iUl2EdsGangInfoInt.i_gang "Level 2: Uebesetzung des aktuellen Gangs" SWORD UMR___1_1000_0_S6_S3 1 100 -32.768 32.767 DISPLAY_IDENTIFIER i_gang.iUl2EdsGangInfoInt ECU_ADDRESS 0xFFF8C2F6 /end MEASUREMENT
/begin MEASUREMENT iUl2EdsGangInfoInt.istgang "Level 2: aktueller Gang" SBYTE UMR___1_1_0_S6_S3 1 100 -1 8 DISPLAY_IDENTIFIER istgang.iUl2EdsGangInfoInt ECU_ADDRESS 0xFFF8C2F8 /end MEASUREMENT
/begin MEASUREMENT iUl2EdsGangInfoInt.n_verz_igang "Zaehler für die konstante Kombination der Bestromung" UWORD UMR___1_1_0_S6_S3 1 100 0 256 DISPLAY_IDENTIFIER n_verz_igang.iUl2EdsGangInfoInt ECU_ADDRESS 0xFFF8C2FA /end MEASUREMENT
/begin MEASUREMENT iUl2EdsGangInfoInt.n_kup_statisch_offen "Anzahl von Kupplungen die offen angesteuert sind" UBYTE UMR___1_1_0_S6_S3 1 100 0 5 DISPLAY_IDENTIFIER n_kup_statisch_offen.iUl2EdsGangInfoInt ECU_ADDRESS 0xFFF8C2FC /end MEASUREMENT
/begin MEASUREMENT iUl2EdsGangInfoInt.n_kup_nicht_statisch_offen "Anzahl von Kupplungen die nicht offen angesteuert sind" UBYTE UMR___1_1_0_S6_S3 1 100 0 5 DISPLAY_IDENTIFIER n_kup_nicht_statisch_offen.iUl2EdsGangInfoInt ECU_ADDRESS 0xFFF8C2FD /end MEASUREMENT
/begin MEASUREMENT iUl2EdsGangInfoInt.gang_aus_offen_kup "Level 2: möglicher Gang" SBYTE UMR___1_1_0_S6_S3 1 100 -1 8 DISPLAY_IDENTIFIER gang_aus_offen_kup.iUl2EdsGangInfoInt ECU_ADDRESS 0xFFF8C2FE /end MEASUREMENT
/begin MEASUREMENT iUl2EdsGangInfoFl.gang_aus_bestromung "Level 2: Kombination der Bestromung" FLOAT32_IEEE UMR___1_1_0_S6_S3 1 100 -1 8 FORMAT "%4.2" DISPLAY_IDENTIFIER gang_aus_bestromung.iUl2EdsGangInfoFl ECU_ADDRESS 0xFFF8C334 /end MEASUREMENT
/begin MEASUREMENT iUl2EdsGangInfoFl.gang_aus_bestromung_alt "Level 2: Kombination der Bestromung letztes Zyklus" FLOAT32_IEEE UMR___1_1_0_S6_S3 1 100 -1 8 FORMAT "%4.2" DISPLAY_IDENTIFIER gang_aus_bestromung_alt.iUl2EdsGangInfoFl ECU_ADDRESS 0xFFF8C338 /end MEASUREMENT
/begin MEASUREMENT iUl2EdsGangInfoFl.i_gang "Level 2: Uebesetzung des aktuellen Gangs" FLOAT32_IEEE UMR___1_1000_0_S6_S3 1 100 -32.768 32.767 DISPLAY_IDENTIFIER i_gang.iUl2EdsGangInfoFl ECU_ADDRESS 0xFFF8C33C /end MEASUREMENT
/begin MEASUREMENT iUl2EdsGangInfoFl.istgang "Level 2: aktueller Gang" FLOAT32_IEEE UMR___1_1_0_S6_S3 1 100 -1 8 FORMAT "%4.2" DISPLAY_IDENTIFIER istgang.iUl2EdsGangInfoFl ECU_ADDRESS 0xFFF8C340 /end MEASUREMENT
/begin MEASUREMENT iUl2EdsGangInfoFl.n_verz_igang "Zaehler für die konstante Kombination der Bestromung" FLOAT32_IEEE UMR___1_1_0_S6_S3 1 100 0 256 FORMAT "%4.2" DISPLAY_IDENTIFIER n_verz_igang.iUl2EdsGangInfoFl ECU_ADDRESS 0xFFF8C344 /end MEASUREMENT
/begin MEASUREMENT iUl2EdsGangInfoFl.n_kup_statisch_offen "Anzahl von Kupplungen die offen angesteuert sind" FLOAT32_IEEE UMR___1_1_0_S6_S3 1 100 0 5 FORMAT "%4.2" DISPLAY_IDENTIFIER n_kup_statisch_offen.iUl2EdsGangInfoFl ECU_ADDRESS 0xFFF8C348 /end MEASUREMENT
/begin MEASUREMENT iUl2EdsGangInfoFl.n_kup_nicht_statisch_offen "Anzahl von Kupplungen die nicht offen angesteuert sind" FLOAT32_IEEE UMR___1_1_0_S6_S3 1 100 0 5 FORMAT "%4.2" DISPLAY_IDENTIFIER n_kup_nicht_statisch_offen.iUl2EdsGangInfoFl ECU_ADDRESS 0xFFF8C34C /end MEASUREMENT
/begin MEASUREMENT iUl2EdsGangInfoFl.gang_aus_offen_kup "Level 2: möglicher Gang" FLOAT32_IEEE UMR___1_1_0_S6_S3 1 100 -1 8 FORMAT "%4.2" DISPLAY_IDENTIFIER gang_aus_offen_kup.iUl2EdsGangInfoFl ECU_ADDRESS 0xFFF8C350 /end MEASUREMENT
/begin MEASUREMENT iUl2EdsKflKupAInt.f_geschlossen "Zustand der Kupplung" UBYTE Conv.cUl2EdsKflKupInt._.f_geschlossen_S6_S3 1 100 0 1 BIT_MASK 0x1 DISPLAY_IDENTIFIER f_geschlossen.iUl2EdsKflKupAInt ECU_ADDRESS 0xFFF8C354 /end MEASUREMENT
/begin MEASUREMENT iUl2EdsKflKupAFl.f_geschlossen "Zustand der Kupplung" FLOAT32_IEEE UMR___1_1_0_S6_S3 1 100 0 1 FORMAT "%4.2" DISPLAY_IDENTIFIER f_geschlossen.iUl2EdsKflKupAFl ECU_ADDRESS 0xFFF8C360 /end MEASUREMENT
/begin MEASUREMENT iUl2EdsKflKupBInt.f_geschlossen "Zustand der Kupplung" UBYTE Conv.cUl2EdsKflKupInt._.f_geschlossen_S6_S3 1 100 0 1 BIT_MASK 0x1 DISPLAY_IDENTIFIER f_geschlossen.iUl2EdsKflKupBInt ECU_ADDRESS 0xFFF8C36C /end MEASUREMENT
/begin MEASUREMENT iUl2EdsKflKupBFl.f_geschlossen "Zustand der Kupplung" FLOAT32_IEEE UMR___1_1_0_S6_S3 1 100 0 1 FORMAT "%4.2" DISPLAY_IDENTIFIER f_geschlossen.iUl2EdsKflKupBFl ECU_ADDRESS 0xFFF8C378 /end MEASUREMENT
/begin MEASUREMENT iUl2EdsKflKupCInt.f_geschlossen "Zustand der Kupplung" UBYTE Conv.cUl2EdsKflKupInt._.f_geschlossen_S6_S3 1 100 0 1 BIT_MASK 0x1 DISPLAY_IDENTIFIER f_geschlossen.iUl2EdsKflKupCInt ECU_ADDRESS 0xFFF8C384 /end MEASUREMENT
/begin MEASUREMENT iUl2EdsKflKupCFl.f_geschlossen "Zustand der Kupplung" FLOAT32_IEEE UMR___1_1_0_S6_S3 1 100 0 1 FORMAT "%4.2" DISPLAY_IDENTIFIER f_geschlossen.iUl2EdsKflKupCFl ECU_ADDRESS 0xFFF8C390 /end MEASUREMENT
/begin MEASUREMENT iUl2EdsKflKupDInt.f_geschlossen "Zustand der Kupplung" UBYTE Conv.cUl2EdsKflKupInt._.f_geschlossen_S6_S3 1 100 0 1 BIT_MASK 0x1 DISPLAY_IDENTIFIER f_geschlossen.iUl2EdsKflKupDInt ECU_ADDRESS 0xFFF8C39C /end MEASUREMENT
/begin MEASUREMENT iUl2EdsKflKupDFl.f_geschlossen "Zustand der Kupplung" FLOAT32_IEEE UMR___1_1_0_S6_S3 1 100 0 1 FORMAT "%4.2" DISPLAY_IDENTIFIER f_geschlossen.iUl2EdsKflKupDFl ECU_ADDRESS 0xFFF8C3A8 /end MEASUREMENT
/begin MEASUREMENT iUl2EdsKflKupEInt.f_geschlossen "Zustand der Kupplung" UBYTE Conv.cUl2EdsKflKupInt._.f_geschlossen_S6_S3 1 100 0 1 BIT_MASK 0x1 DISPLAY_IDENTIFIER f_geschlossen.iUl2EdsKflKupEInt ECU_ADDRESS 0xFFF8C3B4 /end MEASUREMENT
/begin MEASUREMENT iUl2EdsKflKupEFl.f_geschlossen "Zustand der Kupplung" FLOAT32_IEEE UMR___1_1_0_S6_S3 1 100 0 1 FORMAT "%4.2" DISPLAY_IDENTIFIER f_geschlossen.iUl2EdsKflKupEFl ECU_ADDRESS 0xFFF8C3C0 /end MEASUREMENT
/begin MEASUREMENT iUl2EdsKflInt.zustand_direkt "git an, ob der Kraftfluss vorhanden ist" UBYTE Conv.cUl2EdsKflInt._.zustand_direkt_S6_S3 1 100 0 2 DISPLAY_IDENTIFIER zustand_direkt.iUl2EdsKflInt ECU_ADDRESS 0xFFF8A078 /end MEASUREMENT
/begin MEASUREMENT iUl2EdsKflInt.zustand "git an, ob der Kraftfluss vorhanden ist (abhängig von n_verz_posueb)" UBYTE Conv.cUl2EdsKflInt._.zustand_S6_S3 1 100 0 2 DISPLAY_IDENTIFIER zustand.iUl2EdsKflInt ECU_ADDRESS 0xFFF8A079 /end MEASUREMENT
/begin MEASUREMENT iUl2EdsKflInt.n_kup_zu "git an, ob der Kraftfluss vorhanden ist" UWORD UMR___1_1_0_S6_S3 1 100 0 256 DISPLAY_IDENTIFIER n_kup_zu.iUl2EdsKflInt ECU_ADDRESS 0xFFF8A07A /end MEASUREMENT
/begin MEASUREMENT iUl2EdsKflInt.n_verz_powerflowueb "git an, ob der Kraftfluss vorhanden ist" UWORD UMR___1_1_0_S6_S3 1 100 0 256 DISPLAY_IDENTIFIER n_verz_powerflowueb.iUl2EdsKflInt ECU_ADDRESS 0xFFF8A07C /end MEASUREMENT
/begin MEASUREMENT iUl2EdsKflFl.zustand_direkt "git an, ob der Kraftfluss vorhanden ist" FLOAT32_IEEE UMR___1_1_0_S6_S3 1 100 0 1 FORMAT "%4.2" DISPLAY_IDENTIFIER zustand_direkt.iUl2EdsKflFl ECU_ADDRESS 0xFFF8C3CC /end MEASUREMENT
/begin MEASUREMENT iUl2EdsKflFl.zustand "git an, ob der Kraftfluss vorhanden ist (abhängig von n_verz_posueb)" FLOAT32_IEEE UMR___1_1_0_S6_S3 1 100 0 1 FORMAT "%4.2" DISPLAY_IDENTIFIER zustand.iUl2EdsKflFl ECU_ADDRESS 0xFFF8C3D0 /end MEASUREMENT
/begin MEASUREMENT iUl2EdsKflFl.n_kup_zu "git an, ob der Kraftfluss vorhanden ist" FLOAT32_IEEE UMR___1_1_0_S6_S3 1 100 0 256 FORMAT "%4.2" DISPLAY_IDENTIFIER n_kup_zu.iUl2EdsKflFl ECU_ADDRESS 0xFFF8C3D4 /end MEASUREMENT
/begin MEASUREMENT iUl2EdsKflFl.n_verz_powerflowueb "git an, ob der Kraftfluss vorhanden ist" FLOAT32_IEEE UMR___1_1_0_S6_S3 1 100 0 256 FORMAT "%4.2" DISPLAY_IDENTIFIER n_verz_powerflowueb.iUl2EdsKflFl ECU_ADDRESS 0xFFF8C3D8 /end MEASUREMENT
/begin MEASUREMENT iUl2DrehzahlBeobInt.fl_drehzbeob_schaltung "Flag das anzeigt, ob laut Drehzahlbeobachter eine Schaltung aktiv ist oder nicht" UBYTE Conv.cUl2DrehzahlBeobInt._.fl_drehzbeob_schaltung_S6_S3 1 100 0 1 BIT_MASK 0x1 DISPLAY_IDENTIFIER fl_drehzbeob_schaltung.iUl2DrehzahlBeobInt ECU_ADDRESS 0xFFF8A694 /end MEASUREMENT
/begin MEASUREMENT iUl2DrehzahlBeobFl.fl_drehzbeob_schaltung "Flag das anzeigt, ob laut Drehzahlbeobachter eine Schaltung aktiv ist oder nicht" FLOAT32_IEEE Conv.cUl2DrehzahlBeobFl._.fl_drehzbeob_schaltung_S6_S3 1 100 0 1 FORMAT "%4.2" DISPLAY_IDENTIFIER fl_drehzbeob_schaltung.iUl2DrehzahlBeobFl ECU_ADDRESS 0xFFF8F2AC /end MEASUREMENT
/begin MEASUREMENT iUl2IGangInt.i_gang "Aktuelle Übersetzung" UWORD UMR___1_1000_0_S6_S3 1 100 0 65.535 DISPLAY_IDENTIFIER i_gang.iUl2IGangInt ECU_ADDRESS 0xFFF8F1EA /end MEASUREMENT
/begin MEASUREMENT iUl2IGangFl.i_gang "Aktuelle Übersetzung Floatberechnung" FLOAT32_IEEE UMR___1_1000_0_S6_S3 1 100 0 65.535 DISPLAY_IDENTIFIER i_gang.iUl2IGangFl ECU_ADDRESS 0xFFF8F1F0 /end MEASUREMENT
/begin MEASUREMENT iUl2KupplK0Int.cUl2KupBasisInt._.f_geschlossen "Das Flag zeigt an ob die Kupplung geschlossen ist" UBYTE UMR___1_1_0_S6_S3 1 100 0 1 DISPLAY_IDENTIFIER f_geschlossen._.cUl2KupBasisInt.iUl2KupplK0Int ECU_ADDRESS 0xFFF8E850 /end MEASUREMENT
/begin MEASUREMENT iUl2KupplK0Int.f_init "Gibt an ob die Kupplungswerte Initialisiert wurden sind." UBYTE UMR___1_1_0_S6_S3 1 100 0 1 BIT_MASK 0x1 DISPLAY_IDENTIFIER f_init.iUl2KupplK0Int ECU_ADDRESS 0xFFF8E860 /end MEASUREMENT
/begin MEASUREMENT iUl2KupplK0Int.f_erste_bef_erk "Das Flag zeigt an, dass die erste Befüllung erkannt wurde." UBYTE UMR___1_1_0_S6_S3 1 100 0 1 BIT_MASK 0x1 DISPLAY_IDENTIFIER f_erste_bef_erk.iUl2KupplK0Int ECU_ADDRESS 0xFFF8E861 /end MEASUREMENT
/begin MEASUREMENT iUl2KupplK0Int.n_kup_oeffnet_k0 "Zähler zur Verzögerung der Erkennung - Schaltelement nicht geschaltet" UBYTE UMR___1_1_0_S6_S3 1 100 0 255 DISPLAY_IDENTIFIER n_kup_oeffnet_k0.iUl2KupplK0Int ECU_ADDRESS 0xFFF8E862 /end MEASUREMENT
/begin MEASUREMENT iUl2KupplK0Int.i_sw_kup_schliesst "aktuelle Stromschwelle um die Kupplung als geschlossen zu erkennen" UWORD UMR_MA__1_10_0_S6_S3 1 100 0 6553.5 DISPLAY_IDENTIFIER i_sw_kup_schliesst.iUl2KupplK0Int ECU_ADDRESS 0xFFF8E864 /end MEASUREMENT
/begin MEASUREMENT iUl2KupplK0Int.i_sw_kup_oeffnet "aktuelle Stromschwelle um die Kupplung als offen zu erkennen" UWORD UMR_MA__1_10_0_S6_S3 1 100 0 6553.5 DISPLAY_IDENTIFIER i_sw_kup_oeffnet.iUl2KupplK0Int ECU_ADDRESS 0xFFF8E866 /end MEASUREMENT
/begin MEASUREMENT iUl2KupplK0Int.delta_i_edslogik "Differenz zwischen Kupplungsstrom u. Stromschwelle (KF_IEDSMAXMMOTCGLOGIKUEB bzw. KF_IEDSMINMMOTCGLOGIKUEB)" UWORD UMR_MA__1_10_0_S6_S3 1 100 0 1000 DISPLAY_IDENTIFIER delta_i_edslogik.iUl2KupplK0Int ECU_ADDRESS 0xFFF8E868 /end MEASUREMENT
/begin MEASUREMENT iUl2KupplK0Int.n_stoeredslogik_schwelle_k0 "Schwelle die Überschritten werden muss um die Kupplung als geschlossen zu erkennen" UWORD UMR___1_1_0_S6_S3 1 100 0 510 DISPLAY_IDENTIFIER n_stoeredslogik_schwelle_k0.iUl2KupplK0Int ECU_ADDRESS 0xFFF8E86A /end MEASUREMENT
/begin MEASUREMENT iUl2KupplK0Int.n_stoeredslogik_init_k0 "kleinster Wert auf KF_MAXSTOERCGDELTAI_EDSLOGIK_K0" UWORD UMR___1_1_0_S6_S3 1 100 0 255 DISPLAY_IDENTIFIER n_stoeredslogik_init_k0.iUl2KupplK0Int ECU_ADDRESS 0xFFF8E86C /end MEASUREMENT
/begin MEASUREMENT iUl2KupplK0Int.n_stoeredslogik_k0 "Stoerzaehler für falsch bestromte Kupplung" UWORD UMR___1_1_0_S6_S3 1 100 0 65535 DISPLAY_IDENTIFIER n_stoeredslogik_k0.iUl2KupplK0Int ECU_ADDRESS 0xFFF8E86E /end MEASUREMENT
/begin MEASUREMENT iUl2KupplK0Fl.cUl2KupBasisFl._.f_geschlossen "Das Flag zeigt an ob die Kupplung geschlossen ist" FLOAT32_IEEE UMR___1_1_0_S6_S3 1 100 0 1 FORMAT "%4.2" DISPLAY_IDENTIFIER f_geschlossen._.cUl2KupBasisFl.iUl2KupplK0Fl ECU_ADDRESS 0xFFF8E870 /end MEASUREMENT
/begin MEASUREMENT iUl2KupplK0Fl.f_init "Gibt an ob die Kupplungswerte Initialisiert wurden sind." FLOAT32_IEEE UMR___1_1_0_S6_S3 1 100 0 1 FORMAT "%4.2" DISPLAY_IDENTIFIER f_init.iUl2KupplK0Fl ECU_ADDRESS 0xFFF8E880 /end MEASUREMENT
/begin MEASUREMENT iUl2KupplK0Fl.i_sw_kup_schliesst "aktuelle Stromschwelle um die Kupplung als geschlossen zu erkennen" FLOAT32_IEEE UMR_MA__1_10_0_S6_S3 1 100 0 6553.5 DISPLAY_IDENTIFIER i_sw_kup_schliesst.iUl2KupplK0Fl ECU_ADDRESS 0xFFF8E884 /end MEASUREMENT
/begin MEASUREMENT iUl2KupplK0Fl.i_sw_kup_oeffnet "aktuelle Stromschwelle um die Kupplung als offen zu erkennen" FLOAT32_IEEE UMR_MA__1_10_0_S6_S3 1 100 0 6553.5 DISPLAY_IDENTIFIER i_sw_kup_oeffnet.iUl2KupplK0Fl ECU_ADDRESS 0xFFF8E888 /end MEASUREMENT
/begin MEASUREMENT iUl2KupplK0Fl.f_erste_bef_erk "Das Flag zeigt an, dass die erste Befüllung erkannt wurde." FLOAT32_IEEE UMR___1_1_0_S6_S3 1 100 0 1 FORMAT "%4.2" DISPLAY_IDENTIFIER f_erste_bef_erk.iUl2KupplK0Fl ECU_ADDRESS 0xFFF8E88C /end MEASUREMENT
/begin MEASUREMENT iUl2KupplK0Fl.delta_i_edslogik "Differenz zwischen Kupplungsstrom u. Stromschwelle (KF_IEDSMAXMMOTCGLOGIKUEB bzw. KF_IEDSMINMMOTCGLOGIKUEB)" FLOAT32_IEEE UMR_MA__1_10_0_S6_S3 1 100 0 1000 DISPLAY_IDENTIFIER delta_i_edslogik.iUl2KupplK0Fl ECU_ADDRESS 0xFFF8E890 /end MEASUREMENT
/begin MEASUREMENT iUl2KupplK0Fl.n_kup_oeffnet_k0 "Zähler zur Verzögerung der Erkennung - Schaltelement nicht geschaltet" FLOAT32_IEEE UMR___1_1_0_S6_S3 1 100 0 255 FORMAT "%4.2" DISPLAY_IDENTIFIER n_kup_oeffnet_k0.iUl2KupplK0Fl ECU_ADDRESS 0xFFF8E894 /end MEASUREMENT
/begin MEASUREMENT iUl2KupplK0Fl.n_stoeredslogik_schwelle_k0 "Schwelle die Überschritten werden muss um die Kupplung als geschlossen zu erkennen" FLOAT32_IEEE UMR___1_1_0_S6_S3 1 100 0 510 FORMAT "%4.2" DISPLAY_IDENTIFIER n_stoeredslogik_schwelle_k0.iUl2KupplK0Fl ECU_ADDRESS 0xFFF8E898 /end MEASUREMENT
/begin MEASUREMENT iUl2KupplK0Fl.n_stoeredslogik_init_k0 "kleinster Wert auf KF_MAXSTOERCGDELTAI_EDSLOGIK_K0" FLOAT32_IEEE UMR___1_1_0_S6_S3 1 100 0 255 FORMAT "%4.2" DISPLAY_IDENTIFIER n_stoeredslogik_init_k0.iUl2KupplK0Fl ECU_ADDRESS 0xFFF8E89C /end MEASUREMENT
/begin MEASUREMENT iUl2KupplK0Fl.n_stoeredslogik_k0 "Stoerzaehler für falsch bestromte Kupplung" FLOAT32_IEEE UMR___1_1_0_S6_S3 1 100 0 65535 FORMAT "%4.2" DISPLAY_IDENTIFIER n_stoeredslogik_k0.iUl2KupplK0Fl ECU_ADDRESS 0xFFF8E8A0 /end MEASUREMENT
/begin MEASUREMENT iUl2KoordKupplInt.maxstoercgdeltai_edslogik_max "Liefert den größten Wert der in KF_MAXSTOERCGDELTAI_EDSLOGIK_x (X = Kupplung) bzgl. aller Kupplungen appliziert ist. Hier wird die K0, falls vorhanden nicht mitbetrachtet." UWORD UMR___1_1_0_S6_S3 1 100 0 65535 DISPLAY_IDENTIFIER maxstoercgdeltai_edslogik_max.iUl2KoordKupplInt ECU_ADDRESS 0xFFF8A238 /end MEASUREMENT
/begin MEASUREMENT iUl2KoordKupplInt.n_kup_zu_edslogik_summe "Der Zaehler zeigt die Anzahl der geschlossenen Kupplungen an. Darüber hinaus wird die Kupplung B als IAE bei einer applizierten Schwelle schon als geschlossen erkannt" UBYTE UMR___1_1_0_S6_S3 1 100 0 5 DISPLAY_IDENTIFIER n_kup_zu_edslogik_summe.iUl2KoordKupplInt ECU_ADDRESS 0xFFF8A23A /end MEASUREMENT
/begin MEASUREMENT iUl2KoordKupplInt.n_kup_zu_edslogik "Der Zaehler zeigt die Anzahl der geschlossenen Kupplungen an." UBYTE UMR___1_1_0_S6_S3 1 100 0 5 DISPLAY_IDENTIFIER n_kup_zu_edslogik.iUl2KoordKupplInt ECU_ADDRESS 0xFFF8A23B /end MEASUREMENT
/begin MEASUREMENT iUl2KoordKupplInt.fl_unplausi_edslogik "Der Zaehler zeigt die Anzahl der geschlossenen Kupplungen an." UBYTE UMR___1_1_0_S6_S3 1 100 0 1 BIT_MASK 0x1 DISPLAY_IDENTIFIER fl_unplausi_edslogik.iUl2KoordKupplInt ECU_ADDRESS 0xFFF8A23C /end MEASUREMENT
/begin MEASUREMENT iUl2KoordKupplFl.maxstoercgdeltai_edslogik_max "Liefert den größten Wert der in KF_MAXSTOERCGDELTAI_EDSLOGIK_x (X = Kupplung) bzgl. aller Kupplungen appliziert ist. Hier wird die K0, falls vorhanden nicht mitbetrachtet." FLOAT32_IEEE UMR___1_1_0_S6_S3 1 100 0 65535 FORMAT "%4.2" DISPLAY_IDENTIFIER maxstoercgdeltai_edslogik_max.iUl2KoordKupplFl ECU_ADDRESS 0xFFF8E8A4 /end MEASUREMENT
/begin MEASUREMENT iUl2KoordKupplFl.n_kup_zu_edslogik_summe "Der Zaehler zeigt die Anzahl der geschlossenen Kupplungen an. Darüber hinaus wird die Kupplung B als IAE bei einer applizierten Schwelle schon als geschlossen erkannt" FLOAT32_IEEE UMR___1_1_0_S6_S3 1 100 0 5 FORMAT "%4.2" DISPLAY_IDENTIFIER n_kup_zu_edslogik_summe.iUl2KoordKupplFl ECU_ADDRESS 0xFFF8E8A8 /end MEASUREMENT
/begin MEASUREMENT iUl2KoordKupplFl.n_kup_zu_edslogik "Der Zaehler zeigt die Anzahl der geschlossenen Kupplungen an. (nur K_A bis K_E)" FLOAT32_IEEE UMR___1_1_0_S6_S3 1 100 0 5 FORMAT "%4.2" DISPLAY_IDENTIFIER n_kup_zu_edslogik.iUl2KoordKupplFl ECU_ADDRESS 0xFFF8E8AC /end MEASUREMENT
/begin MEASUREMENT iUl2KoordKupplFl.fl_unplausi_edslogik "Der Zaehler zeigt die Anzahl der geschlossenen Kupplungen an." FLOAT32_IEEE UMR___1_1_0_S6_S3 1 100 0 1 FORMAT "%4.2" DISPLAY_IDENTIFIER fl_unplausi_edslogik.iUl2KoordKupplFl ECU_ADDRESS 0xFFF8E8B0 /end MEASUREMENT
/begin MEASUREMENT iUl2EdsSignalInt.posv_ueb_aktiv_l2 "Die Messgröße wird gesetzt, wenn alle Kupplungen mit, Ausnahme der Kupplung C geschaltet erkannt werden UND das und MV_POS UND der Parksperrenmagnet nicht angesteuert sind" UBYTE Conv.cUl2EdsSignalInt._.posv_ueb_aktiv_l2_S6_S3 1 100 0 1 DISPLAY_IDENTIFIER posv_ueb_aktiv_l2.iUl2EdsSignalInt ECU_ADDRESS 0xFFF8A258 /end MEASUREMENT
/begin MEASUREMENT iUl2EdsSignalInt.globale_einst_bed "Globale Einstiegsbedingung die für alle Überwachungsfunktionen gilt." UBYTE Conv.cUl2EdsSignalInt._.globale_einst_bed_S6_S3 1 100 0 1 DISPLAY_IDENTIFIER globale_einst_bed.iUl2EdsSignalInt ECU_ADDRESS 0xFFF8A259 /end MEASUREMENT
/begin MEASUREMENT iUl2EdsSignalInt.n_poskflwechsel_zaehler "Startet mit verlassen von D bzw. R" UWORD UMR___1_1_0_S6_S3 1 100 0 65535 DISPLAY_IDENTIFIER n_poskflwechsel_zaehler.iUl2EdsSignalInt ECU_ADDRESS 0xFFF8A25A /end MEASUREMENT
/begin MEASUREMENT iUl2EdsSignalInt.pos_alt "merkt sich die vorherige Position" UBYTE Conv.cUl2EdsSignalInt._.pos_alt_S6_S3 1 100 0 8 DISPLAY_IDENTIFIER pos_alt.iUl2EdsSignalInt ECU_ADDRESS 0xFFF8A25C /end MEASUREMENT
/begin MEASUREMENT iUl2EdsSignalFl.posv_ueb_aktiv_l2 "Die Messgröße wird gesetzt, wenn alle Kupplungen mit, Ausnahme der Kupplung C geschaltet erkannt werden UND das und MV_POS UND der Parksperrenmagnet nicht angesteuert sind" FLOAT32_IEEE Conv.cUl2EdsSignalFl._.posv_ueb_aktiv_l2_S6_S3 1 100 0 1 FORMAT "%4.2" DISPLAY_IDENTIFIER posv_ueb_aktiv_l2.iUl2EdsSignalFl ECU_ADDRESS 0xFFF8F1D8 /end MEASUREMENT
/begin MEASUREMENT iUl2EdsSignalFl.globale_einst_bed "Globale Einstiegsbedingung die für alle Überwachungsfunktionen gilt." FLOAT32_IEEE Conv.cUl2EdsSignalFl._.globale_einst_bed_S6_S3 1 100 0 1 FORMAT "%4.2" DISPLAY_IDENTIFIER globale_einst_bed.iUl2EdsSignalFl ECU_ADDRESS 0xFFF8F1DC /end MEASUREMENT
/begin MEASUREMENT iUl2EdsSignalFl.n_poskflwechsel_zaehler "Startet mit verlassen von D bzw. R" FLOAT32_IEEE UMR___1_1_0_S6_S3 1 100 0 65535 FORMAT "%4.2" DISPLAY_IDENTIFIER n_poskflwechsel_zaehler.iUl2EdsSignalFl ECU_ADDRESS 0xFFF8F1E0 /end MEASUREMENT
/begin MEASUREMENT iUl2EdsSignalFl.pos_alt "merkt sich die vorherige Position" FLOAT32_IEEE UMR___1_1_0_S6_S3 1 100 0 8 FORMAT "%4.2" DISPLAY_IDENTIFIER pos_alt.iUl2EdsSignalFl ECU_ADDRESS 0xFFF8F1E4 /end MEASUREMENT
/begin MEASUREMENT iUl2KraftschlussInt.n_maxkabpos_c_zaehler "Zähler der beim Öffnen der Kupplung C hochzählt" UWORD UMR___1_1_0_S6_S3 1 100 0 65535 DISPLAY_IDENTIFIER n_maxkabpos_c_zaehler.iUl2KraftschlussInt ECU_ADDRESS 0xFFF8A23E /end MEASUREMENT
/begin MEASUREMENT iUl2KraftschlussInt.n_maxkabpos_e_zaehler "Zähler der beim Öffnen der Kupplung E hochzählt" UWORD UMR___1_1_0_S6_S3 1 100 0 65535 DISPLAY_IDENTIFIER n_maxkabpos_e_zaehler.iUl2KraftschlussInt ECU_ADDRESS 0xFFF8A240 /end MEASUREMENT
/begin MEASUREMENT iUl2KraftschlussInt.kup_a_geschl "gibt an ob Kupplung A geschlossen ist" UBYTE Conv.cUl2KraftschlussInt._.kup_a_geschl_S6_S3 1 100 0 1 BIT_MASK 0x1 DISPLAY_IDENTIFIER kup_a_geschl.iUl2KraftschlussInt ECU_ADDRESS 0xFFF8A242 /end MEASUREMENT
/begin MEASUREMENT iUl2KraftschlussInt.kup_b_geschl "gibt an ob Kupplung B geschlossen ist" UBYTE Conv.cUl2KraftschlussInt._.kup_b_geschl_S6_S3 1 100 0 1 BIT_MASK 0x1 DISPLAY_IDENTIFIER kup_b_geschl.iUl2KraftschlussInt ECU_ADDRESS 0xFFF8A243 /end MEASUREMENT
/begin MEASUREMENT iUl2KraftschlussInt.kup_c_geschl "gibt an ob Kupplung C geschlossen ist" UBYTE Conv.cUl2KraftschlussInt._.kup_c_geschl_S6_S3 1 100 0 1 BIT_MASK 0x1 DISPLAY_IDENTIFIER kup_c_geschl.iUl2KraftschlussInt ECU_ADDRESS 0xFFF8A244 /end MEASUREMENT
/begin MEASUREMENT iUl2KraftschlussInt.kup_d_geschl "gibt an ob Kupplung D geschlossen ist" UBYTE Conv.cUl2KraftschlussInt._.kup_d_geschl_S6_S3 1 100 0 1 BIT_MASK 0x1 DISPLAY_IDENTIFIER kup_d_geschl.iUl2KraftschlussInt ECU_ADDRESS 0xFFF8A245 /end MEASUREMENT
/begin MEASUREMENT iUl2KraftschlussInt.kup_e_geschl "gibt an ob Kupplung E geschlossen ist" UBYTE Conv.cUl2KraftschlussInt._.kup_e_geschl_S6_S3 1 100 0 1 BIT_MASK 0x1 DISPLAY_IDENTIFIER kup_e_geschl.iUl2KraftschlussInt ECU_ADDRESS 0xFFF8A246 /end MEASUREMENT
/begin MEASUREMENT iUl2KraftschlussInt.n_verz_edslogik "Entprellzähler für Kraftschlusserkennung" UWORD UMR___1_1_0_S6_S3 1 100 0 65535 DISPLAY_IDENTIFIER n_verz_edslogik.iUl2KraftschlussInt ECU_ADDRESS 0xFFF8A248 /end MEASUREMENT
/begin MEASUREMENT iUl2KraftschlussInt.zustand "Speichert den aktuellen Kraftschlusszustand" UBYTE Conv.cUl2KraftschlussInt._.zustand_S6_S3 1 100 0 255 DISPLAY_IDENTIFIER zustand.iUl2KraftschlussInt ECU_ADDRESS 0xFFF8A24A /end MEASUREMENT
/begin MEASUREMENT iUl2KraftschlussInt.zustand_gespeichert "Speichert den alten Kraftschlusszustand" UBYTE Conv.cUl2KraftschlussInt._.zustand_gespeichert_S6_S3 1 100 0 255 DISPLAY_IDENTIFIER zustand_gespeichert.iUl2KraftschlussInt ECU_ADDRESS 0xFFF8A24B /end MEASUREMENT
/begin MEASUREMENT iUl2KraftschlussFl.n_maxkabpos_c_zaehler "Zähler der beim Öffnen der Kupplung C hochzählt" FLOAT32_IEEE UMR___1_1_0_S6_S3 1 100 0 65535 FORMAT "%4.2" DISPLAY_IDENTIFIER n_maxkabpos_c_zaehler.iUl2KraftschlussFl ECU_ADDRESS 0xFFF8EBF4 /end MEASUREMENT
/begin MEASUREMENT iUl2KraftschlussFl.n_maxkabpos_e_zaehler "Zähler der beim Öffnen der Kupplung E hochzählt" FLOAT32_IEEE UMR___1_1_0_S6_S3 1 100 0 65535 FORMAT "%4.2" DISPLAY_IDENTIFIER n_maxkabpos_e_zaehler.iUl2KraftschlussFl ECU_ADDRESS 0xFFF8EBF8 /end MEASUREMENT
/begin MEASUREMENT iUl2KraftschlussFl.kup_a_geschl "gibt an ob Kupplung A geschlossen ist" FLOAT32_IEEE UMR___1_1_0_S6_S3 1 100 0 1 FORMAT "%4.2" DISPLAY_IDENTIFIER kup_a_geschl.iUl2KraftschlussFl ECU_ADDRESS 0xFFF8EBFC /end MEASUREMENT
/begin MEASUREMENT iUl2KraftschlussFl.kup_b_geschl "gibt an ob Kupplung B geschlossen ist" FLOAT32_IEEE UMR___1_1_0_S6_S3 1 100 0 1 FORMAT "%4.2" DISPLAY_IDENTIFIER kup_b_geschl.iUl2KraftschlussFl ECU_ADDRESS 0xFFF8EC00 /end MEASUREMENT
/begin MEASUREMENT iUl2KraftschlussFl.kup_c_geschl "gibt an ob Kupplung B geschlossen ist" FLOAT32_IEEE UMR___1_1_0_S6_S3 1 100 0 1 FORMAT "%4.2" DISPLAY_IDENTIFIER kup_c_geschl.iUl2KraftschlussFl ECU_ADDRESS 0xFFF8EC04 /end MEASUREMENT
/begin MEASUREMENT iUl2KraftschlussFl.kup_d_geschl "gibt an ob Kupplung D geschlossen ist" FLOAT32_IEEE UMR___1_1_0_S6_S3 1 100 0 1 FORMAT "%4.2" DISPLAY_IDENTIFIER kup_d_geschl.iUl2KraftschlussFl ECU_ADDRESS 0xFFF8EC08 /end MEASUREMENT
/begin MEASUREMENT iUl2KraftschlussFl.kup_e_geschl "gibt an ob Kupplung E geschlossen ist" FLOAT32_IEEE UMR___1_1_0_S6_S3 1 100 0 1 FORMAT "%4.2" DISPLAY_IDENTIFIER kup_e_geschl.iUl2KraftschlussFl ECU_ADDRESS 0xFFF8EC0C /end MEASUREMENT
/begin MEASUREMENT iUl2KraftschlussFl.n_verz_edslogik "Entprellzähler für Kraftschlusserkennung" FLOAT32_IEEE UMR___1_1_0_S6_S3 1 100 0 65535 FORMAT "%4.2" DISPLAY_IDENTIFIER n_verz_edslogik.iUl2KraftschlussFl ECU_ADDRESS 0xFFF8EC10 /end MEASUREMENT
/begin MEASUREMENT iUl2KraftschlussFl.zustand "Speichert den aktuellen Kraftschlusszustand" FLOAT32_IEEE Conv.cUl2KraftschlussFl._.zustand_S6_S3 1 100 0 255 FORMAT "%4.2" DISPLAY_IDENTIFIER zustand.iUl2KraftschlussFl ECU_ADDRESS 0xFFF8EC14 /end MEASUREMENT
/begin MEASUREMENT iUl2KraftschlussFl.zustand_gespeichert "Speichert den alten Kraftschlusszustand" FLOAT32_IEEE Conv.cUl2KraftschlussFl._.zustand_gespeichert_S6_S3 1 100 0 255 FORMAT "%4.2" DISPLAY_IDENTIFIER zustand_gespeichert.iUl2KraftschlussFl ECU_ADDRESS 0xFFF8EC18 /end MEASUREMENT
/begin MEASUREMENT iUl2EdsLogikInt.n_zaehler_rueck "Zaehler zum Rückfiltern eines Fehlereintrags" UWORD UMR___1_1_0_S6_S3 1 100 0 32767 DISPLAY_IDENTIFIER n_zaehler_rueck.iUl2EdsLogikInt ECU_ADDRESS 0xFFF8F3D0 /end MEASUREMENT
/begin MEASUREMENT iUl2EdsLogikInt.fzg_geschwindigkeit_alt_l2 "alte Fahrzeuggeschwindigkeit, wenn fl_unplausi_edslogik gleich 1 ist" UWORD UMR_KM_H_1_1_0_S6_S3 1 100 0 400 DISPLAY_IDENTIFIER fzg_geschwindigkeit_alt_l2.iUl2EdsLogikInt ECU_ADDRESS 0xFFF8F3D2 /end MEASUREMENT
/begin MEASUREMENT iUl2EdsLogikFl.n_zaehler_rueck "Zaehler zum Rückfiltern eines Fehlereintrags" FLOAT32_IEEE UMR___1_1_0_S6_S3 1 100 0 32767 FORMAT "%4.2" DISPLAY_IDENTIFIER n_zaehler_rueck.iUl2EdsLogikFl ECU_ADDRESS 0xFFF8F3D4 /end MEASUREMENT
/begin MEASUREMENT iUl2EdsLogikFl.fzg_geschwindigkeit_alt_l2 "alte Fahrzeuggeschwindigkeit, wenn fl_unplausi_edslogik gleich 1 ist" FLOAT32_IEEE UMR_KM_H_1_1_0_S6_S3 1 100 0 400 DISPLAY_IDENTIFIER fzg_geschwindigkeit_alt_l2.iUl2EdsLogikFl ECU_ADDRESS 0xFFF8F3D8 /end MEASUREMENT
/begin MEASUREMENT iUl2AktuatorAnstDRInt.n_stoer_fahrtr_edslogik "Fehlerzaehler der Überwachungsfunktion" UWORD UMR___1_1_0_S6_S3 1 100 0 65535 DISPLAY_IDENTIFIER n_stoer_fahrtr_edslogik.iUl2AktuatorAnstDRInt ECU_ADDRESS 0xFFF8A27E /end MEASUREMENT
/begin MEASUREMENT iUl2AktuatorAnstDRInt.n_erfolg_fahrtr_edslogik "Erfolgszaehler der Überwachungsfunktion" UWORD UMR___1_1_0_S6_S3 1 100 0 65535 DISPLAY_IDENTIFIER n_erfolg_fahrtr_edslogik.iUl2AktuatorAnstDRInt ECU_ADDRESS 0xFFF8A280 /end MEASUREMENT
/begin MEASUREMENT iUl2AktuatorAnstDRInt.zustand "" UWORD Conv.cUl2AktuatorAnstDRInt._.zustand_S6_S3 1 100 0 3 DISPLAY_IDENTIFIER zustand.iUl2AktuatorAnstDRInt ECU_ADDRESS 0xFFF8A282 /end MEASUREMENT
/begin MEASUREMENT iUl2AktuatorAnstDRInt.timer_fahrtr_edslogik "Int Timer der Überwachungsfunktion Fahrrichtungsverwechsler" UWORD UMR___1_1_0_S6_S3 1 100 0 65535 DISPLAY_IDENTIFIER timer_fahrtr_edslogik.iUl2AktuatorAnstDRInt ECU_ADDRESS 0xFFF8A284 /end MEASUREMENT
/begin MEASUREMENT iUl2AktuatorAnstDRInt.fehler_i_gang "Flag gibt an, ob ein Fehler vorhanden ist." UBYTE Conv.cUl2AktuatorAnstDRInt._.fehler_i_gang_S6_S3 1 100 0 1 BIT_MASK 0x1 DISPLAY_IDENTIFIER fehler_i_gang.iUl2AktuatorAnstDRInt ECU_ADDRESS 0xFFF8A286 /end MEASUREMENT
/begin MEASUREMENT iUl2AktuatorAnstDRInt.pos_igang_wechsel "pos_l2 aus vorherigem Berechnungsschritt" UBYTE Conv.cUl2AktuatorAnstDRInt._.pos_igang_wechsel_S6_S3 1 100 0 12 DISPLAY_IDENTIFIER pos_igang_wechsel.iUl2AktuatorAnstDRInt ECU_ADDRESS 0xFFF8A287 /end MEASUREMENT
/begin MEASUREMENT iUl2AktuatorAnstDRInt.pos_l2_alt "pos_l2 aus vorherigem Berechnungsschritt" UBYTE Conv.cUl2AktuatorAnstDRInt._.pos_l2_alt_S6_S3 1 100 0 12 DISPLAY_IDENTIFIER pos_l2_alt.iUl2AktuatorAnstDRInt ECU_ADDRESS 0xFFF8A288 /end MEASUREMENT
/begin MEASUREMENT iUl2AktuatorAnstDRInt.init_igang_ungl_null "i_gang_lev2 Prüfung auf 0 Durchgang waehrend Ueberwachung" UBYTE Conv.cUl2AktuatorAnstDRInt._.init_igang_ungl_null_S6_S3 1 100 0 1 BIT_MASK 0x1 DISPLAY_IDENTIFIER init_igang_ungl_null.iUl2AktuatorAnstDRInt ECU_ADDRESS 0xFFF8A289 /end MEASUREMENT
/begin MEASUREMENT iUl2AktuatorAnstDRInt.stoerungen_pos "Anzahl pos_l2 ungleich pos Pruefungen waehrend Ueberwachung" UWORD UMR___1_1_0_S6_S3 1 100 0 1001 DISPLAY_IDENTIFIER stoerungen_pos.iUl2AktuatorAnstDRInt ECU_ADDRESS 0xFFF8A28A /end MEASUREMENT
/begin MEASUREMENT iUl2AktuatorAnstDRFl.n_stoer_fahrtr_edslogik "Fehlerzaehler der Überwachungsfunktion" FLOAT32_IEEE UMR___1_1_0_S6_S3 1 100 0 65535 FORMAT "%4.2" DISPLAY_IDENTIFIER n_stoer_fahrtr_edslogik.iUl2AktuatorAnstDRFl ECU_ADDRESS 0xFFF8F494 /end MEASUREMENT
/begin MEASUREMENT iUl2AktuatorAnstDRFl.n_erfolg_fahrtr_edslogik "Erfolgszaehler der Überwachungsfunktion" FLOAT32_IEEE UMR___1_1_0_S6_S3 1 100 0 65535 FORMAT "%4.2" DISPLAY_IDENTIFIER n_erfolg_fahrtr_edslogik.iUl2AktuatorAnstDRFl ECU_ADDRESS 0xFFF8F498 /end MEASUREMENT
/begin MEASUREMENT iUl2AktuatorAnstDRFl.zustand "" FLOAT32_IEEE UMR___1_1_0_S6_S3 1 100 0 3 FORMAT "%4.2" DISPLAY_IDENTIFIER zustand.iUl2AktuatorAnstDRFl ECU_ADDRESS 0xFFF8F49C /end MEASUREMENT
/begin MEASUREMENT iUl2AktuatorAnstDRFl.timer_fahrtr_edslogik "Float Timer der Überwachungsfunktion Fahrrichtungsverwechsler" FLOAT32_IEEE UMR___1_1_0_S6_S3 1 100 0 65535 FORMAT "%4.2" DISPLAY_IDENTIFIER timer_fahrtr_edslogik.iUl2AktuatorAnstDRFl ECU_ADDRESS 0xFFF8F4A0 /end MEASUREMENT
/begin MEASUREMENT iUl2AktuatorAnstDRFl.fehler_i_gang "Flag gibt an, ob ein Fehler vorhanden ist." FLOAT32_IEEE Conv.cUl2AktuatorAnstDRFl._.fehler_i_gang_S6_S3 1 100 0 1 FORMAT "%4.2" DISPLAY_IDENTIFIER fehler_i_gang.iUl2AktuatorAnstDRFl ECU_ADDRESS 0xFFF8F4A4 /end MEASUREMENT
/begin MEASUREMENT iUl2AktuatorAnstDRFl.pos_igang_wechsel "pos_l2 aus vorherigem Berechnungsschritt" FLOAT32_IEEE UMR___1_1_0_S6_S3 1 100 0 12 FORMAT "%4.2" DISPLAY_IDENTIFIER pos_igang_wechsel.iUl2AktuatorAnstDRFl ECU_ADDRESS 0xFFF8F4A8 /end MEASUREMENT
/begin MEASUREMENT iUl2AktuatorAnstDRFl.pos_l2_alt "Float pos_l2 aus vorherigem Berechnungsschritt" FLOAT32_IEEE UMR___1_1_0_S6_S3 1 100 0 12 FORMAT "%4.2" DISPLAY_IDENTIFIER pos_l2_alt.iUl2AktuatorAnstDRFl ECU_ADDRESS 0xFFF8F4AC /end MEASUREMENT
/begin MEASUREMENT iUl2AktuatorAnstDRFl.init_igang_ungl_null "i_gang_lev2 Prüfung auf 0 Durchgang waehrend Ueberwachung" FLOAT32_IEEE UMR___1_1_0_S6_S3 1 100 0 1 FORMAT "%4.2" DISPLAY_IDENTIFIER init_igang_ungl_null.iUl2AktuatorAnstDRFl ECU_ADDRESS 0xFFF8F4B0 /end MEASUREMENT
/begin MEASUREMENT iUl2AktuatorAnstDRFl.stoerungen_pos "Float Anzahl pos_l2 ungleich pos Pruefungen waehrend Ueberwachung" FLOAT32_IEEE UMR___1_1_0_S6_S3 1 100 0 1001 FORMAT "%4.2" DISPLAY_IDENTIFIER stoerungen_pos.iUl2AktuatorAnstDRFl ECU_ADDRESS 0xFFF8F4B4 /end MEASUREMENT
/begin MEASUREMENT iUl2PosAnstDRInt.n_erfolg_fahrtr_pos "Erfolgszähler bis der Fehler zurückgenommen werden kann." UWORD UMR___1_1_0_S6_S3 1 100 0 65535 DISPLAY_IDENTIFIER n_erfolg_fahrtr_pos.iUl2PosAnstDRInt ECU_ADDRESS 0xFFF8A28C /end MEASUREMENT
/begin MEASUREMENT iUl2PosAnstDRInt.n_stoer_fahrtr_pos "Stoerzaehler bis Fehlerreaktion beginnt." UWORD UMR___1_1_0_S6_S3 1 100 0 65535 DISPLAY_IDENTIFIER n_stoer_fahrtr_pos.iUl2PosAnstDRInt ECU_ADDRESS 0xFFF8A28E /end MEASUREMENT
/begin MEASUREMENT iUl2PosAnstDRInt.zustand "Zustand des Fahrtrichtungsverwechslers" UBYTE Conv.cUl2PosAnstDRInt._.zustand_S6_S3 1 100 0 255 DISPLAY_IDENTIFIER zustand.iUl2PosAnstDRInt ECU_ADDRESS 0xFFF8A290 /end MEASUREMENT
/begin MEASUREMENT iUl2PosAnstDRFl.n_erfolg_fahrtr_pos "Erfolgszähler bis der Fehler zurückgenommen werden kann." FLOAT32_IEEE UMR___1_1_0_S6_S3 1 100 0 65535 FORMAT "%4.2" DISPLAY_IDENTIFIER n_erfolg_fahrtr_pos.iUl2PosAnstDRFl ECU_ADDRESS 0xFFF8F4B8 /end MEASUREMENT
/begin MEASUREMENT iUl2PosAnstDRFl.n_stoer_fahrtr_pos "Stoerzaehler bis Fehlerreaktion beginnt." FLOAT32_IEEE UMR___1_1_0_S6_S3 1 100 0 65535 FORMAT "%4.2" DISPLAY_IDENTIFIER n_stoer_fahrtr_pos.iUl2PosAnstDRFl ECU_ADDRESS 0xFFF8F4BC /end MEASUREMENT
/begin MEASUREMENT iUl2PosAnstDRFl.zustand "Zustand des Fahrtrichtungsverwechslers" FLOAT32_IEEE UMR___1_1_0_S6_S3 1 100 0 2 FORMAT "%4.2" DISPLAY_IDENTIFIER zustand.iUl2PosAnstDRFl ECU_ADDRESS 0xFFF8F4C0 /end MEASUREMENT
/begin MEASUREMENT iUl2RGangSicherungInt.fl_rgang_erkannt "Flag Rueckwaerts erkannt" UBYTE Conv.cUl2RGangSicherungInt._.fl_rgang_erkannt_S6_S3 1 100 0 1 BIT_MASK 0x1 DISPLAY_IDENTIFIER fl_rgang_erkannt.iUl2RGangSicherungInt ECU_ADDRESS 0xFFF8A69B /end MEASUREMENT
/begin MEASUREMENT iUl2RGangSicherungFl.fl_rgang_erkannt "Flag Rueckwaerts erkannt" FLOAT32_IEEE UMR___1_1_0_S6_S3 1 100 0 1 FORMAT "%4.2" DISPLAY_IDENTIFIER fl_rgang_erkannt.iUl2RGangSicherungFl ECU_ADDRESS 0xFFF8F490 /end MEASUREMENT
/begin MEASUREMENT iUl2PAbsicherungEinlP.n_stoervplausipos_p "Störzähler für Ueberwachung unzulaessiges Auslegen Pos. P" UWORD UMR___1_1_0_S6_S3 1 100 0 256 DISPLAY_IDENTIFIER n_stoervplausipos_p.iUl2PAbsicherungEinlP ECU_ADDRESS 0xFFF8F48C /end MEASUREMENT
/begin MEASUREMENT iUl2PAbsicherungEinlP.n_richtigvplausipos_p "Gutzähler für Ueberwachung unzulaessiges Auslegen Pos. P" UWORD UMR___1_1_0_S6_S3 1 100 0 256 DISPLAY_IDENTIFIER n_richtigvplausipos_p.iUl2PAbsicherungEinlP ECU_ADDRESS 0xFFF8F48E /end MEASUREMENT
/begin MEASUREMENT iUl2PAbsicherungAuslPInt.einst_bed_einmalig "Wird auf 1 gesetzt wenn P u. Sensorsignal einmalig gesetzt sind u. wieder auf 0 wenn P ausgelegt wird" UBYTE Conv.cUl2PAbsicherungAuslPInt._.einst_bed_einmalig_S6_S3 1 100 0 1 DISPLAY_IDENTIFIER einst_bed_einmalig.iUl2PAbsicherungAuslPInt ECU_ADDRESS 0xFFF8F474 /end MEASUREMENT
/begin MEASUREMENT iUl2PAbsicherungAuslPInt.n_stoerpos_p "Stoerzaehler bis Fehlerreaktion beginnt." UWORD UMR___1_1_0_S6_S3 1 100 0 256 DISPLAY_IDENTIFIER n_stoerpos_p.iUl2PAbsicherungAuslPInt ECU_ADDRESS 0xFFF8F476 /end MEASUREMENT
/begin MEASUREMENT iUl2PAbsicherungAuslPInt.n_richtigpos_p "Gutzähler bis Fehlerreaktion zurückgenommen wird." UWORD UMR___1_1_0_S6_S3 1 100 0 256 DISPLAY_IDENTIFIER n_richtigpos_p.iUl2PAbsicherungAuslPInt ECU_ADDRESS 0xFFF8F478 /end MEASUREMENT
/begin MEASUREMENT iUl2PAbsicherungAuslPInt.n_vpospueb "Verzögerungszähler, der mit dem Wechsel auf pos_l2 startet" UWORD UMR___1_1_0_S6_S3 1 100 0 65535 DISPLAY_IDENTIFIER n_vpospueb.iUl2PAbsicherungAuslPInt ECU_ADDRESS 0xFFF8F47A /end MEASUREMENT
/begin MEASUREMENT iUl2PAbsicherungAuslPFl.einst_bed_einmalig "Wird auf 1 gesetzt wenn P u. Sensorsignal einmalig gesetzt sind u. wieder auf 0 wenn P ausgelegt wird" FLOAT32_IEEE Conv.cUl2PAbsicherungAuslPFl._.einst_bed_einmalig_S6_S3 1 100 0 1 FORMAT "%4.2" DISPLAY_IDENTIFIER einst_bed_einmalig.iUl2PAbsicherungAuslPFl ECU_ADDRESS 0xFFF8F47C /end MEASUREMENT
/begin MEASUREMENT iUl2PAbsicherungAuslPFl.n_stoerpos_p "Stoerzaehler bis Fehlerreaktion beginnt." FLOAT32_IEEE UMR___1_1_0_S6_S3 1 100 0 256 FORMAT "%4.2" DISPLAY_IDENTIFIER n_stoerpos_p.iUl2PAbsicherungAuslPFl ECU_ADDRESS 0xFFF8F480 /end MEASUREMENT
/begin MEASUREMENT iUl2PAbsicherungAuslPFl.n_richtigpos_p "Gutzähler bis Fehlerreaktion zurückgenommen wird." FLOAT32_IEEE UMR___1_1_0_S6_S3 1 100 0 256 FORMAT "%4.2" DISPLAY_IDENTIFIER n_richtigpos_p.iUl2PAbsicherungAuslPFl ECU_ADDRESS 0xFFF8F484 /end MEASUREMENT
/begin MEASUREMENT iUl2PAbsicherungAuslPFl.n_vpospueb "Verzögerungszähler, der mit dem Wechsel auf pos_l2 startet" FLOAT32_IEEE UMR___1_1_0_S6_S3 1 100 0 65535 FORMAT "%4.2" DISPLAY_IDENTIFIER n_vpospueb.iUl2PAbsicherungAuslPFl ECU_ADDRESS 0xFFF8F488 /end MEASUREMENT
/begin MEASUREMENT iUl2EdsKAInt.cUl2EdsBasisInt._.strom "Nummer der EDS" UWORD UMR_MA__1_10_0_S6_S3 1 100 0 1200 DISPLAY_IDENTIFIER strom._.cUl2EdsBasisInt.iUl2EdsKAInt ECU_ADDRESS 0xFFF8DE2C /end MEASUREMENT
/begin MEASUREMENT iUl2EdsKAInt.cUl2EdsBasisInt._.strom_alt "alter Stromwert der EDS" UWORD UMR_MA__1_10_0_S6_S3 1 100 0 1200 DISPLAY_IDENTIFIER strom_alt._.cUl2EdsBasisInt.iUl2EdsKAInt ECU_ADDRESS 0xFFF8DE2E /end MEASUREMENT
/begin MEASUREMENT iUl2EdsKAInt.type "Nummer der EDS" UBYTE Conv.cUl2HydEdsInt._.type_S6_S3 1 100 0 1 DISPLAY_IDENTIFIER type.iUl2EdsKAInt ECU_ADDRESS 0xFFF8DE34 /end MEASUREMENT
/begin MEASUREMENT iUl2EdsKAFl.cUl2EdsBasisFl._.strom "Nummer der EDS" FLOAT32_IEEE UMR_MA__1_10_0_S6_S3 1 100 0 1200 DISPLAY_IDENTIFIER strom._.cUl2EdsBasisFl.iUl2EdsKAFl ECU_ADDRESS 0xFFF8DE38 /end MEASUREMENT
/begin MEASUREMENT iUl2EdsKAFl.cUl2EdsBasisFl._.strom_alt "Nummer der EDS" FLOAT32_IEEE UMR_MA__1_10_0_S6_S3 1 100 0 1200 DISPLAY_IDENTIFIER strom_alt._.cUl2EdsBasisFl.iUl2EdsKAFl ECU_ADDRESS 0xFFF8DE3C /end MEASUREMENT
/begin MEASUREMENT iUl2EdsKAFl.type "Nummer der EDS" FLOAT32_IEEE UMR___1_1_0_S6_S3 1 100 0 1 FORMAT "%4.2" DISPLAY_IDENTIFIER type.iUl2EdsKAFl ECU_ADDRESS 0xFFF8DE44 /end MEASUREMENT
/begin MEASUREMENT iUl2EdsKAMittelInt.cUl2EdsBasisInt._.strom "Nummer der EDS" UWORD UMR_MA__1_10_0_S6_S3 1 100 0 1200 DISPLAY_IDENTIFIER strom._.cUl2EdsBasisInt.iUl2EdsKAMittelInt ECU_ADDRESS 0xFFF8DE48 /end MEASUREMENT
/begin MEASUREMENT iUl2EdsKAMittelInt.cUl2EdsBasisInt._.strom_alt "alter Stromwert der EDS" UWORD UMR_MA__1_10_0_S6_S3 1 100 0 1200 DISPLAY_IDENTIFIER strom_alt._.cUl2EdsBasisInt.iUl2EdsKAMittelInt ECU_ADDRESS 0xFFF8DE4A /end MEASUREMENT
/begin MEASUREMENT iUl2EdsKAMittelInt.type "Nummer der EDS" UBYTE Conv.cUl2HydEdsInt._.type_S6_S3 1 100 0 1 DISPLAY_IDENTIFIER type.iUl2EdsKAMittelInt ECU_ADDRESS 0xFFF8DE50 /end MEASUREMENT
/begin MEASUREMENT iUl2EdsKAMittelFl.cUl2EdsBasisFl._.strom "Nummer der EDS" FLOAT32_IEEE UMR_MA__1_10_0_S6_S3 1 100 0 1200 DISPLAY_IDENTIFIER strom._.cUl2EdsBasisFl.iUl2EdsKAMittelFl ECU_ADDRESS 0xFFF8DE54 /end MEASUREMENT
/begin MEASUREMENT iUl2EdsKAMittelFl.cUl2EdsBasisFl._.strom_alt "Nummer der EDS" FLOAT32_IEEE UMR_MA__1_10_0_S6_S3 1 100 0 1200 DISPLAY_IDENTIFIER strom_alt._.cUl2EdsBasisFl.iUl2EdsKAMittelFl ECU_ADDRESS 0xFFF8DE58 /end MEASUREMENT
/begin MEASUREMENT iUl2EdsKAMittelFl.type "Nummer der EDS" FLOAT32_IEEE UMR___1_1_0_S6_S3 1 100 0 1 FORMAT "%4.2" DISPLAY_IDENTIFIER type.iUl2EdsKAMittelFl ECU_ADDRESS 0xFFF8DE60 /end MEASUREMENT
/begin MEASUREMENT iUl2EdsKBInt.cUl2EdsBasisInt._.strom "Nummer der EDS" UWORD UMR_MA__1_10_0_S6_S3 1 100 0 1200 DISPLAY_IDENTIFIER strom._.cUl2EdsBasisInt.iUl2EdsKBInt ECU_ADDRESS 0xFFF8DE64 /end MEASUREMENT
/begin MEASUREMENT iUl2EdsKBInt.cUl2EdsBasisInt._.strom_alt "alter Stromwert der EDS" UWORD UMR_MA__1_10_0_S6_S3 1 100 0 1200 DISPLAY_IDENTIFIER strom_alt._.cUl2EdsBasisInt.iUl2EdsKBInt ECU_ADDRESS 0xFFF8DE66 /end MEASUREMENT
/begin MEASUREMENT iUl2EdsKBInt.type "Nummer der EDS" UBYTE Conv.cUl2HydEdsInt._.type_S6_S3 1 100 0 1 DISPLAY_IDENTIFIER type.iUl2EdsKBInt ECU_ADDRESS 0xFFF8DE6C /end MEASUREMENT
/begin MEASUREMENT iUl2EdsKBFl.cUl2EdsBasisFl._.strom "Nummer der EDS" FLOAT32_IEEE UMR_MA__1_10_0_S6_S3 1 100 0 1200 DISPLAY_IDENTIFIER strom._.cUl2EdsBasisFl.iUl2EdsKBFl ECU_ADDRESS 0xFFF8DE70 /end MEASUREMENT
/begin MEASUREMENT iUl2EdsKBFl.cUl2EdsBasisFl._.strom_alt "Nummer der EDS" FLOAT32_IEEE UMR_MA__1_10_0_S6_S3 1 100 0 1200 DISPLAY_IDENTIFIER strom_alt._.cUl2EdsBasisFl.iUl2EdsKBFl ECU_ADDRESS 0xFFF8DE74 /end MEASUREMENT
/begin MEASUREMENT iUl2EdsKBFl.type "Nummer der EDS" FLOAT32_IEEE UMR___1_1_0_S6_S3 1 100 0 1 FORMAT "%4.2" DISPLAY_IDENTIFIER type.iUl2EdsKBFl ECU_ADDRESS 0xFFF8DE7C /end MEASUREMENT
/begin MEASUREMENT iUl2EdsKBMittelInt.cUl2EdsBasisInt._.strom "Nummer der EDS" UWORD UMR_MA__1_10_0_S6_S3 1 100 0 1200 DISPLAY_IDENTIFIER strom._.cUl2EdsBasisInt.iUl2EdsKBMittelInt ECU_ADDRESS 0xFFF8DE80 /end MEASUREMENT
/begin MEASUREMENT iUl2EdsKBMittelInt.cUl2EdsBasisInt._.strom_alt "alter Stromwert der EDS" UWORD UMR_MA__1_10_0_S6_S3 1 100 0 1200 DISPLAY_IDENTIFIER strom_alt._.cUl2EdsBasisInt.iUl2EdsKBMittelInt ECU_ADDRESS 0xFFF8DE82 /end MEASUREMENT
/begin MEASUREMENT iUl2EdsKBMittelInt.type "Nummer der EDS" UBYTE Conv.cUl2HydEdsInt._.type_S6_S3 1 100 0 1 DISPLAY_IDENTIFIER type.iUl2EdsKBMittelInt ECU_ADDRESS 0xFFF8DE88 /end MEASUREMENT
/begin MEASUREMENT iUl2EdsKBMittelFl.cUl2EdsBasisFl._.strom "Nummer der EDS" FLOAT32_IEEE UMR_MA__1_10_0_S6_S3 1 100 0 1200 DISPLAY_IDENTIFIER strom._.cUl2EdsBasisFl.iUl2EdsKBMittelFl ECU_ADDRESS 0xFFF8DE8C /end MEASUREMENT
/begin MEASUREMENT iUl2EdsKBMittelFl.cUl2EdsBasisFl._.strom_alt "Nummer der EDS" FLOAT32_IEEE UMR_MA__1_10_0_S6_S3 1 100 0 1200 DISPLAY_IDENTIFIER strom_alt._.cUl2EdsBasisFl.iUl2EdsKBMittelFl ECU_ADDRESS 0xFFF8DE90 /end MEASUREMENT
/begin MEASUREMENT iUl2EdsKBMittelFl.type "Nummer der EDS" FLOAT32_IEEE UMR___1_1_0_S6_S3 1 100 0 1 FORMAT "%4.2" DISPLAY_IDENTIFIER type.iUl2EdsKBMittelFl ECU_ADDRESS 0xFFF8DE98 /end MEASUREMENT
/begin MEASUREMENT iUl2EdsKCInt.cUl2EdsBasisInt._.strom "Nummer der EDS" UWORD UMR_MA__1_10_0_S6_S3 1 100 0 1200 DISPLAY_IDENTIFIER strom._.cUl2EdsBasisInt.iUl2EdsKCInt ECU_ADDRESS 0xFFF8DE9C /end MEASUREMENT
/begin MEASUREMENT iUl2EdsKCInt.cUl2EdsBasisInt._.strom_alt "alter Stromwert der EDS" UWORD UMR_MA__1_10_0_S6_S3 1 100 0 1200 DISPLAY_IDENTIFIER strom_alt._.cUl2EdsBasisInt.iUl2EdsKCInt ECU_ADDRESS 0xFFF8DE9E /end MEASUREMENT
/begin MEASUREMENT iUl2EdsKCInt.type "Nummer der EDS" UBYTE Conv.cUl2HydEdsInt._.type_S6_S3 1 100 0 1 DISPLAY_IDENTIFIER type.iUl2EdsKCInt ECU_ADDRESS 0xFFF8DEA4 /end MEASUREMENT
/begin MEASUREMENT iUl2EdsKCFl.cUl2EdsBasisFl._.strom "Nummer der EDS" FLOAT32_IEEE UMR_MA__1_10_0_S6_S3 1 100 0 1200 DISPLAY_IDENTIFIER strom._.cUl2EdsBasisFl.iUl2EdsKCFl ECU_ADDRESS 0xFFF8DEA8 /end MEASUREMENT
/begin MEASUREMENT iUl2EdsKCFl.cUl2EdsBasisFl._.strom_alt "Nummer der EDS" FLOAT32_IEEE UMR_MA__1_10_0_S6_S3 1 100 0 1200 DISPLAY_IDENTIFIER strom_alt._.cUl2EdsBasisFl.iUl2EdsKCFl ECU_ADDRESS 0xFFF8DEAC /end MEASUREMENT
/begin MEASUREMENT iUl2EdsKCFl.type "Nummer der EDS" FLOAT32_IEEE UMR___1_1_0_S6_S3 1 100 0 1 FORMAT "%4.2" DISPLAY_IDENTIFIER type.iUl2EdsKCFl ECU_ADDRESS 0xFFF8DEB4 /end MEASUREMENT
/begin MEASUREMENT iUl2EdsKCMittelInt.cUl2EdsBasisInt._.strom "Nummer der EDS" UWORD UMR_MA__1_10_0_S6_S3 1 100 0 1200 DISPLAY_IDENTIFIER strom._.cUl2EdsBasisInt.iUl2EdsKCMittelInt ECU_ADDRESS 0xFFF8DEB8 /end MEASUREMENT
/begin MEASUREMENT iUl2EdsKCMittelInt.cUl2EdsBasisInt._.strom_alt "alter Stromwert der EDS" UWORD UMR_MA__1_10_0_S6_S3 1 100 0 1200 DISPLAY_IDENTIFIER strom_alt._.cUl2EdsBasisInt.iUl2EdsKCMittelInt ECU_ADDRESS 0xFFF8DEBA /end MEASUREMENT
/begin MEASUREMENT iUl2EdsKCMittelInt.type "Nummer der EDS" UBYTE Conv.cUl2HydEdsInt._.type_S6_S3 1 100 0 1 DISPLAY_IDENTIFIER type.iUl2EdsKCMittelInt ECU_ADDRESS 0xFFF8DEC0 /end MEASUREMENT
/begin MEASUREMENT iUl2EdsKCMittelFl.cUl2EdsBasisFl._.strom "Nummer der EDS" FLOAT32_IEEE UMR_MA__1_10_0_S6_S3 1 100 0 1200 DISPLAY_IDENTIFIER strom._.cUl2EdsBasisFl.iUl2EdsKCMittelFl ECU_ADDRESS 0xFFF8DEC4 /end MEASUREMENT
/begin MEASUREMENT iUl2EdsKCMittelFl.cUl2EdsBasisFl._.strom_alt "Nummer der EDS" FLOAT32_IEEE UMR_MA__1_10_0_S6_S3 1 100 0 1200 DISPLAY_IDENTIFIER strom_alt._.cUl2EdsBasisFl.iUl2EdsKCMittelFl ECU_ADDRESS 0xFFF8DEC8 /end MEASUREMENT
/begin MEASUREMENT iUl2EdsKCMittelFl.type "Nummer der EDS" FLOAT32_IEEE UMR___1_1_0_S6_S3 1 100 0 1 FORMAT "%4.2" DISPLAY_IDENTIFIER type.iUl2EdsKCMittelFl ECU_ADDRESS 0xFFF8DED0 /end MEASUREMENT
/begin MEASUREMENT iUl2EdsKDInt.cUl2EdsBasisInt._.strom "Nummer der EDS" UWORD UMR_MA__1_10_0_S6_S3 1 100 0 1200 DISPLAY_IDENTIFIER strom._.cUl2EdsBasisInt.iUl2EdsKDInt ECU_ADDRESS 0xFFF8DED4 /end MEASUREMENT
/begin MEASUREMENT iUl2EdsKDInt.cUl2EdsBasisInt._.strom_alt "alter Stromwert der EDS" UWORD UMR_MA__1_10_0_S6_S3 1 100 0 1200 DISPLAY_IDENTIFIER strom_alt._.cUl2EdsBasisInt.iUl2EdsKDInt ECU_ADDRESS 0xFFF8DED6 /end MEASUREMENT
/begin MEASUREMENT iUl2EdsKDInt.type "Nummer der EDS" UBYTE Conv.cUl2HydEdsInt._.type_S6_S3 1 100 0 1 DISPLAY_IDENTIFIER type.iUl2EdsKDInt ECU_ADDRESS 0xFFF8DEDC /end MEASUREMENT
/begin MEASUREMENT iUl2EdsKDFl.cUl2EdsBasisFl._.strom "Nummer der EDS" FLOAT32_IEEE UMR_MA__1_10_0_S6_S3 1 100 0 1200 DISPLAY_IDENTIFIER strom._.cUl2EdsBasisFl.iUl2EdsKDFl ECU_ADDRESS 0xFFF8DEE0 /end MEASUREMENT
/begin MEASUREMENT iUl2EdsKDFl.cUl2EdsBasisFl._.strom_alt "Nummer der EDS" FLOAT32_IEEE UMR_MA__1_10_0_S6_S3 1 100 0 1200 DISPLAY_IDENTIFIER strom_alt._.cUl2EdsBasisFl.iUl2EdsKDFl ECU_ADDRESS 0xFFF8DEE4 /end MEASUREMENT
/begin MEASUREMENT iUl2EdsKDFl.type "Nummer der EDS" FLOAT32_IEEE UMR___1_1_0_S6_S3 1 100 0 1 FORMAT "%4.2" DISPLAY_IDENTIFIER type.iUl2EdsKDFl ECU_ADDRESS 0xFFF8DEEC /end MEASUREMENT
/begin MEASUREMENT iUl2EdsKDMittelInt.cUl2EdsBasisInt._.strom "Nummer der EDS" UWORD UMR_MA__1_10_0_S6_S3 1 100 0 1200 DISPLAY_IDENTIFIER strom._.cUl2EdsBasisInt.iUl2EdsKDMittelInt ECU_ADDRESS 0xFFF8DEF0 /end MEASUREMENT
/begin MEASUREMENT iUl2EdsKDMittelInt.cUl2EdsBasisInt._.strom_alt "alter Stromwert der EDS" UWORD UMR_MA__1_10_0_S6_S3 1 100 0 1200 DISPLAY_IDENTIFIER strom_alt._.cUl2EdsBasisInt.iUl2EdsKDMittelInt ECU_ADDRESS 0xFFF8DEF2 /end MEASUREMENT
/begin MEASUREMENT iUl2EdsKDMittelInt.type "Nummer der EDS" UBYTE Conv.cUl2HydEdsInt._.type_S6_S3 1 100 0 1 DISPLAY_IDENTIFIER type.iUl2EdsKDMittelInt ECU_ADDRESS 0xFFF8DEF8 /end MEASUREMENT
/begin MEASUREMENT iUl2EdsKDMittelFl.cUl2EdsBasisFl._.strom "Nummer der EDS" FLOAT32_IEEE UMR_MA__1_10_0_S6_S3 1 100 0 1200 DISPLAY_IDENTIFIER strom._.cUl2EdsBasisFl.iUl2EdsKDMittelFl ECU_ADDRESS 0xFFF8DEFC /end MEASUREMENT
/begin MEASUREMENT iUl2EdsKDMittelFl.cUl2EdsBasisFl._.strom_alt "Nummer der EDS" FLOAT32_IEEE UMR_MA__1_10_0_S6_S3 1 100 0 1200 DISPLAY_IDENTIFIER strom_alt._.cUl2EdsBasisFl.iUl2EdsKDMittelFl ECU_ADDRESS 0xFFF8DF00 /end MEASUREMENT
/begin MEASUREMENT iUl2EdsKDMittelFl.type "Nummer der EDS" FLOAT32_IEEE UMR___1_1_0_S6_S3 1 100 0 1 FORMAT "%4.2" DISPLAY_IDENTIFIER type.iUl2EdsKDMittelFl ECU_ADDRESS 0xFFF8DF08 /end MEASUREMENT
/begin MEASUREMENT iUl2EdsKEInt.cUl2EdsBasisInt._.strom "Nummer der EDS" UWORD UMR_MA__1_10_0_S6_S3 1 100 0 1200 DISPLAY_IDENTIFIER strom._.cUl2EdsBasisInt.iUl2EdsKEInt ECU_ADDRESS 0xFFF8DF0C /end MEASUREMENT
/begin MEASUREMENT iUl2EdsKEInt.cUl2EdsBasisInt._.strom_alt "alter Stromwert der EDS" UWORD UMR_MA__1_10_0_S6_S3 1 100 0 1200 DISPLAY_IDENTIFIER strom_alt._.cUl2EdsBasisInt.iUl2EdsKEInt ECU_ADDRESS 0xFFF8DF0E /end MEASUREMENT
/begin MEASUREMENT iUl2EdsKEInt.type "Nummer der EDS" UBYTE Conv.cUl2HydEdsInt._.type_S6_S3 1 100 0 1 DISPLAY_IDENTIFIER type.iUl2EdsKEInt ECU_ADDRESS 0xFFF8DF14 /end MEASUREMENT
/begin MEASUREMENT iUl2EdsKEFl.cUl2EdsBasisFl._.strom "Nummer der EDS" FLOAT32_IEEE UMR_MA__1_10_0_S6_S3 1 100 0 1200 DISPLAY_IDENTIFIER strom._.cUl2EdsBasisFl.iUl2EdsKEFl ECU_ADDRESS 0xFFF8DF18 /end MEASUREMENT
/begin MEASUREMENT iUl2EdsKEFl.cUl2EdsBasisFl._.strom_alt "Nummer der EDS" FLOAT32_IEEE UMR_MA__1_10_0_S6_S3 1 100 0 1200 DISPLAY_IDENTIFIER strom_alt._.cUl2EdsBasisFl.iUl2EdsKEFl ECU_ADDRESS 0xFFF8DF1C /end MEASUREMENT
/begin MEASUREMENT iUl2EdsKEFl.type "Nummer der EDS" FLOAT32_IEEE UMR___1_1_0_S6_S3 1 100 0 1 FORMAT "%4.2" DISPLAY_IDENTIFIER type.iUl2EdsKEFl ECU_ADDRESS 0xFFF8DF24 /end MEASUREMENT
/begin MEASUREMENT iUl2EdsKEMittelInt.cUl2EdsBasisInt._.strom "Nummer der EDS" UWORD UMR_MA__1_10_0_S6_S3 1 100 0 1200 DISPLAY_IDENTIFIER strom._.cUl2EdsBasisInt.iUl2EdsKEMittelInt ECU_ADDRESS 0xFFF8DF28 /end MEASUREMENT
/begin MEASUREMENT iUl2EdsKEMittelInt.cUl2EdsBasisInt._.strom_alt "alter Stromwert der EDS" UWORD UMR_MA__1_10_0_S6_S3 1 100 0 1200 DISPLAY_IDENTIFIER strom_alt._.cUl2EdsBasisInt.iUl2EdsKEMittelInt ECU_ADDRESS 0xFFF8DF2A /end MEASUREMENT
/begin MEASUREMENT iUl2EdsKEMittelInt.type "Nummer der EDS" UBYTE Conv.cUl2HydEdsInt._.type_S6_S3 1 100 0 1 DISPLAY_IDENTIFIER type.iUl2EdsKEMittelInt ECU_ADDRESS 0xFFF8DF30 /end MEASUREMENT
/begin MEASUREMENT iUl2EdsKEMittelFl.cUl2EdsBasisFl._.strom "Nummer der EDS" FLOAT32_IEEE UMR_MA__1_10_0_S6_S3 1 100 0 1200 DISPLAY_IDENTIFIER strom._.cUl2EdsBasisFl.iUl2EdsKEMittelFl ECU_ADDRESS 0xFFF8DF34 /end MEASUREMENT
/begin MEASUREMENT iUl2EdsKEMittelFl.cUl2EdsBasisFl._.strom_alt "Nummer der EDS" FLOAT32_IEEE UMR_MA__1_10_0_S6_S3 1 100 0 1200 DISPLAY_IDENTIFIER strom_alt._.cUl2EdsBasisFl.iUl2EdsKEMittelFl ECU_ADDRESS 0xFFF8DF38 /end MEASUREMENT
/begin MEASUREMENT iUl2EdsKEMittelFl.type "Nummer der EDS" FLOAT32_IEEE UMR___1_1_0_S6_S3 1 100 0 1 FORMAT "%4.2" DISPLAY_IDENTIFIER type.iUl2EdsKEMittelFl ECU_ADDRESS 0xFFF8DF40 /end MEASUREMENT
/begin MEASUREMENT iUl2EdsKK0Int.cUl2EdsBasisInt._.strom "Nummer der EDS" UWORD UMR_MA__1_10_0_S6_S3 1 100 0 1200 DISPLAY_IDENTIFIER strom._.cUl2EdsBasisInt.iUl2EdsKK0Int ECU_ADDRESS 0xFFF8DF44 /end MEASUREMENT
/begin MEASUREMENT iUl2EdsKK0Int.cUl2EdsBasisInt._.strom_alt "alter Stromwert der EDS" UWORD UMR_MA__1_10_0_S6_S3 1 100 0 1200 DISPLAY_IDENTIFIER strom_alt._.cUl2EdsBasisInt.iUl2EdsKK0Int ECU_ADDRESS 0xFFF8DF46 /end MEASUREMENT
/begin MEASUREMENT iUl2EdsKK0Int.type "Nummer der EDS" UBYTE Conv.cUl2HydEdsInt._.type_S6_S3 1 100 0 1 DISPLAY_IDENTIFIER type.iUl2EdsKK0Int ECU_ADDRESS 0xFFF8DF4C /end MEASUREMENT
/begin MEASUREMENT iUl2EdsKK0Fl.cUl2EdsBasisFl._.strom "Nummer der EDS" FLOAT32_IEEE UMR_MA__1_10_0_S6_S3 1 100 0 1200 DISPLAY_IDENTIFIER strom._.cUl2EdsBasisFl.iUl2EdsKK0Fl ECU_ADDRESS 0xFFF8DF50 /end MEASUREMENT
/begin MEASUREMENT iUl2EdsKK0Fl.cUl2EdsBasisFl._.strom_alt "Nummer der EDS" FLOAT32_IEEE UMR_MA__1_10_0_S6_S3 1 100 0 1200 DISPLAY_IDENTIFIER strom_alt._.cUl2EdsBasisFl.iUl2EdsKK0Fl ECU_ADDRESS 0xFFF8DF54 /end MEASUREMENT
/begin MEASUREMENT iUl2EdsKK0Fl.type "Nummer der EDS" FLOAT32_IEEE UMR___1_1_0_S6_S3 1 100 0 1 FORMAT "%4.2" DISPLAY_IDENTIFIER type.iUl2EdsKK0Fl ECU_ADDRESS 0xFFF8DF5C /end MEASUREMENT
/begin MEASUREMENT iUl2EdsPosInt.cUl2EdsBasisInt._.strom "Nummer der EDS" UWORD UMR_MA__1_10_0_S6_S3 1 100 0 1200 DISPLAY_IDENTIFIER strom._.cUl2EdsBasisInt.iUl2EdsPosInt ECU_ADDRESS 0xFFF8DF60 /end MEASUREMENT
/begin MEASUREMENT iUl2EdsPosInt.cUl2EdsBasisInt._.strom_alt "alter Stromwert der EDS" UWORD UMR_MA__1_10_0_S6_S3 1 100 0 1200 DISPLAY_IDENTIFIER strom_alt._.cUl2EdsBasisInt.iUl2EdsPosInt ECU_ADDRESS 0xFFF8DF62 /end MEASUREMENT
/begin MEASUREMENT iUl2EdsPosInt.type "Nummer der EDS" UBYTE Conv.cUl2HydEdsInt._.type_S6_S3 1 100 0 1 DISPLAY_IDENTIFIER type.iUl2EdsPosInt ECU_ADDRESS 0xFFF8DF68 /end MEASUREMENT
/begin MEASUREMENT iUl2EdsPosFl.cUl2EdsBasisFl._.strom "Nummer der EDS" FLOAT32_IEEE UMR_MA__1_10_0_S6_S3 1 100 0 1200 DISPLAY_IDENTIFIER strom._.cUl2EdsBasisFl.iUl2EdsPosFl ECU_ADDRESS 0xFFF8DF6C /end MEASUREMENT
/begin MEASUREMENT iUl2EdsPosFl.cUl2EdsBasisFl._.strom_alt "Nummer der EDS" FLOAT32_IEEE UMR_MA__1_10_0_S6_S3 1 100 0 1200 DISPLAY_IDENTIFIER strom_alt._.cUl2EdsBasisFl.iUl2EdsPosFl ECU_ADDRESS 0xFFF8DF70 /end MEASUREMENT
/begin MEASUREMENT iUl2EdsPosFl.type "Nummer der EDS" FLOAT32_IEEE UMR___1_1_0_S6_S3 1 100 0 1 FORMAT "%4.2" DISPLAY_IDENTIFIER type.iUl2EdsPosFl ECU_ADDRESS 0xFFF8DF78 /end MEASUREMENT
/begin MEASUREMENT iUl2MvPZylInt.cUl2EdsBasisInt._.strom "Nummer der EDS" UWORD UMR_MA__1_10_0_S6_S3 1 100 0 1200 DISPLAY_IDENTIFIER strom._.cUl2EdsBasisInt.iUl2MvPZylInt ECU_ADDRESS 0xFFF8DF7C /end MEASUREMENT
/begin MEASUREMENT iUl2MvPZylInt.cUl2EdsBasisInt._.strom_alt "alter Stromwert der EDS" UWORD UMR_MA__1_10_0_S6_S3 1 100 0 1200 DISPLAY_IDENTIFIER strom_alt._.cUl2EdsBasisInt.iUl2MvPZylInt ECU_ADDRESS 0xFFF8DF7E /end MEASUREMENT
/begin MEASUREMENT iUl2MvPZylInt.flanke "Gibt an ob der Sensor offen, geschlossen oder in einen der Beiden Zustände wechselt." UBYTE Conv.cUl2HydMvInt._.flanke_S6_S3 1 100 0 2 DISPLAY_IDENTIFIER flanke.iUl2MvPZylInt ECU_ADDRESS 0xFFF8DF84 /end MEASUREMENT
/begin MEASUREMENT iUl2MvPZylFl.cUl2EdsBasisFl._.strom "Nummer der EDS" FLOAT32_IEEE UMR_MA__1_10_0_S6_S3 1 100 0 1200 DISPLAY_IDENTIFIER strom._.cUl2EdsBasisFl.iUl2MvPZylFl ECU_ADDRESS 0xFFF8DF88 /end MEASUREMENT
/begin MEASUREMENT iUl2MvPZylFl.cUl2EdsBasisFl._.strom_alt "Nummer der EDS" FLOAT32_IEEE UMR_MA__1_10_0_S6_S3 1 100 0 1200 DISPLAY_IDENTIFIER strom_alt._.cUl2EdsBasisFl.iUl2MvPZylFl ECU_ADDRESS 0xFFF8DF8C /end MEASUREMENT
/begin MEASUREMENT iUl2MvPZylFl.flanke "Gibt an ob der Sensor offen, geschlossen oder in einen der Beiden Zustände wechselt." FLOAT32_IEEE Conv.cUl2HydMvFl._.flanke_S6_S3 1 100 0 2 FORMAT "%4.2" DISPLAY_IDENTIFIER flanke.iUl2MvPZylFl ECU_ADDRESS 0xFFF8DF94 /end MEASUREMENT
/begin MEASUREMENT iUl2EdsPSysInt.cUl2EdsBasisInt._.strom "Nummer der EDS" UWORD UMR_MA__1_10_0_S6_S3 1 100 0 1200 DISPLAY_IDENTIFIER strom._.cUl2EdsBasisInt.iUl2EdsPSysInt ECU_ADDRESS 0xFFF8DF98 /end MEASUREMENT
/begin MEASUREMENT iUl2EdsPSysInt.cUl2EdsBasisInt._.strom_alt "alter Stromwert der EDS" UWORD UMR_MA__1_10_0_S6_S3 1 100 0 1200 DISPLAY_IDENTIFIER strom_alt._.cUl2EdsBasisInt.iUl2EdsPSysInt ECU_ADDRESS 0xFFF8DF9A /end MEASUREMENT
/begin MEASUREMENT iUl2EdsPSysInt.type "Nummer der EDS" UBYTE Conv.cUl2HydEdsInt._.type_S6_S3 1 100 0 1 DISPLAY_IDENTIFIER type.iUl2EdsPSysInt ECU_ADDRESS 0xFFF8DFA0 /end MEASUREMENT
/begin MEASUREMENT iUl2EdsPSysFl.cUl2EdsBasisFl._.strom "Nummer der EDS" FLOAT32_IEEE UMR_MA__1_10_0_S6_S3 1 100 0 1200 DISPLAY_IDENTIFIER strom._.cUl2EdsBasisFl.iUl2EdsPSysFl ECU_ADDRESS 0xFFF8DFA4 /end MEASUREMENT
/begin MEASUREMENT iUl2EdsPSysFl.cUl2EdsBasisFl._.strom_alt "Nummer der EDS" FLOAT32_IEEE UMR_MA__1_10_0_S6_S3 1 100 0 1200 DISPLAY_IDENTIFIER strom_alt._.cUl2EdsBasisFl.iUl2EdsPSysFl ECU_ADDRESS 0xFFF8DFA8 /end MEASUREMENT
/begin MEASUREMENT iUl2EdsPSysFl.type "Nummer der EDS" FLOAT32_IEEE UMR___1_1_0_S6_S3 1 100 0 1 FORMAT "%4.2" DISPLAY_IDENTIFIER type.iUl2EdsPSysFl ECU_ADDRESS 0xFFF8DFB0 /end MEASUREMENT
/begin MEASUREMENT iUl2KupplAInt.cUl2KupBasisInt._.f_geschlossen "Das Flag zeigt an ob die Kupplung geschlossen ist" UBYTE UMR___1_1_0_S6_S3 1 100 0 1 DISPLAY_IDENTIFIER f_geschlossen._.cUl2KupBasisInt.iUl2KupplAInt ECU_ADDRESS 0xFFF8E8DC /end MEASUREMENT
/begin MEASUREMENT iUl2KupplAInt.f_init "Gibt an ob die Kupplungswerte Initialisiert wurden sind." UBYTE UMR___1_1_0_S6_S3 1 100 0 1 DISPLAY_IDENTIFIER f_init.iUl2KupplAInt ECU_ADDRESS 0xFFF8E8EC /end MEASUREMENT
/begin MEASUREMENT iUl2KupplAInt.n_stoeredslogik_schwelle "Schwelle die Überschritten werden muss um die Kupplung als geschlossen zu erkennen" SWORD UMR___1_1_0_S6_S3 1 100 0 510 DISPLAY_IDENTIFIER n_stoeredslogik_schwelle.iUl2KupplAInt ECU_ADDRESS 0xFFF8E8EE /end MEASUREMENT
/begin MEASUREMENT iUl2KupplAInt.n_stoeredslogik_init "Kleinster Wert auf dem Feld KF_MAXSTOERCGDELTAI_EDSLOGIK" SWORD UMR___1_1_0_S6_S3 1 100 0 255 DISPLAY_IDENTIFIER n_stoeredslogik_init.iUl2KupplAInt ECU_ADDRESS 0xFFF8E8F0 /end MEASUREMENT
/begin MEASUREMENT iUl2KupplAInt.n_stoeredslogik "Stoerzaehler für falsch bestromte Kupplung" SWORD UMR___1_1_0_S6_S3 1 100 0 32767 DISPLAY_IDENTIFIER n_stoeredslogik.iUl2KupplAInt ECU_ADDRESS 0xFFF8E8F2 /end MEASUREMENT
/begin MEASUREMENT iUl2KupplAInt.i_sw_kup_schliesst "aktuelle Stromschwelle, die überschritten/unterschritten werden muss um die Kupplung als geschlossen zu erkennen" SWORD UMR_MA__1_10_0_S6_S3 1 100 0 3276.7 DISPLAY_IDENTIFIER i_sw_kup_schliesst.iUl2KupplAInt ECU_ADDRESS 0xFFF8E8F4 /end MEASUREMENT
/begin MEASUREMENT iUl2KupplAInt.i_sw_kup_oeffnet "aktuelle Stromschwelle, die überschritten/unterschritten werden muss um die Kupplung als geöffnet zu erkennen" SWORD UMR_MA__1_10_0_S6_S3 1 100 0 3276.7 DISPLAY_IDENTIFIER i_sw_kup_oeffnet.iUl2KupplAInt ECU_ADDRESS 0xFFF8E8F6 /end MEASUREMENT
/begin MEASUREMENT iUl2KupplAInt.n_kup_oeffnet "Zähler zur Verzögerung der Erkennung - Schaltelement nicht geschaltet" UBYTE UMR___1_1_0_S6_S3 1 100 0 255 DISPLAY_IDENTIFIER n_kup_oeffnet.iUl2KupplAInt ECU_ADDRESS 0xFFF8E8F8 /end MEASUREMENT
/begin MEASUREMENT iUl2KupplAInt.n_kup_oeffnet_stromlos "Zähler zur Verzögerung der Erkennung - Schaltelement nicht geschaltet" UBYTE UMR___1_1_0_S6_S3 1 100 0 255 DISPLAY_IDENTIFIER n_kup_oeffnet_stromlos.iUl2KupplAInt ECU_ADDRESS 0xFFF8E8F9 /end MEASUREMENT
/begin MEASUREMENT iUl2KupplAInt.n_kup_basis_korrektur "Zähler zur Verzögerung der Korrektur des Störzählers durch Basisstrombedingung" UBYTE UMR___1_1_0_S6_S3 1 100 0 255 DISPLAY_IDENTIFIER n_kup_basis_korrektur.iUl2KupplAInt ECU_ADDRESS 0xFFF8E8FA /end MEASUREMENT
/begin MEASUREMENT iUl2KupplAInt.delta_i_edslogik "Differenz zwischen Kupplungsstrom u. Stromschwelle (KF_IEDSMAXMMOTCGLOGIKUEB bzw. KF_IEDSMINMMOTCGLOGIKUEB)" SWORD UMR_MA__1_10_0_S6_S3 1 100 0 1000 DISPLAY_IDENTIFIER delta_i_edslogik.iUl2KupplAInt ECU_ADDRESS 0xFFF8E8FC /end MEASUREMENT
/begin MEASUREMENT iUl2KupplAInt.f_erste_bef_erk "Das Flag zeigt an, dass die erste Befüllung erkannt wurde." UBYTE UMR___1_1_0_S6_S3 1 100 0 1 DISPLAY_IDENTIFIER f_erste_bef_erk.iUl2KupplAInt ECU_ADDRESS 0xFFF8E8FE /end MEASUREMENT
/begin MEASUREMENT iUl2KupplAInt.nverzmin_dekrement "Das Flag zeigt an, dass die erste Befüllung erkannt wurde." UBYTE UMR___1_1_0_S6_S3 1 100 0 255 DISPLAY_IDENTIFIER nverzmin_dekrement.iUl2KupplAInt ECU_ADDRESS 0xFFF8E8FF /end MEASUREMENT
/begin MEASUREMENT iUl2KupplAFl.cUl2KupBasisFl._.f_geschlossen "Das Flag zeigt an ob die Kupplung geschlossen ist" FLOAT32_IEEE UMR___1_1_0_S6_S3 1 100 0 1 FORMAT "%4.2" DISPLAY_IDENTIFIER f_geschlossen._.cUl2KupBasisFl.iUl2KupplAFl ECU_ADDRESS 0xFFF8E900 /end MEASUREMENT
/begin MEASUREMENT iUl2KupplAFl.f_init "Gibt an ob die Kupplungswerte Initialisiert wurden sind." FLOAT32_IEEE UMR___1_1_0_S6_S3 1 100 0 1 FORMAT "%4.2" DISPLAY_IDENTIFIER f_init.iUl2KupplAFl ECU_ADDRESS 0xFFF8E910 /end MEASUREMENT
/begin MEASUREMENT iUl2KupplAFl.n_stoeredslogik_schwelle "Schwelle die Überschritten werden muss um die Kupplung als geschlossen zu erkennen" FLOAT32_IEEE UMR___1_1_0_S6_S3 1 100 0 510 FORMAT "%4.2" DISPLAY_IDENTIFIER n_stoeredslogik_schwelle.iUl2KupplAFl ECU_ADDRESS 0xFFF8E914 /end MEASUREMENT
/begin MEASUREMENT iUl2KupplAFl.n_stoeredslogik_init "Kleinster Wert auf dem Feld KF_MAXSTOERCGDELTAI_EDSLOGIK" FLOAT32_IEEE UMR___1_1_0_S6_S3 1 100 0 255 FORMAT "%4.2" DISPLAY_IDENTIFIER n_stoeredslogik_init.iUl2KupplAFl ECU_ADDRESS 0xFFF8E918 /end MEASUREMENT
/begin MEASUREMENT iUl2KupplAFl.n_stoeredslogik "Stoerzaehler für falsch bestromte Kupplung" FLOAT32_IEEE UMR___1_1_0_S6_S3 1 100 0 32767 FORMAT "%4.2" DISPLAY_IDENTIFIER n_stoeredslogik.iUl2KupplAFl ECU_ADDRESS 0xFFF8E91C /end MEASUREMENT
/begin MEASUREMENT iUl2KupplAFl.i_sw_kup_schliesst "aktuelle Stromschwelle, die überschritten/unterschritten werden muss um die Kupplung als geschlossen zu erkennen" FLOAT32_IEEE UMR_MA__1_10_0_S6_S3 1 100 0 3276.7 DISPLAY_IDENTIFIER i_sw_kup_schliesst.iUl2KupplAFl ECU_ADDRESS 0xFFF8E920 /end MEASUREMENT
/begin MEASUREMENT iUl2KupplAFl.i_sw_kup_oeffnet "aktuelle Stromschwelle, die überschritten/unterschritten werden muss um die Kupplung als geöffnet zu erkennen" FLOAT32_IEEE UMR_MA__1_10_0_S6_S3 1 100 0 3276.7 DISPLAY_IDENTIFIER i_sw_kup_oeffnet.iUl2KupplAFl ECU_ADDRESS 0xFFF8E924 /end MEASUREMENT
/begin MEASUREMENT iUl2KupplAFl.n_kup_oeffnet "Zähler zur Verzögerung der Erkennung - Schaltelement nicht geschaltet" FLOAT32_IEEE UMR___1_1_0_S6_S3 1 100 0 255 FORMAT "%4.2" DISPLAY_IDENTIFIER n_kup_oeffnet.iUl2KupplAFl ECU_ADDRESS 0xFFF8E928 /end MEASUREMENT
/begin MEASUREMENT iUl2KupplAFl.n_kup_oeffnet_stromlos "Zähler zur Verzögerung der Erkennung - Schaltelement nicht geschaltet" FLOAT32_IEEE UMR___1_1_0_S6_S3 1 100 0 255 FORMAT "%4.2" DISPLAY_IDENTIFIER n_kup_oeffnet_stromlos.iUl2KupplAFl ECU_ADDRESS 0xFFF8E92C /end MEASUREMENT
/begin MEASUREMENT iUl2KupplAFl.n_kup_basis_korrektur "Zähler zur Verzögerung der Korrektur des Störzählers durch Basisstrombedingung" FLOAT32_IEEE UMR___1_1_0_S6_S3 1 100 0 255 FORMAT "%4.2" DISPLAY_IDENTIFIER n_kup_basis_korrektur.iUl2KupplAFl ECU_ADDRESS 0xFFF8E930 /end MEASUREMENT
/begin MEASUREMENT iUl2KupplAFl.delta_i_edslogik "Differenz zwischen Kupplungsstrom u. Stromschwelle (KF_IEDSMAXMMOTCGLOGIKUEB bzw. KF_IEDSMINMMOTCGLOGIKUEB)" FLOAT32_IEEE UMR_MA__1_10_0_S6_S3 1 100 0 1000 DISPLAY_IDENTIFIER delta_i_edslogik.iUl2KupplAFl ECU_ADDRESS 0xFFF8E934 /end MEASUREMENT
/begin MEASUREMENT iUl2KupplAFl.f_erste_bef_erk "Das Flag zeigt an, dass die erste Befüllung erkannt wurde." FLOAT32_IEEE UMR___1_1_0_S6_S3 1 100 0 1 FORMAT "%4.2" DISPLAY_IDENTIFIER f_erste_bef_erk.iUl2KupplAFl ECU_ADDRESS 0xFFF8E938 /end MEASUREMENT
/begin MEASUREMENT iUl2KupplAFl.nverzmin_dekrement "Das Flag zeigt an, dass die erste Befüllung erkannt wurde." FLOAT32_IEEE UMR___1_1_0_S6_S3 1 100 0 255 FORMAT "%4.2" DISPLAY_IDENTIFIER nverzmin_dekrement.iUl2KupplAFl ECU_ADDRESS 0xFFF8E93C /end MEASUREMENT
/begin MEASUREMENT iUl2KupplToggleAInt.cUl2KupBasisInt._.f_geschlossen "Das Flag zeigt an ob die Kupplung geschlossen ist" UBYTE UMR___1_1_0_S6_S3 1 100 0 1 DISPLAY_IDENTIFIER f_geschlossen._.cUl2KupBasisInt.iUl2KupplToggleAInt ECU_ADDRESS 0xFFF8E940 /end MEASUREMENT
/begin MEASUREMENT iUl2KupplToggleAInt.schwelle_toggel_stoer "Schwelle für Störungen, nach denen eine Kupplung als geschlossen erkannt wird" UBYTE UMR___1_1_0_S6_S3 1 100 0 255 DISPLAY_IDENTIFIER schwelle_toggel_stoer.iUl2KupplToggleAInt ECU_ADDRESS 0xFFF8E950 /end MEASUREMENT
/begin MEASUREMENT iUl2KupplToggleAInt.schwelle_toggel_gut "Schwelle wann eine Kupplung als entleert gilt" UWORD UMR___1_1_0_S6_S3 1 100 0 255 DISPLAY_IDENTIFIER schwelle_toggel_gut.iUl2KupplToggleAInt ECU_ADDRESS 0xFFF8E952 /end MEASUREMENT
/begin MEASUREMENT iUl2KupplToggleAInt.n_stoer_edslogik_toggel "Zustand" UWORD UMR___1_1_0_S6_S3 1 100 0 256 DISPLAY_IDENTIFIER n_stoer_edslogik_toggel.iUl2KupplToggleAInt ECU_ADDRESS 0xFFF8E954 /end MEASUREMENT
/begin MEASUREMENT iUl2KupplToggleAInt.n_gut_edslogik_toggel "Zustand" UWORD UMR___1_1_0_S6_S3 1 100 0 256 DISPLAY_IDENTIFIER n_gut_edslogik_toggel.iUl2KupplToggleAInt ECU_ADDRESS 0xFFF8E956 /end MEASUREMENT
/begin MEASUREMENT iUl2KupplToggleAFl.cUl2KupBasisFl._.f_geschlossen "Das Flag zeigt an ob die Kupplung geschlossen ist" FLOAT32_IEEE UMR___1_1_0_S6_S3 1 100 0 1 FORMAT "%4.2" DISPLAY_IDENTIFIER f_geschlossen._.cUl2KupBasisFl.iUl2KupplToggleAFl ECU_ADDRESS 0xFFF8E958 /end MEASUREMENT
/begin MEASUREMENT iUl2KupplToggleAFl.schwelle_toggel_stoer "Schwelle für Störungen, nach denen eine Kupplung als geschlossen erkannt wird" FLOAT32_IEEE UMR___1_1_0_S6_S3 1 100 0 255 FORMAT "%4.2" DISPLAY_IDENTIFIER schwelle_toggel_stoer.iUl2KupplToggleAFl ECU_ADDRESS 0xFFF8E968 /end MEASUREMENT
/begin MEASUREMENT iUl2KupplToggleAFl.schwelle_toggel_gut "Schwelle wann eine Kupplung als entleert gilt" FLOAT32_IEEE UMR___1_1_0_S6_S3 1 100 0 255 FORMAT "%4.2" DISPLAY_IDENTIFIER schwelle_toggel_gut.iUl2KupplToggleAFl ECU_ADDRESS 0xFFF8E96C /end MEASUREMENT
/begin MEASUREMENT iUl2KupplToggleAFl.n_stoer_edslogik_toggel "Zustand" FLOAT32_IEEE UMR___1_1_0_S6_S3 1 100 0 256 FORMAT "%4.2" DISPLAY_IDENTIFIER n_stoer_edslogik_toggel.iUl2KupplToggleAFl ECU_ADDRESS 0xFFF8E970 /end MEASUREMENT
/begin MEASUREMENT iUl2KupplToggleAFl.n_gut_edslogik_toggel "Zustand" FLOAT32_IEEE UMR___1_1_0_S6_S3 1 100 0 256 FORMAT "%4.2" DISPLAY_IDENTIFIER n_gut_edslogik_toggel.iUl2KupplToggleAFl ECU_ADDRESS 0xFFF8E974 /end MEASUREMENT
/begin MEASUREMENT iUl2KupplBInt.cUl2KupBasisInt._.f_geschlossen "Das Flag zeigt an ob die Kupplung geschlossen ist" UBYTE UMR___1_1_0_S6_S3 1 100 0 1 DISPLAY_IDENTIFIER f_geschlossen._.cUl2KupBasisInt.iUl2KupplBInt ECU_ADDRESS 0xFFF8E978 /end MEASUREMENT
/begin MEASUREMENT iUl2KupplBInt.f_init "Gibt an ob die Kupplungswerte Initialisiert wurden sind." UBYTE UMR___1_1_0_S6_S3 1 100 0 1 DISPLAY_IDENTIFIER f_init.iUl2KupplBInt ECU_ADDRESS 0xFFF8E988 /end MEASUREMENT
/begin MEASUREMENT iUl2KupplBInt.n_stoeredslogik_schwelle "Schwelle die Überschritten werden muss um die Kupplung als geschlossen zu erkennen" SWORD UMR___1_1_0_S6_S3 1 100 0 510 DISPLAY_IDENTIFIER n_stoeredslogik_schwelle.iUl2KupplBInt ECU_ADDRESS 0xFFF8E98A /end MEASUREMENT
/begin MEASUREMENT iUl2KupplBInt.n_stoeredslogik_init "Kleinster Wert auf dem Feld KF_MAXSTOERCGDELTAI_EDSLOGIK" SWORD UMR___1_1_0_S6_S3 1 100 0 255 DISPLAY_IDENTIFIER n_stoeredslogik_init.iUl2KupplBInt ECU_ADDRESS 0xFFF8E98C /end MEASUREMENT
/begin MEASUREMENT iUl2KupplBInt.n_stoeredslogik "Stoerzaehler für falsch bestromte Kupplung" SWORD UMR___1_1_0_S6_S3 1 100 0 32767 DISPLAY_IDENTIFIER n_stoeredslogik.iUl2KupplBInt ECU_ADDRESS 0xFFF8E98E /end MEASUREMENT
/begin MEASUREMENT iUl2KupplBInt.i_sw_kup_schliesst "aktuelle Stromschwelle, die überschritten/unterschritten werden muss um die Kupplung als geschlossen zu erkennen" SWORD UMR_MA__1_10_0_S6_S3 1 100 0 3276.7 DISPLAY_IDENTIFIER i_sw_kup_schliesst.iUl2KupplBInt ECU_ADDRESS 0xFFF8E990 /end MEASUREMENT
/begin MEASUREMENT iUl2KupplBInt.i_sw_kup_oeffnet "aktuelle Stromschwelle, die überschritten/unterschritten werden muss um die Kupplung als geöffnet zu erkennen" SWORD UMR_MA__1_10_0_S6_S3 1 100 0 3276.7 DISPLAY_IDENTIFIER i_sw_kup_oeffnet.iUl2KupplBInt ECU_ADDRESS 0xFFF8E992 /end MEASUREMENT
/begin MEASUREMENT iUl2KupplBInt.n_kup_oeffnet "Zähler zur Verzögerung der Erkennung - Schaltelement nicht geschaltet" UBYTE UMR___1_1_0_S6_S3 1 100 0 255 DISPLAY_IDENTIFIER n_kup_oeffnet.iUl2KupplBInt ECU_ADDRESS 0xFFF8E994 /end MEASUREMENT
/begin MEASUREMENT iUl2KupplBInt.n_kup_oeffnet_stromlos "Zähler zur Verzögerung der Erkennung - Schaltelement nicht geschaltet" UBYTE UMR___1_1_0_S6_S3 1 100 0 255 DISPLAY_IDENTIFIER n_kup_oeffnet_stromlos.iUl2KupplBInt ECU_ADDRESS 0xFFF8E995 /end MEASUREMENT
/begin MEASUREMENT iUl2KupplBInt.n_kup_basis_korrektur "Zähler zur Verzögerung der Korrektur des Störzählers durch Basisstrombedingung" UBYTE UMR___1_1_0_S6_S3 1 100 0 255 DISPLAY_IDENTIFIER n_kup_basis_korrektur.iUl2KupplBInt ECU_ADDRESS 0xFFF8E996 /end MEASUREMENT
/begin MEASUREMENT iUl2KupplBInt.delta_i_edslogik "Differenz zwischen Kupplungsstrom u. Stromschwelle (KF_IEDSMAXMMOTCGLOGIKUEB bzw. KF_IEDSMINMMOTCGLOGIKUEB)" SWORD UMR_MA__1_10_0_S6_S3 1 100 0 1000 DISPLAY_IDENTIFIER delta_i_edslogik.iUl2KupplBInt ECU_ADDRESS 0xFFF8E998 /end MEASUREMENT
/begin MEASUREMENT iUl2KupplBInt.f_erste_bef_erk "Das Flag zeigt an, dass die erste Befüllung erkannt wurde." UBYTE UMR___1_1_0_S6_S3 1 100 0 1 DISPLAY_IDENTIFIER f_erste_bef_erk.iUl2KupplBInt ECU_ADDRESS 0xFFF8E99A /end MEASUREMENT
/begin MEASUREMENT iUl2KupplBInt.nverzmin_dekrement "Das Flag zeigt an, dass die erste Befüllung erkannt wurde." UBYTE UMR___1_1_0_S6_S3 1 100 0 255 DISPLAY_IDENTIFIER nverzmin_dekrement.iUl2KupplBInt ECU_ADDRESS 0xFFF8E99B /end MEASUREMENT
/begin MEASUREMENT iUl2KupplBFl.cUl2KupBasisFl._.f_geschlossen "Das Flag zeigt an ob die Kupplung geschlossen ist" FLOAT32_IEEE UMR___1_1_0_S6_S3 1 100 0 1 FORMAT "%4.2" DISPLAY_IDENTIFIER f_geschlossen._.cUl2KupBasisFl.iUl2KupplBFl ECU_ADDRESS 0xFFF8E99C /end MEASUREMENT
/begin MEASUREMENT iUl2KupplBFl.f_init "Gibt an ob die Kupplungswerte Initialisiert wurden sind." FLOAT32_IEEE UMR___1_1_0_S6_S3 1 100 0 1 FORMAT "%4.2" DISPLAY_IDENTIFIER f_init.iUl2KupplBFl ECU_ADDRESS 0xFFF8E9AC /end MEASUREMENT
/begin MEASUREMENT iUl2KupplBFl.n_stoeredslogik_schwelle "Schwelle die Überschritten werden muss um die Kupplung als geschlossen zu erkennen" FLOAT32_IEEE UMR___1_1_0_S6_S3 1 100 0 510 FORMAT "%4.2" DISPLAY_IDENTIFIER n_stoeredslogik_schwelle.iUl2KupplBFl ECU_ADDRESS 0xFFF8E9B0 /end MEASUREMENT
/begin MEASUREMENT iUl2KupplBFl.n_stoeredslogik_init "Kleinster Wert auf dem Feld KF_MAXSTOERCGDELTAI_EDSLOGIK" FLOAT32_IEEE UMR___1_1_0_S6_S3 1 100 0 255 FORMAT "%4.2" DISPLAY_IDENTIFIER n_stoeredslogik_init.iUl2KupplBFl ECU_ADDRESS 0xFFF8E9B4 /end MEASUREMENT
/begin MEASUREMENT iUl2KupplBFl.n_stoeredslogik "Stoerzaehler für falsch bestromte Kupplung" FLOAT32_IEEE UMR___1_1_0_S6_S3 1 100 0 32767 FORMAT "%4.2" DISPLAY_IDENTIFIER n_stoeredslogik.iUl2KupplBFl ECU_ADDRESS 0xFFF8E9B8 /end MEASUREMENT
/begin MEASUREMENT iUl2KupplBFl.i_sw_kup_schliesst "aktuelle Stromschwelle, die überschritten/unterschritten werden muss um die Kupplung als geschlossen zu erkennen" FLOAT32_IEEE UMR_MA__1_10_0_S6_S3 1 100 0 3276.7 DISPLAY_IDENTIFIER i_sw_kup_schliesst.iUl2KupplBFl ECU_ADDRESS 0xFFF8E9BC /end MEASUREMENT
/begin MEASUREMENT iUl2KupplBFl.i_sw_kup_oeffnet "aktuelle Stromschwelle, die überschritten/unterschritten werden muss um die Kupplung als geöffnet zu erkennen" FLOAT32_IEEE UMR_MA__1_10_0_S6_S3 1 100 0 3276.7 DISPLAY_IDENTIFIER i_sw_kup_oeffnet.iUl2KupplBFl ECU_ADDRESS 0xFFF8E9C0 /end MEASUREMENT
/begin MEASUREMENT iUl2KupplBFl.n_kup_oeffnet "Zähler zur Verzögerung der Erkennung - Schaltelement nicht geschaltet" FLOAT32_IEEE UMR___1_1_0_S6_S3 1 100 0 255 FORMAT "%4.2" DISPLAY_IDENTIFIER n_kup_oeffnet.iUl2KupplBFl ECU_ADDRESS 0xFFF8E9C4 /end MEASUREMENT
/begin MEASUREMENT iUl2KupplBFl.n_kup_oeffnet_stromlos "Zähler zur Verzögerung der Erkennung - Schaltelement nicht geschaltet" FLOAT32_IEEE UMR___1_1_0_S6_S3 1 100 0 255 FORMAT "%4.2" DISPLAY_IDENTIFIER n_kup_oeffnet_stromlos.iUl2KupplBFl ECU_ADDRESS 0xFFF8E9C8 /end MEASUREMENT
/begin MEASUREMENT iUl2KupplBFl.n_kup_basis_korrektur "Zähler zur Verzögerung der Korrektur des Störzählers durch Basisstrombedingung" FLOAT32_IEEE UMR___1_1_0_S6_S3 1 100 0 255 FORMAT "%4.2" DISPLAY_IDENTIFIER n_kup_basis_korrektur.iUl2KupplBFl ECU_ADDRESS 0xFFF8E9CC /end MEASUREMENT
/begin MEASUREMENT iUl2KupplBFl.delta_i_edslogik "Differenz zwischen Kupplungsstrom u. Stromschwelle (KF_IEDSMAXMMOTCGLOGIKUEB bzw. KF_IEDSMINMMOTCGLOGIKUEB)" FLOAT32_IEEE UMR_MA__1_10_0_S6_S3 1 100 0 1000 DISPLAY_IDENTIFIER delta_i_edslogik.iUl2KupplBFl ECU_ADDRESS 0xFFF8E9D0 /end MEASUREMENT
/begin MEASUREMENT iUl2KupplBFl.f_erste_bef_erk "Das Flag zeigt an, dass die erste Befüllung erkannt wurde." FLOAT32_IEEE UMR___1_1_0_S6_S3 1 100 0 1 FORMAT "%4.2" DISPLAY_IDENTIFIER f_erste_bef_erk.iUl2KupplBFl ECU_ADDRESS 0xFFF8E9D4 /end MEASUREMENT
/begin MEASUREMENT iUl2KupplBFl.nverzmin_dekrement "Das Flag zeigt an, dass die erste Befüllung erkannt wurde." FLOAT32_IEEE UMR___1_1_0_S6_S3 1 100 0 255 FORMAT "%4.2" DISPLAY_IDENTIFIER nverzmin_dekrement.iUl2KupplBFl ECU_ADDRESS 0xFFF8E9D8 /end MEASUREMENT
/begin MEASUREMENT iUl2KupplToggleBInt.cUl2KupBasisInt._.f_geschlossen "Das Flag zeigt an ob die Kupplung geschlossen ist" UBYTE UMR___1_1_0_S6_S3 1 100 0 1 DISPLAY_IDENTIFIER f_geschlossen._.cUl2KupBasisInt.iUl2KupplToggleBInt ECU_ADDRESS 0xFFF8E9DC /end MEASUREMENT
/begin MEASUREMENT iUl2KupplToggleBInt.schwelle_toggel_stoer "Schwelle für Störungen, nach denen eine Kupplung als geschlossen erkannt wird" UBYTE UMR___1_1_0_S6_S3 1 100 0 255 DISPLAY_IDENTIFIER schwelle_toggel_stoer.iUl2KupplToggleBInt ECU_ADDRESS 0xFFF8E9EC /end MEASUREMENT
/begin MEASUREMENT iUl2KupplToggleBInt.schwelle_toggel_gut "Schwelle wann eine Kupplung als entleert gilt" UWORD UMR___1_1_0_S6_S3 1 100 0 255 DISPLAY_IDENTIFIER schwelle_toggel_gut.iUl2KupplToggleBInt ECU_ADDRESS 0xFFF8E9EE /end MEASUREMENT
/begin MEASUREMENT iUl2KupplToggleBInt.n_stoer_edslogik_toggel "Zustand" UWORD UMR___1_1_0_S6_S3 1 100 0 256 DISPLAY_IDENTIFIER n_stoer_edslogik_toggel.iUl2KupplToggleBInt ECU_ADDRESS 0xFFF8E9F0 /end MEASUREMENT
/begin MEASUREMENT iUl2KupplToggleBInt.n_gut_edslogik_toggel "Zustand" UWORD UMR___1_1_0_S6_S3 1 100 0 256 DISPLAY_IDENTIFIER n_gut_edslogik_toggel.iUl2KupplToggleBInt ECU_ADDRESS 0xFFF8E9F2 /end MEASUREMENT
/begin MEASUREMENT iUl2KupplToggleBFl.cUl2KupBasisFl._.f_geschlossen "Das Flag zeigt an ob die Kupplung geschlossen ist" FLOAT32_IEEE UMR___1_1_0_S6_S3 1 100 0 1 FORMAT "%4.2" DISPLAY_IDENTIFIER f_geschlossen._.cUl2KupBasisFl.iUl2KupplToggleBFl ECU_ADDRESS 0xFFF8E9F4 /end MEASUREMENT
/begin MEASUREMENT iUl2KupplToggleBFl.schwelle_toggel_stoer "Schwelle für Störungen, nach denen eine Kupplung als geschlossen erkannt wird" FLOAT32_IEEE UMR___1_1_0_S6_S3 1 100 0 255 FORMAT "%4.2" DISPLAY_IDENTIFIER schwelle_toggel_stoer.iUl2KupplToggleBFl ECU_ADDRESS 0xFFF8EA04 /end MEASUREMENT
/begin MEASUREMENT iUl2KupplToggleBFl.schwelle_toggel_gut "Schwelle wann eine Kupplung als entleert gilt" FLOAT32_IEEE UMR___1_1_0_S6_S3 1 100 0 255 FORMAT "%4.2" DISPLAY_IDENTIFIER schwelle_toggel_gut.iUl2KupplToggleBFl ECU_ADDRESS 0xFFF8EA08 /end MEASUREMENT
/begin MEASUREMENT iUl2KupplToggleBFl.n_stoer_edslogik_toggel "Zustand" FLOAT32_IEEE UMR___1_1_0_S6_S3 1 100 0 256 FORMAT "%4.2" DISPLAY_IDENTIFIER n_stoer_edslogik_toggel.iUl2KupplToggleBFl ECU_ADDRESS 0xFFF8EA0C /end MEASUREMENT
/begin MEASUREMENT iUl2KupplToggleBFl.n_gut_edslogik_toggel "Zustand" FLOAT32_IEEE UMR___1_1_0_S6_S3 1 100 0 256 FORMAT "%4.2" DISPLAY_IDENTIFIER n_gut_edslogik_toggel.iUl2KupplToggleBFl ECU_ADDRESS 0xFFF8EA10 /end MEASUREMENT
/begin MEASUREMENT iUl2KupplCInt.cUl2KupBasisInt._.f_geschlossen "Das Flag zeigt an ob die Kupplung geschlossen ist" UBYTE UMR___1_1_0_S6_S3 1 100 0 1 DISPLAY_IDENTIFIER f_geschlossen._.cUl2KupBasisInt.iUl2KupplCInt ECU_ADDRESS 0xFFF8EA14 /end MEASUREMENT
/begin MEASUREMENT iUl2KupplCInt.f_init "Gibt an ob die Kupplungswerte Initialisiert wurden sind." UBYTE UMR___1_1_0_S6_S3 1 100 0 1 DISPLAY_IDENTIFIER f_init.iUl2KupplCInt ECU_ADDRESS 0xFFF8EA24 /end MEASUREMENT
/begin MEASUREMENT iUl2KupplCInt.n_stoeredslogik_schwelle "Schwelle die Überschritten werden muss um die Kupplung als geschlossen zu erkennen" SWORD UMR___1_1_0_S6_S3 1 100 0 510 DISPLAY_IDENTIFIER n_stoeredslogik_schwelle.iUl2KupplCInt ECU_ADDRESS 0xFFF8EA26 /end MEASUREMENT
/begin MEASUREMENT iUl2KupplCInt.n_stoeredslogik_init "Kleinster Wert auf dem Feld KF_MAXSTOERCGDELTAI_EDSLOGIK" SWORD UMR___1_1_0_S6_S3 1 100 0 255 DISPLAY_IDENTIFIER n_stoeredslogik_init.iUl2KupplCInt ECU_ADDRESS 0xFFF8EA28 /end MEASUREMENT
/begin MEASUREMENT iUl2KupplCInt.n_stoeredslogik "Stoerzaehler für falsch bestromte Kupplung" SWORD UMR___1_1_0_S6_S3 1 100 0 32767 DISPLAY_IDENTIFIER n_stoeredslogik.iUl2KupplCInt ECU_ADDRESS 0xFFF8EA2A /end MEASUREMENT
/begin MEASUREMENT iUl2KupplCInt.i_sw_kup_schliesst "aktuelle Stromschwelle, die überschritten/unterschritten werden muss um die Kupplung als geschlossen zu erkennen" SWORD UMR_MA__1_10_0_S6_S3 1 100 0 3276.7 DISPLAY_IDENTIFIER i_sw_kup_schliesst.iUl2KupplCInt ECU_ADDRESS 0xFFF8EA2C /end MEASUREMENT
/begin MEASUREMENT iUl2KupplCInt.i_sw_kup_oeffnet "aktuelle Stromschwelle, die überschritten/unterschritten werden muss um die Kupplung als geöffnet zu erkennen" SWORD UMR_MA__1_10_0_S6_S3 1 100 0 3276.7 DISPLAY_IDENTIFIER i_sw_kup_oeffnet.iUl2KupplCInt ECU_ADDRESS 0xFFF8EA2E /end MEASUREMENT
/begin MEASUREMENT iUl2KupplCInt.n_kup_oeffnet "Zähler zur Verzögerung der Erkennung - Schaltelement nicht geschaltet" UBYTE UMR___1_1_0_S6_S3 1 100 0 255 DISPLAY_IDENTIFIER n_kup_oeffnet.iUl2KupplCInt ECU_ADDRESS 0xFFF8EA30 /end MEASUREMENT
/begin MEASUREMENT iUl2KupplCInt.n_kup_oeffnet_stromlos "Zähler zur Verzögerung der Erkennung - Schaltelement nicht geschaltet" UBYTE UMR___1_1_0_S6_S3 1 100 0 255 DISPLAY_IDENTIFIER n_kup_oeffnet_stromlos.iUl2KupplCInt ECU_ADDRESS 0xFFF8EA31 /end MEASUREMENT
/begin MEASUREMENT iUl2KupplCInt.n_kup_basis_korrektur "Zähler zur Verzögerung der Korrektur des Störzählers durch Basisstrombedingung" UBYTE UMR___1_1_0_S6_S3 1 100 0 255 DISPLAY_IDENTIFIER n_kup_basis_korrektur.iUl2KupplCInt ECU_ADDRESS 0xFFF8EA32 /end MEASUREMENT
/begin MEASUREMENT iUl2KupplCInt.delta_i_edslogik "Differenz zwischen Kupplungsstrom u. Stromschwelle (KF_IEDSMAXMMOTCGLOGIKUEB bzw. KF_IEDSMINMMOTCGLOGIKUEB)" SWORD UMR_MA__1_10_0_S6_S3 1 100 0 1000 DISPLAY_IDENTIFIER delta_i_edslogik.iUl2KupplCInt ECU_ADDRESS 0xFFF8EA34 /end MEASUREMENT
/begin MEASUREMENT iUl2KupplCInt.f_erste_bef_erk "Das Flag zeigt an, dass die erste Befüllung erkannt wurde." UBYTE UMR___1_1_0_S6_S3 1 100 0 1 DISPLAY_IDENTIFIER f_erste_bef_erk.iUl2KupplCInt ECU_ADDRESS 0xFFF8EA36 /end MEASUREMENT
/begin MEASUREMENT iUl2KupplCInt.nverzmin_dekrement "Das Flag zeigt an, dass die erste Befüllung erkannt wurde." UBYTE UMR___1_1_0_S6_S3 1 100 0 255 DISPLAY_IDENTIFIER nverzmin_dekrement.iUl2KupplCInt ECU_ADDRESS 0xFFF8EA37 /end MEASUREMENT
/begin MEASUREMENT iUl2KupplCFl.cUl2KupBasisFl._.f_geschlossen "Das Flag zeigt an ob die Kupplung geschlossen ist" FLOAT32_IEEE UMR___1_1_0_S6_S3 1 100 0 1 FORMAT "%4.2" DISPLAY_IDENTIFIER f_geschlossen._.cUl2KupBasisFl.iUl2KupplCFl ECU_ADDRESS 0xFFF8EA38 /end MEASUREMENT
/begin MEASUREMENT iUl2KupplCFl.f_init "Gibt an ob die Kupplungswerte Initialisiert wurden sind." FLOAT32_IEEE UMR___1_1_0_S6_S3 1 100 0 1 FORMAT "%4.2" DISPLAY_IDENTIFIER f_init.iUl2KupplCFl ECU_ADDRESS 0xFFF8EA48 /end MEASUREMENT
/begin MEASUREMENT iUl2KupplCFl.n_stoeredslogik_schwelle "Schwelle die Überschritten werden muss um die Kupplung als geschlossen zu erkennen" FLOAT32_IEEE UMR___1_1_0_S6_S3 1 100 0 510 FORMAT "%4.2" DISPLAY_IDENTIFIER n_stoeredslogik_schwelle.iUl2KupplCFl ECU_ADDRESS 0xFFF8EA4C /end MEASUREMENT
/begin MEASUREMENT iUl2KupplCFl.n_stoeredslogik_init "Kleinster Wert auf dem Feld KF_MAXSTOERCGDELTAI_EDSLOGIK" FLOAT32_IEEE UMR___1_1_0_S6_S3 1 100 0 255 FORMAT "%4.2" DISPLAY_IDENTIFIER n_stoeredslogik_init.iUl2KupplCFl ECU_ADDRESS 0xFFF8EA50 /end MEASUREMENT
/begin MEASUREMENT iUl2KupplCFl.n_stoeredslogik "Stoerzaehler für falsch bestromte Kupplung" FLOAT32_IEEE UMR___1_1_0_S6_S3 1 100 0 32767 FORMAT "%4.2" DISPLAY_IDENTIFIER n_stoeredslogik.iUl2KupplCFl ECU_ADDRESS 0xFFF8EA54 /end MEASUREMENT
/begin MEASUREMENT iUl2KupplCFl.i_sw_kup_schliesst "aktuelle Stromschwelle, die überschritten/unterschritten werden muss um die Kupplung als geschlossen zu erkennen" FLOAT32_IEEE UMR_MA__1_10_0_S6_S3 1 100 0 3276.7 DISPLAY_IDENTIFIER i_sw_kup_schliesst.iUl2KupplCFl ECU_ADDRESS 0xFFF8EA58 /end MEASUREMENT
/begin MEASUREMENT iUl2KupplCFl.i_sw_kup_oeffnet "aktuelle Stromschwelle, die überschritten/unterschritten werden muss um die Kupplung als geöffnet zu erkennen" FLOAT32_IEEE UMR_MA__1_10_0_S6_S3 1 100 0 3276.7 DISPLAY_IDENTIFIER i_sw_kup_oeffnet.iUl2KupplCFl ECU_ADDRESS 0xFFF8EA5C /end MEASUREMENT
/begin MEASUREMENT iUl2KupplCFl.n_kup_oeffnet "Zähler zur Verzögerung der Erkennung - Schaltelement nicht geschaltet" FLOAT32_IEEE UMR___1_1_0_S6_S3 1 100 0 255 FORMAT "%4.2" DISPLAY_IDENTIFIER n_kup_oeffnet.iUl2KupplCFl ECU_ADDRESS 0xFFF8EA60 /end MEASUREMENT
/begin MEASUREMENT iUl2KupplCFl.n_kup_oeffnet_stromlos "Zähler zur Verzögerung der Erkennung - Schaltelement nicht geschaltet" FLOAT32_IEEE UMR___1_1_0_S6_S3 1 100 0 255 FORMAT "%4.2" DISPLAY_IDENTIFIER n_kup_oeffnet_stromlos.iUl2KupplCFl ECU_ADDRESS 0xFFF8EA64 /end MEASUREMENT
/begin MEASUREMENT iUl2KupplCFl.n_kup_basis_korrektur "Zähler zur Verzögerung der Korrektur des Störzählers durch Basisstrombedingung" FLOAT32_IEEE UMR___1_1_0_S6_S3 1 100 0 255 FORMAT "%4.2" DISPLAY_IDENTIFIER n_kup_basis_korrektur.iUl2KupplCFl ECU_ADDRESS 0xFFF8EA68 /end MEASUREMENT
/begin MEASUREMENT iUl2KupplCFl.delta_i_edslogik "Differenz zwischen Kupplungsstrom u. Stromschwelle (KF_IEDSMAXMMOTCGLOGIKUEB bzw. KF_IEDSMINMMOTCGLOGIKUEB)" FLOAT32_IEEE UMR_MA__1_10_0_S6_S3 1 100 0 1000 DISPLAY_IDENTIFIER delta_i_edslogik.iUl2KupplCFl ECU_ADDRESS 0xFFF8EA6C /end MEASUREMENT
/begin MEASUREMENT iUl2KupplCFl.f_erste_bef_erk "Das Flag zeigt an, dass die erste Befüllung erkannt wurde." FLOAT32_IEEE UMR___1_1_0_S6_S3 1 100 0 1 FORMAT "%4.2" DISPLAY_IDENTIFIER f_erste_bef_erk.iUl2KupplCFl ECU_ADDRESS 0xFFF8EA70 /end MEASUREMENT
/begin MEASUREMENT iUl2KupplCFl.nverzmin_dekrement "Das Flag zeigt an, dass die erste Befüllung erkannt wurde." FLOAT32_IEEE UMR___1_1_0_S6_S3 1 100 0 255 FORMAT "%4.2" DISPLAY_IDENTIFIER nverzmin_dekrement.iUl2KupplCFl ECU_ADDRESS 0xFFF8EA74 /end MEASUREMENT
/begin MEASUREMENT iUl2KupplToggleCInt.cUl2KupBasisInt._.f_geschlossen "Das Flag zeigt an ob die Kupplung geschlossen ist" UBYTE UMR___1_1_0_S6_S3 1 100 0 1 DISPLAY_IDENTIFIER f_geschlossen._.cUl2KupBasisInt.iUl2KupplToggleCInt ECU_ADDRESS 0xFFF8EA78 /end MEASUREMENT
/begin MEASUREMENT iUl2KupplToggleCInt.schwelle_toggel_stoer "Schwelle für Störungen, nach denen eine Kupplung als geschlossen erkannt wird" UBYTE UMR___1_1_0_S6_S3 1 100 0 255 DISPLAY_IDENTIFIER schwelle_toggel_stoer.iUl2KupplToggleCInt ECU_ADDRESS 0xFFF8EA88 /end MEASUREMENT
/begin MEASUREMENT iUl2KupplToggleCInt.schwelle_toggel_gut "Schwelle wann eine Kupplung als entleert gilt" UWORD UMR___1_1_0_S6_S3 1 100 0 255 DISPLAY_IDENTIFIER schwelle_toggel_gut.iUl2KupplToggleCInt ECU_ADDRESS 0xFFF8EA8A /end MEASUREMENT
/begin MEASUREMENT iUl2KupplToggleCInt.n_stoer_edslogik_toggel "Zustand" UWORD UMR___1_1_0_S6_S3 1 100 0 256 DISPLAY_IDENTIFIER n_stoer_edslogik_toggel.iUl2KupplToggleCInt ECU_ADDRESS 0xFFF8EA8C /end MEASUREMENT
/begin MEASUREMENT iUl2KupplToggleCInt.n_gut_edslogik_toggel "Zustand" UWORD UMR___1_1_0_S6_S3 1 100 0 256 DISPLAY_IDENTIFIER n_gut_edslogik_toggel.iUl2KupplToggleCInt ECU_ADDRESS 0xFFF8EA8E /end MEASUREMENT
/begin MEASUREMENT iUl2KupplToggleCFl.cUl2KupBasisFl._.f_geschlossen "Das Flag zeigt an ob die Kupplung geschlossen ist" FLOAT32_IEEE UMR___1_1_0_S6_S3 1 100 0 1 FORMAT "%4.2" DISPLAY_IDENTIFIER f_geschlossen._.cUl2KupBasisFl.iUl2KupplToggleCFl ECU_ADDRESS 0xFFF8EA90 /end MEASUREMENT
/begin MEASUREMENT iUl2KupplToggleCFl.schwelle_toggel_stoer "Schwelle für Störungen, nach denen eine Kupplung als geschlossen erkannt wird" FLOAT32_IEEE UMR___1_1_0_S6_S3 1 100 0 255 FORMAT "%4.2" DISPLAY_IDENTIFIER schwelle_toggel_stoer.iUl2KupplToggleCFl ECU_ADDRESS 0xFFF8EAA0 /end MEASUREMENT
/begin MEASUREMENT iUl2KupplToggleCFl.schwelle_toggel_gut "Schwelle wann eine Kupplung als entleert gilt" FLOAT32_IEEE UMR___1_1_0_S6_S3 1 100 0 255 FORMAT "%4.2" DISPLAY_IDENTIFIER schwelle_toggel_gut.iUl2KupplToggleCFl ECU_ADDRESS 0xFFF8EAA4 /end MEASUREMENT
/begin MEASUREMENT iUl2KupplToggleCFl.n_stoer_edslogik_toggel "Zustand" FLOAT32_IEEE UMR___1_1_0_S6_S3 1 100 0 256 FORMAT "%4.2" DISPLAY_IDENTIFIER n_stoer_edslogik_toggel.iUl2KupplToggleCFl ECU_ADDRESS 0xFFF8EAA8 /end MEASUREMENT
/begin MEASUREMENT iUl2KupplToggleCFl.n_gut_edslogik_toggel "Zustand" FLOAT32_IEEE UMR___1_1_0_S6_S3 1 100 0 256 FORMAT "%4.2" DISPLAY_IDENTIFIER n_gut_edslogik_toggel.iUl2KupplToggleCFl ECU_ADDRESS 0xFFF8EAAC /end MEASUREMENT
/begin MEASUREMENT iUl2KupplDInt.cUl2KupBasisInt._.f_geschlossen "Das Flag zeigt an ob die Kupplung geschlossen ist" UBYTE UMR___1_1_0_S6_S3 1 100 0 1 DISPLAY_IDENTIFIER f_geschlossen._.cUl2KupBasisInt.iUl2KupplDInt ECU_ADDRESS 0xFFF8EAB0 /end MEASUREMENT
/begin MEASUREMENT iUl2KupplDInt.f_init "Gibt an ob die Kupplungswerte Initialisiert wurden sind." UBYTE UMR___1_1_0_S6_S3 1 100 0 1 DISPLAY_IDENTIFIER f_init.iUl2KupplDInt ECU_ADDRESS 0xFFF8EAC0 /end MEASUREMENT
/begin MEASUREMENT iUl2KupplDInt.n_stoeredslogik_schwelle "Schwelle die Überschritten werden muss um die Kupplung als geschlossen zu erkennen" SWORD UMR___1_1_0_S6_S3 1 100 0 510 DISPLAY_IDENTIFIER n_stoeredslogik_schwelle.iUl2KupplDInt ECU_ADDRESS 0xFFF8EAC2 /end MEASUREMENT
/begin MEASUREMENT iUl2KupplDInt.n_stoeredslogik_init "Kleinster Wert auf dem Feld KF_MAXSTOERCGDELTAI_EDSLOGIK" SWORD UMR___1_1_0_S6_S3 1 100 0 255 DISPLAY_IDENTIFIER n_stoeredslogik_init.iUl2KupplDInt ECU_ADDRESS 0xFFF8EAC4 /end MEASUREMENT
/begin MEASUREMENT iUl2KupplDInt.n_stoeredslogik "Stoerzaehler für falsch bestromte Kupplung" SWORD UMR___1_1_0_S6_S3 1 100 0 32767 DISPLAY_IDENTIFIER n_stoeredslogik.iUl2KupplDInt ECU_ADDRESS 0xFFF8EAC6 /end MEASUREMENT
/begin MEASUREMENT iUl2KupplDInt.i_sw_kup_schliesst "aktuelle Stromschwelle, die überschritten/unterschritten werden muss um die Kupplung als geschlossen zu erkennen" SWORD UMR_MA__1_10_0_S6_S3 1 100 0 3276.7 DISPLAY_IDENTIFIER i_sw_kup_schliesst.iUl2KupplDInt ECU_ADDRESS 0xFFF8EAC8 /end MEASUREMENT
/begin MEASUREMENT iUl2KupplDInt.i_sw_kup_oeffnet "aktuelle Stromschwelle, die überschritten/unterschritten werden muss um die Kupplung als geöffnet zu erkennen" SWORD UMR_MA__1_10_0_S6_S3 1 100 0 3276.7 DISPLAY_IDENTIFIER i_sw_kup_oeffnet.iUl2KupplDInt ECU_ADDRESS 0xFFF8EACA /end MEASUREMENT
/begin MEASUREMENT iUl2KupplDInt.n_kup_oeffnet "Zähler zur Verzögerung der Erkennung - Schaltelement nicht geschaltet" UBYTE UMR___1_1_0_S6_S3 1 100 0 255 DISPLAY_IDENTIFIER n_kup_oeffnet.iUl2KupplDInt ECU_ADDRESS 0xFFF8EACC /end MEASUREMENT
/begin MEASUREMENT iUl2KupplDInt.n_kup_oeffnet_stromlos "Zähler zur Verzögerung der Erkennung - Schaltelement nicht geschaltet" UBYTE UMR___1_1_0_S6_S3 1 100 0 255 DISPLAY_IDENTIFIER n_kup_oeffnet_stromlos.iUl2KupplDInt ECU_ADDRESS 0xFFF8EACD /end MEASUREMENT
/begin MEASUREMENT iUl2KupplDInt.n_kup_basis_korrektur "Zähler zur Verzögerung der Korrektur des Störzählers durch Basisstrombedingung" UBYTE UMR___1_1_0_S6_S3 1 100 0 255 DISPLAY_IDENTIFIER n_kup_basis_korrektur.iUl2KupplDInt ECU_ADDRESS 0xFFF8EACE /end MEASUREMENT
/begin MEASUREMENT iUl2KupplDInt.delta_i_edslogik "Differenz zwischen Kupplungsstrom u. Stromschwelle (KF_IEDSMAXMMOTCGLOGIKUEB bzw. KF_IEDSMINMMOTCGLOGIKUEB)" SWORD UMR_MA__1_10_0_S6_S3 1 100 0 1000 DISPLAY_IDENTIFIER delta_i_edslogik.iUl2KupplDInt ECU_ADDRESS 0xFFF8EAD0 /end MEASUREMENT
/begin MEASUREMENT iUl2KupplDInt.f_erste_bef_erk "Das Flag zeigt an, dass die erste Befüllung erkannt wurde." UBYTE UMR___1_1_0_S6_S3 1 100 0 1 DISPLAY_IDENTIFIER f_erste_bef_erk.iUl2KupplDInt ECU_ADDRESS 0xFFF8EAD2 /end MEASUREMENT
/begin MEASUREMENT iUl2KupplDInt.nverzmin_dekrement "Das Flag zeigt an, dass die erste Befüllung erkannt wurde." UBYTE UMR___1_1_0_S6_S3 1 100 0 255 DISPLAY_IDENTIFIER nverzmin_dekrement.iUl2KupplDInt ECU_ADDRESS 0xFFF8EAD3 /end MEASUREMENT
/begin MEASUREMENT iUl2KupplDFl.cUl2KupBasisFl._.f_geschlossen "Das Flag zeigt an ob die Kupplung geschlossen ist" FLOAT32_IEEE UMR___1_1_0_S6_S3 1 100 0 1 FORMAT "%4.2" DISPLAY_IDENTIFIER f_geschlossen._.cUl2KupBasisFl.iUl2KupplDFl ECU_ADDRESS 0xFFF8EAD4 /end MEASUREMENT
/begin MEASUREMENT iUl2KupplDFl.f_init "Gibt an ob die Kupplungswerte Initialisiert wurden sind." FLOAT32_IEEE UMR___1_1_0_S6_S3 1 100 0 1 FORMAT "%4.2" DISPLAY_IDENTIFIER f_init.iUl2KupplDFl ECU_ADDRESS 0xFFF8EAE4 /end MEASUREMENT
/begin MEASUREMENT iUl2KupplDFl.n_stoeredslogik_schwelle "Schwelle die Überschritten werden muss um die Kupplung als geschlossen zu erkennen" FLOAT32_IEEE UMR___1_1_0_S6_S3 1 100 0 510 FORMAT "%4.2" DISPLAY_IDENTIFIER n_stoeredslogik_schwelle.iUl2KupplDFl ECU_ADDRESS 0xFFF8EAE8 /end MEASUREMENT
/begin MEASUREMENT iUl2KupplDFl.n_stoeredslogik_init "Kleinster Wert auf dem Feld KF_MAXSTOERCGDELTAI_EDSLOGIK" FLOAT32_IEEE UMR___1_1_0_S6_S3 1 100 0 255 FORMAT "%4.2" DISPLAY_IDENTIFIER n_stoeredslogik_init.iUl2KupplDFl ECU_ADDRESS 0xFFF8EAEC /end MEASUREMENT
/begin MEASUREMENT iUl2KupplDFl.n_stoeredslogik "Stoerzaehler für falsch bestromte Kupplung" FLOAT32_IEEE UMR___1_1_0_S6_S3 1 100 0 32767 FORMAT "%4.2" DISPLAY_IDENTIFIER n_stoeredslogik.iUl2KupplDFl ECU_ADDRESS 0xFFF8EAF0 /end MEASUREMENT
/begin MEASUREMENT iUl2KupplDFl.i_sw_kup_schliesst "aktuelle Stromschwelle, die überschritten/unterschritten werden muss um die Kupplung als geschlossen zu erkennen" FLOAT32_IEEE UMR_MA__1_10_0_S6_S3 1 100 0 3276.7 DISPLAY_IDENTIFIER i_sw_kup_schliesst.iUl2KupplDFl ECU_ADDRESS 0xFFF8EAF4 /end MEASUREMENT
/begin MEASUREMENT iUl2KupplDFl.i_sw_kup_oeffnet "aktuelle Stromschwelle, die überschritten/unterschritten werden muss um die Kupplung als geöffnet zu erkennen" FLOAT32_IEEE UMR_MA__1_10_0_S6_S3 1 100 0 3276.7 DISPLAY_IDENTIFIER i_sw_kup_oeffnet.iUl2KupplDFl ECU_ADDRESS 0xFFF8EAF8 /end MEASUREMENT
/begin MEASUREMENT iUl2KupplDFl.n_kup_oeffnet "Zähler zur Verzögerung der Erkennung - Schaltelement nicht geschaltet" FLOAT32_IEEE UMR___1_1_0_S6_S3 1 100 0 255 FORMAT "%4.2" DISPLAY_IDENTIFIER n_kup_oeffnet.iUl2KupplDFl ECU_ADDRESS 0xFFF8EAFC /end MEASUREMENT
/begin MEASUREMENT iUl2KupplDFl.n_kup_oeffnet_stromlos "Zähler zur Verzögerung der Erkennung - Schaltelement nicht geschaltet" FLOAT32_IEEE UMR___1_1_0_S6_S3 1 100 0 255 FORMAT "%4.2" DISPLAY_IDENTIFIER n_kup_oeffnet_stromlos.iUl2KupplDFl ECU_ADDRESS 0xFFF8EB00 /end MEASUREMENT
/begin MEASUREMENT iUl2KupplDFl.n_kup_basis_korrektur "Zähler zur Verzögerung der Korrektur des Störzählers durch Basisstrombedingung" FLOAT32_IEEE UMR___1_1_0_S6_S3 1 100 0 255 FORMAT "%4.2" DISPLAY_IDENTIFIER n_kup_basis_korrektur.iUl2KupplDFl ECU_ADDRESS 0xFFF8EB04 /end MEASUREMENT
/begin MEASUREMENT iUl2KupplDFl.delta_i_edslogik "Differenz zwischen Kupplungsstrom u. Stromschwelle (KF_IEDSMAXMMOTCGLOGIKUEB bzw. KF_IEDSMINMMOTCGLOGIKUEB)" FLOAT32_IEEE UMR_MA__1_10_0_S6_S3 1 100 0 1000 DISPLAY_IDENTIFIER delta_i_edslogik.iUl2KupplDFl ECU_ADDRESS 0xFFF8EB08 /end MEASUREMENT
/begin MEASUREMENT iUl2KupplDFl.f_erste_bef_erk "Das Flag zeigt an, dass die erste Befüllung erkannt wurde." FLOAT32_IEEE UMR___1_1_0_S6_S3 1 100 0 1 FORMAT "%4.2" DISPLAY_IDENTIFIER f_erste_bef_erk.iUl2KupplDFl ECU_ADDRESS 0xFFF8EB0C /end MEASUREMENT
/begin MEASUREMENT iUl2KupplDFl.nverzmin_dekrement "Das Flag zeigt an, dass die erste Befüllung erkannt wurde." FLOAT32_IEEE UMR___1_1_0_S6_S3 1 100 0 255 FORMAT "%4.2" DISPLAY_IDENTIFIER nverzmin_dekrement.iUl2KupplDFl ECU_ADDRESS 0xFFF8EB10 /end MEASUREMENT
/begin MEASUREMENT iUl2KupplToggleDInt.cUl2KupBasisInt._.f_geschlossen "Das Flag zeigt an ob die Kupplung geschlossen ist" UBYTE UMR___1_1_0_S6_S3 1 100 0 1 DISPLAY_IDENTIFIER f_geschlossen._.cUl2KupBasisInt.iUl2KupplToggleDInt ECU_ADDRESS 0xFFF8EB14 /end MEASUREMENT
/begin MEASUREMENT iUl2KupplToggleDInt.schwelle_toggel_stoer "Schwelle für Störungen, nach denen eine Kupplung als geschlossen erkannt wird" UBYTE UMR___1_1_0_S6_S3 1 100 0 255 DISPLAY_IDENTIFIER schwelle_toggel_stoer.iUl2KupplToggleDInt ECU_ADDRESS 0xFFF8EB24 /end MEASUREMENT
/begin MEASUREMENT iUl2KupplToggleDInt.schwelle_toggel_gut "Schwelle wann eine Kupplung als entleert gilt" UWORD UMR___1_1_0_S6_S3 1 100 0 255 DISPLAY_IDENTIFIER schwelle_toggel_gut.iUl2KupplToggleDInt ECU_ADDRESS 0xFFF8EB26 /end MEASUREMENT
/begin MEASUREMENT iUl2KupplToggleDInt.n_stoer_edslogik_toggel "Zustand" UWORD UMR___1_1_0_S6_S3 1 100 0 256 DISPLAY_IDENTIFIER n_stoer_edslogik_toggel.iUl2KupplToggleDInt ECU_ADDRESS 0xFFF8EB28 /end MEASUREMENT
/begin MEASUREMENT iUl2KupplToggleDInt.n_gut_edslogik_toggel "Zustand" UWORD UMR___1_1_0_S6_S3 1 100 0 256 DISPLAY_IDENTIFIER n_gut_edslogik_toggel.iUl2KupplToggleDInt ECU_ADDRESS 0xFFF8EB2A /end MEASUREMENT
/begin MEASUREMENT iUl2KupplToggleDFl.cUl2KupBasisFl._.f_geschlossen "Das Flag zeigt an ob die Kupplung geschlossen ist" FLOAT32_IEEE UMR___1_1_0_S6_S3 1 100 0 1 FORMAT "%4.2" DISPLAY_IDENTIFIER f_geschlossen._.cUl2KupBasisFl.iUl2KupplToggleDFl ECU_ADDRESS 0xFFF8EB2C /end MEASUREMENT
/begin MEASUREMENT iUl2KupplToggleDFl.schwelle_toggel_stoer "Schwelle für Störungen, nach denen eine Kupplung als geschlossen erkannt wird" FLOAT32_IEEE UMR___1_1_0_S6_S3 1 100 0 255 FORMAT "%4.2" DISPLAY_IDENTIFIER schwelle_toggel_stoer.iUl2KupplToggleDFl ECU_ADDRESS 0xFFF8EB3C /end MEASUREMENT
/begin MEASUREMENT iUl2KupplToggleDFl.schwelle_toggel_gut "Schwelle wann eine Kupplung als entleert gilt" FLOAT32_IEEE UMR___1_1_0_S6_S3 1 100 0 255 FORMAT "%4.2" DISPLAY_IDENTIFIER schwelle_toggel_gut.iUl2KupplToggleDFl ECU_ADDRESS 0xFFF8EB40 /end MEASUREMENT
/begin MEASUREMENT iUl2KupplToggleDFl.n_stoer_edslogik_toggel "Zustand" FLOAT32_IEEE UMR___1_1_0_S6_S3 1 100 0 256 FORMAT "%4.2" DISPLAY_IDENTIFIER n_stoer_edslogik_toggel.iUl2KupplToggleDFl ECU_ADDRESS 0xFFF8EB44 /end MEASUREMENT
/begin MEASUREMENT iUl2KupplToggleDFl.n_gut_edslogik_toggel "Zustand" FLOAT32_IEEE UMR___1_1_0_S6_S3 1 100 0 256 FORMAT "%4.2" DISPLAY_IDENTIFIER n_gut_edslogik_toggel.iUl2KupplToggleDFl ECU_ADDRESS 0xFFF8EB48 /end MEASUREMENT
/begin MEASUREMENT iUl2KupplEInt.cUl2KupBasisInt._.f_geschlossen "Das Flag zeigt an ob die Kupplung geschlossen ist" UBYTE UMR___1_1_0_S6_S3 1 100 0 1 DISPLAY_IDENTIFIER f_geschlossen._.cUl2KupBasisInt.iUl2KupplEInt ECU_ADDRESS 0xFFF8EB4C /end MEASUREMENT
/begin MEASUREMENT iUl2KupplEInt.f_init "Gibt an ob die Kupplungswerte Initialisiert wurden sind." UBYTE UMR___1_1_0_S6_S3 1 100 0 1 DISPLAY_IDENTIFIER f_init.iUl2KupplEInt ECU_ADDRESS 0xFFF8EB5C /end MEASUREMENT
/begin MEASUREMENT iUl2KupplEInt.n_stoeredslogik_schwelle "Schwelle die Überschritten werden muss um die Kupplung als geschlossen zu erkennen" SWORD UMR___1_1_0_S6_S3 1 100 0 510 DISPLAY_IDENTIFIER n_stoeredslogik_schwelle.iUl2KupplEInt ECU_ADDRESS 0xFFF8EB5E /end MEASUREMENT
/begin MEASUREMENT iUl2KupplEInt.n_stoeredslogik_init "Kleinster Wert auf dem Feld KF_MAXSTOERCGDELTAI_EDSLOGIK" SWORD UMR___1_1_0_S6_S3 1 100 0 255 DISPLAY_IDENTIFIER n_stoeredslogik_init.iUl2KupplEInt ECU_ADDRESS 0xFFF8EB60 /end MEASUREMENT
/begin MEASUREMENT iUl2KupplEInt.n_stoeredslogik "Stoerzaehler für falsch bestromte Kupplung" SWORD UMR___1_1_0_S6_S3 1 100 0 32767 DISPLAY_IDENTIFIER n_stoeredslogik.iUl2KupplEInt ECU_ADDRESS 0xFFF8EB62 /end MEASUREMENT
/begin MEASUREMENT iUl2KupplEInt.i_sw_kup_schliesst "aktuelle Stromschwelle, die überschritten/unterschritten werden muss um die Kupplung als geschlossen zu erkennen" SWORD UMR_MA__1_10_0_S6_S3 1 100 0 3276.7 DISPLAY_IDENTIFIER i_sw_kup_schliesst.iUl2KupplEInt ECU_ADDRESS 0xFFF8EB64 /end MEASUREMENT
/begin MEASUREMENT iUl2KupplEInt.i_sw_kup_oeffnet "aktuelle Stromschwelle, die überschritten/unterschritten werden muss um die Kupplung als geöffnet zu erkennen" SWORD UMR_MA__1_10_0_S6_S3 1 100 0 3276.7 DISPLAY_IDENTIFIER i_sw_kup_oeffnet.iUl2KupplEInt ECU_ADDRESS 0xFFF8EB66 /end MEASUREMENT
/begin MEASUREMENT iUl2KupplEInt.n_kup_oeffnet "Zähler zur Verzögerung der Erkennung - Schaltelement nicht geschaltet" UBYTE UMR___1_1_0_S6_S3 1 100 0 255 DISPLAY_IDENTIFIER n_kup_oeffnet.iUl2KupplEInt ECU_ADDRESS 0xFFF8EB68 /end MEASUREMENT
/begin MEASUREMENT iUl2KupplEInt.n_kup_oeffnet_stromlos "Zähler zur Verzögerung der Erkennung - Schaltelement nicht geschaltet" UBYTE UMR___1_1_0_S6_S3 1 100 0 255 DISPLAY_IDENTIFIER n_kup_oeffnet_stromlos.iUl2KupplEInt ECU_ADDRESS 0xFFF8EB69 /end MEASUREMENT
/begin MEASUREMENT iUl2KupplEInt.n_kup_basis_korrektur "Zähler zur Verzögerung der Korrektur des Störzählers durch Basisstrombedingung" UBYTE UMR___1_1_0_S6_S3 1 100 0 255 DISPLAY_IDENTIFIER n_kup_basis_korrektur.iUl2KupplEInt ECU_ADDRESS 0xFFF8EB6A /end MEASUREMENT
/begin MEASUREMENT iUl2KupplEInt.delta_i_edslogik "Differenz zwischen Kupplungsstrom u. Stromschwelle (KF_IEDSMAXMMOTCGLOGIKUEB bzw. KF_IEDSMINMMOTCGLOGIKUEB)" SWORD UMR_MA__1_10_0_S6_S3 1 100 0 1000 DISPLAY_IDENTIFIER delta_i_edslogik.iUl2KupplEInt ECU_ADDRESS 0xFFF8EB6C /end MEASUREMENT
/begin MEASUREMENT iUl2KupplEInt.f_erste_bef_erk "Das Flag zeigt an, dass die erste Befüllung erkannt wurde." UBYTE UMR___1_1_0_S6_S3 1 100 0 1 DISPLAY_IDENTIFIER f_erste_bef_erk.iUl2KupplEInt ECU_ADDRESS 0xFFF8EB6E /end MEASUREMENT
/begin MEASUREMENT iUl2KupplEInt.nverzmin_dekrement "Das Flag zeigt an, dass die erste Befüllung erkannt wurde." UBYTE UMR___1_1_0_S6_S3 1 100 0 255 DISPLAY_IDENTIFIER nverzmin_dekrement.iUl2KupplEInt ECU_ADDRESS 0xFFF8EB6F /end MEASUREMENT
/begin MEASUREMENT iUl2KupplEFl.cUl2KupBasisFl._.f_geschlossen "Das Flag zeigt an ob die Kupplung geschlossen ist" FLOAT32_IEEE UMR___1_1_0_S6_S3 1 100 0 1 FORMAT "%4.2" DISPLAY_IDENTIFIER f_geschlossen._.cUl2KupBasisFl.iUl2KupplEFl ECU_ADDRESS 0xFFF8EB70 /end MEASUREMENT
/begin MEASUREMENT iUl2KupplEFl.f_init "Gibt an ob die Kupplungswerte Initialisiert wurden sind." FLOAT32_IEEE UMR___1_1_0_S6_S3 1 100 0 1 FORMAT "%4.2" DISPLAY_IDENTIFIER f_init.iUl2KupplEFl ECU_ADDRESS 0xFFF8EB80 /end MEASUREMENT
/begin MEASUREMENT iUl2KupplEFl.n_stoeredslogik_schwelle "Schwelle die Überschritten werden muss um die Kupplung als geschlossen zu erkennen" FLOAT32_IEEE UMR___1_1_0_S6_S3 1 100 0 510 FORMAT "%4.2" DISPLAY_IDENTIFIER n_stoeredslogik_schwelle.iUl2KupplEFl ECU_ADDRESS 0xFFF8EB84 /end MEASUREMENT
/begin MEASUREMENT iUl2KupplEFl.n_stoeredslogik_init "Kleinster Wert auf dem Feld KF_MAXSTOERCGDELTAI_EDSLOGIK" FLOAT32_IEEE UMR___1_1_0_S6_S3 1 100 0 255 FORMAT "%4.2" DISPLAY_IDENTIFIER n_stoeredslogik_init.iUl2KupplEFl ECU_ADDRESS 0xFFF8EB88 /end MEASUREMENT
/begin MEASUREMENT iUl2KupplEFl.n_stoeredslogik "Stoerzaehler für falsch bestromte Kupplung" FLOAT32_IEEE UMR___1_1_0_S6_S3 1 100 0 32767 FORMAT "%4.2" DISPLAY_IDENTIFIER n_stoeredslogik.iUl2KupplEFl ECU_ADDRESS 0xFFF8EB8C /end MEASUREMENT
/begin MEASUREMENT iUl2KupplEFl.i_sw_kup_schliesst "aktuelle Stromschwelle, die überschritten/unterschritten werden muss um die Kupplung als geschlossen zu erkennen" FLOAT32_IEEE UMR_MA__1_10_0_S6_S3 1 100 0 3276.7 DISPLAY_IDENTIFIER i_sw_kup_schliesst.iUl2KupplEFl ECU_ADDRESS 0xFFF8EB90 /end MEASUREMENT
/begin MEASUREMENT iUl2KupplEFl.i_sw_kup_oeffnet "aktuelle Stromschwelle, die überschritten/unterschritten werden muss um die Kupplung als geöffnet zu erkennen" FLOAT32_IEEE UMR_MA__1_10_0_S6_S3 1 100 0 3276.7 DISPLAY_IDENTIFIER i_sw_kup_oeffnet.iUl2KupplEFl ECU_ADDRESS 0xFFF8EB94 /end MEASUREMENT
/begin MEASUREMENT iUl2KupplEFl.n_kup_oeffnet "Zähler zur Verzögerung der Erkennung - Schaltelement nicht geschaltet" FLOAT32_IEEE UMR___1_1_0_S6_S3 1 100 0 255 FORMAT "%4.2" DISPLAY_IDENTIFIER n_kup_oeffnet.iUl2KupplEFl ECU_ADDRESS 0xFFF8EB98 /end MEASUREMENT
/begin MEASUREMENT iUl2KupplEFl.n_kup_oeffnet_stromlos "Zähler zur Verzögerung der Erkennung - Schaltelement nicht geschaltet" FLOAT32_IEEE UMR___1_1_0_S6_S3 1 100 0 255 FORMAT "%4.2" DISPLAY_IDENTIFIER n_kup_oeffnet_stromlos.iUl2KupplEFl ECU_ADDRESS 0xFFF8EB9C /end MEASUREMENT
/begin MEASUREMENT iUl2KupplEFl.n_kup_basis_korrektur "Zähler zur Verzögerung der Korrektur des Störzählers durch Basisstrombedingung" FLOAT32_IEEE UMR___1_1_0_S6_S3 1 100 0 255 FORMAT "%4.2" DISPLAY_IDENTIFIER n_kup_basis_korrektur.iUl2KupplEFl ECU_ADDRESS 0xFFF8EBA0 /end MEASUREMENT
/begin MEASUREMENT iUl2KupplEFl.delta_i_edslogik "Differenz zwischen Kupplungsstrom u. Stromschwelle (KF_IEDSMAXMMOTCGLOGIKUEB bzw. KF_IEDSMINMMOTCGLOGIKUEB)" FLOAT32_IEEE UMR_MA__1_10_0_S6_S3 1 100 0 1000 DISPLAY_IDENTIFIER delta_i_edslogik.iUl2KupplEFl ECU_ADDRESS 0xFFF8EBA4 /end MEASUREMENT
/begin MEASUREMENT iUl2KupplEFl.f_erste_bef_erk "Das Flag zeigt an, dass die erste Befüllung erkannt wurde." FLOAT32_IEEE UMR___1_1_0_S6_S3 1 100 0 1 FORMAT "%4.2" DISPLAY_IDENTIFIER f_erste_bef_erk.iUl2KupplEFl ECU_ADDRESS 0xFFF8EBA8 /end MEASUREMENT
/begin MEASUREMENT iUl2KupplEFl.nverzmin_dekrement "Das Flag zeigt an, dass die erste Befüllung erkannt wurde." FLOAT32_IEEE UMR___1_1_0_S6_S3 1 100 0 255 FORMAT "%4.2" DISPLAY_IDENTIFIER nverzmin_dekrement.iUl2KupplEFl ECU_ADDRESS 0xFFF8EBAC /end MEASUREMENT
/begin MEASUREMENT iUl2KupplToggleEInt.cUl2KupBasisInt._.f_geschlossen "Das Flag zeigt an ob die Kupplung geschlossen ist" UBYTE UMR___1_1_0_S6_S3 1 100 0 1 DISPLAY_IDENTIFIER f_geschlossen._.cUl2KupBasisInt.iUl2KupplToggleEInt ECU_ADDRESS 0xFFF8EBB0 /end MEASUREMENT
/begin MEASUREMENT iUl2KupplToggleEInt.schwelle_toggel_stoer "Schwelle für Störungen, nach denen eine Kupplung als geschlossen erkannt wird" UBYTE UMR___1_1_0_S6_S3 1 100 0 255 DISPLAY_IDENTIFIER schwelle_toggel_stoer.iUl2KupplToggleEInt ECU_ADDRESS 0xFFF8EBC0 /end MEASUREMENT
/begin MEASUREMENT iUl2KupplToggleEInt.schwelle_toggel_gut "Schwelle wann eine Kupplung als entleert gilt" UWORD UMR___1_1_0_S6_S3 1 100 0 255 DISPLAY_IDENTIFIER schwelle_toggel_gut.iUl2KupplToggleEInt ECU_ADDRESS 0xFFF8EBC2 /end MEASUREMENT
/begin MEASUREMENT iUl2KupplToggleEInt.n_stoer_edslogik_toggel "Zustand" UWORD UMR___1_1_0_S6_S3 1 100 0 256 DISPLAY_IDENTIFIER n_stoer_edslogik_toggel.iUl2KupplToggleEInt ECU_ADDRESS 0xFFF8EBC4 /end MEASUREMENT
/begin MEASUREMENT iUl2KupplToggleEInt.n_gut_edslogik_toggel "Zustand" UWORD UMR___1_1_0_S6_S3 1 100 0 256 DISPLAY_IDENTIFIER n_gut_edslogik_toggel.iUl2KupplToggleEInt ECU_ADDRESS 0xFFF8EBC6 /end MEASUREMENT
/begin MEASUREMENT iUl2KupplToggleEFl.cUl2KupBasisFl._.f_geschlossen "Das Flag zeigt an ob die Kupplung geschlossen ist" FLOAT32_IEEE UMR___1_1_0_S6_S3 1 100 0 1 FORMAT "%4.2" DISPLAY_IDENTIFIER f_geschlossen._.cUl2KupBasisFl.iUl2KupplToggleEFl ECU_ADDRESS 0xFFF8EBC8 /end MEASUREMENT
/begin MEASUREMENT iUl2KupplToggleEFl.schwelle_toggel_stoer "Schwelle für Störungen, nach denen eine Kupplung als geschlossen erkannt wird" FLOAT32_IEEE UMR___1_1_0_S6_S3 1 100 0 255 FORMAT "%4.2" DISPLAY_IDENTIFIER schwelle_toggel_stoer.iUl2KupplToggleEFl ECU_ADDRESS 0xFFF8EBD8 /end MEASUREMENT
/begin MEASUREMENT iUl2KupplToggleEFl.schwelle_toggel_gut "Schwelle wann eine Kupplung als entleert gilt" FLOAT32_IEEE UMR___1_1_0_S6_S3 1 100 0 255 FORMAT "%4.2" DISPLAY_IDENTIFIER schwelle_toggel_gut.iUl2KupplToggleEFl ECU_ADDRESS 0xFFF8EBDC /end MEASUREMENT
/begin MEASUREMENT iUl2KupplToggleEFl.n_stoer_edslogik_toggel "Zustand" FLOAT32_IEEE UMR___1_1_0_S6_S3 1 100 0 256 FORMAT "%4.2" DISPLAY_IDENTIFIER n_stoer_edslogik_toggel.iUl2KupplToggleEFl ECU_ADDRESS 0xFFF8EBE0 /end MEASUREMENT
/begin MEASUREMENT iUl2KupplToggleEFl.n_gut_edslogik_toggel "Zustand" FLOAT32_IEEE UMR___1_1_0_S6_S3 1 100 0 256 FORMAT "%4.2" DISPLAY_IDENTIFIER n_gut_edslogik_toggel.iUl2KupplToggleEFl ECU_ADDRESS 0xFFF8EBE4 /end MEASUREMENT
/begin MEASUREMENT iUl2KupplBSfktInt.n_verz_edslogik "Verzögerung bis Kupplung als geschlossen gilt" UWORD UMR___1_1_0_S6_S3 1 100 0 256 DISPLAY_IDENTIFIER n_verz_edslogik.iUl2KupplBSfktInt ECU_ADDRESS 0xFFF8EBE8 /end MEASUREMENT
/begin MEASUREMENT iUl2KupplBSfktInt.n_kup_zu_edslogik_anfahrkup "Kupplung gilt als offen o. geschlosen" UBYTE Conv.cUl2KupplBSfktInt._.n_kup_zu_edslogik_anfahrkup_S6_S3 1 100 0 1 DISPLAY_IDENTIFIER n_kup_zu_edslogik_anfahrkup.iUl2KupplBSfktInt ECU_ADDRESS 0xFFF8EBEA /end MEASUREMENT
/begin MEASUREMENT iUl2KupplBSfktFl.n_verz_edslogik "Verzögerung bis Kupplung als geschlossen gilt" FLOAT32_IEEE UMR___1_1_0_S6_S3 1 100 0 256 FORMAT "%4.2" DISPLAY_IDENTIFIER n_verz_edslogik.iUl2KupplBSfktFl ECU_ADDRESS 0xFFF8EBEC /end MEASUREMENT
/begin MEASUREMENT iUl2KupplBSfktFl.n_kup_zu_edslogik_anfahrkup "Kupplung gilt als offen o. geschlosen" FLOAT32_IEEE Conv.cUl2KupplBSfktFl._.n_kup_zu_edslogik_anfahrkup_S6_S3 1 100 0 1 FORMAT "%4.2" DISPLAY_IDENTIFIER n_kup_zu_edslogik_anfahrkup.iUl2KupplBSfktFl ECU_ADDRESS 0xFFF8EBF0 /end MEASUREMENT
/begin COMPU_METHOD SBW_POW_360000_S1_S3 "int = ((phys * 360000) / 1) - (0) mAh" RAT_FUNC "%8.6" "mAh" COEFFS 0 360000 -0 0 0 1 /end COMPU_METHOD
/begin COMPU_METHOD SBW_DREHMOMENT_NM_S1_S3 "int = ((phys * 1) / 1) - (-32000) Drehmoment" RAT_FUNC "%2.0" "Drehmoment" COEFFS 0 1 32000 0 0 1 /end COMPU_METHOD
/begin COMPU_METHOD UMR___1_1000_0_S6_S3 "int = ((phys * 1000) / 1) - (0) [-]" RAT_FUNC "%5.3" "[-]" COEFFS 0 1000 -0 0 0 1 /end COMPU_METHOD
/begin COMPU_METHOD UMR___1_1_0_S6_S3 "int = ((phys * 1) / 1) - (0) [-]" RAT_FUNC "%2.0" "[-]" COEFFS 0 1 -0 0 0 1 /end COMPU_METHOD
/begin COMPU_METHOD UMR_MA__1_10_0_S6_S3 "int = ((phys * 10) / 1) - (0) [mA]" RAT_FUNC "%3.1" "[mA]" COEFFS 0 10 -0 0 0 1 /end COMPU_METHOD
/begin COMPU_METHOD UMR_NM__1_1_0_S6_S3 "int = ((phys * 1) / 1) - (0) [Nm]" RAT_FUNC "%2.0" "[Nm]" COEFFS 0 1 -0 0 0 1 /end COMPU_METHOD
/begin COMPU_METHOD UMR_NM__1_1_M32000_S6_S3 "int = ((phys * 1) / 1) - (-32000) [Nm]" RAT_FUNC "%2.0" "[Nm]" COEFFS 0 1 32000 0 0 1 /end COMPU_METHOD
/begin COMPU_METHOD UMR_BAR__1_2_0_S6_S3 "int = ((phys * 2) / 1) - (0) [bar]" RAT_FUNC "%4.2" "[bar]" COEFFS 0 2 -0 0 0 1 /end COMPU_METHOD
/begin COMPU_METHOD UMR_U_MIN_1_1_0_S6_S3 "int = ((phys * 1) / 1) - (0) [U/min]" RAT_FUNC "%2.0" "[U/min]" COEFFS 0 1 -0 0 0 1 /end COMPU_METHOD
/begin COMPU_METHOD UMR_GRADC__1_1_M40_S6_S3 "int = ((phys * 1) / 1) - (-40) [°C]" RAT_FUNC "%2.0" "[°C]" COEFFS 0 1 40 0 0 1 /end COMPU_METHOD
/begin COMPU_METHOD UMR_KM_H_1_1_0_S6_S3 "int = ((phys * 1) / 1) - (0) [km/h]" RAT_FUNC "%2.0" "[km/h]" COEFFS 0 1 -0 0 0 1 /end COMPU_METHOD
/begin COMPU_METHOD UMR_M_SEC2_1_32_0_S6_S3 "int = ((phys * 32) / 1) - (0) [m/s^2]" RAT_FUNC "%4.2" "[m/s^2]" COEFFS 0 32 -0 0 0 1 /end COMPU_METHOD
/begin COMPU_METHOD Conv.cUl2ItfipInt._.iv_nmotstatusl2_S6_S3 "Umrechnung fuer Messgroesse cUl2ItfipInt::iv_nmotstatusl2" TAB_VERB "%4.0" "" COMPU_TAB_REF Conv.cUl2ItfipInt._.iv_nmotstatusl2_S6_S3 /end COMPU_METHOD
/begin COMPU_METHOD Conv.cUl2ItfipInt._.n_mot_status_l2_S6_S3 "Umrechnung fuer Messgroesse cUl2ItfipInt::n_mot_status_l2" TAB_VERB "%4.0" "" COMPU_TAB_REF Conv.cUl2ItfipInt._.n_mot_status_l2_S6_S3 /end COMPU_METHOD
/begin COMPU_METHOD Conv.cUl2ItfipInt._.iv_dscfehlerl2_S6_S3 "Umrechnung fuer Messgroesse cUl2ItfipInt::iv_dscfehlerl2" TAB_VERB "%4.0" "" COMPU_TAB_REF Conv.cUl2ItfipInt._.iv_dscfehlerl2_S6_S3 /end COMPU_METHOD
/begin COMPU_METHOD Conv.cUl2ItfipInt._.dsc_fehler_l2_S6_S3 "Umrechnung fuer Messgroesse cUl2ItfipInt::dsc_fehler_l2" TAB_VERB "%4.0" "" COMPU_TAB_REF Conv.cUl2ItfipInt._.dsc_fehler_l2_S6_S3 /end COMPU_METHOD
/begin COMPU_METHOD Conv.cUl2ItfipInt._.iv_pos_l2_S6_S3 "Umrechnung fuer Messgroesse cUl2ItfipInt::iv_pos_l2" TAB_VERB "%4.0" "" COMPU_TAB_REF Conv.cUl2ItfipInt._.iv_pos_l2_S6_S3 /end COMPU_METHOD
/begin COMPU_METHOD Conv.cUl2ItfipInt._.pos_l2_S6_S3 "Umrechnung fuer Messgroesse cUl2ItfipInt::pos_l2" TAB_VERB "%4.0" "" COMPU_TAB_REF Conv.cUl2ItfipInt._.pos_l2_S6_S3 /end COMPU_METHOD
/begin COMPU_METHOD Conv.cUl2ItfipInt._.iv_nmo_vm_status_l2_S6_S3 "Umrechnung fuer Messgroesse cUl2ItfipInt::iv_nmo_vm_status_l2" TAB_VERB "%4.0" "" COMPU_TAB_REF Conv.cUl2ItfipInt._.iv_nmo_vm_status_l2_S6_S3 /end COMPU_METHOD
/begin COMPU_METHOD Conv.cUl2ItfipInt._.nmo_vm_status_l2_S6_S3 "Umrechnung fuer Messgroesse cUl2ItfipInt::nmo_vm_status_l2" TAB_VERB "%4.0" "" COMPU_TAB_REF Conv.cUl2ItfipInt._.nmo_vm_status_l2_S6_S3 /end COMPU_METHOD
/begin COMPU_METHOD Conv.cUl2ItfipInt._.iv_v_unplausibel_l2_S6_S3 "Umrechnung fuer Messgroesse cUl2ItfipInt::iv_v_unplausibel_l2" TAB_VERB "%4.0" "" COMPU_TAB_REF Conv.cUl2ItfipInt._.iv_v_unplausibel_l2_S6_S3 /end COMPU_METHOD
/begin COMPU_METHOD Conv.cUl2ItfipInt._.v_unplausibel_l2_S6_S3 "Umrechnung fuer Messgroesse cUl2ItfipInt::v_unplausibel_l2" TAB_VERB "%4.0" "" COMPU_TAB_REF Conv.cUl2ItfipInt._.v_unplausibel_l2_S6_S3 /end COMPU_METHOD
/begin COMPU_METHOD Conv.cUl2ItfipInt._.iv_ps_sensor_signal_l2_S6_S3 "Umrechnung fuer Messgroesse cUl2ItfipInt::iv_ps_sensor_signal_l2" TAB_VERB "%4.0" "" COMPU_TAB_REF Conv.cUl2ItfipInt._.iv_ps_sensor_signal_l2_S6_S3 /end COMPU_METHOD
/begin COMPU_METHOD Conv.cUl2ItfipInt._.ps_sensor_signal_l2_S6_S3 "Umrechnung fuer Messgroesse cUl2ItfipInt::ps_sensor_signal_l2" TAB_VERB "%4.0" "" COMPU_TAB_REF Conv.cUl2ItfipInt._.ps_sensor_signal_l2_S6_S3 /end COMPU_METHOD
/begin COMPU_METHOD Conv.cUl2ItfipInt._.iv_ps_sensor_status_l2_S6_S3 "Umrechnung fuer Messgroesse cUl2ItfipInt::iv_ps_sensor_status_l2" TAB_VERB "%4.0" "" COMPU_TAB_REF Conv.cUl2ItfipInt._.iv_ps_sensor_status_l2_S6_S3 /end COMPU_METHOD
/begin COMPU_METHOD Conv.cUl2ItfipInt._.ps_sensor_status_l2_S6_S3 "Umrechnung fuer Messgroesse cUl2ItfipInt::ps_sensor_status_l2" TAB_VERB "%4.0" "" COMPU_TAB_REF Conv.cUl2ItfipInt._.ps_sensor_status_l2_S6_S3 /end COMPU_METHOD
/begin COMPU_METHOD Conv.cUl2ItfipInt._.iv_vehstabnsys_err_l2_S6_S3 "Umrechnung fuer Messgroesse cUl2ItfipInt::iv_vehstabnsys_err_l2" TAB_VERB "%4.0" "" COMPU_TAB_REF Conv.cUl2ItfipInt._.iv_vehstabnsys_err_l2_S6_S3 /end COMPU_METHOD
/begin COMPU_METHOD Conv.cUl2ItfipInt._.vehstabnsys_err_l2_S6_S3 "Umrechnung fuer Messgroesse cUl2ItfipInt::vehstabnsys_err_l2" TAB_VERB "%4.0" "" COMPU_TAB_REF Conv.cUl2ItfipInt._.vehstabnsys_err_l2_S6_S3 /end COMPU_METHOD
/begin COMPU_METHOD Conv.cUl2ItfipInt._.iv_parking_brake_l2_S6_S3 "Umrechnung fuer Messgroesse cUl2ItfipInt::iv_parking_brake_l2" TAB_VERB "%4.0" "" COMPU_TAB_REF Conv.cUl2ItfipInt._.iv_parking_brake_l2_S6_S3 /end COMPU_METHOD
/begin COMPU_METHOD Conv.cUl2ItfipInt._.parking_brake_l2_S6_S3 "Umrechnung fuer Messgroesse cUl2ItfipInt::parking_brake_l2" TAB_VERB "%4.0" "" COMPU_TAB_REF Conv.cUl2ItfipInt._.parking_brake_l2_S6_S3 /end COMPU_METHOD
/begin COMPU_METHOD Conv.cUl2ItfipInt._.iv_nab_direction_S6_S3 "Umrechnung fuer Messgroesse cUl2ItfipInt::iv_nab_direction" TAB_VERB "%4.0" "" COMPU_TAB_REF Conv.cUl2ItfipInt._.iv_nab_direction_S6_S3 /end COMPU_METHOD
/begin COMPU_METHOD Conv.cUl2ItfipInt._.nab_direction_S6_S3 "Umrechnung fuer Messgroesse cUl2ItfipInt::nab_direction" TAB_VERB "%4.0" "" COMPU_TAB_REF Conv.cUl2ItfipInt._.nab_direction_S6_S3 /end COMPU_METHOD
/begin COMPU_METHOD Conv.cUl2ItfipFl._.iv_dscfehlerl2komp_S6_S3 "Umrechnung fuer Messgroesse cUl2ItfipFl::iv_dscfehlerl2komp" TAB_VERB "%4.0" "" COMPU_TAB_REF Conv.cUl2ItfipFl._.iv_dscfehlerl2komp_S6_S3 /end COMPU_METHOD
/begin COMPU_METHOD Conv.cUl2ItfipFl._.iv_pos_l2_komp_S6_S3 "Umrechnung fuer Messgroesse cUl2ItfipFl::iv_pos_l2_komp" TAB_VERB "%4.0" "" COMPU_TAB_REF Conv.cUl2ItfipFl._.iv_pos_l2_komp_S6_S3 /end COMPU_METHOD
/begin COMPU_METHOD Conv.cUl2ItfipFl._.iv_nmo_vm_status_l2_komp_S6_S3 "Umrechnung fuer Messgroesse cUl2ItfipFl::iv_nmo_vm_status_l2_komp" TAB_VERB "%4.0" "" COMPU_TAB_REF Conv.cUl2ItfipFl._.iv_nmo_vm_status_l2_komp_S6_S3 /end COMPU_METHOD
/begin COMPU_METHOD Conv.cUl2ItfipFl._.iv_v_unplausibel_l2_komp_S6_S3 "Umrechnung fuer Messgroesse cUl2ItfipFl::iv_v_unplausibel_l2_komp" TAB_VERB "%4.0" "" COMPU_TAB_REF Conv.cUl2ItfipFl._.iv_v_unplausibel_l2_komp_S6_S3 /end COMPU_METHOD
/begin COMPU_METHOD Conv.cUl2ItfipFl._.iv_ps_sensor_signal_l2_komp_S6_S3 "Umrechnung fuer Messgroesse cUl2ItfipFl::iv_ps_sensor_signal_l2_komp" TAB_VERB "%4.0" "" COMPU_TAB_REF Conv.cUl2ItfipFl._.iv_ps_sensor_signal_l2_komp_S6_S3 /end COMPU_METHOD
/begin COMPU_METHOD Conv.cUl2ItfipFl._.iv_ps_sensor_status_l2_komp_S6_S3 "Umrechnung fuer Messgroesse cUl2ItfipFl::iv_ps_sensor_status_l2_komp" TAB_VERB "%4.0" "" COMPU_TAB_REF Conv.cUl2ItfipFl._.iv_ps_sensor_status_l2_komp_S6_S3 /end COMPU_METHOD
/begin COMPU_METHOD Conv.cUl2ItfipFl._.ps_sensor_status_l2_S6_S3 "Umrechnung fuer Messgroesse cUl2ItfipFl::ps_sensor_status_l2" TAB_VERB "%4.0" "" COMPU_TAB_REF Conv.cUl2ItfipFl._.ps_sensor_status_l2_S6_S3 /end COMPU_METHOD
/begin COMPU_METHOD Conv.cUl2ItfipUewInt._.status_k0_S6_S3 "Umrechnung fuer Messgroesse cUl2ItfipUewInt::status_k0" TAB_VERB "%4.0" "" COMPU_TAB_REF Conv.cUl2ItfipUewInt._.status_k0_S6_S3 /end COMPU_METHOD
/begin COMPU_METHOD Conv.cUl2ItfipUewInt._.me_red_status_S6_S3 "Umrechnung fuer Messgroesse cUl2ItfipUewInt::me_red_status" TAB_VERB "%4.0" "" COMPU_TAB_REF Conv.cUl2ItfipUewInt._.me_red_status_S6_S3 /end COMPU_METHOD
/begin COMPU_METHOD Conv.cUl2ItfipUewInt._.zielgang_sas_S6_S3 "Umrechnung fuer Messgroesse cUl2ItfipUewInt::zielgang_sas" TAB_VERB "%4.0" "" COMPU_TAB_REF Conv.cUl2ItfipUewInt._.zielgang_sas_S6_S3 /end COMPU_METHOD
/begin COMPU_METHOD Conv.cUl2ItfipUewInt._.istgang_S6_S3 "Umrechnung fuer Messgroesse cUl2ItfipUewInt::istgang" TAB_VERB "%4.0" "" COMPU_TAB_REF Conv.cUl2ItfipUewInt._.istgang_S6_S3 /end COMPU_METHOD
/begin COMPU_METHOD Conv.cUl2ItfipUewInt._.pos_atsys_S6_S3 "Umrechnung fuer Messgroesse cUl2ItfipUewInt::pos_atsys" TAB_VERB "%4.0" "" COMPU_TAB_REF Conv.cUl2ItfipUewInt._.pos_atsys_S6_S3 /end COMPU_METHOD
/begin COMPU_METHOD Conv.cUl2ItfipUewFl._.status_k0_S6_S3 "Umrechnung fuer Messgroesse cUl2ItfipUewFl::status_k0" TAB_VERB "%4.0" "" COMPU_TAB_REF Conv.cUl2ItfipUewFl._.status_k0_S6_S3 /end COMPU_METHOD
/begin COMPU_METHOD Conv.cUl2ItfipUewFl._.me_red_status_S6_S3 "Umrechnung fuer Messgroesse cUl2ItfipUewFl::me_red_status" TAB_VERB "%4.0" "" COMPU_TAB_REF Conv.cUl2ItfipUewFl._.me_red_status_S6_S3 /end COMPU_METHOD
/begin COMPU_METHOD Conv.cUl2ItfipUewFl._.zielgang_sas_S6_S3 "Umrechnung fuer Messgroesse cUl2ItfipUewFl::zielgang_sas" TAB_VERB "%4.0" "" COMPU_TAB_REF Conv.cUl2ItfipUewFl._.zielgang_sas_S6_S3 /end COMPU_METHOD
/begin COMPU_METHOD Conv.cUl2ItfipUewFl._.istgang_S6_S3 "Umrechnung fuer Messgroesse cUl2ItfipUewFl::istgang" TAB_VERB "%4.0" "" COMPU_TAB_REF Conv.cUl2ItfipUewFl._.istgang_S6_S3 /end COMPU_METHOD
/begin COMPU_METHOD Conv.cUl2HydEdsInt._.type_S6_S3 "Umrechnung fuer Messgroesse cUl2HydEdsInt::type" TAB_VERB "%4.0" "" COMPU_TAB_REF Conv.cUl2HydEdsInt._.type_S6_S3 /end COMPU_METHOD
/begin COMPU_METHOD Conv.cUl2HydMvInt._.flanke_S6_S3 "Umrechnung fuer Messgroesse cUl2HydMvInt::flanke" TAB_VERB "%4.0" "" COMPU_TAB_REF Conv.cUl2HydMvInt._.flanke_S6_S3 /end COMPU_METHOD
/begin COMPU_METHOD Conv.cUl2HydMvFl._.flanke_S6_S3 "Umrechnung fuer Messgroesse cUl2HydMvFl::flanke" TAB_VERB "%4.0" "" COMPU_TAB_REF Conv.cUl2HydMvFl._.flanke_S6_S3 /end COMPU_METHOD
/begin COMPU_METHOD Conv.cUl2IMinKupInt._.min_kup_bestr_gang_info_S6_S3 "Umrechnung fuer Messgroesse cUl2IMinKupInt::min_kup_bestr_gang_info" TAB_VERB "%4.0" "" COMPU_TAB_REF Conv.cUl2IMinKupInt._.min_kup_bestr_gang_info_S6_S3 /end COMPU_METHOD
/begin COMPU_METHOD Conv.cUl2IMinKupFl._.min_kup_bestr_gang_info_S6_S3 "Umrechnung fuer Messgroesse cUl2IMinKupFl::min_kup_bestr_gang_info" TAB_VERB "%4.0" "" COMPU_TAB_REF Conv.cUl2IMinKupFl._.min_kup_bestr_gang_info_S6_S3 /end COMPU_METHOD
/begin COMPU_METHOD Conv.cUl2StromlosAusserPsInt._.stromlos_ausser_ps_edslg_S6_S3 "Umrechnung fuer Messgroesse cUl2StromlosAusserPsInt::stromlos_ausser_ps_edslg" TAB_VERB "%4.0" "" COMPU_TAB_REF Conv.cUl2StromlosAusserPsInt._.stromlos_ausser_ps_edslg_S6_S3 /end COMPU_METHOD
/begin COMPU_METHOD Conv.cUl2StromlosAusserPsInt._.alt_stromlos_ausser_ps_edslg_S6_S3 "Umrechnung fuer Messgroesse cUl2StromlosAusserPsInt::alt_stromlos_ausser_ps_edslg" TAB_VERB "%4.0" "" COMPU_TAB_REF Conv.cUl2StromlosAusserPsInt._.alt_stromlos_ausser_ps_edslg_S6_S3 /end COMPU_METHOD
/begin COMPU_METHOD Conv.cUl2StromlosAusserPsFl._.stromlos_ausser_ps_edslg_S6_S3 "Umrechnung fuer Messgroesse cUl2StromlosAusserPsFl::stromlos_ausser_ps_edslg" TAB_VERB "%4.0" "" COMPU_TAB_REF Conv.cUl2StromlosAusserPsFl._.stromlos_ausser_ps_edslg_S6_S3 /end COMPU_METHOD
/begin COMPU_METHOD Conv.cUl2StromlosAusserPsFl._.alt_stromlos_ausser_ps_edslg_S6_S3 "Umrechnung fuer Messgroesse cUl2StromlosAusserPsFl::alt_stromlos_ausser_ps_edslg" TAB_VERB "%4.0" "" COMPU_TAB_REF Conv.cUl2StromlosAusserPsFl._.alt_stromlos_ausser_ps_edslg_S6_S3 /end COMPU_METHOD
/begin COMPU_METHOD Conv.cUl2EdsKflKupInt._.f_geschlossen_S6_S3 "Umrechnung fuer Messgroesse cUl2EdsKflKupInt::f_geschlossen" TAB_VERB "%4.0" "" COMPU_TAB_REF Conv.cUl2EdsKflKupInt._.f_geschlossen_S6_S3 /end COMPU_METHOD
/begin COMPU_METHOD Conv.cUl2EdsKflInt._.zustand_direkt_S6_S3 "Umrechnung fuer Messgroesse cUl2EdsKflInt::zustand_direkt" TAB_VERB "%4.0" "" COMPU_TAB_REF Conv.cUl2EdsKflInt._.zustand_direkt_S6_S3 /end COMPU_METHOD
/begin COMPU_METHOD Conv.cUl2EdsKflInt._.zustand_S6_S3 "Umrechnung fuer Messgroesse cUl2EdsKflInt::zustand" TAB_VERB "%4.0" "" COMPU_TAB_REF Conv.cUl2EdsKflInt._.zustand_S6_S3 /end COMPU_METHOD
/begin COMPU_METHOD Conv.cUl2DrehzahlBeobInt._.fl_drehzbeob_schaltung_S6_S3 "Umrechnung fuer Messgroesse cUl2DrehzahlBeobInt::fl_drehzbeob_schaltung" TAB_VERB "%4.0" "" COMPU_TAB_REF Conv.cUl2DrehzahlBeobInt._.fl_drehzbeob_schaltung_S6_S3 /end COMPU_METHOD
/begin COMPU_METHOD Conv.cUl2DrehzahlBeobFl._.fl_drehzbeob_schaltung_S6_S3 "Umrechnung fuer Messgroesse cUl2DrehzahlBeobFl::fl_drehzbeob_schaltung" TAB_VERB "%4.0" "" COMPU_TAB_REF Conv.cUl2DrehzahlBeobFl._.fl_drehzbeob_schaltung_S6_S3 /end COMPU_METHOD
/begin COMPU_METHOD Conv.cUl2KupplBSfktInt._.n_kup_zu_edslogik_anfahrkup_S6_S3 "Umrechnung fuer Messgroesse cUl2KupplBSfktInt::n_kup_zu_edslogik_anfahrkup" TAB_VERB "%4.0" "" COMPU_TAB_REF Conv.cUl2KupplBSfktInt._.n_kup_zu_edslogik_anfahrkup_S6_S3 /end COMPU_METHOD
/begin COMPU_METHOD Conv.cUl2KupplBSfktFl._.n_kup_zu_edslogik_anfahrkup_S6_S3 "Umrechnung fuer Messgroesse cUl2KupplBSfktFl::n_kup_zu_edslogik_anfahrkup" TAB_VERB "%4.0" "" COMPU_TAB_REF Conv.cUl2KupplBSfktFl._.n_kup_zu_edslogik_anfahrkup_S6_S3 /end COMPU_METHOD
/begin COMPU_METHOD Conv.cUl2EdsSignalInt._.posv_ueb_aktiv_l2_S6_S3 "Umrechnung fuer Messgroesse cUl2EdsSignalInt::posv_ueb_aktiv_l2" TAB_VERB "%4.0" "" COMPU_TAB_REF Conv.cUl2EdsSignalInt._.posv_ueb_aktiv_l2_S6_S3 /end COMPU_METHOD
/begin COMPU_METHOD Conv.cUl2EdsSignalInt._.globale_einst_bed_S6_S3 "Umrechnung fuer Messgroesse cUl2EdsSignalInt::globale_einst_bed" TAB_VERB "%4.0" "" COMPU_TAB_REF Conv.cUl2EdsSignalInt._.globale_einst_bed_S6_S3 /end COMPU_METHOD
/begin COMPU_METHOD Conv.cUl2EdsSignalInt._.pos_alt_S6_S3 "Umrechnung fuer Messgroesse cUl2EdsSignalInt::pos_alt" TAB_VERB "%4.0" "" COMPU_TAB_REF Conv.cUl2EdsSignalInt._.pos_alt_S6_S3 /end COMPU_METHOD
/begin COMPU_METHOD Conv.cUl2EdsSignalFl._.posv_ueb_aktiv_l2_S6_S3 "Umrechnung fuer Messgroesse cUl2EdsSignalFl::posv_ueb_aktiv_l2" TAB_VERB "%4.0" "" COMPU_TAB_REF Conv.cUl2EdsSignalFl._.posv_ueb_aktiv_l2_S6_S3 /end COMPU_METHOD
/begin COMPU_METHOD Conv.cUl2EdsSignalFl._.globale_einst_bed_S6_S3 "Umrechnung fuer Messgroesse cUl2EdsSignalFl::globale_einst_bed" TAB_VERB "%4.0" "" COMPU_TAB_REF Conv.cUl2EdsSignalFl._.globale_einst_bed_S6_S3 /end COMPU_METHOD
/begin COMPU_METHOD Conv.cUl2KraftschlussInt._.kup_a_geschl_S6_S3 "Umrechnung fuer Messgroesse cUl2KraftschlussInt::kup_a_geschl" TAB_VERB "%4.0" "" COMPU_TAB_REF Conv.cUl2KraftschlussInt._.kup_a_geschl_S6_S3 /end COMPU_METHOD
/begin COMPU_METHOD Conv.cUl2KraftschlussInt._.kup_b_geschl_S6_S3 "Umrechnung fuer Messgroesse cUl2KraftschlussInt::kup_b_geschl" TAB_VERB "%4.0" "" COMPU_TAB_REF Conv.cUl2KraftschlussInt._.kup_b_geschl_S6_S3 /end COMPU_METHOD
/begin COMPU_METHOD Conv.cUl2KraftschlussInt._.kup_c_geschl_S6_S3 "Umrechnung fuer Messgroesse cUl2KraftschlussInt::kup_c_geschl" TAB_VERB "%4.0" "" COMPU_TAB_REF Conv.cUl2KraftschlussInt._.kup_c_geschl_S6_S3 /end COMPU_METHOD
/begin COMPU_METHOD Conv.cUl2KraftschlussInt._.kup_d_geschl_S6_S3 "Umrechnung fuer Messgroesse cUl2KraftschlussInt::kup_d_geschl" TAB_VERB "%4.0" "" COMPU_TAB_REF Conv.cUl2KraftschlussInt._.kup_d_geschl_S6_S3 /end COMPU_METHOD
/begin COMPU_METHOD Conv.cUl2KraftschlussInt._.kup_e_geschl_S6_S3 "Umrechnung fuer Messgroesse cUl2KraftschlussInt::kup_e_geschl" TAB_VERB "%4.0" "" COMPU_TAB_REF Conv.cUl2KraftschlussInt._.kup_e_geschl_S6_S3 /end COMPU_METHOD
/begin COMPU_METHOD Conv.cUl2KraftschlussInt._.zustand_S6_S3 "Umrechnung fuer Messgroesse cUl2KraftschlussInt::zustand" TAB_VERB "%4.0" "" COMPU_TAB_REF Conv.cUl2KraftschlussInt._.zustand_S6_S3 /end COMPU_METHOD
/begin COMPU_METHOD Conv.cUl2KraftschlussInt._.zustand_gespeichert_S6_S3 "Umrechnung fuer Messgroesse cUl2KraftschlussInt::zustand_gespeichert" TAB_VERB "%4.0" "" COMPU_TAB_REF Conv.cUl2KraftschlussInt._.zustand_gespeichert_S6_S3 /end COMPU_METHOD
/begin COMPU_METHOD Conv.cUl2KraftschlussFl._.zustand_S6_S3 "Umrechnung fuer Messgroesse cUl2KraftschlussFl::zustand" TAB_VERB "%4.0" "" COMPU_TAB_REF Conv.cUl2KraftschlussFl._.zustand_S6_S3 /end COMPU_METHOD
/begin COMPU_METHOD Conv.cUl2KraftschlussFl._.zustand_gespeichert_S6_S3 "Umrechnung fuer Messgroesse cUl2KraftschlussFl::zustand_gespeichert" TAB_VERB "%4.0" "" COMPU_TAB_REF Conv.cUl2KraftschlussFl._.zustand_gespeichert_S6_S3 /end COMPU_METHOD
/begin COMPU_METHOD Conv.cUl2AktuatorAnstDRInt._.zustand_S6_S3 "Umrechnung fuer Messgroesse cUl2AktuatorAnstDRInt::zustand" TAB_VERB "%4.0" "" COMPU_TAB_REF Conv.cUl2AktuatorAnstDRInt._.zustand_S6_S3 /end COMPU_METHOD
/begin COMPU_METHOD Conv.cUl2AktuatorAnstDRInt._.fehler_i_gang_S6_S3 "Umrechnung fuer Messgroesse cUl2AktuatorAnstDRInt::fehler_i_gang" TAB_VERB "%4.0" "" COMPU_TAB_REF Conv.cUl2AktuatorAnstDRInt._.fehler_i_gang_S6_S3 /end COMPU_METHOD
/begin COMPU_METHOD Conv.cUl2AktuatorAnstDRInt._.pos_igang_wechsel_S6_S3 "Umrechnung fuer Messgroesse cUl2AktuatorAnstDRInt::pos_igang_wechsel" TAB_VERB "%4.0" "" COMPU_TAB_REF Conv.cUl2AktuatorAnstDRInt._.pos_igang_wechsel_S6_S3 /end COMPU_METHOD
/begin COMPU_METHOD Conv.cUl2AktuatorAnstDRInt._.pos_l2_alt_S6_S3 "Umrechnung fuer Messgroesse cUl2AktuatorAnstDRInt::pos_l2_alt" TAB_VERB "%4.0" "" COMPU_TAB_REF Conv.cUl2AktuatorAnstDRInt._.pos_l2_alt_S6_S3 /end COMPU_METHOD
/begin COMPU_METHOD Conv.cUl2AktuatorAnstDRInt._.init_igang_ungl_null_S6_S3 "Umrechnung fuer Messgroesse cUl2AktuatorAnstDRInt::init_igang_ungl_null" TAB_VERB "%4.0" "" COMPU_TAB_REF Conv.cUl2AktuatorAnstDRInt._.init_igang_ungl_null_S6_S3 /end COMPU_METHOD
/begin COMPU_METHOD Conv.cUl2AktuatorAnstDRFl._.fehler_i_gang_S6_S3 "Umrechnung fuer Messgroesse cUl2AktuatorAnstDRFl::fehler_i_gang" TAB_VERB "%4.0" "" COMPU_TAB_REF Conv.cUl2AktuatorAnstDRFl._.fehler_i_gang_S6_S3 /end COMPU_METHOD
/begin COMPU_METHOD Conv.cUl2PosAnstDRInt._.zustand_S6_S3 "Umrechnung fuer Messgroesse cUl2PosAnstDRInt::zustand" TAB_VERB "%4.0" "" COMPU_TAB_REF Conv.cUl2PosAnstDRInt._.zustand_S6_S3 /end COMPU_METHOD
/begin COMPU_METHOD Conv.cUl2RGangSicherungInt._.fl_rgang_erkannt_S6_S3 "Umrechnung fuer Messgroesse cUl2RGangSicherungInt::fl_rgang_erkannt" TAB_VERB "%4.0" "" COMPU_TAB_REF Conv.cUl2RGangSicherungInt._.fl_rgang_erkannt_S6_S3 /end COMPU_METHOD
/begin COMPU_METHOD Conv.cUl2PAbsicherungAuslPInt._.einst_bed_einmalig_S6_S3 "Umrechnung fuer Messgroesse cUl2PAbsicherungAuslPInt::einst_bed_einmalig" TAB_VERB "%4.0" "" COMPU_TAB_REF Conv.cUl2PAbsicherungAuslPInt._.einst_bed_einmalig_S6_S3 /end COMPU_METHOD
/begin COMPU_METHOD Conv.cUl2PAbsicherungAuslPFl._.einst_bed_einmalig_S6_S3 "Umrechnung fuer Messgroesse cUl2PAbsicherungAuslPFl::einst_bed_einmalig" TAB_VERB "%4.0" "" COMPU_TAB_REF Conv.cUl2PAbsicherungAuslPFl._.einst_bed_einmalig_S6_S3 /end COMPU_METHOD
/begin COMPU_VTAB Conv.cUl2ItfipInt._.iv_nmotstatusl2_S6_S3 "Umrechnung fuer Messgroesse cUl2ItfipInt::iv_nmotstatusl2" TAB_VERB 3 0 "Signal i.O." 1 "Ersatzwert" 2 "Signal fehlerhaft" /end COMPU_VTAB
/begin COMPU_VTAB Conv.cUl2ItfipInt._.n_mot_status_l2_S6_S3 "Umrechnung fuer Messgroesse cUl2ItfipInt::n_mot_status_l2" TAB_VERB 3 0 "Signal i.O." 1 "Ersatzwert" 2 "Signal fehlerhaft" /end COMPU_VTAB
/begin COMPU_VTAB Conv.cUl2ItfipInt._.iv_dscfehlerl2_S6_S3 "Umrechnung fuer Messgroesse cUl2ItfipInt::iv_dscfehlerl2" TAB_VERB 2 0 "DSC (ESP) in ordnung / aktiv" 1 "DSC (ESP) fehlerhaft / deaktiviert" /end COMPU_VTAB
/begin COMPU_VTAB Conv.cUl2ItfipInt._.dsc_fehler_l2_S6_S3 "Umrechnung fuer Messgroesse cUl2ItfipInt::dsc_fehler_l2" TAB_VERB 2 0 "DSC (ESP) in ordnung / aktiv" 1 "DSC (ESP) fehlerhaft / deaktiviert" /end COMPU_VTAB
/begin COMPU_VTAB Conv.cUl2ItfipInt._.iv_pos_l2_S6_S3 "Umrechnung fuer Messgroesse cUl2ItfipInt::iv_pos_l2" TAB_VERB 9 0 "Pos. 1" 1 "Pos. 2" 2 "Pos. 3" 3 "Pos. 4" 4 "Pos. 5" 5 "Pos. D" 6 "Pos. N" 7 "Pos. R" 8 "Pos. P" /end COMPU_VTAB
/begin COMPU_VTAB Conv.cUl2ItfipInt._.pos_l2_S6_S3 "Umrechnung fuer Messgroesse cUl2ItfipInt::pos_l2" TAB_VERB 9 0 "Pos. 1" 1 "Pos. 2" 2 "Pos. 3" 3 "Pos. 4" 4 "Pos. 5" 5 "Pos. D" 6 "Pos. N" 7 "Pos. R" 8 "Pos. P" /end COMPU_VTAB
/begin COMPU_VTAB Conv.cUl2ItfipInt._.iv_nmo_vm_status_l2_S6_S3 "Umrechnung fuer Messgroesse cUl2ItfipInt::iv_nmo_vm_status_l2" TAB_VERB 3 0 "Signal i.O." 1 "Ersatzwert" 2 "Signal fehlerhaft" /end COMPU_VTAB
/begin COMPU_VTAB Conv.cUl2ItfipInt._.nmo_vm_status_l2_S6_S3 "Umrechnung fuer Messgroesse cUl2ItfipInt::nmo_vm_status_l2" TAB_VERB 3 0 "Signal i.O." 1 "Ersatzwert" 2 "Signal fehlerhaft" /end COMPU_VTAB
/begin COMPU_VTAB Conv.cUl2ItfipInt._.iv_v_unplausibel_l2_S6_S3 "Umrechnung fuer Messgroesse cUl2ItfipInt::iv_v_unplausibel_l2" TAB_VERB 2 0 "plausibel" 1 "unplausibel" /end COMPU_VTAB
/begin COMPU_VTAB Conv.cUl2ItfipInt._.v_unplausibel_l2_S6_S3 "Umrechnung fuer Messgroesse cUl2ItfipInt::v_unplausibel_l2" TAB_VERB 2 0 "plausibel" 1 "unplausibel" /end COMPU_VTAB
/begin COMPU_VTAB Conv.cUl2ItfipInt._.iv_ps_sensor_signal_l2_S6_S3 "Umrechnung fuer Messgroesse cUl2ItfipInt::iv_ps_sensor_signal_l2" TAB_VERB 4 0 "Position nicht P erkannt" 1 "Position P erkannt" 2 "Zwischenpostition erkannt" 3 "Fehler erkannt" /end COMPU_VTAB
/begin COMPU_VTAB Conv.cUl2ItfipInt._.ps_sensor_signal_l2_S6_S3 "Umrechnung fuer Messgroesse cUl2ItfipInt::ps_sensor_signal_l2" TAB_VERB 4 0 "Position nicht P erkannt" 1 "Position P erkannt" 2 "Zwischenpostition erkannt" 3 "Fehler erkannt" /end COMPU_VTAB
/begin COMPU_VTAB Conv.cUl2ItfipInt._.iv_ps_sensor_status_l2_S6_S3 "Umrechnung fuer Messgroesse cUl2ItfipInt::iv_ps_sensor_status_l2" TAB_VERB 3 0 "Signal i.O." 1 "Ersatzwert" 2 "Signal fehlerhaft" /end COMPU_VTAB
/begin COMPU_VTAB Conv.cUl2ItfipInt._.ps_sensor_status_l2_S6_S3 "Umrechnung fuer Messgroesse cUl2ItfipInt::ps_sensor_status_l2" TAB_VERB 3 0 "Signal i.O." 1 "Ersatzwert" 2 "Signal fehlerhaft" /end COMPU_VTAB
/begin COMPU_VTAB Conv.cUl2ItfipInt._.iv_vehstabnsys_err_l2_S6_S3 "Umrechnung fuer Messgroesse cUl2ItfipInt::iv_vehstabnsys_err_l2" TAB_VERB 2 0 "alle Stabilitätssysteme bereit oder aktiv" 1 "mindestens ein Stabilitätssystem ist nicht bereit" /end COMPU_VTAB
/begin COMPU_VTAB Conv.cUl2ItfipInt._.vehstabnsys_err_l2_S6_S3 "Umrechnung fuer Messgroesse cUl2ItfipInt::vehstabnsys_err_l2" TAB_VERB 2 0 "alle Stabilitätssysteme bereit oder aktiv" 1 "mindestens ein Stabilitätssystem ist nicht bereit" /end COMPU_VTAB
/begin COMPU_VTAB Conv.cUl2ItfipInt._.iv_parking_brake_l2_S6_S3 "Umrechnung fuer Messgroesse cUl2ItfipInt::iv_parking_brake_l2" TAB_VERB 2 0 "Handbremse nicht aktiv" 1 "Handbremse aktiv" /end COMPU_VTAB
/begin COMPU_VTAB Conv.cUl2ItfipInt._.parking_brake_l2_S6_S3 "Umrechnung fuer Messgroesse cUl2ItfipInt::parking_brake_l2" TAB_VERB 2 0 "Handbremse nicht aktiv" 1 "Handbremse aktiv" /end COMPU_VTAB
/begin COMPU_VTAB Conv.cUl2ItfipInt._.iv_nab_direction_S6_S3 "Umrechnung fuer Messgroesse cUl2ItfipInt::iv_nab_direction" TAB_VERB 3 0 "Drehrichtung unbestimmt" 1 "Drehrichtung vorwaerts" 2 "Drehrichtung rueckwaerts" /end COMPU_VTAB
/begin COMPU_VTAB Conv.cUl2ItfipInt._.nab_direction_S6_S3 "Umrechnung fuer Messgroesse cUl2ItfipInt::nab_direction" TAB_VERB 2 -1 "Drehrichtung rueckwaerts" 1 "Drehrichtung vorwaerts und undefiniert" /end COMPU_VTAB
/begin COMPU_VTAB Conv.cUl2ItfipFl._.iv_dscfehlerl2komp_S6_S3 "Umrechnung fuer Messgroesse cUl2ItfipFl::iv_dscfehlerl2komp" TAB_VERB 2 254 "DSC (ESP) fehlerhaft / deaktiviert" 255 "DSC (ESP) in ordnung / aktiv" /end COMPU_VTAB
/begin COMPU_VTAB Conv.cUl2ItfipFl._.iv_pos_l2_komp_S6_S3 "Umrechnung fuer Messgroesse cUl2ItfipFl::iv_pos_l2_komp" TAB_VERB 9 247 "Pos. P" 248 "Pos. R" 249 "Pos. N" 250 "Pos. D" 251 "Pos. 5" 252 "Pos. 4" 253 "Pos. 3" 254 "Pos. 2" 255 "Pos. 1" /end COMPU_VTAB
/begin COMPU_VTAB Conv.cUl2ItfipFl._.iv_nmo_vm_status_l2_komp_S6_S3 "Umrechnung fuer Messgroesse cUl2ItfipFl::iv_nmo_vm_status_l2_komp" TAB_VERB 3 255 "Signal i.O." 254 "Ersatzwert" 253 "Signal fehlerhaft" /end COMPU_VTAB
/begin COMPU_VTAB Conv.cUl2ItfipFl._.iv_v_unplausibel_l2_komp_S6_S3 "Umrechnung fuer Messgroesse cUl2ItfipFl::iv_v_unplausibel_l2_komp" TAB_VERB 2 255 "plausibel" 254 "unplausibel" /end COMPU_VTAB
/begin COMPU_VTAB Conv.cUl2ItfipFl._.iv_ps_sensor_signal_l2_komp_S6_S3 "Umrechnung fuer Messgroesse cUl2ItfipFl::iv_ps_sensor_signal_l2_komp" TAB_VERB 4 255 "Position nicht P erkannt" 254 "Position P erkannt" 253 "Zwischenpostition erkannt" 252 "Fehler erkannt" /end COMPU_VTAB
/begin COMPU_VTAB Conv.cUl2ItfipFl._.iv_ps_sensor_status_l2_komp_S6_S3 "Umrechnung fuer Messgroesse cUl2ItfipFl::iv_ps_sensor_status_l2_komp" TAB_VERB 3 255 "Signal i.O." 254 "Ersatzwert" 253 "Signal fehlerhaft" /end COMPU_VTAB
/begin COMPU_VTAB Conv.cUl2ItfipFl._.ps_sensor_status_l2_S6_S3 "Umrechnung fuer Messgroesse cUl2ItfipFl::ps_sensor_status_l2" TAB_VERB 3 0 "Signal i.O." 1 "Ersatzwert" 2 "Signal fehlerhaft" /end COMPU_VTAB
/begin COMPU_VTAB Conv.cUl2ItfipUewInt._.status_k0_S6_S3 "Umrechnung fuer Messgroesse cUl2ItfipUewInt::status_k0" TAB_VERB 6 0 "K0 offen" 1 "K0 Angelegt" 2 "K0 Druckstellung" 3 "K0 Schlupfgeregelt" 4 "K0 Geregelt Geschlossen" 5 "K0 Geschlossen" /end COMPU_VTAB
/begin COMPU_VTAB Conv.cUl2ItfipUewInt._.me_red_status_S6_S3 "Umrechnung fuer Messgroesse cUl2ItfipUewInt::me_red_status" TAB_VERB 4 0 "keine Momentenanforderung" 1 "Momentenerhoehung" 2 "Momentenerniedrigung" 3 "Signal ungueltig" /end COMPU_VTAB
/begin COMPU_VTAB Conv.cUl2ItfipUewInt._.zielgang_sas_S6_S3 "Umrechnung fuer Messgroesse cUl2ItfipUewInt::zielgang_sas" TAB_VERB 10 -1 "GR1" 0 "KEIN_GANG" 1 "G1" 2 "G2" 3 "G3" 4 "G4" 5 "G5" 6 "G6" 7 "G7" 8 "G8" /end COMPU_VTAB
/begin COMPU_VTAB Conv.cUl2ItfipUewInt._.istgang_S6_S3 "Umrechnung fuer Messgroesse cUl2ItfipUewInt::istgang" TAB_VERB 10 -1 "GR1" 0 "KEIN_GANG" 1 "G1" 2 "G2" 3 "G3" 4 "G4" 5 "G5" 6 "G6" 7 "G7" 8 "G8" /end COMPU_VTAB
/begin COMPU_VTAB Conv.cUl2ItfipUewInt._.pos_atsys_S6_S3 "Umrechnung fuer Messgroesse cUl2ItfipUewInt::pos_atsys" TAB_VERB 9 0 "Pos. 1" 1 "Pos. 2" 2 "Pos. 3" 3 "Pos. 4" 4 "Pos. 5" 5 "Pos. D" 6 "Pos. N" 7 "Pos. R" 8 "Pos. P" /end COMPU_VTAB
/begin COMPU_VTAB Conv.cUl2ItfipUewFl._.status_k0_S6_S3 "Umrechnung fuer Messgroesse cUl2ItfipUewFl::status_k0" TAB_VERB 6 0 "K0 offen" 1 "K0 Angelegt" 2 "K0 Druckstellung" 3 "K0 Schlupfgeregelt" 4 "K0 Geregelt Geschlossen" 5 "K0 Geschlossen" /end COMPU_VTAB
/begin COMPU_VTAB Conv.cUl2ItfipUewFl._.me_red_status_S6_S3 "Umrechnung fuer Messgroesse cUl2ItfipUewFl::me_red_status" TAB_VERB 4 0 "keine Momentenanforderung" 1 "Momentenerhoehung" 2 "Momentenerniedrigung" 3 "Signal ungueltig" /end COMPU_VTAB
/begin COMPU_VTAB Conv.cUl2ItfipUewFl._.zielgang_sas_S6_S3 "Umrechnung fuer Messgroesse cUl2ItfipUewFl::zielgang_sas" TAB_VERB 10 -1 "GR1" 0 "KEIN_GANG" 1 "G1" 2 "G2" 3 "G3" 4 "G4" 5 "G5" 6 "G6" 7 "G7" 8 "G8" /end COMPU_VTAB
/begin COMPU_VTAB Conv.cUl2ItfipUewFl._.istgang_S6_S3 "Umrechnung fuer Messgroesse cUl2ItfipUewFl::istgang" TAB_VERB 10 -1 "GR1" 0 "KEIN_GANG" 1 "G1" 2 "G2" 3 "G3" 4 "G4" 5 "G5" 6 "G6" 7 "G7" 8 "G8" /end COMPU_VTAB
/begin COMPU_VTAB Conv.cUl2HydEdsInt._.type_S6_S3 "Umrechnung fuer Messgroesse cUl2HydEdsInt::type" TAB_VERB 2 0 "FALLEND" 1 "STEIGEND" /end COMPU_VTAB
/begin COMPU_VTAB Conv.cUl2HydMvInt._.flanke_S6_S3 "Umrechnung fuer Messgroesse cUl2HydMvInt::flanke" TAB_VERB 3 0 "STATISCH_INT" 1 "UNBESTROMT_AUF_BESTROMT_INT" 2 "BESTROMT_AUF_UNBESTROMT_INT" /end COMPU_VTAB
/begin COMPU_VTAB Conv.cUl2HydMvFl._.flanke_S6_S3 "Umrechnung fuer Messgroesse cUl2HydMvFl::flanke" TAB_VERB 3 0 "STATISCH_FL" 1 "UNBESTROMT_AUF_BESTROMT_FL" 2 "BESTROMT_AUF_UNBESTROMT_FL" /end COMPU_VTAB
/begin COMPU_VTAB Conv.cUl2IMinKupInt._.min_kup_bestr_gang_info_S6_S3 "Umrechnung fuer Messgroesse cUl2IMinKupInt::min_kup_bestr_gang_info" TAB_VERB 2 0 "Mechanischer Notlauf nicht aktiv: alle relevanten Druckregler >50mA" 1 "Mechanischer Notlauf aktiv: alle relevanten Druckregler <=50mA (Stromlos)" /end COMPU_VTAB
/begin COMPU_VTAB Conv.cUl2IMinKupFl._.min_kup_bestr_gang_info_S6_S3 "Umrechnung fuer Messgroesse cUl2IMinKupFl::min_kup_bestr_gang_info" TAB_VERB 2 0 "Mechanischer Notlauf nicht aktiv: alle relevanten Druckregler >50mA" 1 "Mechanischer Notlauf aktiv: alle relevanten Druckregler <=50mA (Stromlos)" /end COMPU_VTAB
/begin COMPU_VTAB Conv.cUl2StromlosAusserPsInt._.stromlos_ausser_ps_edslg_S6_S3 "Umrechnung fuer Messgroesse cUl2StromlosAusserPsInt::stromlos_ausser_ps_edslg" TAB_VERB 2 0 "alle relevanten Druckregler >50mA" 1 "alle relevanten Druckregler <=50mA (Stromlos)" /end COMPU_VTAB
/begin COMPU_VTAB Conv.cUl2StromlosAusserPsInt._.alt_stromlos_ausser_ps_edslg_S6_S3 "Umrechnung fuer Messgroesse cUl2StromlosAusserPsInt::alt_stromlos_ausser_ps_edslg" TAB_VERB 2 0 "alle relevanten Druckregler >50mA" 1 "alle relevanten Druckregler <=50mA (Stromlos)" /end COMPU_VTAB
/begin COMPU_VTAB Conv.cUl2StromlosAusserPsFl._.stromlos_ausser_ps_edslg_S6_S3 "Umrechnung fuer Messgroesse cUl2StromlosAusserPsFl::stromlos_ausser_ps_edslg" TAB_VERB 2 0 "alle relevanten Druckregler >50mA" 1 "alle relevanten Druckregler <=50mA (Stromlos)" /end COMPU_VTAB
/begin COMPU_VTAB Conv.cUl2StromlosAusserPsFl._.alt_stromlos_ausser_ps_edslg_S6_S3 "Umrechnung fuer Messgroesse cUl2StromlosAusserPsFl::alt_stromlos_ausser_ps_edslg" TAB_VERB 2 0 "alle relevanten Druckregler >50mA" 1 "alle relevanten Druckregler <=50mA (Stromlos)" /end COMPU_VTAB
/begin COMPU_VTAB Conv.cUl2EdsKflKupInt._.f_geschlossen_S6_S3 "Umrechnung fuer Messgroesse cUl2EdsKflKupInt::f_geschlossen" TAB_VERB 2 0 "FALSE" 1 "TRUE" /end COMPU_VTAB
/begin COMPU_VTAB Conv.cUl2EdsKflInt._.zustand_direkt_S6_S3 "Umrechnung fuer Messgroesse cUl2EdsKflInt::zustand_direkt" TAB_VERB 3 0 "Kein Kraftfluss" 1 "Kraftfluss vorwaerts" 2 "Kraftfluss rueckwaerts" /end COMPU_VTAB
/begin COMPU_VTAB Conv.cUl2EdsKflInt._.zustand_S6_S3 "Umrechnung fuer Messgroesse cUl2EdsKflInt::zustand" TAB_VERB 3 0 "Kein Kraftfluss" 1 "Kraftfluss vorwaerts" 2 "Kraftfluss rueckwaerts" /end COMPU_VTAB
/begin COMPU_VTAB Conv.cUl2DrehzahlBeobInt._.fl_drehzbeob_schaltung_S6_S3 "Umrechnung fuer Messgroesse cUl2DrehzahlBeobInt::fl_drehzbeob_schaltung" TAB_VERB 2 0 "keine Schaltung aktiv" 1 "Schaltung aktiv" /end COMPU_VTAB
/begin COMPU_VTAB Conv.cUl2DrehzahlBeobFl._.fl_drehzbeob_schaltung_S6_S3 "Umrechnung fuer Messgroesse cUl2DrehzahlBeobFl::fl_drehzbeob_schaltung" TAB_VERB 2 0 "keine Schaltung aktiv" 1 "Schaltung aktiv" /end COMPU_VTAB
/begin COMPU_VTAB Conv.cUl2KupplBSfktInt._.n_kup_zu_edslogik_anfahrkup_S6_S3 "Umrechnung fuer Messgroesse cUl2KupplBSfktInt::n_kup_zu_edslogik_anfahrkup" TAB_VERB 2 0 "offen" 1 "geschlossen" /end COMPU_VTAB
/begin COMPU_VTAB Conv.cUl2KupplBSfktFl._.n_kup_zu_edslogik_anfahrkup_S6_S3 "Umrechnung fuer Messgroesse cUl2KupplBSfktFl::n_kup_zu_edslogik_anfahrkup" TAB_VERB 2 0 "offen" 1 "geschlossen" /end COMPU_VTAB
/begin COMPU_VTAB Conv.cUl2EdsSignalInt._.posv_ueb_aktiv_l2_S6_S3 "Umrechnung fuer Messgroesse cUl2EdsSignalInt::posv_ueb_aktiv_l2" TAB_VERB 2 0 "Bedingung NICHT erfüllt" 1 "Bedingung erfüllt" /end COMPU_VTAB
/begin COMPU_VTAB Conv.cUl2EdsSignalInt._.globale_einst_bed_S6_S3 "Umrechnung fuer Messgroesse cUl2EdsSignalInt::globale_einst_bed" TAB_VERB 2 0 "Bedingung NICHT erfüllt" 1 "Bedingung erfüllt" /end COMPU_VTAB
/begin COMPU_VTAB Conv.cUl2EdsSignalInt._.pos_alt_S6_S3 "Umrechnung fuer Messgroesse cUl2EdsSignalInt::pos_alt" TAB_VERB 9 0 "Pos. 1" 1 "Pos. 2" 2 "Pos. 3" 3 "Pos. 4" 4 "Pos. 5" 5 "Pos. D" 6 "Pos. N" 7 "Pos. R" 8 "Pos. P" /end COMPU_VTAB
/begin COMPU_VTAB Conv.cUl2EdsSignalFl._.posv_ueb_aktiv_l2_S6_S3 "Umrechnung fuer Messgroesse cUl2EdsSignalFl::posv_ueb_aktiv_l2" TAB_VERB 2 0 "Bedingung NICHT erfüllt" 1 "Bedingung erfüllt" /end COMPU_VTAB
/begin COMPU_VTAB Conv.cUl2EdsSignalFl._.globale_einst_bed_S6_S3 "Umrechnung fuer Messgroesse cUl2EdsSignalFl::globale_einst_bed" TAB_VERB 2 0 "Bedingung NICHT erfüllt" 1 "Bedingung erfüllt" /end COMPU_VTAB
/begin COMPU_VTAB Conv.cUl2KraftschlussInt._.kup_a_geschl_S6_S3 "Umrechnung fuer Messgroesse cUl2KraftschlussInt::kup_a_geschl" TAB_VERB 2 0 "offen" 1 "geschlossen" /end COMPU_VTAB
/begin COMPU_VTAB Conv.cUl2KraftschlussInt._.kup_b_geschl_S6_S3 "Umrechnung fuer Messgroesse cUl2KraftschlussInt::kup_b_geschl" TAB_VERB 2 0 "offen" 1 "geschlossen" /end COMPU_VTAB
/begin COMPU_VTAB Conv.cUl2KraftschlussInt._.kup_c_geschl_S6_S3 "Umrechnung fuer Messgroesse cUl2KraftschlussInt::kup_c_geschl" TAB_VERB 2 0 "offen" 1 "geschlossen" /end COMPU_VTAB
/begin COMPU_VTAB Conv.cUl2KraftschlussInt._.kup_d_geschl_S6_S3 "Umrechnung fuer Messgroesse cUl2KraftschlussInt::kup_d_geschl" TAB_VERB 2 0 "offen" 1 "geschlossen" /end COMPU_VTAB
/begin COMPU_VTAB Conv.cUl2KraftschlussInt._.kup_e_geschl_S6_S3 "Umrechnung fuer Messgroesse cUl2KraftschlussInt::kup_e_geschl" TAB_VERB 2 0 "offen" 1 "geschlossen" /end COMPU_VTAB
/begin COMPU_VTAB Conv.cUl2KraftschlussInt._.zustand_S6_S3 "Umrechnung fuer Messgroesse cUl2KraftschlussInt::zustand" TAB_VERB 3 0 "(nicht) Kraftfluss Rückwärts erkannt" 1 "Kraftfluss Rückwärts erkannt" 2 "Kraftschluss über CDF erkannt" /end COMPU_VTAB
/begin COMPU_VTAB Conv.cUl2KraftschlussInt._.zustand_gespeichert_S6_S3 "Umrechnung fuer Messgroesse cUl2KraftschlussInt::zustand_gespeichert" TAB_VERB 3 0 "(nicht) Kraftfluss Rückwärts erkannt" 1 "Kraftfluss Rückwärts erkannt" 2 "Kraftschluss über CDF erkannt" /end COMPU_VTAB
/begin COMPU_VTAB Conv.cUl2KraftschlussFl._.zustand_S6_S3 "Umrechnung fuer Messgroesse cUl2KraftschlussFl::zustand" TAB_VERB 3 0 "(nicht) Kraftfluss Rückwärts erkannt" 1 "Kraftfluss Rückwärts erkannt" 2 "Kraftschluss über CDF erkannt" /end COMPU_VTAB
/begin COMPU_VTAB Conv.cUl2KraftschlussFl._.zustand_gespeichert_S6_S3 "Umrechnung fuer Messgroesse cUl2KraftschlussFl::zustand_gespeichert" TAB_VERB 3 0 "Kraftfluss Rückwärts NICHT erkannt" 1 "Kraftfluss Rückwärts erkannt" 2 "Kraftschluss über CDF erkannt" /end COMPU_VTAB
/begin COMPU_VTAB Conv.cUl2AktuatorAnstDRInt._.zustand_S6_S3 "Umrechnung fuer Messgroesse cUl2AktuatorAnstDRInt::zustand" TAB_VERB 3 0 "POS_IGANG" 1 "POS_IGANG_NULL" 2 "POS_WECHSEL" /end COMPU_VTAB
/begin COMPU_VTAB Conv.cUl2AktuatorAnstDRInt._.fehler_i_gang_S6_S3 "Umrechnung fuer Messgroesse cUl2AktuatorAnstDRInt::fehler_i_gang" TAB_VERB 2 0 "Kein Fehler vorhanden." 1 "Fehler vorhanden." /end COMPU_VTAB
/begin COMPU_VTAB Conv.cUl2AktuatorAnstDRInt._.pos_igang_wechsel_S6_S3 "Umrechnung fuer Messgroesse cUl2AktuatorAnstDRInt::pos_igang_wechsel" TAB_VERB 9 0 "Pos. 1" 1 "Pos. 2" 2 "Pos. 3" 3 "Pos. 4" 4 "Pos. 5" 5 "Pos. D" 6 "Pos. N" 7 "Pos. R" 8 "Pos. P" /end COMPU_VTAB
/begin COMPU_VTAB Conv.cUl2AktuatorAnstDRInt._.pos_l2_alt_S6_S3 "Umrechnung fuer Messgroesse cUl2AktuatorAnstDRInt::pos_l2_alt" TAB_VERB 9 0 "Pos. 1" 1 "Pos. 2" 2 "Pos. 3" 3 "Pos. 4" 4 "Pos. 5" 5 "Pos. D" 6 "Pos. N" 7 "Pos. R" 8 "Pos. P" /end COMPU_VTAB
/begin COMPU_VTAB Conv.cUl2AktuatorAnstDRInt._.init_igang_ungl_null_S6_S3 "Umrechnung fuer Messgroesse cUl2AktuatorAnstDRInt::init_igang_ungl_null" TAB_VERB 2 0 "i_gang == 0" 1 "i_gang != 0" /end COMPU_VTAB
/begin COMPU_VTAB Conv.cUl2AktuatorAnstDRFl._.fehler_i_gang_S6_S3 "Umrechnung fuer Messgroesse cUl2AktuatorAnstDRFl::fehler_i_gang" TAB_VERB 2 0 "Kein Fehler vorhanden." 1 "Fehler vorhanden." /end COMPU_VTAB
/begin COMPU_VTAB Conv.cUl2PosAnstDRInt._.zustand_S6_S3 "Umrechnung fuer Messgroesse cUl2PosAnstDRInt::zustand" TAB_VERB 3 0 "INIT-Zustand" 1 "Fehler erkannt" 2 "Wechsel von pos_l2" /end COMPU_VTAB
/begin COMPU_VTAB Conv.cUl2RGangSicherungInt._.fl_rgang_erkannt_S6_S3 "Umrechnung fuer Messgroesse cUl2RGangSicherungInt::fl_rgang_erkannt" TAB_VERB 2 0 "R Gang nicht erkannt" 1 "R Gang erkannt" /end COMPU_VTAB
/begin COMPU_VTAB Conv.cUl2PAbsicherungAuslPInt._.einst_bed_einmalig_S6_S3 "Umrechnung fuer Messgroesse cUl2PAbsicherungAuslPInt::einst_bed_einmalig" TAB_VERB 2 0 "P u. Sensorsignal NICHT einmalig gesetzt" 1 "P u. Sensorsignal einmalig gesetzt" /end COMPU_VTAB
/begin COMPU_VTAB Conv.cUl2PAbsicherungAuslPFl._.einst_bed_einmalig_S6_S3 "Umrechnung fuer Messgroesse cUl2PAbsicherungAuslPFl::einst_bed_einmalig" TAB_VERB 2 0 "P u. Sensorsignal NICHT einmalig gesetzt" 1 "P u. Sensorsignal einmalig gesetzt" /end COMPU_VTAB
/begin FUNCTION UL2_ITF_REQ_UEW "Die Unterstruktur UL2_ITF_IN enthält alle Schnittstellen die von einer externen Komponente kommen"
 /begin LOC_MEASUREMENT iUl2ItfipFl.ay_ref_l2 iUl2ItfipFl.ay_ref_status_l2 iUl2ItfipFl.brm_l2 iUl2ItfipFl.brm_status_l2 iUl2ItfipFl.brp_status_l2 iUl2ItfipFl.c_getr_l2 iUl2ItfipFl.dsc_fehler_l2 iUl2ItfipFl.fzg_geschwindigkeit_max_l2 iUl2ItfipFl.iv_ay_ref_l2_komp iUl2ItfipFl.iv_ay_ref_status_l2_komp iUl2ItfipFl.iv_brm_l2_komp iUl2ItfipFl.iv_brm_status_l2_komp iUl2ItfipFl.iv_brp_status_l2_komp iUl2ItfipFl.iv_c_getr_l2_komp iUl2ItfipFl.iv_dscfehlerl2komp iUl2ItfipFl.iv_fzg_geschwindigkeit_max_l2_komp iUl2ItfipFl.iv_m_ist_em_l2_komp iUl2ItfipFl.iv_m_ist_vm_l2_komp iUl2ItfipFl.iv_m_mot_l2_komp iUl2ItfipFl.iv_mmotist_l2_komp iUl2ItfipFl.iv_n_ab_l2_komp iUl2ItfipFl.iv_n_ab_max_l2_komp iUl2ItfipFl.iv_n_ab_status_l2_komp iUl2ItfipFl.iv_n_turb_l2_komp iUl2ItfipFl.iv_nab_direction iUl2ItfipFl.iv_nmo_vm_l2_komp iUl2ItfipFl.iv_nmo_vm_status_l2_komp iUl2ItfipFl.iv_nmotabregell2komp iUl2ItfipFl.iv_nmotl2komp iUl2ItfipFl.iv_nmotstatusl2komp iUl2ItfipFl.iv_p_bremse_l2_komp iUl2ItfipFl.iv_parking_brake_l2_komp iUl2ItfipFl.iv_pos_l2_komp iUl2ItfipFl.iv_ps_sensor_signal_l2_komp iUl2ItfipFl.iv_ps_sensor_status_l2_komp iUl2ItfipFl.iv_soll_brake_torq_driver_l2_komp iUl2ItfipFl.iv_soll_brake_torq_driver_status_l2_komp iUl2ItfipFl.iv_v_unplausibel_l2_komp iUl2ItfipFl.iv_vehstabnsys_err_l2_komp iUl2ItfipFl.m_ist_em_l2 iUl2ItfipFl.m_ist_vm_l2 iUl2ItfipFl.m_mot_l2 iUl2ItfipFl.mmotist_l2 iUl2ItfipFl.n_ab_l2 iUl2ItfipFl.n_ab_max_l2 iUl2ItfipFl.n_ab_status_l2 iUl2ItfipFl.n_mot_l2 iUl2ItfipFl.n_mot_status_l2 iUl2ItfipFl.n_motabregel_l2 iUl2ItfipFl.n_turb_l2 iUl2ItfipFl.nab_direction iUl2ItfipFl.nmo_vm_l2 iUl2ItfipFl.nmo_vm_status_l2 iUl2ItfipFl.p_bremse_l2 iUl2ItfipFl.parking_brake_l2 iUl2ItfipFl.pos_l2 iUl2ItfipFl.ps_sensor_signal_l2 iUl2ItfipFl.ps_sensor_status_l2 iUl2ItfipFl.soll_brake_torq_driver_l2 iUl2ItfipFl.soll_brake_torq_driver_status_l2 iUl2ItfipFl.v_unplausibel_l2 iUl2ItfipFl.vehstabnsys_err_l2 iUl2ItfipInt.ay_ref_l2 iUl2ItfipInt.ay_ref_status_l2 iUl2ItfipInt.brm_l2 iUl2ItfipInt.brm_status_l2 iUl2ItfipInt.brp_status_l2 iUl2ItfipInt.c_getr_l2 iUl2ItfipInt.dsc_fehler_l2 iUl2ItfipInt.fzg_geschwindigkeit_max_l2 iUl2ItfipInt.iv_ay_ref_l2 iUl2ItfipInt.iv_ay_ref_status_l2 iUl2ItfipInt.iv_brm_l2 iUl2ItfipInt.iv_brm_status_l2 iUl2ItfipInt.iv_brp_status_l2 iUl2ItfipInt.iv_c_getr_l2 iUl2ItfipInt.iv_dscfehlerl2 iUl2ItfipInt.iv_fzg_geschwindigkeit_max_l2 iUl2ItfipInt.iv_m_ist_em_l2 iUl2ItfipInt.iv_m_ist_vm_l2 iUl2ItfipInt.iv_m_mot_l2 iUl2ItfipInt.iv_mmotist_l2 iUl2ItfipInt.iv_n_ab_l2 iUl2ItfipInt.iv_n_ab_max_l2 iUl2ItfipInt.iv_n_ab_status_l2 iUl2ItfipInt.iv_n_turb_l2 iUl2ItfipInt.iv_nab_direction iUl2ItfipInt.iv_nmo_vm_l2 iUl2ItfipInt.iv_nmo_vm_status_l2 iUl2ItfipInt.iv_nmotabregell2 iUl2ItfipInt.iv_nmotl2 iUl2ItfipInt.iv_nmotstatusl2 iUl2ItfipInt.iv_p_bremse_l2 iUl2ItfipInt.iv_parking_brake_l2 iUl2ItfipInt.iv_pos_l2 iUl2ItfipInt.iv_ps_sensor_signal_l2 iUl2ItfipInt.iv_ps_sensor_status_l2 iUl2ItfipInt.iv_soll_brake_torq_driver_l2 iUl2ItfipInt.iv_soll_brake_torq_driver_status_l2 iUl2ItfipInt.iv_v_unplausibel_l2 iUl2ItfipInt.iv_vehstabnsys_err_l2 iUl2ItfipInt.m_ist_em_l2 iUl2ItfipInt.m_ist_vm_l2 iUl2ItfipInt.m_mot_l2 iUl2ItfipInt.mmotist_l2 iUl2ItfipInt.n_ab_l2 iUl2ItfipInt.n_ab_max_l2 iUl2ItfipInt.n_ab_status_l2 iUl2ItfipInt.n_mot_l2 iUl2ItfipInt.n_mot_status_l2 iUl2ItfipInt.n_motabregel_l2 iUl2ItfipInt.n_turb_l2 iUl2ItfipInt.nab_direction iUl2ItfipInt.nmo_vm_l2 iUl2ItfipInt.nmo_vm_status_l2 iUl2ItfipInt.p_bremse_l2 iUl2ItfipInt.parking_brake_l2 iUl2ItfipInt.pos_l2 iUl2ItfipInt.ps_sensor_signal_l2 iUl2ItfipInt.ps_sensor_status_l2 iUl2ItfipInt.soll_brake_torq_driver_l2 iUl2ItfipInt.soll_brake_torq_driver_status_l2 iUl2ItfipInt.swi_m_mot_l2 iUl2ItfipInt.v_unplausibel_l2 iUl2ItfipInt.vehstabnsys_err_l2 iUl2ItfipUewFl.istgang iUl2ItfipUewFl.m_getrauf iUl2ItfipUewFl.m_motmax iUl2ItfipUewFl.me_red_abs iUl2ItfipUewFl.me_red_status iUl2ItfipUewFl.me_rel iUl2ItfipUewFl.pos_atsys iUl2ItfipUewFl.status_k0 iUl2ItfipUewFl.zielgang_sas iUl2ItfipUewInt.istgang iUl2ItfipUewInt.m_getrauf iUl2ItfipUewInt.m_motmax iUl2ItfipUewInt.me_red_abs iUl2ItfipUewInt.me_red_status iUl2ItfipUewInt.me_rel iUl2ItfipUewInt.pos_atsys iUl2ItfipUewInt.status_k0 iUl2ItfipUewInt.zielgang_sas /end LOC_MEASUREMENT
/end FUNCTION
/begin FUNCTION UL2_SYSTEMZUSTAENDE "Dieses Unterpaket enthält Funktionen/Berechnungen/Abbildungen von Getriebezuständen, die von versch. Überwachungsfkt. benötigt werden. Die enthaltenen Fkt. müssen immer vor den Überwachungen aufgerufen werden."
 /begin SUB_FUNCTION UL2_HYD_MODELL UL2_HYD_ZUSTAND UL2_HYD_FAHR_ZUSTAND UL2_HYD_KFL UL2_DREHZAHLBEOBACHTER UL2_DREHZAHL /end SUB_FUNCTION
/end FUNCTION
/begin FUNCTION UL2_HYD_MODELL "Abbildung der Hydraulik auf Klassenebene"
 /begin LOC_MEASUREMENT iUl2EdsKAFl.cUl2EdsBasisFl._.strom iUl2EdsKAFl.cUl2EdsBasisFl._.strom_alt iUl2EdsKAFl.type iUl2EdsKAInt.cUl2EdsBasisInt._.strom iUl2EdsKAInt.cUl2EdsBasisInt._.strom_alt iUl2EdsKAInt.type iUl2EdsKAMittelFl.cUl2EdsBasisFl._.strom iUl2EdsKAMittelFl.cUl2EdsBasisFl._.strom_alt iUl2EdsKAMittelFl.type iUl2EdsKAMittelInt.cUl2EdsBasisInt._.strom iUl2EdsKAMittelInt.cUl2EdsBasisInt._.strom_alt iUl2EdsKAMittelInt.type iUl2EdsKBFl.cUl2EdsBasisFl._.strom iUl2EdsKBFl.cUl2EdsBasisFl._.strom_alt iUl2EdsKBFl.type iUl2EdsKBInt.cUl2EdsBasisInt._.strom iUl2EdsKBInt.cUl2EdsBasisInt._.strom_alt iUl2EdsKBInt.type iUl2EdsKBMittelFl.cUl2EdsBasisFl._.strom iUl2EdsKBMittelFl.cUl2EdsBasisFl._.strom_alt iUl2EdsKBMittelFl.type iUl2EdsKBMittelInt.cUl2EdsBasisInt._.strom iUl2EdsKBMittelInt.cUl2EdsBasisInt._.strom_alt iUl2EdsKBMittelInt.type iUl2EdsKCFl.cUl2EdsBasisFl._.strom iUl2EdsKCFl.cUl2EdsBasisFl._.strom_alt iUl2EdsKCFl.type iUl2EdsKCInt.cUl2EdsBasisInt._.strom iUl2EdsKCInt.cUl2EdsBasisInt._.strom_alt iUl2EdsKCInt.type iUl2EdsKCMittelFl.cUl2EdsBasisFl._.strom iUl2EdsKCMittelFl.cUl2EdsBasisFl._.strom_alt iUl2EdsKCMittelFl.type iUl2EdsKCMittelInt.cUl2EdsBasisInt._.strom iUl2EdsKCMittelInt.cUl2EdsBasisInt._.strom_alt iUl2EdsKCMittelInt.type iUl2EdsKDFl.cUl2EdsBasisFl._.strom iUl2EdsKDFl.cUl2EdsBasisFl._.strom_alt iUl2EdsKDFl.type iUl2EdsKDInt.cUl2EdsBasisInt._.strom iUl2EdsKDInt.cUl2EdsBasisInt._.strom_alt iUl2EdsKDInt.type iUl2EdsKDMittelFl.cUl2EdsBasisFl._.strom iUl2EdsKDMittelFl.cUl2EdsBasisFl._.strom_alt iUl2EdsKDMittelFl.type iUl2EdsKDMittelInt.cUl2EdsBasisInt._.strom iUl2EdsKDMittelInt.cUl2EdsBasisInt._.strom_alt iUl2EdsKDMittelInt.type iUl2EdsKEFl.cUl2EdsBasisFl._.strom iUl2EdsKEFl.cUl2EdsBasisFl._.strom_alt iUl2EdsKEFl.type iUl2EdsKEInt.cUl2EdsBasisInt._.strom iUl2EdsKEInt.cUl2EdsBasisInt._.strom_alt iUl2EdsKEInt.type iUl2EdsKEMittelFl.cUl2EdsBasisFl._.strom iUl2EdsKEMittelFl.cUl2EdsBasisFl._.strom_alt iUl2EdsKEMittelFl.type iUl2EdsKEMittelInt.cUl2EdsBasisInt._.strom iUl2EdsKEMittelInt.cUl2EdsBasisInt._.strom_alt iUl2EdsKEMittelInt.type iUl2EdsKK0Fl.cUl2EdsBasisFl._.strom iUl2EdsKK0Fl.cUl2EdsBasisFl._.strom_alt iUl2EdsKK0Fl.type iUl2EdsKK0Int.cUl2EdsBasisInt._.strom iUl2EdsKK0Int.cUl2EdsBasisInt._.strom_alt iUl2EdsKK0Int.type iUl2EdsPSysFl.cUl2EdsBasisFl._.strom iUl2EdsPSysFl.cUl2EdsBasisFl._.strom_alt iUl2EdsPSysFl.type iUl2EdsPSysInt.cUl2EdsBasisInt._.strom iUl2EdsPSysInt.cUl2EdsBasisInt._.strom_alt iUl2EdsPSysInt.type iUl2EdsPosFl.cUl2EdsBasisFl._.strom iUl2EdsPosFl.cUl2EdsBasisFl._.strom_alt iUl2EdsPosFl.type iUl2EdsPosInt.cUl2EdsBasisInt._.strom iUl2EdsPosInt.cUl2EdsBasisInt._.strom_alt iUl2EdsPosInt.type iUl2MvPZylFl.cUl2EdsBasisFl._.strom iUl2MvPZylFl.cUl2EdsBasisFl._.strom_alt iUl2MvPZylFl.flanke iUl2MvPZylInt.cUl2EdsBasisInt._.strom iUl2MvPZylInt.cUl2EdsBasisInt._.strom_alt iUl2MvPZylInt.flanke /end LOC_MEASUREMENT
/end FUNCTION
/begin FUNCTION UL2_HYD_ZUSTAND "Stromlosberechnung"
 /begin LOC_MEASUREMENT iUl2IMinKupFl.min_kup_bestr_gang_info iUl2IMinKupInt.min_kup_bestr_gang_info iUl2StromlosAusserPsFl.alt_stromlos_ausser_ps_edslg iUl2StromlosAusserPsFl.stromlos_ausser_ps_edslg iUl2StromlosAusserPsInt.alt_stromlos_ausser_ps_edslg iUl2StromlosAusserPsInt.stromlos_ausser_ps_edslg /end LOC_MEASUREMENT
/end FUNCTION
/begin FUNCTION UL2_HYD_FAHR_ZUSTAND "Information bzgl. Gängen und Schaltungen aus Strominformationen"
 /begin LOC_MEASUREMENT iUl2EdsGangInfoFl.gang_aus_bestromung iUl2EdsGangInfoFl.gang_aus_bestromung_alt iUl2EdsGangInfoFl.gang_aus_offen_kup iUl2EdsGangInfoFl.i_gang iUl2EdsGangInfoFl.istgang iUl2EdsGangInfoFl.n_kup_nicht_statisch_offen iUl2EdsGangInfoFl.n_kup_statisch_offen iUl2EdsGangInfoFl.n_verz_igang iUl2EdsGangInfoInt.gang_aus_bestromung iUl2EdsGangInfoInt.gang_aus_bestromung_alt iUl2EdsGangInfoInt.gang_aus_offen_kup iUl2EdsGangInfoInt.i_gang iUl2EdsGangInfoInt.istgang iUl2EdsGangInfoInt.n_kup_nicht_statisch_offen iUl2EdsGangInfoInt.n_kup_statisch_offen iUl2EdsGangInfoInt.n_verz_igang /end LOC_MEASUREMENT
/end FUNCTION
/begin FUNCTION UL2_HYD_KFL "Kraftschluss abgeleitet von den Strömen"
 /begin LOC_MEASUREMENT iUl2EdsKflFl.n_kup_zu iUl2EdsKflFl.n_verz_powerflowueb iUl2EdsKflFl.zustand iUl2EdsKflFl.zustand_direkt iUl2EdsKflInt.n_kup_zu iUl2EdsKflInt.n_verz_powerflowueb iUl2EdsKflInt.zustand iUl2EdsKflInt.zustand_direkt iUl2EdsKflKupAFl.f_geschlossen iUl2EdsKflKupAInt.f_geschlossen iUl2EdsKflKupBFl.f_geschlossen iUl2EdsKflKupBInt.f_geschlossen iUl2EdsKflKupCFl.f_geschlossen iUl2EdsKflKupCInt.f_geschlossen iUl2EdsKflKupDFl.f_geschlossen iUl2EdsKflKupDInt.f_geschlossen iUl2EdsKflKupEFl.f_geschlossen iUl2EdsKflKupEInt.f_geschlossen /end LOC_MEASUREMENT
/end FUNCTION
/begin FUNCTION UL2_DREHZAHLBEOBACHTER "Drehzahlbeobachter"
 /begin LOC_MEASUREMENT iUl2DrehzahlBeobFl.fl_drehzbeob_schaltung iUl2DrehzahlBeobInt.fl_drehzbeob_schaltung /end LOC_MEASUREMENT
/end FUNCTION
/begin FUNCTION UL2_DREHZAHL "enthaelt die Berechnungen mit Drehzahlen" /begin LOC_MEASUREMENT iUl2IGangFl.i_gang iUl2IGangInt.i_gang /end LOC_MEASUREMENT /end FUNCTION
/begin FUNCTION UL2_UEW_EDSLOGIK_KUPPL "Kupplungsmodell"
 /begin LOC_MEASUREMENT iUl2KoordKupplFl.fl_unplausi_edslogik iUl2KoordKupplFl.maxstoercgdeltai_edslogik_max iUl2KoordKupplFl.n_kup_zu_edslogik iUl2KoordKupplFl.n_kup_zu_edslogik_summe iUl2KoordKupplInt.fl_unplausi_edslogik iUl2KoordKupplInt.maxstoercgdeltai_edslogik_max iUl2KoordKupplInt.n_kup_zu_edslogik iUl2KoordKupplInt.n_kup_zu_edslogik_summe iUl2KupplAFl.cUl2KupBasisFl._.f_geschlossen iUl2KupplAFl.delta_i_edslogik iUl2KupplAFl.f_erste_bef_erk iUl2KupplAFl.f_init iUl2KupplAFl.i_sw_kup_oeffnet iUl2KupplAFl.i_sw_kup_schliesst iUl2KupplAFl.n_kup_basis_korrektur iUl2KupplAFl.n_kup_oeffnet iUl2KupplAFl.n_kup_oeffnet_stromlos iUl2KupplAFl.n_stoeredslogik iUl2KupplAFl.n_stoeredslogik_init iUl2KupplAFl.n_stoeredslogik_schwelle iUl2KupplAFl.nverzmin_dekrement iUl2KupplAInt.cUl2KupBasisInt._.f_geschlossen iUl2KupplAInt.delta_i_edslogik iUl2KupplAInt.f_erste_bef_erk iUl2KupplAInt.f_init iUl2KupplAInt.i_sw_kup_oeffnet iUl2KupplAInt.i_sw_kup_schliesst iUl2KupplAInt.n_kup_basis_korrektur iUl2KupplAInt.n_kup_oeffnet iUl2KupplAInt.n_kup_oeffnet_stromlos iUl2KupplAInt.n_stoeredslogik iUl2KupplAInt.n_stoeredslogik_init iUl2KupplAInt.n_stoeredslogik_schwelle iUl2KupplAInt.nverzmin_dekrement iUl2KupplBFl.cUl2KupBasisFl._.f_geschlossen iUl2KupplBFl.delta_i_edslogik iUl2KupplBFl.f_erste_bef_erk iUl2KupplBFl.f_init iUl2KupplBFl.i_sw_kup_oeffnet iUl2KupplBFl.i_sw_kup_schliesst iUl2KupplBFl.n_kup_basis_korrektur iUl2KupplBFl.n_kup_oeffnet iUl2KupplBFl.n_kup_oeffnet_stromlos iUl2KupplBFl.n_stoeredslogik iUl2KupplBFl.n_stoeredslogik_init iUl2KupplBFl.n_stoeredslogik_schwelle iUl2KupplBFl.nverzmin_dekrement iUl2KupplBInt.cUl2KupBasisInt._.f_geschlossen iUl2KupplBInt.delta_i_edslogik iUl2KupplBInt.f_erste_bef_erk iUl2KupplBInt.f_init iUl2KupplBInt.i_sw_kup_oeffnet iUl2KupplBInt.i_sw_kup_schliesst iUl2KupplBInt.n_kup_basis_korrektur iUl2KupplBInt.n_kup_oeffnet iUl2KupplBInt.n_kup_oeffnet_stromlos iUl2KupplBInt.n_stoeredslogik iUl2KupplBInt.n_stoeredslogik_init iUl2KupplBInt.n_stoeredslogik_schwelle iUl2KupplBInt.nverzmin_dekrement iUl2KupplBSfktFl.n_kup_zu_edslogik_anfahrkup iUl2KupplBSfktFl.n_verz_edslogik iUl2KupplBSfktInt.n_kup_zu_edslogik_anfahrkup iUl2KupplBSfktInt.n_verz_edslogik iUl2KupplCFl.cUl2KupBasisFl._.f_geschlossen iUl2KupplCFl.delta_i_edslogik iUl2KupplCFl.f_erste_bef_erk iUl2KupplCFl.f_init iUl2KupplCFl.i_sw_kup_oeffnet iUl2KupplCFl.i_sw_kup_schliesst iUl2KupplCFl.n_kup_basis_korrektur iUl2KupplCFl.n_kup_oeffnet iUl2KupplCFl.n_kup_oeffnet_stromlos iUl2KupplCFl.n_stoeredslogik iUl2KupplCFl.n_stoeredslogik_init iUl2KupplCFl.n_stoeredslogik_schwelle iUl2KupplCFl.nverzmin_dekrement iUl2KupplCInt.cUl2KupBasisInt._.f_geschlossen iUl2KupplCInt.delta_i_edslogik iUl2KupplCInt.f_erste_bef_erk iUl2KupplCInt.f_init iUl2KupplCInt.i_sw_kup_oeffnet iUl2KupplCInt.i_sw_kup_schliesst iUl2KupplCInt.n_kup_basis_korrektur iUl2KupplCInt.n_kup_oeffnet iUl2KupplCInt.n_kup_oeffnet_stromlos iUl2KupplCInt.n_stoeredslogik iUl2KupplCInt.n_stoeredslogik_init iUl2KupplCInt.n_stoeredslogik_schwelle iUl2KupplCInt.nverzmin_dekrement iUl2KupplDFl.cUl2KupBasisFl._.f_geschlossen iUl2KupplDFl.delta_i_edslogik iUl2KupplDFl.f_erste_bef_erk iUl2KupplDFl.f_init iUl2KupplDFl.i_sw_kup_oeffnet iUl2KupplDFl.i_sw_kup_schliesst iUl2KupplDFl.n_kup_basis_korrektur iUl2KupplDFl.n_kup_oeffnet iUl2KupplDFl.n_kup_oeffnet_stromlos iUl2KupplDFl.n_stoeredslogik iUl2KupplDFl.n_stoeredslogik_init iUl2KupplDFl.n_stoeredslogik_schwelle iUl2KupplDFl.nverzmin_dekrement iUl2KupplDInt.cUl2KupBasisInt._.f_geschlossen iUl2KupplDInt.delta_i_edslogik iUl2KupplDInt.f_erste_bef_erk iUl2KupplDInt.f_init iUl2KupplDInt.i_sw_kup_oeffnet iUl2KupplDInt.i_sw_kup_schliesst iUl2KupplDInt.n_kup_basis_korrektur iUl2KupplDInt.n_kup_oeffnet iUl2KupplDInt.n_kup_oeffnet_stromlos iUl2KupplDInt.n_stoeredslogik iUl2KupplDInt.n_stoeredslogik_init iUl2KupplDInt.n_stoeredslogik_schwelle iUl2KupplDInt.nverzmin_dekrement iUl2KupplEFl.cUl2KupBasisFl._.f_geschlossen iUl2KupplEFl.delta_i_edslogik iUl2KupplEFl.f_erste_bef_erk iUl2KupplEFl.f_init iUl2KupplEFl.i_sw_kup_oeffnet iUl2KupplEFl.i_sw_kup_schliesst iUl2KupplEFl.n_kup_basis_korrektur iUl2KupplEFl.n_kup_oeffnet iUl2KupplEFl.n_kup_oeffnet_stromlos iUl2KupplEFl.n_stoeredslogik iUl2KupplEFl.n_stoeredslogik_init iUl2KupplEFl.n_stoeredslogik_schwelle iUl2KupplEFl.nverzmin_dekrement iUl2KupplEInt.cUl2KupBasisInt._.f_geschlossen iUl2KupplEInt.delta_i_edslogik iUl2KupplEInt.f_erste_bef_erk iUl2KupplEInt.f_init iUl2KupplEInt.i_sw_kup_oeffnet iUl2KupplEInt.i_sw_kup_schliesst iUl2KupplEInt.n_kup_basis_korrektur iUl2KupplEInt.n_kup_oeffnet iUl2KupplEInt.n_kup_oeffnet_stromlos iUl2KupplEInt.n_stoeredslogik iUl2KupplEInt.n_stoeredslogik_init iUl2KupplEInt.n_stoeredslogik_schwelle iUl2KupplEInt.nverzmin_dekrement iUl2KupplK0Fl.cUl2KupBasisFl._.f_geschlossen iUl2KupplK0Fl.delta_i_edslogik iUl2KupplK0Fl.f_erste_bef_erk iUl2KupplK0Fl.f_init iUl2KupplK0Fl.i_sw_kup_oeffnet iUl2KupplK0Fl.i_sw_kup_schliesst iUl2KupplK0Fl.n_kup_oeffnet_k0 iUl2KupplK0Fl.n_stoeredslogik_init_k0 iUl2KupplK0Fl.n_stoeredslogik_k0 iUl2KupplK0Fl.n_stoeredslogik_schwelle_k0 iUl2KupplK0Int.cUl2KupBasisInt._.f_geschlossen iUl2KupplK0Int.delta_i_edslogik iUl2KupplK0Int.f_erste_bef_erk iUl2KupplK0Int.f_init iUl2KupplK0Int.i_sw_kup_oeffnet iUl2KupplK0Int.i_sw_kup_schliesst iUl2KupplK0Int.n_kup_oeffnet_k0 iUl2KupplK0Int.n_stoeredslogik_init_k0 iUl2KupplK0Int.n_stoeredslogik_k0 iUl2KupplK0Int.n_stoeredslogik_schwelle_k0 iUl2KupplToggleAFl.cUl2KupBasisFl._.f_geschlossen iUl2KupplToggleAFl.n_gut_edslogik_toggel iUl2KupplToggleAFl.n_stoer_edslogik_toggel iUl2KupplToggleAFl.schwelle_toggel_gut iUl2KupplToggleAFl.schwelle_toggel_stoer iUl2KupplToggleAInt.cUl2KupBasisInt._.f_geschlossen iUl2KupplToggleAInt.n_gut_edslogik_toggel iUl2KupplToggleAInt.n_stoer_edslogik_toggel iUl2KupplToggleAInt.schwelle_toggel_gut iUl2KupplToggleAInt.schwelle_toggel_stoer iUl2KupplToggleBFl.cUl2KupBasisFl._.f_geschlossen iUl2KupplToggleBFl.n_gut_edslogik_toggel iUl2KupplToggleBFl.n_stoer_edslogik_toggel iUl2KupplToggleBFl.schwelle_toggel_gut iUl2KupplToggleBFl.schwelle_toggel_stoer iUl2KupplToggleBInt.cUl2KupBasisInt._.f_geschlossen iUl2KupplToggleBInt.n_gut_edslogik_toggel iUl2KupplToggleBInt.n_stoer_edslogik_toggel iUl2KupplToggleBInt.schwelle_toggel_gut iUl2KupplToggleBInt.schwelle_toggel_stoer iUl2KupplToggleCFl.cUl2KupBasisFl._.f_geschlossen iUl2KupplToggleCFl.n_gut_edslogik_toggel iUl2KupplToggleCFl.n_stoer_edslogik_toggel iUl2KupplToggleCFl.schwelle_toggel_gut iUl2KupplToggleCFl.schwelle_toggel_stoer iUl2KupplToggleCInt.cUl2KupBasisInt._.f_geschlossen iUl2KupplToggleCInt.n_gut_edslogik_toggel iUl2KupplToggleCInt.n_stoer_edslogik_toggel iUl2KupplToggleCInt.schwelle_toggel_gut iUl2KupplToggleCInt.schwelle_toggel_stoer iUl2KupplToggleDFl.cUl2KupBasisFl._.f_geschlossen iUl2KupplToggleDFl.n_gut_edslogik_toggel iUl2KupplToggleDFl.n_stoer_edslogik_toggel iUl2KupplToggleDFl.schwelle_toggel_gut iUl2KupplToggleDFl.schwelle_toggel_stoer iUl2KupplToggleDInt.cUl2KupBasisInt._.f_geschlossen iUl2KupplToggleDInt.n_gut_edslogik_toggel iUl2KupplToggleDInt.n_stoer_edslogik_toggel iUl2KupplToggleDInt.schwelle_toggel_gut iUl2KupplToggleDInt.schwelle_toggel_stoer iUl2KupplToggleEFl.cUl2KupBasisFl._.f_geschlossen iUl2KupplToggleEFl.n_gut_edslogik_toggel iUl2KupplToggleEFl.n_stoer_edslogik_toggel iUl2KupplToggleEFl.schwelle_toggel_gut iUl2KupplToggleEFl.schwelle_toggel_stoer iUl2KupplToggleEInt.cUl2KupBasisInt._.f_geschlossen iUl2KupplToggleEInt.n_gut_edslogik_toggel iUl2KupplToggleEInt.n_stoer_edslogik_toggel iUl2KupplToggleEInt.schwelle_toggel_gut iUl2KupplToggleEInt.schwelle_toggel_stoer /end LOC_MEASUREMENT
/end FUNCTION
/begin FUNCTION UL2_UEW_EDSLOGIK "Überwachungsfunktionen der EdsLogik"
 /begin SUB_FUNCTION SYSTEMZUSTAENDE UEW_PLAUSI_EDSLOGIK UEW_PLAUSI_SOLLPOS_D_R UEW_PLAUSI_R_GANGSICHERUNG UEW_PLAUSI_EINLEGEN_P UEW_PLAUSI_AUSLEGEN_P UEW_PLAUSI_K0 UEW_PLAUSI_K0_STATUS /end SUB_FUNCTION
/end FUNCTION
/begin FUNCTION SYSTEMZUSTAENDE "Kraftschluss und diverse Signalabbildungen"
 /begin LOC_MEASUREMENT iUl2EdsSignalFl.globale_einst_bed iUl2EdsSignalFl.n_poskflwechsel_zaehler iUl2EdsSignalFl.pos_alt iUl2EdsSignalFl.posv_ueb_aktiv_l2 iUl2EdsSignalInt.globale_einst_bed iUl2EdsSignalInt.n_poskflwechsel_zaehler iUl2EdsSignalInt.pos_alt iUl2EdsSignalInt.posv_ueb_aktiv_l2 iUl2KraftschlussFl.kup_a_geschl iUl2KraftschlussFl.kup_b_geschl iUl2KraftschlussFl.kup_c_geschl iUl2KraftschlussFl.kup_d_geschl iUl2KraftschlussFl.kup_e_geschl iUl2KraftschlussFl.n_maxkabpos_c_zaehler iUl2KraftschlussFl.n_maxkabpos_e_zaehler iUl2KraftschlussFl.n_verz_edslogik iUl2KraftschlussFl.zustand iUl2KraftschlussFl.zustand_gespeichert iUl2KraftschlussInt.kup_a_geschl iUl2KraftschlussInt.kup_b_geschl iUl2KraftschlussInt.kup_c_geschl iUl2KraftschlussInt.kup_d_geschl iUl2KraftschlussInt.kup_e_geschl iUl2KraftschlussInt.n_maxkabpos_c_zaehler iUl2KraftschlussInt.n_maxkabpos_e_zaehler iUl2KraftschlussInt.n_verz_edslogik iUl2KraftschlussInt.zustand iUl2KraftschlussInt.zustand_gespeichert /end LOC_MEASUREMENT
/end FUNCTION
/begin FUNCTION UEW_PLAUSI_EDSLOGIK "Überwachung Anzahl geschalteter Schaltelemente"
 /begin LOC_MEASUREMENT iUl2EdsLogikFl.fzg_geschwindigkeit_alt_l2 iUl2EdsLogikFl.n_zaehler_rueck iUl2EdsLogikInt.fzg_geschwindigkeit_alt_l2 iUl2EdsLogikInt.n_zaehler_rueck /end LOC_MEASUREMENT
/end FUNCTION
/begin FUNCTION UEW_PLAUSI_SOLLPOS_D_R "Teilfunktion Plausibilisierung Aktuatoransteuerung/ Sollposition D/ R"
 /begin LOC_MEASUREMENT iUl2AktuatorAnstDRFl.fehler_i_gang iUl2AktuatorAnstDRFl.init_igang_ungl_null iUl2AktuatorAnstDRFl.n_erfolg_fahrtr_edslogik iUl2AktuatorAnstDRFl.n_stoer_fahrtr_edslogik iUl2AktuatorAnstDRFl.pos_igang_wechsel iUl2AktuatorAnstDRFl.pos_l2_alt iUl2AktuatorAnstDRFl.stoerungen_pos iUl2AktuatorAnstDRFl.timer_fahrtr_edslogik iUl2AktuatorAnstDRFl.zustand iUl2AktuatorAnstDRInt.fehler_i_gang iUl2AktuatorAnstDRInt.init_igang_ungl_null iUl2AktuatorAnstDRInt.n_erfolg_fahrtr_edslogik iUl2AktuatorAnstDRInt.n_stoer_fahrtr_edslogik iUl2AktuatorAnstDRInt.pos_igang_wechsel iUl2AktuatorAnstDRInt.pos_l2_alt iUl2AktuatorAnstDRInt.stoerungen_pos iUl2AktuatorAnstDRInt.timer_fahrtr_edslogik iUl2AktuatorAnstDRInt.zustand iUl2PosAnstDRFl.n_erfolg_fahrtr_pos iUl2PosAnstDRFl.n_stoer_fahrtr_pos iUl2PosAnstDRFl.zustand iUl2PosAnstDRInt.n_erfolg_fahrtr_pos iUl2PosAnstDRInt.n_stoer_fahrtr_pos iUl2PosAnstDRInt.zustand /end LOC_MEASUREMENT
/end FUNCTION
/begin FUNCTION UEW_PLAUSI_R_GANGSICHERUNG "Teilfunktion R-Gangsicherung bei zu hoher Fahrzeuggeschwindigkeit"
 /begin LOC_MEASUREMENT iUl2RGangSicherungFl.fl_rgang_erkannt iUl2RGangSicherungInt.fl_rgang_erkannt /end LOC_MEASUREMENT
/end FUNCTION
/begin FUNCTION UEW_PLAUSI_EINLEGEN_P "Teilfunktion Absicherung gegen unerlaubtes Einlegen von P bei unplausibler Fahrzeuggeschwindigkeit"
 /begin LOC_MEASUREMENT iUl2PAbsicherungEinlP.n_richtigvplausipos_p iUl2PAbsicherungEinlP.n_stoervplausipos_p /end LOC_MEASUREMENT
/end FUNCTION
/begin FUNCTION UEW_PLAUSI_AUSLEGEN_P "Teilfunktion Plausibilisierung Aktuatoransteuerung/ Sollposition P"
 /begin LOC_MEASUREMENT iUl2PAbsicherungAuslPFl.einst_bed_einmalig iUl2PAbsicherungAuslPFl.n_richtigpos_p iUl2PAbsicherungAuslPFl.n_stoerpos_p iUl2PAbsicherungAuslPFl.n_vpospueb iUl2PAbsicherungAuslPInt.einst_bed_einmalig iUl2PAbsicherungAuslPInt.n_richtigpos_p iUl2PAbsicherungAuslPInt.n_stoerpos_p iUl2PAbsicherungAuslPInt.n_vpospueb /end LOC_MEASUREMENT
/end FUNCTION
/end MODULE
/end PROJECT
