ASAP2_VERSION 1 51
/begin PROJECT _929_929 "Gen2_BMW_System_Supplier_Lib"
/begin HEADER "" VERSION "C_03_03" PROJECT_NO _929_929 /end HEADER
/begin MODULE DIM ""
/begin MOD_COMMON "" BYTE_ORDER MSB_FIRST ALIGNMENT_BYTE 1 ALIGNMENT_WORD 2 ALIGNMENT_LONG 4 ALIGNMENT_FLOAT32_IEEE 4 /end MOD_COMMON
/begin CHARACTERISTIC KL_NDGLSPOSHS35 "Drehzahlschwelle positiv fuer den Start der GLS bei HS" CURVE 0x239D90 kl_si16_S6_S3 8000 UMR_U_MIN_1_1_0_S6_S3 0 8000
 /begin AXIS_DESCR STD_AXIS zff_atsys._.iSignale._.obj.sig_m_t UMR_NM__1_1_0_S6_S3 4 -400 1640 DEPOSIT ABSOLUTE MONOTONY MON_INCREASE /end AXIS_DESCR
/end CHARACTERISTIC
/begin CHARACTERISTIC KL_NDGLSNEGHS35 "Drehzahlschwelle negativ fuer den Start der GLS bei HS" CURVE 0x239DA4 kl_si16_S6_S3 8000 UMR_U_MIN_1_1_0_S6_S3 -8000 0
 /begin AXIS_DESCR STD_AXIS zff_atsys._.iSignale._.obj.sig_m_t UMR_NM__1_1_0_S6_S3 4 -400 1640 DEPOSIT ABSOLUTE MONOTONY MON_INCREASE /end AXIS_DESCR
/end CHARACTERISTIC
/begin CHARACTERISTIC KF_NGTGLSHS35 "Turbinendrehzahlgradient fuer Startbedingung der GLS HS" MAP 0x239DB8 kf_si16_S6_S3 32000 UMR_U_MINSEC_1_1_0_S6_S3 -32000 0
 /begin AXIS_DESCR STD_AXIS zff_atsys._.iSignale._.obj.sig_m_t UMR_NM__1_1_0_S6_S3 6 -400 1640 DEPOSIT ABSOLUTE MONOTONY MON_INCREASE /end AXIS_DESCR
 /begin AXIS_DESCR STD_AXIS zff_atsys._.iSignale._.obj.sig_n_t UMR_U_MIN_1_1_0_S6_S3 4 0 8160 DEPOSIT ABSOLUTE MONOTONY MON_INCREASE /end AXIS_DESCR
/end CHARACTERISTIC
/begin CHARACTERISTIC KL_UMSCHGLSKZU35 "Momentenschwelle zu Regelumschaltung" CURVE 0x239E04 kl_si16_S6_S3 1400 UMR_NM__1_1_0_S6_S3 -100 1300
 /begin AXIS_DESCR STD_AXIS zff_atsys._.iSignale._.obj.sig_c_getr UMR_GRADC__1_1_M40_S6_S3 4 -40 215 DEPOSIT ABSOLUTE MONOTONY MON_INCREASE /end AXIS_DESCR
/end CHARACTERISTIC
/begin CHARACTERISTIC KP_GLSKZU35 "Proportionalfaktor PID-Regler GLS" VALUE 0x26DB1E kw_ui16_S6_S3 10000 UMR_MBARMINSEC__1_1_0_S6_S3 0 10000 /end CHARACTERISTIC
/begin CHARACTERISTIC KI_GLSKZU35 "Integralfaktor PID-Regler GLS" VALUE 0x26DB20 kw_ui16_S6_S3 10000 UMR_MBARMINSEC_10MSEC_1_1_0_S6_S3 0 10000 /end CHARACTERISTIC
/begin CHARACTERISTIC TD_STOLGLS35 "max. tol. Schleifzeitdifferenz GLS" VALUE 0x26E6D1 kw_ui8_S6_S3 2540 UMR_MSEC__10_1_0_S6_S3 0 2540 /end CHARACTERISTIC
/begin CHARACTERISTIC K_WNGGRGLSPKZU35 "Korrekturfaktor, wenn gemessene Schleifzeit zu gross (oberhalb der Toleranz) bei Regelung KZU" VALUE 0x26DB22 kw_ui16_S6_S3 65530 UMR_U_MINSEC2_1_1_0_S6_S3 0 65530 /end CHARACTERISTIC
/begin CHARACTERISTIC K_WNGGRGLSPKAB35 "Korrekturfaktor, wenn gemessene Schleifzeit zu gross (oberhalb der Toleranz) bei Regelung KAB" VALUE 0x26DB24 kw_ui16_S6_S3 65530 UMR_U_MINSEC2_1_1_0_S6_S3 0 65530 /end CHARACTERISTIC
/begin CHARACTERISTIC K_WNGKLGLSPKZU35 "Korrekturfaktor, wenn gemessene Schleifzeit zu klein (unterhalb der Toleranz) bei Regelung KZU" VALUE 0x26DB26 kw_ui16_S6_S3 65530 UMR_U_MINSEC2_1_1_0_S6_S3 0 65530 /end CHARACTERISTIC
/begin CHARACTERISTIC K_WNGKLGLSPKAB35 "Korrekturfaktor, wenn gemessene Schleifzeit zu klein (unterhalb der Toleranz) bei Regelung KAB" VALUE 0x26DB28 kw_ui16_S6_S3 65530 UMR_U_MINSEC2_1_1_0_S6_S3 0 65530 /end CHARACTERISTIC
/begin CHARACTERISTIC KI_GLSKAB35 "Integralfaktor PID-Regler GLS" VALUE 0x26DB2A kw_ui16_S6_S3 10000 UMR_MBARMINSEC_10MSEC_1_1_0_S6_S3 0 10000 /end CHARACTERISTIC
/begin CHARACTERISTIC KP_GLSKAB35 "Proportionalfaktor PID-Regler GLS" VALUE 0x26DB2C kw_ui16_S6_S3 10000 UMR_MBARMINSEC__1_1_0_S6_S3 0 10000 /end CHARACTERISTIC
/begin CHARACTERISTIC T_FNGTGLSENDE35 "Filterwert für Filterung Sollgradient bei HS" VALUE 0x26E6D2 kw_ui8_S6_S3 254 UMR_MSEC__1_1_0_S6_S3 0 254 /end CHARACTERISTIC
/begin CHARACTERISTIC W_NGTGLSENDE35 "Endwert für Filterung Sollgradient bei HS" VALUE 0x26DB2E kw_si16_S6_S3 5000 UMR_U_MINSEC_1_1_0_S6_S3 -5000 0 /end CHARACTERISTIC
/begin CHARACTERISTIC KL_TVGLSKABCG35 "Verzoegerungszeit GLS-Beginn" CURVE 0x239E18 kl_ui8_S6_S3 2540 UMR_MSEC__10_1_0_S6_S3 0 2540
 /begin AXIS_DESCR STD_AXIS zff_atsys._.iSignale._.obj.sig_c_getr UMR_GRADC__1_1_M40_S6_S3 3 -40 150 DEPOSIT ABSOLUTE MONOTONY MON_INCREASE /end AXIS_DESCR
/end CHARACTERISTIC
/begin CHARACTERISTIC KL_MPT_WNGTGLS_INIT35 "Filterkonstante Sollgradient PT1-Filter" CURVE 0x239E24 kl_si16_S6_S3 0.99 UMR___1_100_0_S6_S3 0.01 1
 /begin AXIS_DESCR STD_AXIS NO_INPUT_QUANTITY UMR_U_MINSEC_10000_32767_0_S6_S3 3 -9765.92303232 9765.92303232 DEPOSIT ABSOLUTE MONOTONY MON_INCREASE /end AXIS_DESCR
/end CHARACTERISTIC
/begin CHARACTERISTIC KL_NDGLSPOSHS46 "Drehzahlschwelle positiv fuer den Start der GLS bei HS" CURVE 0x239E34 kl_si16_S6_S3 8000 UMR_U_MIN_1_1_0_S6_S3 0 8000
 /begin AXIS_DESCR STD_AXIS zff_atsys._.iSignale._.obj.sig_m_t UMR_NM__1_1_0_S6_S3 4 -400 1640 DEPOSIT ABSOLUTE MONOTONY MON_INCREASE /end AXIS_DESCR
/end CHARACTERISTIC
/begin CHARACTERISTIC KL_NDGLSNEGHS46 "Drehzahlschwelle negativ fuer den Start der GLS bei HS" CURVE 0x239E48 kl_si16_S6_S3 8000 UMR_U_MIN_1_1_0_S6_S3 -8000 0
 /begin AXIS_DESCR STD_AXIS zff_atsys._.iSignale._.obj.sig_m_t UMR_NM__1_1_0_S6_S3 4 -400 1640 DEPOSIT ABSOLUTE MONOTONY MON_INCREASE /end AXIS_DESCR
/end CHARACTERISTIC
/begin CHARACTERISTIC KF_NGTGLSHS46 "Turbinendrehzahlgradient fuer Startbedingung der GLS HS" MAP 0x239E5C kf_si16_S6_S3 32000 UMR_U_MINSEC_1_1_0_S6_S3 -32000 0
 /begin AXIS_DESCR STD_AXIS zff_atsys._.iSignale._.obj.sig_m_t UMR_NM__1_1_0_S6_S3 6 -400 1640 DEPOSIT ABSOLUTE MONOTONY MON_INCREASE /end AXIS_DESCR
 /begin AXIS_DESCR STD_AXIS zff_atsys._.iSignale._.obj.sig_n_t UMR_U_MIN_1_1_0_S6_S3 4 0 8160 DEPOSIT ABSOLUTE MONOTONY MON_INCREASE /end AXIS_DESCR
/end CHARACTERISTIC
/begin CHARACTERISTIC KL_UMSCHGLSKZU46 "Momentenschwelle zu Regelumschaltung" CURVE 0x239EA8 kl_si16_S6_S3 1400 UMR_NM__1_1_0_S6_S3 -100 1300
 /begin AXIS_DESCR STD_AXIS zff_atsys._.iSignale._.obj.sig_c_getr UMR_GRADC__1_1_M40_S6_S3 4 -40 215 DEPOSIT ABSOLUTE MONOTONY MON_INCREASE /end AXIS_DESCR
/end CHARACTERISTIC
/begin CHARACTERISTIC KP_GLSKZU46 "Proportionalfaktor PID-Regler GLS" VALUE 0x26DB30 kw_ui16_S6_S3 10000 UMR_MBARMINSEC__1_1_0_S6_S3 0 10000 /end CHARACTERISTIC
/begin CHARACTERISTIC KI_GLSKZU46 "Integralfaktor PID-Regler GLS" VALUE 0x26DB32 kw_ui16_S6_S3 10000 UMR_MBARMINSEC_10MSEC_1_1_0_S6_S3 0 10000 /end CHARACTERISTIC
/begin CHARACTERISTIC TD_STOLGLS46 "max. tol. Schleifzeitdifferenz GLS" VALUE 0x26E6D3 kw_ui8_S6_S3 2540 UMR_MSEC__10_1_0_S6_S3 0 2540 /end CHARACTERISTIC
/begin CHARACTERISTIC K_WNGGRGLSPKZU46 "Korrekturfaktor, wenn gemessene Schleifzeit zu gross (oberhalb der Toleranz) bei Regelung KZU" VALUE 0x26DB34 kw_ui16_S6_S3 65530 UMR_U_MINSEC2_1_1_0_S6_S3 0 65530 /end CHARACTERISTIC
/begin CHARACTERISTIC K_WNGGRGLSPKAB46 "Korrekturfaktor, wenn gemessene Schleifzeit zu gross (oberhalb der Toleranz) bei Regelung KAB" VALUE 0x26DB36 kw_ui16_S6_S3 65530 UMR_U_MINSEC2_1_1_0_S6_S3 0 65530 /end CHARACTERISTIC
/begin CHARACTERISTIC K_WNGKLGLSPKZU46 "Korrekturfaktor, wenn gemessene Schleifzeit zu klein (unterhalb der Toleranz) bei Regelung KZU" VALUE 0x26DB38 kw_ui16_S6_S3 65530 UMR_U_MINSEC2_1_1_0_S6_S3 0 65530 /end CHARACTERISTIC
/begin CHARACTERISTIC K_WNGKLGLSPKAB46 "Korrekturfaktor, wenn gemessene Schleifzeit zu klein (unterhalb der Toleranz) bei Regelung KAB" VALUE 0x26DB3A kw_ui16_S6_S3 65530 UMR_U_MINSEC2_1_1_0_S6_S3 0 65530 /end CHARACTERISTIC
/begin CHARACTERISTIC KI_GLSKAB46 "Integralfaktor PID-Regler GLS" VALUE 0x26DB3C kw_ui16_S6_S3 10000 UMR_MBARMINSEC_10MSEC_1_1_0_S6_S3 0 10000 /end CHARACTERISTIC
/begin CHARACTERISTIC KP_GLSKAB46 "Proportionalfaktor PID-Regler GLS" VALUE 0x26DB3E kw_ui16_S6_S3 10000 UMR_MBARMINSEC__1_1_0_S6_S3 0 10000 /end CHARACTERISTIC
/begin CHARACTERISTIC T_FNGTGLSENDE46 "Filterwert für Filterung Sollgradient bei HS" VALUE 0x26E6D4 kw_ui8_S6_S3 254 UMR_MSEC__1_1_0_S6_S3 0 254 /end CHARACTERISTIC
/begin CHARACTERISTIC W_NGTGLSENDE46 "Endwert für Filterung Sollgradient bei HS" VALUE 0x26DB40 kw_si16_S6_S3 5000 UMR_U_MINSEC_1_1_0_S6_S3 -5000 0 /end CHARACTERISTIC
/begin CHARACTERISTIC KL_TVGLSKABCG46 "Verzoegerungszeit GLS-Beginn" CURVE 0x239EBC kl_ui8_S6_S3 2540 UMR_MSEC__10_1_0_S6_S3 0 2540
 /begin AXIS_DESCR STD_AXIS zff_atsys._.iSignale._.obj.sig_c_getr UMR_GRADC__1_1_M40_S6_S3 3 -40 150 DEPOSIT ABSOLUTE MONOTONY MON_INCREASE /end AXIS_DESCR
/end CHARACTERISTIC
/begin CHARACTERISTIC KL_MPT_WNGTGLS_INIT46 "Filterkonstante Sollgradient PT1-Filter" CURVE 0x239EC8 kl_si16_S6_S3 0.99 UMR___1_100_0_S6_S3 0.01 1
 /begin AXIS_DESCR STD_AXIS NO_INPUT_QUANTITY UMR_U_MINSEC_10000_32767_0_S6_S3 3 -9765.92303232 9765.92303232 DEPOSIT ABSOLUTE MONOTONY MON_INCREASE /end AXIS_DESCR
/end CHARACTERISTIC
/begin CHARACTERISTIC KL_NDGLSPOSHS57 "Drehzahlschwelle positiv fuer den Start der GLS bei HS" CURVE 0x239ED8 kl_si16_S6_S3 8000 UMR_U_MIN_1_1_0_S6_S3 0 8000
 /begin AXIS_DESCR STD_AXIS zff_atsys._.iSignale._.obj.sig_m_t UMR_NM__1_1_0_S6_S3 4 -400 1640 DEPOSIT ABSOLUTE MONOTONY MON_INCREASE /end AXIS_DESCR
/end CHARACTERISTIC
/begin CHARACTERISTIC KL_NDGLSNEGHS57 "Drehzahlschwelle negativ fuer den Start der GLS bei HS" CURVE 0x239EEC kl_si16_S6_S3 8000 UMR_U_MIN_1_1_0_S6_S3 -8000 0
 /begin AXIS_DESCR STD_AXIS zff_atsys._.iSignale._.obj.sig_m_t UMR_NM__1_1_0_S6_S3 4 -400 1640 DEPOSIT ABSOLUTE MONOTONY MON_INCREASE /end AXIS_DESCR
/end CHARACTERISTIC
/begin CHARACTERISTIC KF_NGTGLSHS57 "Turbinendrehzahlgradient fuer Startbedingung der GLS HS" MAP 0x239F00 kf_si16_S6_S3 32000 UMR_U_MINSEC_1_1_0_S6_S3 -32000 0
 /begin AXIS_DESCR STD_AXIS zff_atsys._.iSignale._.obj.sig_m_t UMR_NM__1_1_0_S6_S3 6 -400 1640 DEPOSIT ABSOLUTE MONOTONY MON_INCREASE /end AXIS_DESCR
 /begin AXIS_DESCR STD_AXIS zff_atsys._.iSignale._.obj.sig_n_t UMR_U_MIN_1_1_0_S6_S3 4 0 8160 DEPOSIT ABSOLUTE MONOTONY MON_INCREASE /end AXIS_DESCR
/end CHARACTERISTIC
/begin CHARACTERISTIC KL_UMSCHGLSKZU57 "Momentenschwelle zu Regelumschaltung" CURVE 0x239F4C kl_si16_S6_S3 1400 UMR_NM__1_1_0_S6_S3 -100 1300
 /begin AXIS_DESCR STD_AXIS zff_atsys._.iSignale._.obj.sig_c_getr UMR_GRADC__1_1_M40_S6_S3 4 -40 215 DEPOSIT ABSOLUTE MONOTONY MON_INCREASE /end AXIS_DESCR
/end CHARACTERISTIC
/begin CHARACTERISTIC KP_GLSKZU57 "Proportionalfaktor PID-Regler GLS" VALUE 0x26DB42 kw_ui16_S6_S3 10000 UMR_MBARMINSEC__1_1_0_S6_S3 0 10000 /end CHARACTERISTIC
/begin CHARACTERISTIC KI_GLSKZU57 "Integralfaktor PID-Regler GLS" VALUE 0x26DB44 kw_ui16_S6_S3 10000 UMR_MBARMINSEC_10MSEC_1_1_0_S6_S3 0 10000 /end CHARACTERISTIC
/begin CHARACTERISTIC TD_STOLGLS57 "max. tol. Schleifzeitdifferenz GLS" VALUE 0x26E6D5 kw_ui8_S6_S3 2540 UMR_MSEC__10_1_0_S6_S3 0 2540 /end CHARACTERISTIC
/begin CHARACTERISTIC K_WNGGRGLSPKZU57 "Korrekturfaktor, wenn gemessene Schleifzeit zu gross (oberhalb der Toleranz) bei Regelung KZU" VALUE 0x26DB46 kw_ui16_S6_S3 65530 UMR_U_MINSEC2_1_1_0_S6_S3 0 65530 /end CHARACTERISTIC
/begin CHARACTERISTIC K_WNGGRGLSPKAB57 "Korrekturfaktor, wenn gemessene Schleifzeit zu gross (oberhalb der Toleranz) bei Regelung KAB" VALUE 0x26DB48 kw_ui16_S6_S3 65530 UMR_U_MINSEC2_1_1_0_S6_S3 0 65530 /end CHARACTERISTIC
/begin CHARACTERISTIC K_WNGKLGLSPKZU57 "Korrekturfaktor, wenn gemessene Schleifzeit zu klein (unterhalb der Toleranz) bei Regelung KZU" VALUE 0x26DB4A kw_ui16_S6_S3 65530 UMR_U_MINSEC2_1_1_0_S6_S3 0 65530 /end CHARACTERISTIC
/begin CHARACTERISTIC K_WNGKLGLSPKAB57 "Korrekturfaktor, wenn gemessene Schleifzeit zu klein (unterhalb der Toleranz) bei Regelung KAB" VALUE 0x26DB4C kw_ui16_S6_S3 65530 UMR_U_MINSEC2_1_1_0_S6_S3 0 65530 /end CHARACTERISTIC
/begin CHARACTERISTIC KI_GLSKAB57 "Integralfaktor PID-Regler GLS" VALUE 0x26DB4E kw_ui16_S6_S3 10000 UMR_MBARMINSEC_10MSEC_1_1_0_S6_S3 0 10000 /end CHARACTERISTIC
/begin CHARACTERISTIC KP_GLSKAB57 "Proportionalfaktor PID-Regler GLS" VALUE 0x26DB50 kw_ui16_S6_S3 10000 UMR_MBARMINSEC__1_1_0_S6_S3 0 10000 /end CHARACTERISTIC
/begin CHARACTERISTIC T_FNGTGLSENDE57 "Filterwert für Filterung Sollgradient bei HS" VALUE 0x26E6D6 kw_ui8_S6_S3 254 UMR_MSEC__1_1_0_S6_S3 0 254 /end CHARACTERISTIC
/begin CHARACTERISTIC W_NGTGLSENDE57 "Endwert für Filterung Sollgradient bei HS" VALUE 0x26DB52 kw_si16_S6_S3 5000 UMR_U_MINSEC_1_1_0_S6_S3 -5000 0 /end CHARACTERISTIC
/begin CHARACTERISTIC KL_TVGLSKABCG57 "Verzoegerungszeit GLS-Beginn" CURVE 0x239F60 kl_ui8_S6_S3 2540 UMR_MSEC__10_1_0_S6_S3 0 2540
 /begin AXIS_DESCR STD_AXIS zff_atsys._.iSignale._.obj.sig_c_getr UMR_GRADC__1_1_M40_S6_S3 3 -40 150 DEPOSIT ABSOLUTE MONOTONY MON_INCREASE /end AXIS_DESCR
/end CHARACTERISTIC
/begin CHARACTERISTIC KL_MPT_WNGTGLS_INIT57 "Filterkonstante Sollgradient PT1-Filter" CURVE 0x239F6C kl_si16_S6_S3 0.99 UMR___1_100_0_S6_S3 0.01 1
 /begin AXIS_DESCR STD_AXIS NO_INPUT_QUANTITY UMR_U_MINSEC_10000_32767_0_S6_S3 3 -9765.92303232 9765.92303232 DEPOSIT ABSOLUTE MONOTONY MON_INCREASE /end AXIS_DESCR
/end CHARACTERISTIC
/begin CHARACTERISTIC KL_NDGLSPOSHS68 "Drehzahlschwelle positiv fuer den Start der GLS bei HS" CURVE 0x239F7C kl_si16_S6_S3 8000 UMR_U_MIN_1_1_0_S6_S3 0 8000
 /begin AXIS_DESCR STD_AXIS zff_atsys._.iSignale._.obj.sig_m_t UMR_NM__1_1_0_S6_S3 4 -400 1640 DEPOSIT ABSOLUTE MONOTONY MON_INCREASE /end AXIS_DESCR
/end CHARACTERISTIC
/begin CHARACTERISTIC KL_NDGLSNEGHS68 "Drehzahlschwelle negativ fuer den Start der GLS bei HS" CURVE 0x239F90 kl_si16_S6_S3 8000 UMR_U_MIN_1_1_0_S6_S3 -8000 0
 /begin AXIS_DESCR STD_AXIS zff_atsys._.iSignale._.obj.sig_m_t UMR_NM__1_1_0_S6_S3 4 -400 1640 DEPOSIT ABSOLUTE MONOTONY MON_INCREASE /end AXIS_DESCR
/end CHARACTERISTIC
/begin CHARACTERISTIC KF_NGTGLSHS68 "Turbinendrehzahlgradient fuer Startbedingung der GLS HS" MAP 0x239FA4 kf_si16_S6_S3 32000 UMR_U_MINSEC_1_1_0_S6_S3 -32000 0
 /begin AXIS_DESCR STD_AXIS zff_atsys._.iSignale._.obj.sig_m_t UMR_NM__1_1_0_S6_S3 6 -400 1640 DEPOSIT ABSOLUTE MONOTONY MON_INCREASE /end AXIS_DESCR
 /begin AXIS_DESCR STD_AXIS zff_atsys._.iSignale._.obj.sig_n_t UMR_U_MIN_1_1_0_S6_S3 4 0 8160 DEPOSIT ABSOLUTE MONOTONY MON_INCREASE /end AXIS_DESCR
/end CHARACTERISTIC
/begin CHARACTERISTIC KL_UMSCHGLSKZU68 "Momentenschwelle zu Regelumschaltung" CURVE 0x239FF0 kl_si16_S6_S3 1400 UMR_NM__1_1_0_S6_S3 -100 1300
 /begin AXIS_DESCR STD_AXIS zff_atsys._.iSignale._.obj.sig_c_getr UMR_GRADC__1_1_M40_S6_S3 4 -40 215 DEPOSIT ABSOLUTE MONOTONY MON_INCREASE /end AXIS_DESCR
/end CHARACTERISTIC
/begin CHARACTERISTIC KP_GLSKZU68 "Proportionalfaktor PID-Regler GLS" VALUE 0x26DB54 kw_ui16_S6_S3 10000 UMR_MBARMINSEC__1_1_0_S6_S3 0 10000 /end CHARACTERISTIC
/begin CHARACTERISTIC KI_GLSKZU68 "Integralfaktor PID-Regler GLS" VALUE 0x26DB56 kw_ui16_S6_S3 10000 UMR_MBARMINSEC_10MSEC_1_1_0_S6_S3 0 10000 /end CHARACTERISTIC
/begin CHARACTERISTIC TD_STOLGLS68 "max. tol. Schleifzeitdifferenz GLS" VALUE 0x26E6D7 kw_ui8_S6_S3 2540 UMR_MSEC__10_1_0_S6_S3 0 2540 /end CHARACTERISTIC
/begin CHARACTERISTIC K_WNGGRGLSPKZU68 "Korrekturfaktor, wenn gemessene Schleifzeit zu gross (oberhalb der Toleranz) bei Regelung KZU" VALUE 0x26DB58 kw_ui16_S6_S3 65530 UMR_U_MINSEC2_1_1_0_S6_S3 0 65530 /end CHARACTERISTIC
/begin CHARACTERISTIC K_WNGGRGLSPKAB68 "Korrekturfaktor, wenn gemessene Schleifzeit zu gross (oberhalb der Toleranz) bei Regelung KAB" VALUE 0x26DB5A kw_ui16_S6_S3 65530 UMR_U_MINSEC2_1_1_0_S6_S3 0 65530 /end CHARACTERISTIC
/begin CHARACTERISTIC K_WNGKLGLSPKZU68 "Korrekturfaktor, wenn gemessene Schleifzeit zu klein (unterhalb der Toleranz) bei Regelung KZU" VALUE 0x26DB5C kw_ui16_S6_S3 65530 UMR_U_MINSEC2_1_1_0_S6_S3 0 65530 /end CHARACTERISTIC
/begin CHARACTERISTIC K_WNGKLGLSPKAB68 "Korrekturfaktor, wenn gemessene Schleifzeit zu klein (unterhalb der Toleranz) bei Regelung KAB" VALUE 0x26DB5E kw_ui16_S6_S3 65530 UMR_U_MINSEC2_1_1_0_S6_S3 0 65530 /end CHARACTERISTIC
/begin CHARACTERISTIC KI_GLSKAB68 "Integralfaktor PID-Regler GLS" VALUE 0x26DB60 kw_ui16_S6_S3 10000 UMR_MBARMINSEC_10MSEC_1_1_0_S6_S3 0 10000 /end CHARACTERISTIC
/begin CHARACTERISTIC KP_GLSKAB68 "Proportionalfaktor PID-Regler GLS" VALUE 0x26DB62 kw_ui16_S6_S3 10000 UMR_MBARMINSEC__1_1_0_S6_S3 0 10000 /end CHARACTERISTIC
/begin CHARACTERISTIC T_FNGTGLSENDE68 "Filterwert für Filterung Sollgradient bei HS" VALUE 0x26E6D8 kw_ui8_S6_S3 254 UMR_MSEC__1_1_0_S6_S3 0 254 /end CHARACTERISTIC
/begin CHARACTERISTIC W_NGTGLSENDE68 "Endwert für Filterung Sollgradient bei HS" VALUE 0x26DB64 kw_si16_S6_S3 5000 UMR_U_MINSEC_1_1_0_S6_S3 -5000 0 /end CHARACTERISTIC
/begin CHARACTERISTIC KL_TVGLSKABCG68 "Verzoegerungszeit GLS-Beginn" CURVE 0x23A004 kl_ui8_S6_S3 2540 UMR_MSEC__10_1_0_S6_S3 0 2540
 /begin AXIS_DESCR STD_AXIS zff_atsys._.iSignale._.obj.sig_c_getr UMR_GRADC__1_1_M40_S6_S3 3 -40 150 DEPOSIT ABSOLUTE MONOTONY MON_INCREASE /end AXIS_DESCR
/end CHARACTERISTIC
/begin CHARACTERISTIC KL_MPT_WNGTGLS_INIT68 "Filterkonstante Sollgradient PT1-Filter" CURVE 0x23A010 kl_si16_S6_S3 0.99 UMR___1_100_0_S6_S3 0.01 1
 /begin AXIS_DESCR STD_AXIS NO_INPUT_QUANTITY UMR_U_MINSEC_10000_32767_0_S6_S3 3 -9765.92303232 9765.92303232 DEPOSIT ABSOLUTE MONOTONY MON_INCREASE /end AXIS_DESCR
/end CHARACTERISTIC
/begin CHARACTERISTIC KL_UMSCHGLSKAB21 "Momentenschwelle zu Regelumschaltung" CURVE 0x23B02C kl_si16_S6_S3 1400 UMR_NM__1_1_0_S6_S3 -100 1300
 /begin AXIS_DESCR STD_AXIS zff_atsys._.iSignale._.obj.sig_c_getr UMR_GRADC__1_1_M40_S6_S3 4 -40 215 DEPOSIT ABSOLUTE MONOTONY MON_INCREASE /end AXIS_DESCR
/end CHARACTERISTIC
/begin CHARACTERISTIC ND_GLSRS21 "Drehzahlkriterium Start Regelung bei RS" VALUE 0x26DB66 kw_ui16_S6_S3 8000 UMR_U_MIN_1_1_0_S6_S3 0 8000 /end CHARACTERISTIC
/begin CHARACTERISTIC KI_GLSKZU21 "I-Faktor PID-Regler GLS" VALUE 0x26DB68 kw_ui16_S6_S3 10000 UMR_MBARMINSEC_10MSEC_1_1_0_S6_S3 0 10000 /end CHARACTERISTIC
/begin CHARACTERISTIC KI_GLSKZU21_EL "I-Faktor PID-Regler GLS" VALUE 0x26DB6A kw_ui16_S6_S3 10000 UMR_MBARMINSEC_10MSEC_1_1_0_S6_S3 0 10000 /end CHARACTERISTIC
/begin CHARACTERISTIC KP_GLSKZU21 "P-Faktor PID-Regler GLS" VALUE 0x26DB6C kw_ui16_S6_S3 10000 UMR_MBARMINSEC__1_1_0_S6_S3 0 10000 /end CHARACTERISTIC
/begin CHARACTERISTIC KP_GLSKZU21_EL "P-Faktor PID-Regler GLS" VALUE 0x26DB6E kw_ui16_S6_S3 10000 UMR_MBARMINSEC__1_1_0_S6_S3 0 10000 /end CHARACTERISTIC
/begin CHARACTERISTIC TD_STOLGLS21 "max. tol. Schleifzeitdifferenz GLS" VALUE 0x26E6D9 kw_ui8_S6_S3 2540 UMR_MSEC__10_1_0_S6_S3 0 2540 /end CHARACTERISTIC
/begin CHARACTERISTIC TD_STOLGLS21_EL "max. tol. Schleifzeitdifferenz GLS" VALUE 0x26E6DA kw_ui8_S6_S3 2540 UMR_MSEC__10_1_0_S6_S3 0 2540 /end CHARACTERISTIC
/begin CHARACTERISTIC K_WNGGRGLSPKZU21 "Korrekturfaktor, wenn gemessene Schleifzeit zu gross (oberhalb der Toleranz) bei Regelung KZU" VALUE 0x26DB70 kw_ui16_S6_S3 65530 UMR_U_MINSEC2_1_1_0_S6_S3 0 65530 /end CHARACTERISTIC
/begin CHARACTERISTIC K_WNGGRGLSPKZU21_EL "Korrekturfaktor, wenn gemessene Schleifzeit zu gross (oberhalb der Toleranz) bei Regelung KZU" VALUE 0x26DB72 kw_ui16_S6_S3 65530 UMR_U_MINSEC2_1_1_0_S6_S3 0 65530 /end CHARACTERISTIC
/begin CHARACTERISTIC K_WNGGRGLSPKAB21 "Korrekturfaktor, wenn gemessene Schleifzeit zu gross (oberhalb der Toleranz) bei Regelung KAB" VALUE 0x26DB74 kw_ui16_S6_S3 65530 UMR_U_MINSEC2_1_1_0_S6_S3 0 65530 /end CHARACTERISTIC
/begin CHARACTERISTIC K_WNGGRGLSPKAB21_EL "Korrekturfaktor, wenn gemessene Schleifzeit zu gross (oberhalb der Toleranz) bei Regelung KAB" VALUE 0x26DB76 kw_ui16_S6_S3 65530 UMR_U_MINSEC2_1_1_0_S6_S3 0 65530 /end CHARACTERISTIC
/begin CHARACTERISTIC K_WNGKLGLSPKZU21 "Korrekturfaktor, wenn gemessene Schleifzeit zu klein (unterhalb der Toleranz) bei Regelung KZU" VALUE 0x26DB78 kw_ui16_S6_S3 65530 UMR_U_MINSEC2_1_1_0_S6_S3 0 65530 /end CHARACTERISTIC
/begin CHARACTERISTIC K_WNGKLGLSPKZU21_EL "Korrekturfaktor, wenn gemessene Schleifzeit zu klein (unterhalb der Toleranz) bei Regelung KZU" VALUE 0x26DB7A kw_ui16_S6_S3 65530 UMR_U_MINSEC2_1_1_0_S6_S3 0 65530 /end CHARACTERISTIC
/begin CHARACTERISTIC K_WNGKLGLSPKAB21 "Korrekturfaktor, wenn gemessene Schleifzeit zu klein (unterhalb der Toleranz) bei Regelung KAB" VALUE 0x26DB7C kw_ui16_S6_S3 65530 UMR_U_MINSEC2_1_1_0_S6_S3 0 65530 /end CHARACTERISTIC
/begin CHARACTERISTIC K_WNGKLGLSPKAB21_EL "Korrekturfaktor, wenn gemessene Schleifzeit zu klein (unterhalb der Toleranz) bei Regelung KAB" VALUE 0x26DB7E kw_ui16_S6_S3 65530 UMR_U_MINSEC2_1_1_0_S6_S3 0 65530 /end CHARACTERISTIC
/begin CHARACTERISTIC KI_GLSKAB21 "Integralfaktor PID-Regler GLS" VALUE 0x26DB80 kw_ui16_S6_S3 10000 UMR_MBARMINSEC_10MSEC_1_1_0_S6_S3 0 10000 /end CHARACTERISTIC
/begin CHARACTERISTIC KI_GLSKAB21_EL "Integralfaktor PID-Regler GLS" VALUE 0x26DB82 kw_ui16_S6_S3 10000 UMR_MBARMINSEC_10MSEC_1_1_0_S6_S3 0 10000 /end CHARACTERISTIC
/begin CHARACTERISTIC KP_GLSKAB21 "Proportionalfaktor PID-Regler GLS" VALUE 0x26DB84 kw_ui16_S6_S3 10000 UMR_MBARMINSEC__1_1_0_S6_S3 0 10000 /end CHARACTERISTIC
/begin CHARACTERISTIC KP_GLSKAB21_EL "Proportionalfaktor PID-Regler GLS" VALUE 0x26DB86 kw_ui16_S6_S3 10000 UMR_MBARMINSEC__1_1_0_S6_S3 0 10000 /end CHARACTERISTIC
/begin CHARACTERISTIC KL_TVGLSKZUCG21 "Verzoegerungszeit GLS-Beginn" CURVE 0x23B040 kl_ui8_S6_S3 2540 UMR_MSEC__10_1_0_S6_S3 0 2540
 /begin AXIS_DESCR STD_AXIS zff_atsys._.iSignale._.obj.sig_c_getr UMR_GRADC__1_1_M40_S6_S3 3 -40 150 DEPOSIT ABSOLUTE MONOTONY MON_INCREASE /end AXIS_DESCR
/end CHARACTERISTIC
/begin CHARACTERISTIC KL_POMTUMSCHKABGLS21 "Offset fuer p_fmin fuer Umschaltung Kab auf Kzu" CURVE 0x23B04C kl_si16_S6_S3 6.25 UMR_BAR__1_1000_0_S6_S3 0 6.25
 /begin AXIS_DESCR STD_AXIS zff_atsys._.iSignale._.obj.sig_m_t UMR_NM__1_1_0_S6_S3 6 -400 1640 DEPOSIT ABSOLUTE MONOTONY MON_INCREASE /end AXIS_DESCR
/end CHARACTERISTIC
/begin CHARACTERISTIC KL_MPT_WNGTGLS_INIT21 "Filterkonstante Sollgradient PT1-Filter" CURVE 0x23B068 kl_si16_S6_S3 0.99 UMR___1_100_0_S6_S3 0.01 1
 /begin AXIS_DESCR STD_AXIS NO_INPUT_QUANTITY UMR_U_MINSEC_10000_32767_0_S6_S3 3 -9765.92303232 9765.92303232 DEPOSIT ABSOLUTE MONOTONY MON_INCREASE /end AXIS_DESCR
/end CHARACTERISTIC
/begin CHARACTERISTIC KL_UMSCHGLSKAB32 "Momentenschwelle zu Regelumschaltung" CURVE 0x23B078 kl_si16_S6_S3 1400 UMR_NM__1_1_0_S6_S3 -100 1300
 /begin AXIS_DESCR STD_AXIS zff_atsys._.iSignale._.obj.sig_c_getr UMR_GRADC__1_1_M40_S6_S3 4 -40 215 DEPOSIT ABSOLUTE MONOTONY MON_INCREASE /end AXIS_DESCR
/end CHARACTERISTIC
/begin CHARACTERISTIC ND_GLSRS32 "Drehzahlkriterium Start Regelung bei RS" VALUE 0x26DB88 kw_ui16_S6_S3 8000 UMR_U_MIN_1_1_0_S6_S3 0 8000 /end CHARACTERISTIC
/begin CHARACTERISTIC KI_GLSKZU32 "I-Faktor PID-Regler GLS" VALUE 0x26DB8A kw_ui16_S6_S3 10000 UMR_MBARMINSEC_10MSEC_1_1_0_S6_S3 0 10000 /end CHARACTERISTIC
/begin CHARACTERISTIC KI_GLSKZU32_EL "I-Faktor PID-Regler GLS" VALUE 0x26DB8C kw_ui16_S6_S3 10000 UMR_MBARMINSEC_10MSEC_1_1_0_S6_S3 0 10000 /end CHARACTERISTIC
/begin CHARACTERISTIC KP_GLSKZU32 "P-Faktor PID-Regler GLS" VALUE 0x26DB8E kw_ui16_S6_S3 10000 UMR_MBARMINSEC__1_1_0_S6_S3 0 10000 /end CHARACTERISTIC
/begin CHARACTERISTIC KP_GLSKZU32_EL "P-Faktor PID-Regler GLS" VALUE 0x26DB90 kw_ui16_S6_S3 10000 UMR_MBARMINSEC__1_1_0_S6_S3 0 10000 /end CHARACTERISTIC
/begin CHARACTERISTIC TD_STOLGLS32 "max. tol. Schleifzeitdifferenz GLS" VALUE 0x26E6DB kw_ui8_S6_S3 2540 UMR_MSEC__10_1_0_S6_S3 0 2540 /end CHARACTERISTIC
/begin CHARACTERISTIC TD_STOLGLS32_EL "max. tol. Schleifzeitdifferenz GLS" VALUE 0x26E6DC kw_ui8_S6_S3 2540 UMR_MSEC__10_1_0_S6_S3 0 2540 /end CHARACTERISTIC
/begin CHARACTERISTIC K_WNGGRGLSPKZU32 "Korrekturfaktor, wenn gemessene Schleifzeit zu gross (oberhalb der Toleranz) bei Regelung KZU" VALUE 0x26DB92 kw_ui16_S6_S3 65530 UMR_U_MINSEC2_1_1_0_S6_S3 0 65530 /end CHARACTERISTIC
/begin CHARACTERISTIC K_WNGGRGLSPKZU32_EL "Korrekturfaktor, wenn gemessene Schleifzeit zu gross (oberhalb der Toleranz) bei Regelung KZU" VALUE 0x26DB94 kw_ui16_S6_S3 65530 UMR_U_MINSEC2_1_1_0_S6_S3 0 65530 /end CHARACTERISTIC
/begin CHARACTERISTIC K_WNGGRGLSPKAB32 "Korrekturfaktor, wenn gemessene Schleifzeit zu gross (oberhalb der Toleranz) bei Regelung KAB" VALUE 0x26DB96 kw_ui16_S6_S3 65530 UMR_U_MINSEC2_1_1_0_S6_S3 0 65530 /end CHARACTERISTIC
/begin CHARACTERISTIC K_WNGGRGLSPKAB32_EL "Korrekturfaktor, wenn gemessene Schleifzeit zu gross (oberhalb der Toleranz) bei Regelung KAB" VALUE 0x26DB98 kw_ui16_S6_S3 65530 UMR_U_MINSEC2_1_1_0_S6_S3 0 65530 /end CHARACTERISTIC
/begin CHARACTERISTIC K_WNGKLGLSPKZU32 "Korrekturfaktor, wenn gemessene Schleifzeit zu klein (unterhalb der Toleranz) bei Regelung KZU" VALUE 0x26DB9A kw_ui16_S6_S3 65530 UMR_U_MINSEC2_1_1_0_S6_S3 0 65530 /end CHARACTERISTIC
/begin CHARACTERISTIC K_WNGKLGLSPKZU32_EL "Korrekturfaktor, wenn gemessene Schleifzeit zu klein (unterhalb der Toleranz) bei Regelung KZU" VALUE 0x26DB9C kw_ui16_S6_S3 65530 UMR_U_MINSEC2_1_1_0_S6_S3 0 65530 /end CHARACTERISTIC
/begin CHARACTERISTIC K_WNGKLGLSPKAB32 "Korrekturfaktor, wenn gemessene Schleifzeit zu klein (unterhalb der Toleranz) bei Regelung KAB" VALUE 0x26DB9E kw_ui16_S6_S3 65530 UMR_U_MINSEC2_1_1_0_S6_S3 0 65530 /end CHARACTERISTIC
/begin CHARACTERISTIC K_WNGKLGLSPKAB32_EL "Korrekturfaktor, wenn gemessene Schleifzeit zu klein (unterhalb der Toleranz) bei Regelung KAB" VALUE 0x26DBA0 kw_ui16_S6_S3 65530 UMR_U_MINSEC2_1_1_0_S6_S3 0 65530 /end CHARACTERISTIC
/begin CHARACTERISTIC KI_GLSKAB32 "Integralfaktor PID-Regler GLS" VALUE 0x26DBA2 kw_ui16_S6_S3 10000 UMR_MBARMINSEC_10MSEC_1_1_0_S6_S3 0 10000 /end CHARACTERISTIC
/begin CHARACTERISTIC KI_GLSKAB32_EL "Integralfaktor PID-Regler GLS" VALUE 0x26DBA4 kw_ui16_S6_S3 10000 UMR_MBARMINSEC_10MSEC_1_1_0_S6_S3 0 10000 /end CHARACTERISTIC
/begin CHARACTERISTIC KP_GLSKAB32 "Proportionalfaktor PID-Regler GLS" VALUE 0x26DBA6 kw_ui16_S6_S3 10000 UMR_MBARMINSEC__1_1_0_S6_S3 0 10000 /end CHARACTERISTIC
/begin CHARACTERISTIC KP_GLSKAB32_EL "Proportionalfaktor PID-Regler GLS" VALUE 0x26DBA8 kw_ui16_S6_S3 10000 UMR_MBARMINSEC__1_1_0_S6_S3 0 10000 /end CHARACTERISTIC
/begin CHARACTERISTIC KL_TVGLSKZUCG32 "Verzoegerungszeit GLS-Beginn" CURVE 0x23B08C kl_ui8_S6_S3 2540 UMR_MSEC__10_1_0_S6_S3 0 2540
 /begin AXIS_DESCR STD_AXIS zff_atsys._.iSignale._.obj.sig_c_getr UMR_GRADC__1_1_M40_S6_S3 3 -40 150 DEPOSIT ABSOLUTE MONOTONY MON_INCREASE /end AXIS_DESCR
/end CHARACTERISTIC
/begin CHARACTERISTIC KL_POMTUMSCHKABGLS32 "Offset fuer p_fmin fuer Umschaltung Kab auf Kzu" CURVE 0x23B098 kl_si16_S6_S3 6.25 UMR_BAR__1_1000_0_S6_S3 0 6.25
 /begin AXIS_DESCR STD_AXIS zff_atsys._.iSignale._.obj.sig_m_t UMR_NM__1_1_0_S6_S3 6 -400 1640 DEPOSIT ABSOLUTE MONOTONY MON_INCREASE /end AXIS_DESCR
/end CHARACTERISTIC
/begin CHARACTERISTIC KL_MPT_WNGTGLS_INIT32 "Filterkonstante Sollgradient PT1-Filter" CURVE 0x23B0B4 kl_si16_S6_S3 0.99 UMR___1_100_0_S6_S3 0.01 1
 /begin AXIS_DESCR STD_AXIS NO_INPUT_QUANTITY UMR_U_MINSEC_10000_32767_0_S6_S3 3 -9765.92303232 9765.92303232 DEPOSIT ABSOLUTE MONOTONY MON_INCREASE /end AXIS_DESCR
/end CHARACTERISTIC
/begin CHARACTERISTIC KL_UMSCHGLSKAB43 "Momentenschwelle zu Regelumschaltung" CURVE 0x23B0C4 kl_si16_S6_S3 1400 UMR_NM__1_1_0_S6_S3 -100 1300
 /begin AXIS_DESCR STD_AXIS zff_atsys._.iSignale._.obj.sig_c_getr UMR_GRADC__1_1_M40_S6_S3 4 -40 215 DEPOSIT ABSOLUTE MONOTONY MON_INCREASE /end AXIS_DESCR
/end CHARACTERISTIC
/begin CHARACTERISTIC ND_GLSRS43 "Drehzahlkriterium Start Regelung bei RS" VALUE 0x26DBAA kw_ui16_S6_S3 8000 UMR_U_MIN_1_1_0_S6_S3 0 8000 /end CHARACTERISTIC
/begin CHARACTERISTIC KI_GLSKZU43 "I-Faktor PID-Regler GLS" VALUE 0x26DBAC kw_ui16_S6_S3 10000 UMR_MBARMINSEC_10MSEC_1_1_0_S6_S3 0 10000 /end CHARACTERISTIC
/begin CHARACTERISTIC KI_GLSKZU43_EL "I-Faktor PID-Regler GLS" VALUE 0x26DBAE kw_ui16_S6_S3 10000 UMR_MBARMINSEC_10MSEC_1_1_0_S6_S3 0 10000 /end CHARACTERISTIC
/begin CHARACTERISTIC KP_GLSKZU43 "P-Faktor PID-Regler GLS" VALUE 0x26DBB0 kw_ui16_S6_S3 10000 UMR_MBARMINSEC__1_1_0_S6_S3 0 10000 /end CHARACTERISTIC
/begin CHARACTERISTIC KP_GLSKZU43_EL "P-Faktor PID-Regler GLS" VALUE 0x26DBB2 kw_ui16_S6_S3 10000 UMR_MBARMINSEC__1_1_0_S6_S3 0 10000 /end CHARACTERISTIC
/begin CHARACTERISTIC TD_STOLGLS43 "max. tol. Schleifzeitdifferenz GLS" VALUE 0x26E6DD kw_ui8_S6_S3 2540 UMR_MSEC__10_1_0_S6_S3 0 2540 /end CHARACTERISTIC
/begin CHARACTERISTIC TD_STOLGLS43_EL "max. tol. Schleifzeitdifferenz GLS" VALUE 0x26E6DE kw_ui8_S6_S3 2540 UMR_MSEC__10_1_0_S6_S3 0 2540 /end CHARACTERISTIC
/begin CHARACTERISTIC K_WNGGRGLSPKZU43 "Korrekturfaktor, wenn gemessene Schleifzeit zu gross (oberhalb der Toleranz) bei Regelung KZU" VALUE 0x26DBB4 kw_ui16_S6_S3 65530 UMR_U_MINSEC2_1_1_0_S6_S3 0 65530 /end CHARACTERISTIC
/begin CHARACTERISTIC K_WNGGRGLSPKZU43_EL "Korrekturfaktor, wenn gemessene Schleifzeit zu gross (oberhalb der Toleranz) bei Regelung KZU" VALUE 0x26DBB6 kw_ui16_S6_S3 65530 UMR_U_MINSEC2_1_1_0_S6_S3 0 65530 /end CHARACTERISTIC
/begin CHARACTERISTIC K_WNGGRGLSPKAB43 "Korrekturfaktor, wenn gemessene Schleifzeit zu gross (oberhalb der Toleranz) bei Regelung KAB" VALUE 0x26DBB8 kw_ui16_S6_S3 65530 UMR_U_MINSEC2_1_1_0_S6_S3 0 65530 /end CHARACTERISTIC
/begin CHARACTERISTIC K_WNGGRGLSPKAB43_EL "Korrekturfaktor, wenn gemessene Schleifzeit zu gross (oberhalb der Toleranz) bei Regelung KAB" VALUE 0x26DBBA kw_ui16_S6_S3 65530 UMR_U_MINSEC2_1_1_0_S6_S3 0 65530 /end CHARACTERISTIC
/begin CHARACTERISTIC K_WNGKLGLSPKZU43 "Korrekturfaktor, wenn gemessene Schleifzeit zu klein (unterhalb der Toleranz) bei Regelung KZU" VALUE 0x26DBBC kw_ui16_S6_S3 65530 UMR_U_MINSEC2_1_1_0_S6_S3 0 65530 /end CHARACTERISTIC
/begin CHARACTERISTIC K_WNGKLGLSPKZU43_EL "Korrekturfaktor, wenn gemessene Schleifzeit zu klein (unterhalb der Toleranz) bei Regelung KZU" VALUE 0x26DBBE kw_ui16_S6_S3 65530 UMR_U_MINSEC2_1_1_0_S6_S3 0 65530 /end CHARACTERISTIC
/begin CHARACTERISTIC K_WNGKLGLSPKAB43 "Korrekturfaktor, wenn gemessene Schleifzeit zu klein (unterhalb der Toleranz) bei Regelung KAB" VALUE 0x26DBC0 kw_ui16_S6_S3 65530 UMR_U_MINSEC2_1_1_0_S6_S3 0 65530 /end CHARACTERISTIC
/begin CHARACTERISTIC K_WNGKLGLSPKAB43_EL "Korrekturfaktor, wenn gemessene Schleifzeit zu klein (unterhalb der Toleranz) bei Regelung KAB" VALUE 0x26DBC2 kw_ui16_S6_S3 65530 UMR_U_MINSEC2_1_1_0_S6_S3 0 65530 /end CHARACTERISTIC
/begin CHARACTERISTIC KI_GLSKAB43 "Integralfaktor PID-Regler GLS" VALUE 0x26DBC4 kw_ui16_S6_S3 10000 UMR_MBARMINSEC_10MSEC_1_1_0_S6_S3 0 10000 /end CHARACTERISTIC
/begin CHARACTERISTIC KI_GLSKAB43_EL "Integralfaktor PID-Regler GLS" VALUE 0x26DBC6 kw_ui16_S6_S3 10000 UMR_MBARMINSEC_10MSEC_1_1_0_S6_S3 0 10000 /end CHARACTERISTIC
/begin CHARACTERISTIC KP_GLSKAB43 "Proportionalfaktor PID-Regler GLS" VALUE 0x26DBC8 kw_ui16_S6_S3 10000 UMR_MBARMINSEC__1_1_0_S6_S3 0 10000 /end CHARACTERISTIC
/begin CHARACTERISTIC KP_GLSKAB43_EL "Proportionalfaktor PID-Regler GLS" VALUE 0x26DBCA kw_ui16_S6_S3 10000 UMR_MBARMINSEC__1_1_0_S6_S3 0 10000 /end CHARACTERISTIC
/begin CHARACTERISTIC KL_TVGLSKZUCG43 "Verzoegerungszeit GLS-Beginn" CURVE 0x23B0D8 kl_ui8_S6_S3 2540 UMR_MSEC__10_1_0_S6_S3 0 2540
 /begin AXIS_DESCR STD_AXIS zff_atsys._.iSignale._.obj.sig_c_getr UMR_GRADC__1_1_M40_S6_S3 3 -40 150 DEPOSIT ABSOLUTE MONOTONY MON_INCREASE /end AXIS_DESCR
/end CHARACTERISTIC
/begin CHARACTERISTIC KL_POMTUMSCHKABGLS43 "Offset fuer p_fmin fuer Umschaltung Kab auf Kzu" CURVE 0x23B0E4 kl_si16_S6_S3 6.25 UMR_BAR__1_1000_0_S6_S3 0 6.25
 /begin AXIS_DESCR STD_AXIS zff_atsys._.iSignale._.obj.sig_m_t UMR_NM__1_1_0_S6_S3 6 -400 1640 DEPOSIT ABSOLUTE MONOTONY MON_INCREASE /end AXIS_DESCR
/end CHARACTERISTIC
/begin CHARACTERISTIC KL_MPT_WNGTGLS_INIT43 "Filterkonstante Sollgradient PT1-Filter" CURVE 0x23B100 kl_si16_S6_S3 0.99 UMR___1_100_0_S6_S3 0.01 1
 /begin AXIS_DESCR STD_AXIS NO_INPUT_QUANTITY UMR_U_MINSEC_10000_32767_0_S6_S3 3 -9765.92303232 9765.92303232 DEPOSIT ABSOLUTE MONOTONY MON_INCREASE /end AXIS_DESCR
/end CHARACTERISTIC
/begin CHARACTERISTIC KL_UMSCHGLSKAB54 "Momentenschwelle zu Regelumschaltung" CURVE 0x23B110 kl_si16_S6_S3 1400 UMR_NM__1_1_0_S6_S3 -100 1300
 /begin AXIS_DESCR STD_AXIS zff_atsys._.iSignale._.obj.sig_c_getr UMR_GRADC__1_1_M40_S6_S3 4 -40 215 DEPOSIT ABSOLUTE MONOTONY MON_INCREASE /end AXIS_DESCR
/end CHARACTERISTIC
/begin CHARACTERISTIC ND_GLSRS54 "Drehzahlkriterium Start Regelung bei RS" VALUE 0x26DBCC kw_ui16_S6_S3 8000 UMR_U_MIN_1_1_0_S6_S3 0 8000 /end CHARACTERISTIC
/begin CHARACTERISTIC KI_GLSKZU54 "I-Faktor PID-Regler GLS" VALUE 0x26DBCE kw_ui16_S6_S3 10000 UMR_MBARMINSEC_10MSEC_1_1_0_S6_S3 0 10000 /end CHARACTERISTIC
/begin CHARACTERISTIC KI_GLSKZU54_EL "I-Faktor PID-Regler GLS" VALUE 0x26DBD0 kw_ui16_S6_S3 10000 UMR_MBARMINSEC_10MSEC_1_1_0_S6_S3 0 10000 /end CHARACTERISTIC
/begin CHARACTERISTIC KP_GLSKZU54 "P-Faktor PID-Regler GLS" VALUE 0x26DBD2 kw_ui16_S6_S3 10000 UMR_MBARMINSEC__1_1_0_S6_S3 0 10000 /end CHARACTERISTIC
/begin CHARACTERISTIC KP_GLSKZU54_EL "P-Faktor PID-Regler GLS" VALUE 0x26DBD4 kw_ui16_S6_S3 10000 UMR_MBARMINSEC__1_1_0_S6_S3 0 10000 /end CHARACTERISTIC
/begin CHARACTERISTIC TD_STOLGLS54 "max. tol. Schleifzeitdifferenz GLS" VALUE 0x26E6DF kw_ui8_S6_S3 2540 UMR_MSEC__10_1_0_S6_S3 0 2540 /end CHARACTERISTIC
/begin CHARACTERISTIC TD_STOLGLS54_EL "max. tol. Schleifzeitdifferenz GLS" VALUE 0x26E6E0 kw_ui8_S6_S3 2540 UMR_MSEC__10_1_0_S6_S3 0 2540 /end CHARACTERISTIC
/begin CHARACTERISTIC K_WNGGRGLSPKZU54 "Korrekturfaktor, wenn gemessene Schleifzeit zu gross (oberhalb der Toleranz) bei Regelung KZU" VALUE 0x26DBD6 kw_ui16_S6_S3 65530 UMR_U_MINSEC2_1_1_0_S6_S3 0 65530 /end CHARACTERISTIC
/begin CHARACTERISTIC K_WNGGRGLSPKZU54_EL "Korrekturfaktor, wenn gemessene Schleifzeit zu gross (oberhalb der Toleranz) bei Regelung KZU" VALUE 0x26DBD8 kw_ui16_S6_S3 65530 UMR_U_MINSEC2_1_1_0_S6_S3 0 65530 /end CHARACTERISTIC
/begin CHARACTERISTIC K_WNGGRGLSPKAB54 "Korrekturfaktor, wenn gemessene Schleifzeit zu gross (oberhalb der Toleranz) bei Regelung KAB" VALUE 0x26DBDA kw_ui16_S6_S3 65530 UMR_U_MINSEC2_1_1_0_S6_S3 0 65530 /end CHARACTERISTIC
/begin CHARACTERISTIC K_WNGGRGLSPKAB54_EL "Korrekturfaktor, wenn gemessene Schleifzeit zu gross (oberhalb der Toleranz) bei Regelung KAB" VALUE 0x26DBDC kw_ui16_S6_S3 65530 UMR_U_MINSEC2_1_1_0_S6_S3 0 65530 /end CHARACTERISTIC
/begin CHARACTERISTIC K_WNGKLGLSPKZU54 "Korrekturfaktor, wenn gemessene Schleifzeit zu klein (unterhalb der Toleranz) bei Regelung KZU" VALUE 0x26DBDE kw_ui16_S6_S3 65530 UMR_U_MINSEC2_1_1_0_S6_S3 0 65530 /end CHARACTERISTIC
/begin CHARACTERISTIC K_WNGKLGLSPKZU54_EL "Korrekturfaktor, wenn gemessene Schleifzeit zu klein (unterhalb der Toleranz) bei Regelung KZU" VALUE 0x26DBE0 kw_ui16_S6_S3 65530 UMR_U_MINSEC2_1_1_0_S6_S3 0 65530 /end CHARACTERISTIC
/begin CHARACTERISTIC K_WNGKLGLSPKAB54 "Korrekturfaktor, wenn gemessene Schleifzeit zu klein (unterhalb der Toleranz) bei Regelung KAB" VALUE 0x26DBE2 kw_ui16_S6_S3 65530 UMR_U_MINSEC2_1_1_0_S6_S3 0 65530 /end CHARACTERISTIC
/begin CHARACTERISTIC K_WNGKLGLSPKAB54_EL "Korrekturfaktor, wenn gemessene Schleifzeit zu klein (unterhalb der Toleranz) bei Regelung KAB" VALUE 0x26DBE4 kw_ui16_S6_S3 65530 UMR_U_MINSEC2_1_1_0_S6_S3 0 65530 /end CHARACTERISTIC
/begin CHARACTERISTIC KI_GLSKAB54 "Integralfaktor PID-Regler GLS" VALUE 0x26DBE6 kw_ui16_S6_S3 10000 UMR_MBARMINSEC_10MSEC_1_1_0_S6_S3 0 10000 /end CHARACTERISTIC
/begin CHARACTERISTIC KI_GLSKAB54_EL "Integralfaktor PID-Regler GLS" VALUE 0x26DBE8 kw_ui16_S6_S3 10000 UMR_MBARMINSEC_10MSEC_1_1_0_S6_S3 0 10000 /end CHARACTERISTIC
/begin CHARACTERISTIC KP_GLSKAB54 "Proportionalfaktor PID-Regler GLS" VALUE 0x26DBEA kw_ui16_S6_S3 10000 UMR_MBARMINSEC__1_1_0_S6_S3 0 10000 /end CHARACTERISTIC
/begin CHARACTERISTIC KP_GLSKAB54_EL "Proportionalfaktor PID-Regler GLS" VALUE 0x26DBEC kw_ui16_S6_S3 10000 UMR_MBARMINSEC__1_1_0_S6_S3 0 10000 /end CHARACTERISTIC
/begin CHARACTERISTIC KL_TVGLSKZUCG54 "Verzoegerungszeit GLS-Beginn" CURVE 0x23B124 kl_ui8_S6_S3 2540 UMR_MSEC__10_1_0_S6_S3 0 2540
 /begin AXIS_DESCR STD_AXIS zff_atsys._.iSignale._.obj.sig_c_getr UMR_GRADC__1_1_M40_S6_S3 3 -40 150 DEPOSIT ABSOLUTE MONOTONY MON_INCREASE /end AXIS_DESCR
/end CHARACTERISTIC
/begin CHARACTERISTIC KL_POMTUMSCHKABGLS54 "Offset fuer p_fmin fuer Umschaltung Kab auf Kzu" CURVE 0x23B130 kl_si16_S6_S3 6.25 UMR_BAR__1_1000_0_S6_S3 0 6.25
 /begin AXIS_DESCR STD_AXIS zff_atsys._.iSignale._.obj.sig_m_t UMR_NM__1_1_0_S6_S3 6 -400 1640 DEPOSIT ABSOLUTE MONOTONY MON_INCREASE /end AXIS_DESCR
/end CHARACTERISTIC
/begin CHARACTERISTIC KL_MPT_WNGTGLS_INIT54 "Filterkonstante Sollgradient PT1-Filter" CURVE 0x23B14C kl_si16_S6_S3 0.99 UMR___1_100_0_S6_S3 0.01 1
 /begin AXIS_DESCR STD_AXIS NO_INPUT_QUANTITY UMR_U_MINSEC_10000_32767_0_S6_S3 3 -9765.92303232 9765.92303232 DEPOSIT ABSOLUTE MONOTONY MON_INCREASE /end AXIS_DESCR
/end CHARACTERISTIC
/begin CHARACTERISTIC KL_UMSCHGLSKAB65 "Momentenschwelle zu Regelumschaltung" CURVE 0x23B15C kl_si16_S6_S3 1400 UMR_NM__1_1_0_S6_S3 -100 1300
 /begin AXIS_DESCR STD_AXIS zff_atsys._.iSignale._.obj.sig_c_getr UMR_GRADC__1_1_M40_S6_S3 4 -40 215 DEPOSIT ABSOLUTE MONOTONY MON_INCREASE /end AXIS_DESCR
/end CHARACTERISTIC
/begin CHARACTERISTIC ND_GLSRS65 "Drehzahlkriterium Start Regelung bei RS" VALUE 0x26DBEE kw_ui16_S6_S3 8000 UMR_U_MIN_1_1_0_S6_S3 0 8000 /end CHARACTERISTIC
/begin CHARACTERISTIC KI_GLSKZU65 "I-Faktor PID-Regler GLS" VALUE 0x26DBF0 kw_ui16_S6_S3 10000 UMR_MBARMINSEC_10MSEC_1_1_0_S6_S3 0 10000 /end CHARACTERISTIC
/begin CHARACTERISTIC KI_GLSKZU65_EL "I-Faktor PID-Regler GLS" VALUE 0x26DBF2 kw_ui16_S6_S3 10000 UMR_MBARMINSEC_10MSEC_1_1_0_S6_S3 0 10000 /end CHARACTERISTIC
/begin CHARACTERISTIC KP_GLSKZU65 "P-Faktor PID-Regler GLS" VALUE 0x26DBF4 kw_ui16_S6_S3 10000 UMR_MBARMINSEC__1_1_0_S6_S3 0 10000 /end CHARACTERISTIC
/begin CHARACTERISTIC KP_GLSKZU65_EL "P-Faktor PID-Regler GLS" VALUE 0x26DBF6 kw_ui16_S6_S3 10000 UMR_MBARMINSEC__1_1_0_S6_S3 0 10000 /end CHARACTERISTIC
/begin CHARACTERISTIC TD_STOLGLS65 "max. tol. Schleifzeitdifferenz GLS" VALUE 0x26E6E1 kw_ui8_S6_S3 2540 UMR_MSEC__10_1_0_S6_S3 0 2540 /end CHARACTERISTIC
/begin CHARACTERISTIC TD_STOLGLS65_EL "max. tol. Schleifzeitdifferenz GLS" VALUE 0x26E6E2 kw_ui8_S6_S3 2540 UMR_MSEC__10_1_0_S6_S3 0 2540 /end CHARACTERISTIC
/begin CHARACTERISTIC K_WNGGRGLSPKZU65 "Korrekturfaktor, wenn gemessene Schleifzeit zu gross (oberhalb der Toleranz) bei Regelung KZU" VALUE 0x26DBF8 kw_ui16_S6_S3 65530 UMR_U_MINSEC2_1_1_0_S6_S3 0 65530 /end CHARACTERISTIC
/begin CHARACTERISTIC K_WNGGRGLSPKZU65_EL "Korrekturfaktor, wenn gemessene Schleifzeit zu gross (oberhalb der Toleranz) bei Regelung KZU" VALUE 0x26DBFA kw_ui16_S6_S3 65530 UMR_U_MINSEC2_1_1_0_S6_S3 0 65530 /end CHARACTERISTIC
/begin CHARACTERISTIC K_WNGGRGLSPKAB65 "Korrekturfaktor, wenn gemessene Schleifzeit zu gross (oberhalb der Toleranz) bei Regelung KAB" VALUE 0x26DBFC kw_ui16_S6_S3 65530 UMR_U_MINSEC2_1_1_0_S6_S3 0 65530 /end CHARACTERISTIC
/begin CHARACTERISTIC K_WNGGRGLSPKAB65_EL "Korrekturfaktor, wenn gemessene Schleifzeit zu gross (oberhalb der Toleranz) bei Regelung KAB" VALUE 0x26DBFE kw_ui16_S6_S3 65530 UMR_U_MINSEC2_1_1_0_S6_S3 0 65530 /end CHARACTERISTIC
/begin CHARACTERISTIC K_WNGKLGLSPKZU65 "Korrekturfaktor, wenn gemessene Schleifzeit zu klein (unterhalb der Toleranz) bei Regelung KZU" VALUE 0x26DC00 kw_ui16_S6_S3 65530 UMR_U_MINSEC2_1_1_0_S6_S3 0 65530 /end CHARACTERISTIC
/begin CHARACTERISTIC K_WNGKLGLSPKZU65_EL "Korrekturfaktor, wenn gemessene Schleifzeit zu klein (unterhalb der Toleranz) bei Regelung KZU" VALUE 0x26DC02 kw_ui16_S6_S3 65530 UMR_U_MINSEC2_1_1_0_S6_S3 0 65530 /end CHARACTERISTIC
/begin CHARACTERISTIC K_WNGKLGLSPKAB65 "Korrekturfaktor, wenn gemessene Schleifzeit zu klein (unterhalb der Toleranz) bei Regelung KAB" VALUE 0x26DC04 kw_ui16_S6_S3 65530 UMR_U_MINSEC2_1_1_0_S6_S3 0 65530 /end CHARACTERISTIC
/begin CHARACTERISTIC K_WNGKLGLSPKAB65_EL "Korrekturfaktor, wenn gemessene Schleifzeit zu klein (unterhalb der Toleranz) bei Regelung KAB" VALUE 0x26DC06 kw_ui16_S6_S3 65530 UMR_U_MINSEC2_1_1_0_S6_S3 0 65530 /end CHARACTERISTIC
/begin CHARACTERISTIC KI_GLSKAB65 "Integralfaktor PID-Regler GLS" VALUE 0x26DC08 kw_ui16_S6_S3 10000 UMR_MBARMINSEC_10MSEC_1_1_0_S6_S3 0 10000 /end CHARACTERISTIC
/begin CHARACTERISTIC KI_GLSKAB65_EL "Integralfaktor PID-Regler GLS" VALUE 0x26DC0A kw_ui16_S6_S3 10000 UMR_MBARMINSEC_10MSEC_1_1_0_S6_S3 0 10000 /end CHARACTERISTIC
/begin CHARACTERISTIC KP_GLSKAB65 "Proportionalfaktor PID-Regler GLS" VALUE 0x26DC0C kw_ui16_S6_S3 10000 UMR_MBARMINSEC__1_1_0_S6_S3 0 10000 /end CHARACTERISTIC
/begin CHARACTERISTIC KP_GLSKAB65_EL "Proportionalfaktor PID-Regler GLS" VALUE 0x26DC0E kw_ui16_S6_S3 10000 UMR_MBARMINSEC__1_1_0_S6_S3 0 10000 /end CHARACTERISTIC
/begin CHARACTERISTIC KL_TVGLSKZUCG65 "Verzoegerungszeit GLS-Beginn" CURVE 0x23B170 kl_ui8_S6_S3 2540 UMR_MSEC__10_1_0_S6_S3 0 2540
 /begin AXIS_DESCR STD_AXIS zff_atsys._.iSignale._.obj.sig_c_getr UMR_GRADC__1_1_M40_S6_S3 3 -40 150 DEPOSIT ABSOLUTE MONOTONY MON_INCREASE /end AXIS_DESCR
/end CHARACTERISTIC
/begin CHARACTERISTIC KL_POMTUMSCHKABGLS65 "Offset fuer p_fmin fuer Umschaltung Kab auf Kzu" CURVE 0x23B17C kl_si16_S6_S3 6.25 UMR_BAR__1_1000_0_S6_S3 0 6.25
 /begin AXIS_DESCR STD_AXIS zff_atsys._.iSignale._.obj.sig_m_t UMR_NM__1_1_0_S6_S3 6 -400 1640 DEPOSIT ABSOLUTE MONOTONY MON_INCREASE /end AXIS_DESCR
/end CHARACTERISTIC
/begin CHARACTERISTIC KL_MPT_WNGTGLS_INIT65 "Filterkonstante Sollgradient PT1-Filter" CURVE 0x23B198 kl_si16_S6_S3 0.99 UMR___1_100_0_S6_S3 0.01 1
 /begin AXIS_DESCR STD_AXIS NO_INPUT_QUANTITY UMR_U_MINSEC_10000_32767_0_S6_S3 3 -9765.92303232 9765.92303232 DEPOSIT ABSOLUTE MONOTONY MON_INCREASE /end AXIS_DESCR
/end CHARACTERISTIC
/begin CHARACTERISTIC KL_UMSCHGLSKAB76 "Momentenschwelle zu Regelumschaltung" CURVE 0x23B1A8 kl_si16_S6_S3 1400 UMR_NM__1_1_0_S6_S3 -100 1300
 /begin AXIS_DESCR STD_AXIS zff_atsys._.iSignale._.obj.sig_c_getr UMR_GRADC__1_1_M40_S6_S3 4 -40 215 DEPOSIT ABSOLUTE MONOTONY MON_INCREASE /end AXIS_DESCR
/end CHARACTERISTIC
/begin CHARACTERISTIC ND_GLSRS76 "Drehzahlkriterium Start Regelung bei RS" VALUE 0x26DC10 kw_ui16_S6_S3 8000 UMR_U_MIN_1_1_0_S6_S3 0 8000 /end CHARACTERISTIC
/begin CHARACTERISTIC KI_GLSKZU76 "I-Faktor PID-Regler GLS" VALUE 0x26DC12 kw_ui16_S6_S3 10000 UMR_MBARMINSEC_10MSEC_1_1_0_S6_S3 0 10000 /end CHARACTERISTIC
/begin CHARACTERISTIC KI_GLSKZU76_EL "I-Faktor PID-Regler GLS" VALUE 0x26DC14 kw_ui16_S6_S3 10000 UMR_MBARMINSEC_10MSEC_1_1_0_S6_S3 0 10000 /end CHARACTERISTIC
/begin CHARACTERISTIC KP_GLSKZU76 "P-Faktor PID-Regler GLS" VALUE 0x26DC16 kw_ui16_S6_S3 10000 UMR_MBARMINSEC__1_1_0_S6_S3 0 10000 /end CHARACTERISTIC
/begin CHARACTERISTIC KP_GLSKZU76_EL "P-Faktor PID-Regler GLS" VALUE 0x26DC18 kw_ui16_S6_S3 10000 UMR_MBARMINSEC__1_1_0_S6_S3 0 10000 /end CHARACTERISTIC
/begin CHARACTERISTIC TD_STOLGLS76 "max. tol. Schleifzeitdifferenz GLS" VALUE 0x26E6E3 kw_ui8_S6_S3 2540 UMR_MSEC__10_1_0_S6_S3 0 2540 /end CHARACTERISTIC
/begin CHARACTERISTIC TD_STOLGLS76_EL "max. tol. Schleifzeitdifferenz GLS" VALUE 0x26E6E4 kw_ui8_S6_S3 2540 UMR_MSEC__10_1_0_S6_S3 0 2540 /end CHARACTERISTIC
/begin CHARACTERISTIC K_WNGGRGLSPKZU76 "Korrekturfaktor, wenn gemessene Schleifzeit zu gross (oberhalb der Toleranz) bei Regelung KZU" VALUE 0x26DC1A kw_ui16_S6_S3 65530 UMR_U_MINSEC2_1_1_0_S6_S3 0 65530 /end CHARACTERISTIC
/begin CHARACTERISTIC K_WNGGRGLSPKZU76_EL "Korrekturfaktor, wenn gemessene Schleifzeit zu gross (oberhalb der Toleranz) bei Regelung KZU" VALUE 0x26DC1C kw_ui16_S6_S3 65530 UMR_U_MINSEC2_1_1_0_S6_S3 0 65530 /end CHARACTERISTIC
/begin CHARACTERISTIC K_WNGGRGLSPKAB76 "Korrekturfaktor, wenn gemessene Schleifzeit zu gross (oberhalb der Toleranz) bei Regelung KAB" VALUE 0x26DC1E kw_ui16_S6_S3 65530 UMR_U_MINSEC2_1_1_0_S6_S3 0 65530 /end CHARACTERISTIC
/begin CHARACTERISTIC K_WNGGRGLSPKAB76_EL "Korrekturfaktor, wenn gemessene Schleifzeit zu gross (oberhalb der Toleranz) bei Regelung KAB" VALUE 0x26DC20 kw_ui16_S6_S3 65530 UMR_U_MINSEC2_1_1_0_S6_S3 0 65530 /end CHARACTERISTIC
/begin CHARACTERISTIC K_WNGKLGLSPKZU76 "Korrekturfaktor, wenn gemessene Schleifzeit zu klein (unterhalb der Toleranz) bei Regelung KZU" VALUE 0x26DC22 kw_ui16_S6_S3 65530 UMR_U_MINSEC2_1_1_0_S6_S3 0 65530 /end CHARACTERISTIC
/begin CHARACTERISTIC K_WNGKLGLSPKZU76_EL "Korrekturfaktor, wenn gemessene Schleifzeit zu klein (unterhalb der Toleranz) bei Regelung KZU" VALUE 0x26DC24 kw_ui16_S6_S3 65530 UMR_U_MINSEC2_1_1_0_S6_S3 0 65530 /end CHARACTERISTIC
/begin CHARACTERISTIC K_WNGKLGLSPKAB76 "Korrekturfaktor, wenn gemessene Schleifzeit zu klein (unterhalb der Toleranz) bei Regelung KAB" VALUE 0x26DC26 kw_ui16_S6_S3 65530 UMR_U_MINSEC2_1_1_0_S6_S3 0 65530 /end CHARACTERISTIC
/begin CHARACTERISTIC K_WNGKLGLSPKAB76_EL "Korrekturfaktor, wenn gemessene Schleifzeit zu klein (unterhalb der Toleranz) bei Regelung KAB" VALUE 0x26DC28 kw_ui16_S6_S3 65530 UMR_U_MINSEC2_1_1_0_S6_S3 0 65530 /end CHARACTERISTIC
/begin CHARACTERISTIC KI_GLSKAB76 "Integralfaktor PID-Regler GLS" VALUE 0x26DC2A kw_ui16_S6_S3 10000 UMR_MBARMINSEC_10MSEC_1_1_0_S6_S3 0 10000 /end CHARACTERISTIC
/begin CHARACTERISTIC KI_GLSKAB76_EL "Integralfaktor PID-Regler GLS" VALUE 0x26DC2C kw_ui16_S6_S3 10000 UMR_MBARMINSEC_10MSEC_1_1_0_S6_S3 0 10000 /end CHARACTERISTIC
/begin CHARACTERISTIC KP_GLSKAB76 "Proportionalfaktor PID-Regler GLS" VALUE 0x26DC2E kw_ui16_S6_S3 10000 UMR_MBARMINSEC__1_1_0_S6_S3 0 10000 /end CHARACTERISTIC
/begin CHARACTERISTIC KP_GLSKAB76_EL "Proportionalfaktor PID-Regler GLS" VALUE 0x26DC30 kw_ui16_S6_S3 10000 UMR_MBARMINSEC__1_1_0_S6_S3 0 10000 /end CHARACTERISTIC
/begin CHARACTERISTIC KL_TVGLSKZUCG76 "Verzoegerungszeit GLS-Beginn" CURVE 0x23B1BC kl_ui8_S6_S3 2540 UMR_MSEC__10_1_0_S6_S3 0 2540
 /begin AXIS_DESCR STD_AXIS zff_atsys._.iSignale._.obj.sig_c_getr UMR_GRADC__1_1_M40_S6_S3 3 -40 150 DEPOSIT ABSOLUTE MONOTONY MON_INCREASE /end AXIS_DESCR
/end CHARACTERISTIC
/begin CHARACTERISTIC KL_POMTUMSCHKABGLS76 "Offset fuer p_fmin fuer Umschaltung Kab auf Kzu" CURVE 0x23B1C8 kl_si16_S6_S3 6.25 UMR_BAR__1_1000_0_S6_S3 0 6.25
 /begin AXIS_DESCR STD_AXIS zff_atsys._.iSignale._.obj.sig_m_t UMR_NM__1_1_0_S6_S3 6 -400 1640 DEPOSIT ABSOLUTE MONOTONY MON_INCREASE /end AXIS_DESCR
/end CHARACTERISTIC
/begin CHARACTERISTIC KL_MPT_WNGTGLS_INIT76 "Filterkonstante Sollgradient PT1-Filter" CURVE 0x23B1E4 kl_si16_S6_S3 0.99 UMR___1_100_0_S6_S3 0.01 1
 /begin AXIS_DESCR STD_AXIS NO_INPUT_QUANTITY UMR_U_MINSEC_10000_32767_0_S6_S3 3 -9765.92303232 9765.92303232 DEPOSIT ABSOLUTE MONOTONY MON_INCREASE /end AXIS_DESCR
/end CHARACTERISTIC
/begin CHARACTERISTIC KL_UMSCHGLSKAB87 "Momentenschwelle zu Regelumschaltung" CURVE 0x23B1F4 kl_si16_S6_S3 1400 UMR_NM__1_1_0_S6_S3 -100 1300
 /begin AXIS_DESCR STD_AXIS zff_atsys._.iSignale._.obj.sig_c_getr UMR_GRADC__1_1_M40_S6_S3 4 -40 215 DEPOSIT ABSOLUTE MONOTONY MON_INCREASE /end AXIS_DESCR
/end CHARACTERISTIC
/begin CHARACTERISTIC ND_GLSRS87 "Drehzahlkriterium Start Regelung bei RS" VALUE 0x26DC32 kw_ui16_S6_S3 8000 UMR_U_MIN_1_1_0_S6_S3 0 8000 /end CHARACTERISTIC
/begin CHARACTERISTIC KI_GLSKZU87 "I-Faktor PID-Regler GLS" VALUE 0x26DC34 kw_ui16_S6_S3 10000 UMR_MBARMINSEC_10MSEC_1_1_0_S6_S3 0 10000 /end CHARACTERISTIC
/begin CHARACTERISTIC KI_GLSKZU87_EL "I-Faktor PID-Regler GLS" VALUE 0x26DC36 kw_ui16_S6_S3 10000 UMR_MBARMINSEC_10MSEC_1_1_0_S6_S3 0 10000 /end CHARACTERISTIC
/begin CHARACTERISTIC KP_GLSKZU87 "P-Faktor PID-Regler GLS" VALUE 0x26DC38 kw_ui16_S6_S3 10000 UMR_MBARMINSEC__1_1_0_S6_S3 0 10000 /end CHARACTERISTIC
/begin CHARACTERISTIC KP_GLSKZU87_EL "P-Faktor PID-Regler GLS" VALUE 0x26DC3A kw_ui16_S6_S3 10000 UMR_MBARMINSEC__1_1_0_S6_S3 0 10000 /end CHARACTERISTIC
/begin CHARACTERISTIC TD_STOLGLS87 "max. tol. Schleifzeitdifferenz GLS" VALUE 0x26E6E5 kw_ui8_S6_S3 2540 UMR_MSEC__10_1_0_S6_S3 0 2540 /end CHARACTERISTIC
/begin CHARACTERISTIC TD_STOLGLS87_EL "max. tol. Schleifzeitdifferenz GLS" VALUE 0x26E6E6 kw_ui8_S6_S3 2540 UMR_MSEC__10_1_0_S6_S3 0 2540 /end CHARACTERISTIC
/begin CHARACTERISTIC K_WNGGRGLSPKZU87 "Korrekturfaktor, wenn gemessene Schleifzeit zu gross (oberhalb der Toleranz) bei Regelung KZU" VALUE 0x26DC3C kw_ui16_S6_S3 65530 UMR_U_MINSEC2_1_1_0_S6_S3 0 65530 /end CHARACTERISTIC
/begin CHARACTERISTIC K_WNGGRGLSPKZU87_EL "Korrekturfaktor, wenn gemessene Schleifzeit zu gross (oberhalb der Toleranz) bei Regelung KZU" VALUE 0x26DC3E kw_ui16_S6_S3 65530 UMR_U_MINSEC2_1_1_0_S6_S3 0 65530 /end CHARACTERISTIC
/begin CHARACTERISTIC K_WNGGRGLSPKAB87 "Korrekturfaktor, wenn gemessene Schleifzeit zu gross (oberhalb der Toleranz) bei Regelung KAB" VALUE 0x26DC40 kw_ui16_S6_S3 65530 UMR_U_MINSEC2_1_1_0_S6_S3 0 65530 /end CHARACTERISTIC
/begin CHARACTERISTIC K_WNGGRGLSPKAB87_EL "Korrekturfaktor, wenn gemessene Schleifzeit zu gross (oberhalb der Toleranz) bei Regelung KAB" VALUE 0x26DC42 kw_ui16_S6_S3 65530 UMR_U_MINSEC2_1_1_0_S6_S3 0 65530 /end CHARACTERISTIC
/begin CHARACTERISTIC K_WNGKLGLSPKZU87 "Korrekturfaktor, wenn gemessene Schleifzeit zu klein (unterhalb der Toleranz) bei Regelung KZU" VALUE 0x26DC44 kw_ui16_S6_S3 65530 UMR_U_MINSEC2_1_1_0_S6_S3 0 65530 /end CHARACTERISTIC
/begin CHARACTERISTIC K_WNGKLGLSPKZU87_EL "Korrekturfaktor, wenn gemessene Schleifzeit zu klein (unterhalb der Toleranz) bei Regelung KZU" VALUE 0x26DC46 kw_ui16_S6_S3 65530 UMR_U_MINSEC2_1_1_0_S6_S3 0 65530 /end CHARACTERISTIC
/begin CHARACTERISTIC K_WNGKLGLSPKAB87 "Korrekturfaktor, wenn gemessene Schleifzeit zu klein (unterhalb der Toleranz) bei Regelung KAB" VALUE 0x26DC48 kw_ui16_S6_S3 65530 UMR_U_MINSEC2_1_1_0_S6_S3 0 65530 /end CHARACTERISTIC
/begin CHARACTERISTIC K_WNGKLGLSPKAB87_EL "Korrekturfaktor, wenn gemessene Schleifzeit zu klein (unterhalb der Toleranz) bei Regelung KAB" VALUE 0x26DC4A kw_ui16_S6_S3 65530 UMR_U_MINSEC2_1_1_0_S6_S3 0 65530 /end CHARACTERISTIC
/begin CHARACTERISTIC KI_GLSKAB87 "Integralfaktor PID-Regler GLS" VALUE 0x26DC4C kw_ui16_S6_S3 10000 UMR_MBARMINSEC_10MSEC_1_1_0_S6_S3 0 10000 /end CHARACTERISTIC
/begin CHARACTERISTIC KI_GLSKAB87_EL "Integralfaktor PID-Regler GLS" VALUE 0x26DC4E kw_ui16_S6_S3 10000 UMR_MBARMINSEC_10MSEC_1_1_0_S6_S3 0 10000 /end CHARACTERISTIC
/begin CHARACTERISTIC KP_GLSKAB87 "Proportionalfaktor PID-Regler GLS" VALUE 0x26DC50 kw_ui16_S6_S3 10000 UMR_MBARMINSEC__1_1_0_S6_S3 0 10000 /end CHARACTERISTIC
/begin CHARACTERISTIC KP_GLSKAB87_EL "Proportionalfaktor PID-Regler GLS" VALUE 0x26DC52 kw_ui16_S6_S3 10000 UMR_MBARMINSEC__1_1_0_S6_S3 0 10000 /end CHARACTERISTIC
/begin CHARACTERISTIC KL_TVGLSKZUCG87 "Verzoegerungszeit GLS-Beginn" CURVE 0x23B208 kl_ui8_S6_S3 2540 UMR_MSEC__10_1_0_S6_S3 0 2540
 /begin AXIS_DESCR STD_AXIS zff_atsys._.iSignale._.obj.sig_c_getr UMR_GRADC__1_1_M40_S6_S3 3 -40 150 DEPOSIT ABSOLUTE MONOTONY MON_INCREASE /end AXIS_DESCR
/end CHARACTERISTIC
/begin CHARACTERISTIC KL_POMTUMSCHKABGLS87 "Offset fuer p_fmin fuer Umschaltung Kab auf Kzu" CURVE 0x23B214 kl_si16_S6_S3 6.25 UMR_BAR__1_1000_0_S6_S3 0 6.25
 /begin AXIS_DESCR STD_AXIS zff_atsys._.iSignale._.obj.sig_m_t UMR_NM__1_1_0_S6_S3 6 -400 1640 DEPOSIT ABSOLUTE MONOTONY MON_INCREASE /end AXIS_DESCR
/end CHARACTERISTIC
/begin CHARACTERISTIC KL_MPT_WNGTGLS_INIT87 "Filterkonstante Sollgradient PT1-Filter" CURVE 0x23B230 kl_si16_S6_S3 0.99 UMR___1_100_0_S6_S3 0.01 1
 /begin AXIS_DESCR STD_AXIS NO_INPUT_QUANTITY UMR_U_MINSEC_10000_32767_0_S6_S3 3 -9765.92303232 9765.92303232 DEPOSIT ABSOLUTE MONOTONY MON_INCREASE /end AXIS_DESCR
/end CHARACTERISTIC
/begin CHARACTERISTIC KL_UMSCHGLSKABSP31 "Momentenschwelle zu Regelumschaltung" CURVE 0x23B240 kl_si16_S6_S3 1400 UMR_NM__1_1_0_S6_S3 -100 1300
 /begin AXIS_DESCR STD_AXIS zff_atsys._.iSignale._.obj.sig_c_getr UMR_GRADC__1_1_M40_S6_S3 4 -40 215 DEPOSIT ABSOLUTE MONOTONY MON_INCREASE /end AXIS_DESCR
/end CHARACTERISTIC
/begin CHARACTERISTIC ND_GLSRSSP31 "Drehzahlkriterium Start Regelung bei RS" VALUE 0x26DC54 kw_ui16_S6_S3 8000 UMR_U_MIN_1_1_0_S6_S3 0 8000 /end CHARACTERISTIC
/begin CHARACTERISTIC KI_GLSKZUSP31 "I-Faktor PID-Regler GLS" VALUE 0x26DC56 kw_ui16_S6_S3 10000 UMR_MBARMINSEC_10MSEC_1_1_0_S6_S3 0 10000 /end CHARACTERISTIC
/begin CHARACTERISTIC KI_GLSKZUSP31_EL "I-Faktor PID-Regler GLS" VALUE 0x26DC58 kw_ui16_S6_S3 10000 UMR_MBARMINSEC_10MSEC_1_1_0_S6_S3 0 10000 /end CHARACTERISTIC
/begin CHARACTERISTIC KP_GLSKZUSP31 "P-Faktor PID-Regler GLS" VALUE 0x26DC5A kw_ui16_S6_S3 10000 UMR_MBARMINSEC__1_1_0_S6_S3 0 10000 /end CHARACTERISTIC
/begin CHARACTERISTIC KP_GLSKZUSP31_EL "P-Faktor PID-Regler GLS" VALUE 0x26DC5C kw_ui16_S6_S3 10000 UMR_MBARMINSEC__1_1_0_S6_S3 0 10000 /end CHARACTERISTIC
/begin CHARACTERISTIC TD_STOLGLSSP31 "max. tol. Schleifzeitdifferenz GLS" VALUE 0x26E6E7 kw_ui8_S6_S3 2540 UMR_MSEC__10_1_0_S6_S3 0 2540 /end CHARACTERISTIC
/begin CHARACTERISTIC TD_STOLGLSSP31_EL "max. tol. Schleifzeitdifferenz GLS" VALUE 0x26E6E8 kw_ui8_S6_S3 2540 UMR_MSEC__10_1_0_S6_S3 0 2540 /end CHARACTERISTIC
/begin CHARACTERISTIC K_WNGGRGLSPKZUSP31 "Korrekturfaktor, wenn gemessene Schleifzeit zu gross (oberhalb der Toleranz) bei Regelung KZU" VALUE 0x26DC5E kw_ui16_S6_S3 65530 UMR_U_MINSEC2_1_1_0_S6_S3 0 65530 /end CHARACTERISTIC
/begin CHARACTERISTIC K_WNGGRGLSPKZUSP31_EL "Korrekturfaktor, wenn gemessene Schleifzeit zu gross (oberhalb der Toleranz) bei Regelung KZU" VALUE 0x26DC60 kw_ui16_S6_S3 65530 UMR_U_MINSEC2_1_1_0_S6_S3 0 65530 /end CHARACTERISTIC
/begin CHARACTERISTIC K_WNGGRGLSPKABSP31 "Korrekturfaktor, wenn gemessene Schleifzeit zu gross (oberhalb der Toleranz) bei Regelung KAB" VALUE 0x26DC62 kw_ui16_S6_S3 65530 UMR_U_MINSEC2_1_1_0_S6_S3 0 65530 /end CHARACTERISTIC
/begin CHARACTERISTIC K_WNGGRGLSPKABSP31_EL "Korrekturfaktor, wenn gemessene Schleifzeit zu gross (oberhalb der Toleranz) bei Regelung KAB" VALUE 0x26DC64 kw_ui16_S6_S3 65530 UMR_U_MINSEC2_1_1_0_S6_S3 0 65530 /end CHARACTERISTIC
/begin CHARACTERISTIC K_WNGKLGLSPKZUSP31 "Korrekturfaktor, wenn gemessene Schleifzeit zu klein (unterhalb der Toleranz) bei Regelung KZU" VALUE 0x26DC66 kw_ui16_S6_S3 65530 UMR_U_MINSEC2_1_1_0_S6_S3 0 65530 /end CHARACTERISTIC
/begin CHARACTERISTIC K_WNGKLGLSPKZUSP31_EL "Korrekturfaktor, wenn gemessene Schleifzeit zu klein (unterhalb der Toleranz) bei Regelung KZU" VALUE 0x26DC68 kw_ui16_S6_S3 65530 UMR_U_MINSEC2_1_1_0_S6_S3 0 65530 /end CHARACTERISTIC
/begin CHARACTERISTIC K_WNGKLGLSPKABSP31 "Korrekturfaktor, wenn gemessene Schleifzeit zu klein (unterhalb der Toleranz) bei Regelung KAB" VALUE 0x26DC6A kw_ui16_S6_S3 65530 UMR_U_MINSEC2_1_1_0_S6_S3 0 65530 /end CHARACTERISTIC
/begin CHARACTERISTIC K_WNGKLGLSPKABSP31_EL "Korrekturfaktor, wenn gemessene Schleifzeit zu klein (unterhalb der Toleranz) bei Regelung KAB" VALUE 0x26DC6C kw_ui16_S6_S3 65530 UMR_U_MINSEC2_1_1_0_S6_S3 0 65530 /end CHARACTERISTIC
/begin CHARACTERISTIC KI_GLSKABSP31 "Integralfaktor PID-Regler GLS" VALUE 0x26DC6E kw_ui16_S6_S3 10000 UMR_MBARMINSEC_10MSEC_1_1_0_S6_S3 0 10000 /end CHARACTERISTIC
/begin CHARACTERISTIC KI_GLSKABSP31_EL "Integralfaktor PID-Regler GLS" VALUE 0x26DC70 kw_ui16_S6_S3 10000 UMR_MBARMINSEC_10MSEC_1_1_0_S6_S3 0 10000 /end CHARACTERISTIC
/begin CHARACTERISTIC KP_GLSKABSP31 "Proportionalfaktor PID-Regler GLS" VALUE 0x26DC72 kw_ui16_S6_S3 10000 UMR_MBARMINSEC__1_1_0_S6_S3 0 10000 /end CHARACTERISTIC
/begin CHARACTERISTIC KP_GLSKABSP31_EL "Proportionalfaktor PID-Regler GLS" VALUE 0x26DC74 kw_ui16_S6_S3 10000 UMR_MBARMINSEC__1_1_0_S6_S3 0 10000 /end CHARACTERISTIC
/begin CHARACTERISTIC KL_TVGLSKZUCGSP31 "Verzoegerungszeit GLS-Beginn" CURVE 0x23B254 kl_ui8_S6_S3 2540 UMR_MSEC__10_1_0_S6_S3 0 2540
 /begin AXIS_DESCR STD_AXIS zff_atsys._.iSignale._.obj.sig_c_getr UMR_GRADC__1_1_M40_S6_S3 3 -40 150 DEPOSIT ABSOLUTE MONOTONY MON_INCREASE /end AXIS_DESCR
/end CHARACTERISTIC
/begin CHARACTERISTIC KL_POMTUMSCHKABGLSSP31 "Offset fuer p_fmin fuer Umschaltung Kab auf Kzu" CURVE 0x23B260 kl_si16_S6_S3 6.25 UMR_BAR__1_1000_0_S6_S3 0 6.25
 /begin AXIS_DESCR STD_AXIS zff_atsys._.iSignale._.obj.sig_m_t UMR_NM__1_1_0_S6_S3 6 -400 1640 DEPOSIT ABSOLUTE MONOTONY MON_INCREASE /end AXIS_DESCR
/end CHARACTERISTIC
/begin CHARACTERISTIC KL_MPT_WNGTGLS_INITSP31 "Filterkonstante Sollgradient PT1-Filter" CURVE 0x23B27C kl_si16_S6_S3 0.99 UMR___1_100_0_S6_S3 0.01 1
 /begin AXIS_DESCR STD_AXIS NO_INPUT_QUANTITY UMR_U_MINSEC_10000_32767_0_S6_S3 3 -9765.92303232 9765.92303232 DEPOSIT ABSOLUTE MONOTONY MON_INCREASE /end AXIS_DESCR
/end CHARACTERISTIC
/begin CHARACTERISTIC KL_UMSCHGLSKABSP42 "Momentenschwelle zu Regelumschaltung" CURVE 0x23B28C kl_si16_S6_S3 1400 UMR_NM__1_1_0_S6_S3 -100 1300
 /begin AXIS_DESCR STD_AXIS zff_atsys._.iSignale._.obj.sig_c_getr UMR_GRADC__1_1_M40_S6_S3 4 -40 215 DEPOSIT ABSOLUTE MONOTONY MON_INCREASE /end AXIS_DESCR
/end CHARACTERISTIC
/begin CHARACTERISTIC ND_GLSRSSP42 "Drehzahlkriterium Start Regelung bei RS" VALUE 0x26DC76 kw_ui16_S6_S3 8000 UMR_U_MIN_1_1_0_S6_S3 0 8000 /end CHARACTERISTIC
/begin CHARACTERISTIC KI_GLSKZUSP42 "I-Faktor PID-Regler GLS" VALUE 0x26DC78 kw_ui16_S6_S3 10000 UMR_MBARMINSEC_10MSEC_1_1_0_S6_S3 0 10000 /end CHARACTERISTIC
/begin CHARACTERISTIC KI_GLSKZUSP42_EL "I-Faktor PID-Regler GLS" VALUE 0x26DC7A kw_ui16_S6_S3 10000 UMR_MBARMINSEC_10MSEC_1_1_0_S6_S3 0 10000 /end CHARACTERISTIC
/begin CHARACTERISTIC KP_GLSKZUSP42 "P-Faktor PID-Regler GLS" VALUE 0x26DC7C kw_ui16_S6_S3 10000 UMR_MBARMINSEC__1_1_0_S6_S3 0 10000 /end CHARACTERISTIC
/begin CHARACTERISTIC KP_GLSKZUSP42_EL "P-Faktor PID-Regler GLS" VALUE 0x26DC7E kw_ui16_S6_S3 10000 UMR_MBARMINSEC__1_1_0_S6_S3 0 10000 /end CHARACTERISTIC
/begin CHARACTERISTIC TD_STOLGLSSP42 "max. tol. Schleifzeitdifferenz GLS" VALUE 0x26E6E9 kw_ui8_S6_S3 2540 UMR_MSEC__10_1_0_S6_S3 0 2540 /end CHARACTERISTIC
/begin CHARACTERISTIC TD_STOLGLSSP42_EL "max. tol. Schleifzeitdifferenz GLS" VALUE 0x26E6EA kw_ui8_S6_S3 2540 UMR_MSEC__10_1_0_S6_S3 0 2540 /end CHARACTERISTIC
/begin CHARACTERISTIC K_WNGGRGLSPKZUSP42 "Korrekturfaktor, wenn gemessene Schleifzeit zu gross (oberhalb der Toleranz) bei Regelung KZU" VALUE 0x26DC80 kw_ui16_S6_S3 65530 UMR_U_MINSEC2_1_1_0_S6_S3 0 65530 /end CHARACTERISTIC
/begin CHARACTERISTIC K_WNGGRGLSPKZUSP42_EL "Korrekturfaktor, wenn gemessene Schleifzeit zu gross (oberhalb der Toleranz) bei Regelung KZU" VALUE 0x26DC82 kw_ui16_S6_S3 65530 UMR_U_MINSEC2_1_1_0_S6_S3 0 65530 /end CHARACTERISTIC
/begin CHARACTERISTIC K_WNGGRGLSPKABSP42 "Korrekturfaktor, wenn gemessene Schleifzeit zu gross (oberhalb der Toleranz) bei Regelung KAB" VALUE 0x26DC84 kw_ui16_S6_S3 65530 UMR_U_MINSEC2_1_1_0_S6_S3 0 65530 /end CHARACTERISTIC
/begin CHARACTERISTIC K_WNGGRGLSPKABSP42_EL "Korrekturfaktor, wenn gemessene Schleifzeit zu gross (oberhalb der Toleranz) bei Regelung KAB" VALUE 0x26DC86 kw_ui16_S6_S3 65530 UMR_U_MINSEC2_1_1_0_S6_S3 0 65530 /end CHARACTERISTIC
/begin CHARACTERISTIC K_WNGKLGLSPKZUSP42 "Korrekturfaktor, wenn gemessene Schleifzeit zu klein (unterhalb der Toleranz) bei Regelung KZU" VALUE 0x26DC88 kw_ui16_S6_S3 65530 UMR_U_MINSEC2_1_1_0_S6_S3 0 65530 /end CHARACTERISTIC
/begin CHARACTERISTIC K_WNGKLGLSPKZUSP42_EL "Korrekturfaktor, wenn gemessene Schleifzeit zu klein (unterhalb der Toleranz) bei Regelung KZU" VALUE 0x26DC8A kw_ui16_S6_S3 65530 UMR_U_MINSEC2_1_1_0_S6_S3 0 65530 /end CHARACTERISTIC
/begin CHARACTERISTIC K_WNGKLGLSPKABSP42 "Korrekturfaktor, wenn gemessene Schleifzeit zu klein (unterhalb der Toleranz) bei Regelung KAB" VALUE 0x26DC8C kw_ui16_S6_S3 65530 UMR_U_MINSEC2_1_1_0_S6_S3 0 65530 /end CHARACTERISTIC
/begin CHARACTERISTIC K_WNGKLGLSPKABSP42_EL "Korrekturfaktor, wenn gemessene Schleifzeit zu klein (unterhalb der Toleranz) bei Regelung KAB" VALUE 0x26DC8E kw_ui16_S6_S3 65530 UMR_U_MINSEC2_1_1_0_S6_S3 0 65530 /end CHARACTERISTIC
/begin CHARACTERISTIC KI_GLSKABSP42 "Integralfaktor PID-Regler GLS" VALUE 0x26DC90 kw_ui16_S6_S3 10000 UMR_MBARMINSEC_10MSEC_1_1_0_S6_S3 0 10000 /end CHARACTERISTIC
/begin CHARACTERISTIC KI_GLSKABSP42_EL "Integralfaktor PID-Regler GLS" VALUE 0x26DC92 kw_ui16_S6_S3 10000 UMR_MBARMINSEC_10MSEC_1_1_0_S6_S3 0 10000 /end CHARACTERISTIC
/begin CHARACTERISTIC KP_GLSKABSP42 "Proportionalfaktor PID-Regler GLS" VALUE 0x26DC94 kw_ui16_S6_S3 10000 UMR_MBARMINSEC__1_1_0_S6_S3 0 10000 /end CHARACTERISTIC
/begin CHARACTERISTIC KP_GLSKABSP42_EL "Proportionalfaktor PID-Regler GLS" VALUE 0x26DC96 kw_ui16_S6_S3 10000 UMR_MBARMINSEC__1_1_0_S6_S3 0 10000 /end CHARACTERISTIC
/begin CHARACTERISTIC KL_TVGLSKZUCGSP42 "Verzoegerungszeit GLS-Beginn" CURVE 0x23B2A0 kl_ui8_S6_S3 2540 UMR_MSEC__10_1_0_S6_S3 0 2540
 /begin AXIS_DESCR STD_AXIS zff_atsys._.iSignale._.obj.sig_c_getr UMR_GRADC__1_1_M40_S6_S3 3 -40 150 DEPOSIT ABSOLUTE MONOTONY MON_INCREASE /end AXIS_DESCR
/end CHARACTERISTIC
/begin CHARACTERISTIC KL_POMTUMSCHKABGLSSP42 "Offset fuer p_fmin fuer Umschaltung Kab auf Kzu" CURVE 0x23B2AC kl_si16_S6_S3 6.25 UMR_BAR__1_1000_0_S6_S3 0 6.25
 /begin AXIS_DESCR STD_AXIS zff_atsys._.iSignale._.obj.sig_m_t UMR_NM__1_1_0_S6_S3 6 -400 1640 DEPOSIT ABSOLUTE MONOTONY MON_INCREASE /end AXIS_DESCR
/end CHARACTERISTIC
/begin CHARACTERISTIC KL_MPT_WNGTGLS_INITSP42 "Filterkonstante Sollgradient PT1-Filter" CURVE 0x23B2C8 kl_si16_S6_S3 0.99 UMR___1_100_0_S6_S3 0.01 1
 /begin AXIS_DESCR STD_AXIS NO_INPUT_QUANTITY UMR_U_MINSEC_10000_32767_0_S6_S3 3 -9765.92303232 9765.92303232 DEPOSIT ABSOLUTE MONOTONY MON_INCREASE /end AXIS_DESCR
/end CHARACTERISTIC
/begin CHARACTERISTIC KL_UMSCHGLSKABSP51 "Momentenschwelle zu Regelumschaltung" CURVE 0x23B2D8 kl_si16_S6_S3 1400 UMR_NM__1_1_0_S6_S3 -100 1300
 /begin AXIS_DESCR STD_AXIS zff_atsys._.iSignale._.obj.sig_c_getr UMR_GRADC__1_1_M40_S6_S3 4 -40 215 DEPOSIT ABSOLUTE MONOTONY MON_INCREASE /end AXIS_DESCR
/end CHARACTERISTIC
/begin CHARACTERISTIC ND_GLSRSSP51 "Drehzahlkriterium Start Regelung bei RS" VALUE 0x26DC98 kw_ui16_S6_S3 8000 UMR_U_MIN_1_1_0_S6_S3 0 8000 /end CHARACTERISTIC
/begin CHARACTERISTIC KI_GLSKZUSP51 "I-Faktor PID-Regler GLS" VALUE 0x26DC9A kw_ui16_S6_S3 10000 UMR_MBARMINSEC_10MSEC_1_1_0_S6_S3 0 10000 /end CHARACTERISTIC
/begin CHARACTERISTIC KI_GLSKZUSP51_EL "I-Faktor PID-Regler GLS" VALUE 0x26DC9C kw_ui16_S6_S3 10000 UMR_MBARMINSEC_10MSEC_1_1_0_S6_S3 0 10000 /end CHARACTERISTIC
/begin CHARACTERISTIC KP_GLSKZUSP51 "P-Faktor PID-Regler GLS" VALUE 0x26DC9E kw_ui16_S6_S3 10000 UMR_MBARMINSEC__1_1_0_S6_S3 0 10000 /end CHARACTERISTIC
/begin CHARACTERISTIC KP_GLSKZUSP51_EL "P-Faktor PID-Regler GLS" VALUE 0x26DCA0 kw_ui16_S6_S3 10000 UMR_MBARMINSEC__1_1_0_S6_S3 0 10000 /end CHARACTERISTIC
/begin CHARACTERISTIC TD_STOLGLSSP51 "max. tol. Schleifzeitdifferenz GLS" VALUE 0x26E6EB kw_ui8_S6_S3 2540 UMR_MSEC__10_1_0_S6_S3 0 2540 /end CHARACTERISTIC
/begin CHARACTERISTIC TD_STOLGLSSP51_EL "max. tol. Schleifzeitdifferenz GLS" VALUE 0x26E6EC kw_ui8_S6_S3 2540 UMR_MSEC__10_1_0_S6_S3 0 2540 /end CHARACTERISTIC
/begin CHARACTERISTIC K_WNGGRGLSPKZUSP51 "Korrekturfaktor, wenn gemessene Schleifzeit zu gross (oberhalb der Toleranz) bei Regelung KZU" VALUE 0x26DCA2 kw_ui16_S6_S3 65530 UMR_U_MINSEC2_1_1_0_S6_S3 0 65530 /end CHARACTERISTIC
/begin CHARACTERISTIC K_WNGGRGLSPKZUSP51_EL "Korrekturfaktor, wenn gemessene Schleifzeit zu gross (oberhalb der Toleranz) bei Regelung KZU" VALUE 0x26DCA4 kw_ui16_S6_S3 65530 UMR_U_MINSEC2_1_1_0_S6_S3 0 65530 /end CHARACTERISTIC
/begin CHARACTERISTIC K_WNGGRGLSPKABSP51 "Korrekturfaktor, wenn gemessene Schleifzeit zu gross (oberhalb der Toleranz) bei Regelung KAB" VALUE 0x26DCA6 kw_ui16_S6_S3 65530 UMR_U_MINSEC2_1_1_0_S6_S3 0 65530 /end CHARACTERISTIC
/begin CHARACTERISTIC K_WNGGRGLSPKABSP51_EL "Korrekturfaktor, wenn gemessene Schleifzeit zu gross (oberhalb der Toleranz) bei Regelung KAB" VALUE 0x26DCA8 kw_ui16_S6_S3 65530 UMR_U_MINSEC2_1_1_0_S6_S3 0 65530 /end CHARACTERISTIC
/begin CHARACTERISTIC K_WNGKLGLSPKZUSP51 "Korrekturfaktor, wenn gemessene Schleifzeit zu klein (unterhalb der Toleranz) bei Regelung KZU" VALUE 0x26DCAA kw_ui16_S6_S3 65530 UMR_U_MINSEC2_1_1_0_S6_S3 0 65530 /end CHARACTERISTIC
/begin CHARACTERISTIC K_WNGKLGLSPKZUSP51_EL "Korrekturfaktor, wenn gemessene Schleifzeit zu klein (unterhalb der Toleranz) bei Regelung KZU" VALUE 0x26DCAC kw_ui16_S6_S3 65530 UMR_U_MINSEC2_1_1_0_S6_S3 0 65530 /end CHARACTERISTIC
/begin CHARACTERISTIC K_WNGKLGLSPKABSP51 "Korrekturfaktor, wenn gemessene Schleifzeit zu klein (unterhalb der Toleranz) bei Regelung KAB" VALUE 0x26DCAE kw_ui16_S6_S3 65530 UMR_U_MINSEC2_1_1_0_S6_S3 0 65530 /end CHARACTERISTIC
/begin CHARACTERISTIC K_WNGKLGLSPKABSP51_EL "Korrekturfaktor, wenn gemessene Schleifzeit zu klein (unterhalb der Toleranz) bei Regelung KAB" VALUE 0x26DCB0 kw_ui16_S6_S3 65530 UMR_U_MINSEC2_1_1_0_S6_S3 0 65530 /end CHARACTERISTIC
/begin CHARACTERISTIC KI_GLSKABSP51 "Integralfaktor PID-Regler GLS" VALUE 0x26DCB2 kw_ui16_S6_S3 10000 UMR_MBARMINSEC_10MSEC_1_1_0_S6_S3 0 10000 /end CHARACTERISTIC
/begin CHARACTERISTIC KI_GLSKABSP51_EL "Integralfaktor PID-Regler GLS" VALUE 0x26DCB4 kw_ui16_S6_S3 10000 UMR_MBARMINSEC_10MSEC_1_1_0_S6_S3 0 10000 /end CHARACTERISTIC
/begin CHARACTERISTIC KP_GLSKABSP51 "Proportionalfaktor PID-Regler GLS" VALUE 0x26DCB6 kw_ui16_S6_S3 10000 UMR_MBARMINSEC__1_1_0_S6_S3 0 10000 /end CHARACTERISTIC
/begin CHARACTERISTIC KP_GLSKABSP51_EL "Proportionalfaktor PID-Regler GLS" VALUE 0x26DCB8 kw_ui16_S6_S3 10000 UMR_MBARMINSEC__1_1_0_S6_S3 0 10000 /end CHARACTERISTIC
/begin CHARACTERISTIC KL_TVGLSKZUCGSP51 "Verzoegerungszeit GLS-Beginn" CURVE 0x23B2EC kl_ui8_S6_S3 2540 UMR_MSEC__10_1_0_S6_S3 0 2540
 /begin AXIS_DESCR STD_AXIS zff_atsys._.iSignale._.obj.sig_c_getr UMR_GRADC__1_1_M40_S6_S3 3 -40 150 DEPOSIT ABSOLUTE MONOTONY MON_INCREASE /end AXIS_DESCR
/end CHARACTERISTIC
/begin CHARACTERISTIC KL_POMTUMSCHKABGLSSP51 "Offset fuer p_fmin fuer Umschaltung Kab auf Kzu" CURVE 0x23B2F8 kl_si16_S6_S3 6.25 UMR_BAR__1_1000_0_S6_S3 0 6.25
 /begin AXIS_DESCR STD_AXIS zff_atsys._.iSignale._.obj.sig_m_t UMR_NM__1_1_0_S6_S3 6 -400 1640 DEPOSIT ABSOLUTE MONOTONY MON_INCREASE /end AXIS_DESCR
/end CHARACTERISTIC
/begin CHARACTERISTIC KL_MPT_WNGTGLS_INITSP51 "Filterkonstante Sollgradient PT1-Filter" CURVE 0x23B314 kl_si16_S6_S3 0.99 UMR___1_100_0_S6_S3 0.01 1
 /begin AXIS_DESCR STD_AXIS NO_INPUT_QUANTITY UMR_U_MINSEC_10000_32767_0_S6_S3 3 -9765.92303232 9765.92303232 DEPOSIT ABSOLUTE MONOTONY MON_INCREASE /end AXIS_DESCR
/end CHARACTERISTIC
/begin CHARACTERISTIC KL_UMSCHGLSKABSP53 "Momentenschwelle zu Regelumschaltung" CURVE 0x23B324 kl_si16_S6_S3 1400 UMR_NM__1_1_0_S6_S3 -100 1300
 /begin AXIS_DESCR STD_AXIS zff_atsys._.iSignale._.obj.sig_c_getr UMR_GRADC__1_1_M40_S6_S3 4 -40 215 DEPOSIT ABSOLUTE MONOTONY MON_INCREASE /end AXIS_DESCR
/end CHARACTERISTIC
/begin CHARACTERISTIC ND_GLSRSSP53 "Drehzahlkriterium Start Regelung bei RS" VALUE 0x26DCBA kw_ui16_S6_S3 8000 UMR_U_MIN_1_1_0_S6_S3 0 8000 /end CHARACTERISTIC
/begin CHARACTERISTIC KI_GLSKZUSP53 "I-Faktor PID-Regler GLS" VALUE 0x26DCBC kw_ui16_S6_S3 10000 UMR_MBARMINSEC_10MSEC_1_1_0_S6_S3 0 10000 /end CHARACTERISTIC
/begin CHARACTERISTIC KI_GLSKZUSP53_EL "I-Faktor PID-Regler GLS" VALUE 0x26DCBE kw_ui16_S6_S3 10000 UMR_MBARMINSEC_10MSEC_1_1_0_S6_S3 0 10000 /end CHARACTERISTIC
/begin CHARACTERISTIC KP_GLSKZUSP53 "P-Faktor PID-Regler GLS" VALUE 0x26DCC0 kw_ui16_S6_S3 10000 UMR_MBARMINSEC__1_1_0_S6_S3 0 10000 /end CHARACTERISTIC
/begin CHARACTERISTIC KP_GLSKZUSP53_EL "P-Faktor PID-Regler GLS" VALUE 0x26DCC2 kw_ui16_S6_S3 10000 UMR_MBARMINSEC__1_1_0_S6_S3 0 10000 /end CHARACTERISTIC
/begin CHARACTERISTIC TD_STOLGLSSP53 "max. tol. Schleifzeitdifferenz GLS" VALUE 0x26E6ED kw_ui8_S6_S3 2540 UMR_MSEC__10_1_0_S6_S3 0 2540 /end CHARACTERISTIC
/begin CHARACTERISTIC TD_STOLGLSSP53_EL "max. tol. Schleifzeitdifferenz GLS" VALUE 0x26E6EE kw_ui8_S6_S3 2540 UMR_MSEC__10_1_0_S6_S3 0 2540 /end CHARACTERISTIC
/begin CHARACTERISTIC K_WNGGRGLSPKZUSP53 "Korrekturfaktor, wenn gemessene Schleifzeit zu gross (oberhalb der Toleranz) bei Regelung KZU" VALUE 0x26DCC4 kw_ui16_S6_S3 65530 UMR_U_MINSEC2_1_1_0_S6_S3 0 65530 /end CHARACTERISTIC
/begin CHARACTERISTIC K_WNGGRGLSPKZUSP53_EL "Korrekturfaktor, wenn gemessene Schleifzeit zu gross (oberhalb der Toleranz) bei Regelung KZU" VALUE 0x26DCC6 kw_ui16_S6_S3 65530 UMR_U_MINSEC2_1_1_0_S6_S3 0 65530 /end CHARACTERISTIC
/begin CHARACTERISTIC K_WNGGRGLSPKABSP53 "Korrekturfaktor, wenn gemessene Schleifzeit zu gross (oberhalb der Toleranz) bei Regelung KAB" VALUE 0x26DCC8 kw_ui16_S6_S3 65530 UMR_U_MINSEC2_1_1_0_S6_S3 0 65530 /end CHARACTERISTIC
/begin CHARACTERISTIC K_WNGGRGLSPKABSP53_EL "Korrekturfaktor, wenn gemessene Schleifzeit zu gross (oberhalb der Toleranz) bei Regelung KAB" VALUE 0x26DCCA kw_ui16_S6_S3 65530 UMR_U_MINSEC2_1_1_0_S6_S3 0 65530 /end CHARACTERISTIC
/begin CHARACTERISTIC K_WNGKLGLSPKZUSP53 "Korrekturfaktor, wenn gemessene Schleifzeit zu klein (unterhalb der Toleranz) bei Regelung KZU" VALUE 0x26DCCC kw_ui16_S6_S3 65530 UMR_U_MINSEC2_1_1_0_S6_S3 0 65530 /end CHARACTERISTIC
/begin CHARACTERISTIC K_WNGKLGLSPKZUSP53_EL "Korrekturfaktor, wenn gemessene Schleifzeit zu klein (unterhalb der Toleranz) bei Regelung KZU" VALUE 0x26DCCE kw_ui16_S6_S3 65530 UMR_U_MINSEC2_1_1_0_S6_S3 0 65530 /end CHARACTERISTIC
/begin CHARACTERISTIC K_WNGKLGLSPKABSP53 "Korrekturfaktor, wenn gemessene Schleifzeit zu klein (unterhalb der Toleranz) bei Regelung KAB" VALUE 0x26DCD0 kw_ui16_S6_S3 65530 UMR_U_MINSEC2_1_1_0_S6_S3 0 65530 /end CHARACTERISTIC
/begin CHARACTERISTIC K_WNGKLGLSPKABSP53_EL "Korrekturfaktor, wenn gemessene Schleifzeit zu klein (unterhalb der Toleranz) bei Regelung KAB" VALUE 0x26DCD2 kw_ui16_S6_S3 65530 UMR_U_MINSEC2_1_1_0_S6_S3 0 65530 /end CHARACTERISTIC
/begin CHARACTERISTIC KI_GLSKABSP53 "Integralfaktor PID-Regler GLS" VALUE 0x26DCD4 kw_ui16_S6_S3 10000 UMR_MBARMINSEC_10MSEC_1_1_0_S6_S3 0 10000 /end CHARACTERISTIC
/begin CHARACTERISTIC KI_GLSKABSP53_EL "Integralfaktor PID-Regler GLS" VALUE 0x26DCD6 kw_ui16_S6_S3 10000 UMR_MBARMINSEC_10MSEC_1_1_0_S6_S3 0 10000 /end CHARACTERISTIC
/begin CHARACTERISTIC KP_GLSKABSP53 "Proportionalfaktor PID-Regler GLS" VALUE 0x26DCD8 kw_ui16_S6_S3 10000 UMR_MBARMINSEC__1_1_0_S6_S3 0 10000 /end CHARACTERISTIC
/begin CHARACTERISTIC KP_GLSKABSP53_EL "Proportionalfaktor PID-Regler GLS" VALUE 0x26DCDA kw_ui16_S6_S3 10000 UMR_MBARMINSEC__1_1_0_S6_S3 0 10000 /end CHARACTERISTIC
/begin CHARACTERISTIC KL_TVGLSKZUCGSP53 "Verzoegerungszeit GLS-Beginn" CURVE 0x23B338 kl_ui8_S6_S3 2540 UMR_MSEC__10_1_0_S6_S3 0 2540
 /begin AXIS_DESCR STD_AXIS zff_atsys._.iSignale._.obj.sig_c_getr UMR_GRADC__1_1_M40_S6_S3 3 -40 150 DEPOSIT ABSOLUTE MONOTONY MON_INCREASE /end AXIS_DESCR
/end CHARACTERISTIC
/begin CHARACTERISTIC KL_POMTUMSCHKABGLSSP53 "Offset fuer p_fmin fuer Umschaltung Kab auf Kzu" CURVE 0x23B344 kl_si16_S6_S3 6.25 UMR_BAR__1_1000_0_S6_S3 0 6.25
 /begin AXIS_DESCR STD_AXIS zff_atsys._.iSignale._.obj.sig_m_t UMR_NM__1_1_0_S6_S3 6 -400 1640 DEPOSIT ABSOLUTE MONOTONY MON_INCREASE /end AXIS_DESCR
/end CHARACTERISTIC
/begin CHARACTERISTIC KL_MPT_WNGTGLS_INITSP53 "Filterkonstante Sollgradient PT1-Filter" CURVE 0x23B360 kl_si16_S6_S3 0.99 UMR___1_100_0_S6_S3 0.01 1
 /begin AXIS_DESCR STD_AXIS NO_INPUT_QUANTITY UMR_U_MINSEC_10000_32767_0_S6_S3 3 -9765.92303232 9765.92303232 DEPOSIT ABSOLUTE MONOTONY MON_INCREASE /end AXIS_DESCR
/end CHARACTERISTIC
/begin CHARACTERISTIC KL_UMSCHGLSKABSP63 "Momentenschwelle zu Regelumschaltung" CURVE 0x23B370 kl_si16_S6_S3 1400 UMR_NM__1_1_0_S6_S3 -100 1300
 /begin AXIS_DESCR STD_AXIS zff_atsys._.iSignale._.obj.sig_c_getr UMR_GRADC__1_1_M40_S6_S3 4 -40 215 DEPOSIT ABSOLUTE MONOTONY MON_INCREASE /end AXIS_DESCR
/end CHARACTERISTIC
/begin CHARACTERISTIC ND_GLSRSSP63 "Drehzahlkriterium Start Regelung bei RS" VALUE 0x26DCDC kw_ui16_S6_S3 8000 UMR_U_MIN_1_1_0_S6_S3 0 8000 /end CHARACTERISTIC
/begin CHARACTERISTIC KI_GLSKZUSP63 "I-Faktor PID-Regler GLS" VALUE 0x26DCDE kw_ui16_S6_S3 10000 UMR_MBARMINSEC_10MSEC_1_1_0_S6_S3 0 10000 /end CHARACTERISTIC
/begin CHARACTERISTIC KI_GLSKZUSP63_EL "I-Faktor PID-Regler GLS" VALUE 0x26DCE0 kw_ui16_S6_S3 10000 UMR_MBARMINSEC_10MSEC_1_1_0_S6_S3 0 10000 /end CHARACTERISTIC
/begin CHARACTERISTIC KP_GLSKZUSP63 "P-Faktor PID-Regler GLS" VALUE 0x26DCE2 kw_ui16_S6_S3 10000 UMR_MBARMINSEC__1_1_0_S6_S3 0 10000 /end CHARACTERISTIC
/begin CHARACTERISTIC KP_GLSKZUSP63_EL "P-Faktor PID-Regler GLS" VALUE 0x26DCE4 kw_ui16_S6_S3 10000 UMR_MBARMINSEC__1_1_0_S6_S3 0 10000 /end CHARACTERISTIC
/begin CHARACTERISTIC TD_STOLGLSSP63 "max. tol. Schleifzeitdifferenz GLS" VALUE 0x26E6EF kw_ui8_S6_S3 2540 UMR_MSEC__10_1_0_S6_S3 0 2540 /end CHARACTERISTIC
/begin CHARACTERISTIC TD_STOLGLSSP63_EL "max. tol. Schleifzeitdifferenz GLS" VALUE 0x26E6F0 kw_ui8_S6_S3 2540 UMR_MSEC__10_1_0_S6_S3 0 2540 /end CHARACTERISTIC
/begin CHARACTERISTIC K_WNGGRGLSPKZUSP63 "Korrekturfaktor, wenn gemessene Schleifzeit zu gross (oberhalb der Toleranz) bei Regelung KZU" VALUE 0x26DCE6 kw_ui16_S6_S3 65530 UMR_U_MINSEC2_1_1_0_S6_S3 0 65530 /end CHARACTERISTIC
/begin CHARACTERISTIC K_WNGGRGLSPKZUSP63_EL "Korrekturfaktor, wenn gemessene Schleifzeit zu gross (oberhalb der Toleranz) bei Regelung KZU" VALUE 0x26DCE8 kw_ui16_S6_S3 65530 UMR_U_MINSEC2_1_1_0_S6_S3 0 65530 /end CHARACTERISTIC
/begin CHARACTERISTIC K_WNGGRGLSPKABSP63 "Korrekturfaktor, wenn gemessene Schleifzeit zu gross (oberhalb der Toleranz) bei Regelung KAB" VALUE 0x26DCEA kw_ui16_S6_S3 65530 UMR_U_MINSEC2_1_1_0_S6_S3 0 65530 /end CHARACTERISTIC
/begin CHARACTERISTIC K_WNGGRGLSPKABSP63_EL "Korrekturfaktor, wenn gemessene Schleifzeit zu gross (oberhalb der Toleranz) bei Regelung KAB" VALUE 0x26DCEC kw_ui16_S6_S3 65530 UMR_U_MINSEC2_1_1_0_S6_S3 0 65530 /end CHARACTERISTIC
/begin CHARACTERISTIC K_WNGKLGLSPKZUSP63 "Korrekturfaktor, wenn gemessene Schleifzeit zu klein (unterhalb der Toleranz) bei Regelung KZU" VALUE 0x26DCEE kw_ui16_S6_S3 65530 UMR_U_MINSEC2_1_1_0_S6_S3 0 65530 /end CHARACTERISTIC
/begin CHARACTERISTIC K_WNGKLGLSPKZUSP63_EL "Korrekturfaktor, wenn gemessene Schleifzeit zu klein (unterhalb der Toleranz) bei Regelung KZU" VALUE 0x26DCF0 kw_ui16_S6_S3 65530 UMR_U_MINSEC2_1_1_0_S6_S3 0 65530 /end CHARACTERISTIC
/begin CHARACTERISTIC K_WNGKLGLSPKABSP63 "Korrekturfaktor, wenn gemessene Schleifzeit zu klein (unterhalb der Toleranz) bei Regelung KAB" VALUE 0x26DCF2 kw_ui16_S6_S3 65530 UMR_U_MINSEC2_1_1_0_S6_S3 0 65530 /end CHARACTERISTIC
/begin CHARACTERISTIC K_WNGKLGLSPKABSP63_EL "Korrekturfaktor, wenn gemessene Schleifzeit zu klein (unterhalb der Toleranz) bei Regelung KAB" VALUE 0x26DCF4 kw_ui16_S6_S3 65530 UMR_U_MINSEC2_1_1_0_S6_S3 0 65530 /end CHARACTERISTIC
/begin CHARACTERISTIC KI_GLSKABSP63 "Integralfaktor PID-Regler GLS" VALUE 0x26DCF6 kw_ui16_S6_S3 10000 UMR_MBARMINSEC_10MSEC_1_1_0_S6_S3 0 10000 /end CHARACTERISTIC
/begin CHARACTERISTIC KI_GLSKABSP63_EL "Integralfaktor PID-Regler GLS" VALUE 0x26DCF8 kw_ui16_S6_S3 10000 UMR_MBARMINSEC_10MSEC_1_1_0_S6_S3 0 10000 /end CHARACTERISTIC
/begin CHARACTERISTIC KP_GLSKABSP63 "Proportionalfaktor PID-Regler GLS" VALUE 0x26DCFA kw_ui16_S6_S3 10000 UMR_MBARMINSEC__1_1_0_S6_S3 0 10000 /end CHARACTERISTIC
/begin CHARACTERISTIC KP_GLSKABSP63_EL "Proportionalfaktor PID-Regler GLS" VALUE 0x26DCFC kw_ui16_S6_S3 10000 UMR_MBARMINSEC__1_1_0_S6_S3 0 10000 /end CHARACTERISTIC
/begin CHARACTERISTIC KL_TVGLSKZUCGSP63 "Verzoegerungszeit GLS-Beginn" CURVE 0x23B384 kl_ui8_S6_S3 2540 UMR_MSEC__10_1_0_S6_S3 0 2540
 /begin AXIS_DESCR STD_AXIS zff_atsys._.iSignale._.obj.sig_c_getr UMR_GRADC__1_1_M40_S6_S3 3 -40 150 DEPOSIT ABSOLUTE MONOTONY MON_INCREASE /end AXIS_DESCR
/end CHARACTERISTIC
/begin CHARACTERISTIC KL_POMTUMSCHKABGLSSP63 "Offset fuer p_fmin fuer Umschaltung Kab auf Kzu" CURVE 0x23B390 kl_si16_S6_S3 6.25 UMR_BAR__1_1000_0_S6_S3 0 6.25
 /begin AXIS_DESCR STD_AXIS zff_atsys._.iSignale._.obj.sig_m_t UMR_NM__1_1_0_S6_S3 6 -400 1640 DEPOSIT ABSOLUTE MONOTONY MON_INCREASE /end AXIS_DESCR
/end CHARACTERISTIC
/begin CHARACTERISTIC KL_MPT_WNGTGLS_INITSP63 "Filterkonstante Sollgradient PT1-Filter" CURVE 0x23B3AC kl_si16_S6_S3 0.99 UMR___1_100_0_S6_S3 0.01 1
 /begin AXIS_DESCR STD_AXIS NO_INPUT_QUANTITY UMR_U_MINSEC_10000_32767_0_S6_S3 3 -9765.92303232 9765.92303232 DEPOSIT ABSOLUTE MONOTONY MON_INCREASE /end AXIS_DESCR
/end CHARACTERISTIC
/begin CHARACTERISTIC KL_UMSCHGLSKABSP64 "Momentenschwelle zu Regelumschaltung" CURVE 0x23B3BC kl_si16_S6_S3 1400 UMR_NM__1_1_0_S6_S3 -100 1300
 /begin AXIS_DESCR STD_AXIS zff_atsys._.iSignale._.obj.sig_c_getr UMR_GRADC__1_1_M40_S6_S3 4 -40 215 DEPOSIT ABSOLUTE MONOTONY MON_INCREASE /end AXIS_DESCR
/end CHARACTERISTIC
/begin CHARACTERISTIC ND_GLSRSSP64 "Drehzahlkriterium Start Regelung bei RS" VALUE 0x26DCFE kw_ui16_S6_S3 8000 UMR_U_MIN_1_1_0_S6_S3 0 8000 /end CHARACTERISTIC
/begin CHARACTERISTIC KI_GLSKZUSP64 "I-Faktor PID-Regler GLS" VALUE 0x26DD00 kw_ui16_S6_S3 10000 UMR_MBARMINSEC_10MSEC_1_1_0_S6_S3 0 10000 /end CHARACTERISTIC
/begin CHARACTERISTIC KI_GLSKZUSP64_EL "I-Faktor PID-Regler GLS" VALUE 0x26DD02 kw_ui16_S6_S3 10000 UMR_MBARMINSEC_10MSEC_1_1_0_S6_S3 0 10000 /end CHARACTERISTIC
/begin CHARACTERISTIC KP_GLSKZUSP64 "P-Faktor PID-Regler GLS" VALUE 0x26DD04 kw_ui16_S6_S3 10000 UMR_MBARMINSEC__1_1_0_S6_S3 0 10000 /end CHARACTERISTIC
/begin CHARACTERISTIC KP_GLSKZUSP64_EL "P-Faktor PID-Regler GLS" VALUE 0x26DD06 kw_ui16_S6_S3 10000 UMR_MBARMINSEC__1_1_0_S6_S3 0 10000 /end CHARACTERISTIC
/begin CHARACTERISTIC TD_STOLGLSSP64 "max. tol. Schleifzeitdifferenz GLS" VALUE 0x26E6F1 kw_ui8_S6_S3 2540 UMR_MSEC__10_1_0_S6_S3 0 2540 /end CHARACTERISTIC
/begin CHARACTERISTIC TD_STOLGLSSP64_EL "max. tol. Schleifzeitdifferenz GLS" VALUE 0x26E6F2 kw_ui8_S6_S3 2540 UMR_MSEC__10_1_0_S6_S3 0 2540 /end CHARACTERISTIC
/begin CHARACTERISTIC K_WNGGRGLSPKZUSP64 "Korrekturfaktor, wenn gemessene Schleifzeit zu gross (oberhalb der Toleranz) bei Regelung KZU" VALUE 0x26DD08 kw_ui16_S6_S3 65530 UMR_U_MINSEC2_1_1_0_S6_S3 0 65530 /end CHARACTERISTIC
/begin CHARACTERISTIC K_WNGGRGLSPKZUSP64_EL "Korrekturfaktor, wenn gemessene Schleifzeit zu gross (oberhalb der Toleranz) bei Regelung KZU" VALUE 0x26DD0A kw_ui16_S6_S3 65530 UMR_U_MINSEC2_1_1_0_S6_S3 0 65530 /end CHARACTERISTIC
/begin CHARACTERISTIC K_WNGGRGLSPKABSP64 "Korrekturfaktor, wenn gemessene Schleifzeit zu gross (oberhalb der Toleranz) bei Regelung KAB" VALUE 0x26DD0C kw_ui16_S6_S3 65530 UMR_U_MINSEC2_1_1_0_S6_S3 0 65530 /end CHARACTERISTIC
/begin CHARACTERISTIC K_WNGGRGLSPKABSP64_EL "Korrekturfaktor, wenn gemessene Schleifzeit zu gross (oberhalb der Toleranz) bei Regelung KAB" VALUE 0x26DD0E kw_ui16_S6_S3 65530 UMR_U_MINSEC2_1_1_0_S6_S3 0 65530 /end CHARACTERISTIC
/begin CHARACTERISTIC K_WNGKLGLSPKZUSP64 "Korrekturfaktor, wenn gemessene Schleifzeit zu klein (unterhalb der Toleranz) bei Regelung KZU" VALUE 0x26DD10 kw_ui16_S6_S3 65530 UMR_U_MINSEC2_1_1_0_S6_S3 0 65530 /end CHARACTERISTIC
/begin CHARACTERISTIC K_WNGKLGLSPKZUSP64_EL "Korrekturfaktor, wenn gemessene Schleifzeit zu klein (unterhalb der Toleranz) bei Regelung KZU" VALUE 0x26DD12 kw_ui16_S6_S3 65530 UMR_U_MINSEC2_1_1_0_S6_S3 0 65530 /end CHARACTERISTIC
/begin CHARACTERISTIC K_WNGKLGLSPKABSP64 "Korrekturfaktor, wenn gemessene Schleifzeit zu klein (unterhalb der Toleranz) bei Regelung KAB" VALUE 0x26DD14 kw_ui16_S6_S3 65530 UMR_U_MINSEC2_1_1_0_S6_S3 0 65530 /end CHARACTERISTIC
/begin CHARACTERISTIC K_WNGKLGLSPKABSP64_EL "Korrekturfaktor, wenn gemessene Schleifzeit zu klein (unterhalb der Toleranz) bei Regelung KAB" VALUE 0x26DD16 kw_ui16_S6_S3 65530 UMR_U_MINSEC2_1_1_0_S6_S3 0 65530 /end CHARACTERISTIC
/begin CHARACTERISTIC KI_GLSKABSP64 "Integralfaktor PID-Regler GLS" VALUE 0x26DD18 kw_ui16_S6_S3 10000 UMR_MBARMINSEC_10MSEC_1_1_0_S6_S3 0 10000 /end CHARACTERISTIC
/begin CHARACTERISTIC KI_GLSKABSP64_EL "Integralfaktor PID-Regler GLS" VALUE 0x26DD1A kw_ui16_S6_S3 10000 UMR_MBARMINSEC_10MSEC_1_1_0_S6_S3 0 10000 /end CHARACTERISTIC
/begin CHARACTERISTIC KP_GLSKABSP64 "Proportionalfaktor PID-Regler GLS" VALUE 0x26DD1C kw_ui16_S6_S3 10000 UMR_MBARMINSEC__1_1_0_S6_S3 0 10000 /end CHARACTERISTIC
/begin CHARACTERISTIC KP_GLSKABSP64_EL "Proportionalfaktor PID-Regler GLS" VALUE 0x26DD1E kw_ui16_S6_S3 10000 UMR_MBARMINSEC__1_1_0_S6_S3 0 10000 /end CHARACTERISTIC
/begin CHARACTERISTIC KL_TVGLSKZUCGSP64 "Verzoegerungszeit GLS-Beginn" CURVE 0x23B3D0 kl_ui8_S6_S3 2540 UMR_MSEC__10_1_0_S6_S3 0 2540
 /begin AXIS_DESCR STD_AXIS zff_atsys._.iSignale._.obj.sig_c_getr UMR_GRADC__1_1_M40_S6_S3 3 -40 150 DEPOSIT ABSOLUTE MONOTONY MON_INCREASE /end AXIS_DESCR
/end CHARACTERISTIC
/begin CHARACTERISTIC KL_POMTUMSCHKABGLSSP64 "Offset fuer p_fmin fuer Umschaltung Kab auf Kzu" CURVE 0x23B3DC kl_si16_S6_S3 6.25 UMR_BAR__1_1000_0_S6_S3 0 6.25
 /begin AXIS_DESCR STD_AXIS zff_atsys._.iSignale._.obj.sig_m_t UMR_NM__1_1_0_S6_S3 6 -400 1640 DEPOSIT ABSOLUTE MONOTONY MON_INCREASE /end AXIS_DESCR
/end CHARACTERISTIC
/begin CHARACTERISTIC KL_MPT_WNGTGLS_INITSP64 "Filterkonstante Sollgradient PT1-Filter" CURVE 0x23B3F8 kl_si16_S6_S3 0.99 UMR___1_100_0_S6_S3 0.01 1
 /begin AXIS_DESCR STD_AXIS NO_INPUT_QUANTITY UMR_U_MINSEC_10000_32767_0_S6_S3 3 -9765.92303232 9765.92303232 DEPOSIT ABSOLUTE MONOTONY MON_INCREASE /end AXIS_DESCR
/end CHARACTERISTIC
/begin CHARACTERISTIC KL_UMSCHGLSKABSP71 "Momentenschwelle zu Regelumschaltung" CURVE 0x23B408 kl_si16_S6_S3 1400 UMR_NM__1_1_0_S6_S3 -100 1300
 /begin AXIS_DESCR STD_AXIS zff_atsys._.iSignale._.obj.sig_c_getr UMR_GRADC__1_1_M40_S6_S3 4 -40 215 DEPOSIT ABSOLUTE MONOTONY MON_INCREASE /end AXIS_DESCR
/end CHARACTERISTIC
/begin CHARACTERISTIC ND_GLSRSSP71 "Drehzahlkriterium Start Regelung bei RS" VALUE 0x26DD20 kw_ui16_S6_S3 8000 UMR_U_MIN_1_1_0_S6_S3 0 8000 /end CHARACTERISTIC
/begin CHARACTERISTIC KI_GLSKZUSP71 "I-Faktor PID-Regler GLS" VALUE 0x26DD22 kw_ui16_S6_S3 10000 UMR_MBARMINSEC_10MSEC_1_1_0_S6_S3 0 10000 /end CHARACTERISTIC
/begin CHARACTERISTIC KI_GLSKZUSP71_EL "I-Faktor PID-Regler GLS" VALUE 0x26DD24 kw_ui16_S6_S3 10000 UMR_MBARMINSEC_10MSEC_1_1_0_S6_S3 0 10000 /end CHARACTERISTIC
/begin CHARACTERISTIC KP_GLSKZUSP71 "P-Faktor PID-Regler GLS" VALUE 0x26DD26 kw_ui16_S6_S3 10000 UMR_MBARMINSEC__1_1_0_S6_S3 0 10000 /end CHARACTERISTIC
/begin CHARACTERISTIC KP_GLSKZUSP71_EL "P-Faktor PID-Regler GLS" VALUE 0x26DD28 kw_ui16_S6_S3 10000 UMR_MBARMINSEC__1_1_0_S6_S3 0 10000 /end CHARACTERISTIC
/begin CHARACTERISTIC TD_STOLGLSSP71 "max. tol. Schleifzeitdifferenz GLS" VALUE 0x26E6F3 kw_ui8_S6_S3 2540 UMR_MSEC__10_1_0_S6_S3 0 2540 /end CHARACTERISTIC
/begin CHARACTERISTIC TD_STOLGLSSP71_EL "max. tol. Schleifzeitdifferenz GLS" VALUE 0x26E6F4 kw_ui8_S6_S3 2540 UMR_MSEC__10_1_0_S6_S3 0 2540 /end CHARACTERISTIC
/begin CHARACTERISTIC K_WNGGRGLSPKZUSP71 "Korrekturfaktor, wenn gemessene Schleifzeit zu gross (oberhalb der Toleranz) bei Regelung KZU" VALUE 0x26DD2A kw_ui16_S6_S3 65530 UMR_U_MINSEC2_1_1_0_S6_S3 0 65530 /end CHARACTERISTIC
/begin CHARACTERISTIC K_WNGGRGLSPKZUSP71_EL "Korrekturfaktor, wenn gemessene Schleifzeit zu gross (oberhalb der Toleranz) bei Regelung KZU" VALUE 0x26DD2C kw_ui16_S6_S3 65530 UMR_U_MINSEC2_1_1_0_S6_S3 0 65530 /end CHARACTERISTIC
/begin CHARACTERISTIC K_WNGGRGLSPKABSP71 "Korrekturfaktor, wenn gemessene Schleifzeit zu gross (oberhalb der Toleranz) bei Regelung KAB" VALUE 0x26DD2E kw_ui16_S6_S3 65530 UMR_U_MINSEC2_1_1_0_S6_S3 0 65530 /end CHARACTERISTIC
/begin CHARACTERISTIC K_WNGGRGLSPKABSP71_EL "Korrekturfaktor, wenn gemessene Schleifzeit zu gross (oberhalb der Toleranz) bei Regelung KAB" VALUE 0x26DD30 kw_ui16_S6_S3 65530 UMR_U_MINSEC2_1_1_0_S6_S3 0 65530 /end CHARACTERISTIC
/begin CHARACTERISTIC K_WNGKLGLSPKZUSP71 "Korrekturfaktor, wenn gemessene Schleifzeit zu klein (unterhalb der Toleranz) bei Regelung KZU" VALUE 0x26DD32 kw_ui16_S6_S3 65530 UMR_U_MINSEC2_1_1_0_S6_S3 0 65530 /end CHARACTERISTIC
/begin CHARACTERISTIC K_WNGKLGLSPKZUSP71_EL "Korrekturfaktor, wenn gemessene Schleifzeit zu klein (unterhalb der Toleranz) bei Regelung KZU" VALUE 0x26DD34 kw_ui16_S6_S3 65530 UMR_U_MINSEC2_1_1_0_S6_S3 0 65530 /end CHARACTERISTIC
/begin CHARACTERISTIC K_WNGKLGLSPKABSP71 "Korrekturfaktor, wenn gemessene Schleifzeit zu klein (unterhalb der Toleranz) bei Regelung KAB" VALUE 0x26DD36 kw_ui16_S6_S3 65530 UMR_U_MINSEC2_1_1_0_S6_S3 0 65530 /end CHARACTERISTIC
/begin CHARACTERISTIC K_WNGKLGLSPKABSP71_EL "Korrekturfaktor, wenn gemessene Schleifzeit zu klein (unterhalb der Toleranz) bei Regelung KAB" VALUE 0x26DD38 kw_ui16_S6_S3 65530 UMR_U_MINSEC2_1_1_0_S6_S3 0 65530 /end CHARACTERISTIC
/begin CHARACTERISTIC KI_GLSKABSP71 "Integralfaktor PID-Regler GLS" VALUE 0x26DD3A kw_ui16_S6_S3 10000 UMR_MBARMINSEC_10MSEC_1_1_0_S6_S3 0 10000 /end CHARACTERISTIC
/begin CHARACTERISTIC KI_GLSKABSP71_EL "Integralfaktor PID-Regler GLS" VALUE 0x26DD3C kw_ui16_S6_S3 10000 UMR_MBARMINSEC_10MSEC_1_1_0_S6_S3 0 10000 /end CHARACTERISTIC
/begin CHARACTERISTIC KP_GLSKABSP71 "Proportionalfaktor PID-Regler GLS" VALUE 0x26DD3E kw_ui16_S6_S3 10000 UMR_MBARMINSEC__1_1_0_S6_S3 0 10000 /end CHARACTERISTIC
/begin CHARACTERISTIC KP_GLSKABSP71_EL "Proportionalfaktor PID-Regler GLS" VALUE 0x26DD40 kw_ui16_S6_S3 10000 UMR_MBARMINSEC__1_1_0_S6_S3 0 10000 /end CHARACTERISTIC
/begin CHARACTERISTIC KL_TVGLSKZUCGSP71 "Verzoegerungszeit GLS-Beginn" CURVE 0x23B41C kl_ui8_S6_S3 2540 UMR_MSEC__10_1_0_S6_S3 0 2540
 /begin AXIS_DESCR STD_AXIS zff_atsys._.iSignale._.obj.sig_c_getr UMR_GRADC__1_1_M40_S6_S3 3 -40 150 DEPOSIT ABSOLUTE MONOTONY MON_INCREASE /end AXIS_DESCR
/end CHARACTERISTIC
/begin CHARACTERISTIC KL_POMTUMSCHKABGLSSP71 "Offset fuer p_fmin fuer Umschaltung Kab auf Kzu" CURVE 0x23B428 kl_si16_S6_S3 6.25 UMR_BAR__1_1000_0_S6_S3 0 6.25
 /begin AXIS_DESCR STD_AXIS zff_atsys._.iSignale._.obj.sig_m_t UMR_NM__1_1_0_S6_S3 6 -400 1640 DEPOSIT ABSOLUTE MONOTONY MON_INCREASE /end AXIS_DESCR
/end CHARACTERISTIC
/begin CHARACTERISTIC KL_MPT_WNGTGLS_INITSP71 "Filterkonstante Sollgradient PT1-Filter" CURVE 0x23B444 kl_si16_S6_S3 0.99 UMR___1_100_0_S6_S3 0.01 1
 /begin AXIS_DESCR STD_AXIS NO_INPUT_QUANTITY UMR_U_MINSEC_10000_32767_0_S6_S3 3 -9765.92303232 9765.92303232 DEPOSIT ABSOLUTE MONOTONY MON_INCREASE /end AXIS_DESCR
/end CHARACTERISTIC
/begin CHARACTERISTIC KL_UMSCHGLSKABSP75 "Momentenschwelle zu Regelumschaltung" CURVE 0x23B454 kl_si16_S6_S3 1400 UMR_NM__1_1_0_S6_S3 -100 1300
 /begin AXIS_DESCR STD_AXIS zff_atsys._.iSignale._.obj.sig_c_getr UMR_GRADC__1_1_M40_S6_S3 4 -40 215 DEPOSIT ABSOLUTE MONOTONY MON_INCREASE /end AXIS_DESCR
/end CHARACTERISTIC
/begin CHARACTERISTIC ND_GLSRSSP75 "Drehzahlkriterium Start Regelung bei RS" VALUE 0x26DD42 kw_ui16_S6_S3 8000 UMR_U_MIN_1_1_0_S6_S3 0 8000 /end CHARACTERISTIC
/begin CHARACTERISTIC KI_GLSKZUSP75 "I-Faktor PID-Regler GLS" VALUE 0x26DD44 kw_ui16_S6_S3 10000 UMR_MBARMINSEC_10MSEC_1_1_0_S6_S3 0 10000 /end CHARACTERISTIC
/begin CHARACTERISTIC KI_GLSKZUSP75_EL "I-Faktor PID-Regler GLS" VALUE 0x26DD46 kw_ui16_S6_S3 10000 UMR_MBARMINSEC_10MSEC_1_1_0_S6_S3 0 10000 /end CHARACTERISTIC
/begin CHARACTERISTIC KP_GLSKZUSP75 "P-Faktor PID-Regler GLS" VALUE 0x26DD48 kw_ui16_S6_S3 10000 UMR_MBARMINSEC__1_1_0_S6_S3 0 10000 /end CHARACTERISTIC
/begin CHARACTERISTIC KP_GLSKZUSP75_EL "P-Faktor PID-Regler GLS" VALUE 0x26DD4A kw_ui16_S6_S3 10000 UMR_MBARMINSEC__1_1_0_S6_S3 0 10000 /end CHARACTERISTIC
/begin CHARACTERISTIC TD_STOLGLSSP75 "max. tol. Schleifzeitdifferenz GLS" VALUE 0x26E6F5 kw_ui8_S6_S3 2540 UMR_MSEC__10_1_0_S6_S3 0 2540 /end CHARACTERISTIC
/begin CHARACTERISTIC TD_STOLGLSSP75_EL "max. tol. Schleifzeitdifferenz GLS" VALUE 0x26E6F6 kw_ui8_S6_S3 2540 UMR_MSEC__10_1_0_S6_S3 0 2540 /end CHARACTERISTIC
/begin CHARACTERISTIC K_WNGGRGLSPKZUSP75 "Korrekturfaktor, wenn gemessene Schleifzeit zu gross (oberhalb der Toleranz) bei Regelung KZU" VALUE 0x26DD4C kw_ui16_S6_S3 65530 UMR_U_MINSEC2_1_1_0_S6_S3 0 65530 /end CHARACTERISTIC
/begin CHARACTERISTIC K_WNGGRGLSPKZUSP75_EL "Korrekturfaktor, wenn gemessene Schleifzeit zu gross (oberhalb der Toleranz) bei Regelung KZU" VALUE 0x26DD4E kw_ui16_S6_S3 65530 UMR_U_MINSEC2_1_1_0_S6_S3 0 65530 /end CHARACTERISTIC
/begin CHARACTERISTIC K_WNGGRGLSPKABSP75 "Korrekturfaktor, wenn gemessene Schleifzeit zu gross (oberhalb der Toleranz) bei Regelung KAB" VALUE 0x26DD50 kw_ui16_S6_S3 65530 UMR_U_MINSEC2_1_1_0_S6_S3 0 65530 /end CHARACTERISTIC
/begin CHARACTERISTIC K_WNGGRGLSPKABSP75_EL "Korrekturfaktor, wenn gemessene Schleifzeit zu gross (oberhalb der Toleranz) bei Regelung KAB" VALUE 0x26DD52 kw_ui16_S6_S3 65530 UMR_U_MINSEC2_1_1_0_S6_S3 0 65530 /end CHARACTERISTIC
/begin CHARACTERISTIC K_WNGKLGLSPKZUSP75 "Korrekturfaktor, wenn gemessene Schleifzeit zu klein (unterhalb der Toleranz) bei Regelung KZU" VALUE 0x26DD54 kw_ui16_S6_S3 65530 UMR_U_MINSEC2_1_1_0_S6_S3 0 65530 /end CHARACTERISTIC
/begin CHARACTERISTIC K_WNGKLGLSPKZUSP75_EL "Korrekturfaktor, wenn gemessene Schleifzeit zu klein (unterhalb der Toleranz) bei Regelung KZU" VALUE 0x26DD56 kw_ui16_S6_S3 65530 UMR_U_MINSEC2_1_1_0_S6_S3 0 65530 /end CHARACTERISTIC
/begin CHARACTERISTIC K_WNGKLGLSPKABSP75 "Korrekturfaktor, wenn gemessene Schleifzeit zu klein (unterhalb der Toleranz) bei Regelung KAB" VALUE 0x26DD58 kw_ui16_S6_S3 65530 UMR_U_MINSEC2_1_1_0_S6_S3 0 65530 /end CHARACTERISTIC
/begin CHARACTERISTIC K_WNGKLGLSPKABSP75_EL "Korrekturfaktor, wenn gemessene Schleifzeit zu klein (unterhalb der Toleranz) bei Regelung KAB" VALUE 0x26DD5A kw_ui16_S6_S3 65530 UMR_U_MINSEC2_1_1_0_S6_S3 0 65530 /end CHARACTERISTIC
/begin CHARACTERISTIC KI_GLSKABSP75 "Integralfaktor PID-Regler GLS" VALUE 0x26DD5C kw_ui16_S6_S3 10000 UMR_MBARMINSEC_10MSEC_1_1_0_S6_S3 0 10000 /end CHARACTERISTIC
/begin CHARACTERISTIC KI_GLSKABSP75_EL "Integralfaktor PID-Regler GLS" VALUE 0x26DD5E kw_ui16_S6_S3 10000 UMR_MBARMINSEC_10MSEC_1_1_0_S6_S3 0 10000 /end CHARACTERISTIC
/begin CHARACTERISTIC KP_GLSKABSP75 "Proportionalfaktor PID-Regler GLS" VALUE 0x26DD60 kw_ui16_S6_S3 10000 UMR_MBARMINSEC__1_1_0_S6_S3 0 10000 /end CHARACTERISTIC
/begin CHARACTERISTIC KP_GLSKABSP75_EL "Proportionalfaktor PID-Regler GLS" VALUE 0x26DD62 kw_ui16_S6_S3 10000 UMR_MBARMINSEC__1_1_0_S6_S3 0 10000 /end CHARACTERISTIC
/begin CHARACTERISTIC KL_TVGLSKZUCGSP75 "Verzoegerungszeit GLS-Beginn" CURVE 0x23B468 kl_ui8_S6_S3 2540 UMR_MSEC__10_1_0_S6_S3 0 2540
 /begin AXIS_DESCR STD_AXIS zff_atsys._.iSignale._.obj.sig_c_getr UMR_GRADC__1_1_M40_S6_S3 3 -40 150 DEPOSIT ABSOLUTE MONOTONY MON_INCREASE /end AXIS_DESCR
/end CHARACTERISTIC
/begin CHARACTERISTIC KL_POMTUMSCHKABGLSSP75 "Offset fuer p_fmin fuer Umschaltung Kab auf Kzu" CURVE 0x23B474 kl_si16_S6_S3 6.25 UMR_BAR__1_1000_0_S6_S3 0 6.25
 /begin AXIS_DESCR STD_AXIS zff_atsys._.iSignale._.obj.sig_m_t UMR_NM__1_1_0_S6_S3 6 -400 1640 DEPOSIT ABSOLUTE MONOTONY MON_INCREASE /end AXIS_DESCR
/end CHARACTERISTIC
/begin CHARACTERISTIC KL_MPT_WNGTGLS_INITSP75 "Filterkonstante Sollgradient PT1-Filter" CURVE 0x23B490 kl_si16_S6_S3 0.99 UMR___1_100_0_S6_S3 0.01 1
 /begin AXIS_DESCR STD_AXIS NO_INPUT_QUANTITY UMR_U_MINSEC_10000_32767_0_S6_S3 3 -9765.92303232 9765.92303232 DEPOSIT ABSOLUTE MONOTONY MON_INCREASE /end AXIS_DESCR
/end CHARACTERISTIC
/begin CHARACTERISTIC KL_UMSCHGLSKABSP82 "Momentenschwelle zu Regelumschaltung" CURVE 0x23B4A0 kl_si16_S6_S3 1400 UMR_NM__1_1_0_S6_S3 -100 1300
 /begin AXIS_DESCR STD_AXIS zff_atsys._.iSignale._.obj.sig_c_getr UMR_GRADC__1_1_M40_S6_S3 4 -40 215 DEPOSIT ABSOLUTE MONOTONY MON_INCREASE /end AXIS_DESCR
/end CHARACTERISTIC
/begin CHARACTERISTIC ND_GLSRSSP82 "Drehzahlkriterium Start Regelung bei RS" VALUE 0x26DD64 kw_ui16_S6_S3 8000 UMR_U_MIN_1_1_0_S6_S3 0 8000 /end CHARACTERISTIC
/begin CHARACTERISTIC KI_GLSKZUSP82 "I-Faktor PID-Regler GLS" VALUE 0x26DD66 kw_ui16_S6_S3 10000 UMR_MBARMINSEC_10MSEC_1_1_0_S6_S3 0 10000 /end CHARACTERISTIC
/begin CHARACTERISTIC KI_GLSKZUSP82_EL "I-Faktor PID-Regler GLS" VALUE 0x26DD68 kw_ui16_S6_S3 10000 UMR_MBARMINSEC_10MSEC_1_1_0_S6_S3 0 10000 /end CHARACTERISTIC
/begin CHARACTERISTIC KP_GLSKZUSP82 "P-Faktor PID-Regler GLS" VALUE 0x26DD6A kw_ui16_S6_S3 10000 UMR_MBARMINSEC__1_1_0_S6_S3 0 10000 /end CHARACTERISTIC
/begin CHARACTERISTIC KP_GLSKZUSP82_EL "P-Faktor PID-Regler GLS" VALUE 0x26DD6C kw_ui16_S6_S3 10000 UMR_MBARMINSEC__1_1_0_S6_S3 0 10000 /end CHARACTERISTIC
/begin CHARACTERISTIC TD_STOLGLSSP82 "max. tol. Schleifzeitdifferenz GLS" VALUE 0x26E6F7 kw_ui8_S6_S3 2540 UMR_MSEC__10_1_0_S6_S3 0 2540 /end CHARACTERISTIC
/begin CHARACTERISTIC TD_STOLGLSSP82_EL "max. tol. Schleifzeitdifferenz GLS" VALUE 0x26E6F8 kw_ui8_S6_S3 2540 UMR_MSEC__10_1_0_S6_S3 0 2540 /end CHARACTERISTIC
/begin CHARACTERISTIC K_WNGGRGLSPKZUSP82 "Korrekturfaktor, wenn gemessene Schleifzeit zu gross (oberhalb der Toleranz) bei Regelung KZU" VALUE 0x26DD6E kw_ui16_S6_S3 65530 UMR_U_MINSEC2_1_1_0_S6_S3 0 65530 /end CHARACTERISTIC
/begin CHARACTERISTIC K_WNGGRGLSPKZUSP82_EL "Korrekturfaktor, wenn gemessene Schleifzeit zu gross (oberhalb der Toleranz) bei Regelung KZU" VALUE 0x26DD70 kw_ui16_S6_S3 65530 UMR_U_MINSEC2_1_1_0_S6_S3 0 65530 /end CHARACTERISTIC
/begin CHARACTERISTIC K_WNGGRGLSPKABSP82 "Korrekturfaktor, wenn gemessene Schleifzeit zu gross (oberhalb der Toleranz) bei Regelung KAB" VALUE 0x26DD72 kw_ui16_S6_S3 65530 UMR_U_MINSEC2_1_1_0_S6_S3 0 65530 /end CHARACTERISTIC
/begin CHARACTERISTIC K_WNGGRGLSPKABSP82_EL "Korrekturfaktor, wenn gemessene Schleifzeit zu gross (oberhalb der Toleranz) bei Regelung KAB" VALUE 0x26DD74 kw_ui16_S6_S3 65530 UMR_U_MINSEC2_1_1_0_S6_S3 0 65530 /end CHARACTERISTIC
/begin CHARACTERISTIC K_WNGKLGLSPKZUSP82 "Korrekturfaktor, wenn gemessene Schleifzeit zu klein (unterhalb der Toleranz) bei Regelung KZU" VALUE 0x26DD76 kw_ui16_S6_S3 65530 UMR_U_MINSEC2_1_1_0_S6_S3 0 65530 /end CHARACTERISTIC
/begin CHARACTERISTIC K_WNGKLGLSPKZUSP82_EL "Korrekturfaktor, wenn gemessene Schleifzeit zu klein (unterhalb der Toleranz) bei Regelung KZU" VALUE 0x26DD78 kw_ui16_S6_S3 65530 UMR_U_MINSEC2_1_1_0_S6_S3 0 65530 /end CHARACTERISTIC
/begin CHARACTERISTIC K_WNGKLGLSPKABSP82 "Korrekturfaktor, wenn gemessene Schleifzeit zu klein (unterhalb der Toleranz) bei Regelung KAB" VALUE 0x26DD7A kw_ui16_S6_S3 65530 UMR_U_MINSEC2_1_1_0_S6_S3 0 65530 /end CHARACTERISTIC
/begin CHARACTERISTIC K_WNGKLGLSPKABSP82_EL "Korrekturfaktor, wenn gemessene Schleifzeit zu klein (unterhalb der Toleranz) bei Regelung KAB" VALUE 0x26DD7C kw_ui16_S6_S3 65530 UMR_U_MINSEC2_1_1_0_S6_S3 0 65530 /end CHARACTERISTIC
/begin CHARACTERISTIC KI_GLSKABSP82 "Integralfaktor PID-Regler GLS" VALUE 0x26DD7E kw_ui16_S6_S3 10000 UMR_MBARMINSEC_10MSEC_1_1_0_S6_S3 0 10000 /end CHARACTERISTIC
/begin CHARACTERISTIC KI_GLSKABSP82_EL "Integralfaktor PID-Regler GLS" VALUE 0x26DD80 kw_ui16_S6_S3 10000 UMR_MBARMINSEC_10MSEC_1_1_0_S6_S3 0 10000 /end CHARACTERISTIC
/begin CHARACTERISTIC KP_GLSKABSP82 "Proportionalfaktor PID-Regler GLS" VALUE 0x26DD82 kw_ui16_S6_S3 10000 UMR_MBARMINSEC__1_1_0_S6_S3 0 10000 /end CHARACTERISTIC
/begin CHARACTERISTIC KP_GLSKABSP82_EL "Proportionalfaktor PID-Regler GLS" VALUE 0x26DD84 kw_ui16_S6_S3 10000 UMR_MBARMINSEC__1_1_0_S6_S3 0 10000 /end CHARACTERISTIC
/begin CHARACTERISTIC KL_TVGLSKZUCGSP82 "Verzoegerungszeit GLS-Beginn" CURVE 0x23B4B4 kl_ui8_S6_S3 2540 UMR_MSEC__10_1_0_S6_S3 0 2540
 /begin AXIS_DESCR STD_AXIS zff_atsys._.iSignale._.obj.sig_c_getr UMR_GRADC__1_1_M40_S6_S3 3 -40 150 DEPOSIT ABSOLUTE MONOTONY MON_INCREASE /end AXIS_DESCR
/end CHARACTERISTIC
/begin CHARACTERISTIC KL_POMTUMSCHKABGLSSP82 "Offset fuer p_fmin fuer Umschaltung Kab auf Kzu" CURVE 0x23B4C0 kl_si16_S6_S3 6.25 UMR_BAR__1_1000_0_S6_S3 0 6.25
 /begin AXIS_DESCR STD_AXIS zff_atsys._.iSignale._.obj.sig_m_t UMR_NM__1_1_0_S6_S3 6 -400 1640 DEPOSIT ABSOLUTE MONOTONY MON_INCREASE /end AXIS_DESCR
/end CHARACTERISTIC
/begin CHARACTERISTIC KL_MPT_WNGTGLS_INITSP82 "Filterkonstante Sollgradient PT1-Filter" CURVE 0x23B4DC kl_si16_S6_S3 0.99 UMR___1_100_0_S6_S3 0.01 1
 /begin AXIS_DESCR STD_AXIS NO_INPUT_QUANTITY UMR_U_MINSEC_10000_32767_0_S6_S3 3 -9765.92303232 9765.92303232 DEPOSIT ABSOLUTE MONOTONY MON_INCREASE /end AXIS_DESCR
/end CHARACTERISTIC
/begin CHARACTERISTIC KL_UMSCHGLSKABSP84 "Momentenschwelle zu Regelumschaltung" CURVE 0x23B4EC kl_si16_S6_S3 1400 UMR_NM__1_1_0_S6_S3 -100 1300
 /begin AXIS_DESCR STD_AXIS zff_atsys._.iSignale._.obj.sig_c_getr UMR_GRADC__1_1_M40_S6_S3 4 -40 215 DEPOSIT ABSOLUTE MONOTONY MON_INCREASE /end AXIS_DESCR
/end CHARACTERISTIC
/begin CHARACTERISTIC ND_GLSRSSP84 "Drehzahlkriterium Start Regelung bei RS" VALUE 0x26DD86 kw_ui16_S6_S3 8000 UMR_U_MIN_1_1_0_S6_S3 0 8000 /end CHARACTERISTIC
/begin CHARACTERISTIC KI_GLSKZUSP84 "I-Faktor PID-Regler GLS" VALUE 0x26DD88 kw_ui16_S6_S3 10000 UMR_MBARMINSEC_10MSEC_1_1_0_S6_S3 0 10000 /end CHARACTERISTIC
/begin CHARACTERISTIC KI_GLSKZUSP84_EL "I-Faktor PID-Regler GLS" VALUE 0x26DD8A kw_ui16_S6_S3 10000 UMR_MBARMINSEC_10MSEC_1_1_0_S6_S3 0 10000 /end CHARACTERISTIC
/begin CHARACTERISTIC KP_GLSKZUSP84 "P-Faktor PID-Regler GLS" VALUE 0x26DD8C kw_ui16_S6_S3 10000 UMR_MBARMINSEC__1_1_0_S6_S3 0 10000 /end CHARACTERISTIC
/begin CHARACTERISTIC KP_GLSKZUSP84_EL "P-Faktor PID-Regler GLS" VALUE 0x26DD8E kw_ui16_S6_S3 10000 UMR_MBARMINSEC__1_1_0_S6_S3 0 10000 /end CHARACTERISTIC
/begin CHARACTERISTIC TD_STOLGLSSP84 "max. tol. Schleifzeitdifferenz GLS" VALUE 0x26E6F9 kw_ui8_S6_S3 2540 UMR_MSEC__10_1_0_S6_S3 0 2540 /end CHARACTERISTIC
/begin CHARACTERISTIC TD_STOLGLSSP84_EL "max. tol. Schleifzeitdifferenz GLS" VALUE 0x26E6FA kw_ui8_S6_S3 2540 UMR_MSEC__10_1_0_S6_S3 0 2540 /end CHARACTERISTIC
/begin CHARACTERISTIC K_WNGGRGLSPKZUSP84 "Korrekturfaktor, wenn gemessene Schleifzeit zu gross (oberhalb der Toleranz) bei Regelung KZU" VALUE 0x26DD90 kw_ui16_S6_S3 65530 UMR_U_MINSEC2_1_1_0_S6_S3 0 65530 /end CHARACTERISTIC
/begin CHARACTERISTIC K_WNGGRGLSPKZUSP84_EL "Korrekturfaktor, wenn gemessene Schleifzeit zu gross (oberhalb der Toleranz) bei Regelung KZU" VALUE 0x26DD92 kw_ui16_S6_S3 65530 UMR_U_MINSEC2_1_1_0_S6_S3 0 65530 /end CHARACTERISTIC
/begin CHARACTERISTIC K_WNGGRGLSPKABSP84 "Korrekturfaktor, wenn gemessene Schleifzeit zu gross (oberhalb der Toleranz) bei Regelung KAB" VALUE 0x26DD94 kw_ui16_S6_S3 65530 UMR_U_MINSEC2_1_1_0_S6_S3 0 65530 /end CHARACTERISTIC
/begin CHARACTERISTIC K_WNGGRGLSPKABSP84_EL "Korrekturfaktor, wenn gemessene Schleifzeit zu gross (oberhalb der Toleranz) bei Regelung KAB" VALUE 0x26DD96 kw_ui16_S6_S3 65530 UMR_U_MINSEC2_1_1_0_S6_S3 0 65530 /end CHARACTERISTIC
/begin CHARACTERISTIC K_WNGKLGLSPKZUSP84 "Korrekturfaktor, wenn gemessene Schleifzeit zu klein (unterhalb der Toleranz) bei Regelung KZU" VALUE 0x26DD98 kw_ui16_S6_S3 65530 UMR_U_MINSEC2_1_1_0_S6_S3 0 65530 /end CHARACTERISTIC
/begin CHARACTERISTIC K_WNGKLGLSPKZUSP84_EL "Korrekturfaktor, wenn gemessene Schleifzeit zu klein (unterhalb der Toleranz) bei Regelung KZU" VALUE 0x26DD9A kw_ui16_S6_S3 65530 UMR_U_MINSEC2_1_1_0_S6_S3 0 65530 /end CHARACTERISTIC
/begin CHARACTERISTIC K_WNGKLGLSPKABSP84 "Korrekturfaktor, wenn gemessene Schleifzeit zu klein (unterhalb der Toleranz) bei Regelung KAB" VALUE 0x26DD9C kw_ui16_S6_S3 65530 UMR_U_MINSEC2_1_1_0_S6_S3 0 65530 /end CHARACTERISTIC
/begin CHARACTERISTIC K_WNGKLGLSPKABSP84_EL "Korrekturfaktor, wenn gemessene Schleifzeit zu klein (unterhalb der Toleranz) bei Regelung KAB" VALUE 0x26DD9E kw_ui16_S6_S3 65530 UMR_U_MINSEC2_1_1_0_S6_S3 0 65530 /end CHARACTERISTIC
/begin CHARACTERISTIC KI_GLSKABSP84 "Integralfaktor PID-Regler GLS" VALUE 0x26DDA0 kw_ui16_S6_S3 10000 UMR_MBARMINSEC_10MSEC_1_1_0_S6_S3 0 10000 /end CHARACTERISTIC
/begin CHARACTERISTIC KI_GLSKABSP84_EL "Integralfaktor PID-Regler GLS" VALUE 0x26DDA2 kw_ui16_S6_S3 10000 UMR_MBARMINSEC_10MSEC_1_1_0_S6_S3 0 10000 /end CHARACTERISTIC
/begin CHARACTERISTIC KP_GLSKABSP84 "Proportionalfaktor PID-Regler GLS" VALUE 0x26DDA4 kw_ui16_S6_S3 10000 UMR_MBARMINSEC__1_1_0_S6_S3 0 10000 /end CHARACTERISTIC
/begin CHARACTERISTIC KP_GLSKABSP84_EL "Proportionalfaktor PID-Regler GLS" VALUE 0x26DDA6 kw_ui16_S6_S3 10000 UMR_MBARMINSEC__1_1_0_S6_S3 0 10000 /end CHARACTERISTIC
/begin CHARACTERISTIC KL_TVGLSKZUCGSP84 "Verzoegerungszeit GLS-Beginn" CURVE 0x23B500 kl_ui8_S6_S3 2540 UMR_MSEC__10_1_0_S6_S3 0 2540
 /begin AXIS_DESCR STD_AXIS zff_atsys._.iSignale._.obj.sig_c_getr UMR_GRADC__1_1_M40_S6_S3 3 -40 150 DEPOSIT ABSOLUTE MONOTONY MON_INCREASE /end AXIS_DESCR
/end CHARACTERISTIC
/begin CHARACTERISTIC KL_POMTUMSCHKABGLSSP84 "Offset fuer p_fmin fuer Umschaltung Kab auf Kzu" CURVE 0x23B50C kl_si16_S6_S3 6.25 UMR_BAR__1_1000_0_S6_S3 0 6.25
 /begin AXIS_DESCR STD_AXIS zff_atsys._.iSignale._.obj.sig_m_t UMR_NM__1_1_0_S6_S3 6 -400 1640 DEPOSIT ABSOLUTE MONOTONY MON_INCREASE /end AXIS_DESCR
/end CHARACTERISTIC
/begin CHARACTERISTIC KL_MPT_WNGTGLS_INITSP84 "Filterkonstante Sollgradient PT1-Filter" CURVE 0x23B528 kl_si16_S6_S3 0.99 UMR___1_100_0_S6_S3 0.01 1
 /begin AXIS_DESCR STD_AXIS NO_INPUT_QUANTITY UMR_U_MINSEC_10000_32767_0_S6_S3 3 -9765.92303232 9765.92303232 DEPOSIT ABSOLUTE MONOTONY MON_INCREASE /end AXIS_DESCR
/end CHARACTERISTIC
/begin CHARACTERISTIC KL_UMSCHGLSKABSP86 "Momentenschwelle zu Regelumschaltung" CURVE 0x23B538 kl_si16_S6_S3 1400 UMR_NM__1_1_0_S6_S3 -100 1300
 /begin AXIS_DESCR STD_AXIS zff_atsys._.iSignale._.obj.sig_c_getr UMR_GRADC__1_1_M40_S6_S3 4 -40 215 DEPOSIT ABSOLUTE MONOTONY MON_INCREASE /end AXIS_DESCR
/end CHARACTERISTIC
/begin CHARACTERISTIC ND_GLSRSSP86 "Drehzahlkriterium Start Regelung bei RS" VALUE 0x26DDA8 kw_ui16_S6_S3 8000 UMR_U_MIN_1_1_0_S6_S3 0 8000 /end CHARACTERISTIC
/begin CHARACTERISTIC KI_GLSKZUSP86 "I-Faktor PID-Regler GLS" VALUE 0x26DDAA kw_ui16_S6_S3 10000 UMR_MBARMINSEC_10MSEC_1_1_0_S6_S3 0 10000 /end CHARACTERISTIC
/begin CHARACTERISTIC KI_GLSKZUSP86_EL "I-Faktor PID-Regler GLS" VALUE 0x26DDAC kw_ui16_S6_S3 10000 UMR_MBARMINSEC_10MSEC_1_1_0_S6_S3 0 10000 /end CHARACTERISTIC
/begin CHARACTERISTIC KP_GLSKZUSP86 "P-Faktor PID-Regler GLS" VALUE 0x26DDAE kw_ui16_S6_S3 10000 UMR_MBARMINSEC__1_1_0_S6_S3 0 10000 /end CHARACTERISTIC
/begin CHARACTERISTIC KP_GLSKZUSP86_EL "P-Faktor PID-Regler GLS" VALUE 0x26DDB0 kw_ui16_S6_S3 10000 UMR_MBARMINSEC__1_1_0_S6_S3 0 10000 /end CHARACTERISTIC
/begin CHARACTERISTIC TD_STOLGLSSP86 "max. tol. Schleifzeitdifferenz GLS" VALUE 0x26E6FB kw_ui8_S6_S3 2540 UMR_MSEC__10_1_0_S6_S3 0 2540 /end CHARACTERISTIC
/begin CHARACTERISTIC TD_STOLGLSSP86_EL "max. tol. Schleifzeitdifferenz GLS" VALUE 0x26E6FC kw_ui8_S6_S3 2540 UMR_MSEC__10_1_0_S6_S3 0 2540 /end CHARACTERISTIC
/begin CHARACTERISTIC K_WNGGRGLSPKZUSP86 "Korrekturfaktor, wenn gemessene Schleifzeit zu gross (oberhalb der Toleranz) bei Regelung KZU" VALUE 0x26DDB2 kw_ui16_S6_S3 65530 UMR_U_MINSEC2_1_1_0_S6_S3 0 65530 /end CHARACTERISTIC
/begin CHARACTERISTIC K_WNGGRGLSPKZUSP86_EL "Korrekturfaktor, wenn gemessene Schleifzeit zu gross (oberhalb der Toleranz) bei Regelung KZU" VALUE 0x26DDB4 kw_ui16_S6_S3 65530 UMR_U_MINSEC2_1_1_0_S6_S3 0 65530 /end CHARACTERISTIC
/begin CHARACTERISTIC K_WNGGRGLSPKABSP86 "Korrekturfaktor, wenn gemessene Schleifzeit zu gross (oberhalb der Toleranz) bei Regelung KAB" VALUE 0x26DDB6 kw_ui16_S6_S3 65530 UMR_U_MINSEC2_1_1_0_S6_S3 0 65530 /end CHARACTERISTIC
/begin CHARACTERISTIC K_WNGGRGLSPKABSP86_EL "Korrekturfaktor, wenn gemessene Schleifzeit zu gross (oberhalb der Toleranz) bei Regelung KAB" VALUE 0x26DDB8 kw_ui16_S6_S3 65530 UMR_U_MINSEC2_1_1_0_S6_S3 0 65530 /end CHARACTERISTIC
/begin CHARACTERISTIC K_WNGKLGLSPKZUSP86 "Korrekturfaktor, wenn gemessene Schleifzeit zu klein (unterhalb der Toleranz) bei Regelung KZU" VALUE 0x26DDBA kw_ui16_S6_S3 65530 UMR_U_MINSEC2_1_1_0_S6_S3 0 65530 /end CHARACTERISTIC
/begin CHARACTERISTIC K_WNGKLGLSPKZUSP86_EL "Korrekturfaktor, wenn gemessene Schleifzeit zu klein (unterhalb der Toleranz) bei Regelung KZU" VALUE 0x26DDBC kw_ui16_S6_S3 65530 UMR_U_MINSEC2_1_1_0_S6_S3 0 65530 /end CHARACTERISTIC
/begin CHARACTERISTIC K_WNGKLGLSPKABSP86 "Korrekturfaktor, wenn gemessene Schleifzeit zu klein (unterhalb der Toleranz) bei Regelung KAB" VALUE 0x26DDBE kw_ui16_S6_S3 65530 UMR_U_MINSEC2_1_1_0_S6_S3 0 65530 /end CHARACTERISTIC
/begin CHARACTERISTIC K_WNGKLGLSPKABSP86_EL "Korrekturfaktor, wenn gemessene Schleifzeit zu klein (unterhalb der Toleranz) bei Regelung KAB" VALUE 0x26DDC0 kw_ui16_S6_S3 65530 UMR_U_MINSEC2_1_1_0_S6_S3 0 65530 /end CHARACTERISTIC
/begin CHARACTERISTIC KI_GLSKABSP86 "Integralfaktor PID-Regler GLS" VALUE 0x26DDC2 kw_ui16_S6_S3 10000 UMR_MBARMINSEC_10MSEC_1_1_0_S6_S3 0 10000 /end CHARACTERISTIC
/begin CHARACTERISTIC KI_GLSKABSP86_EL "Integralfaktor PID-Regler GLS" VALUE 0x26DDC4 kw_ui16_S6_S3 10000 UMR_MBARMINSEC_10MSEC_1_1_0_S6_S3 0 10000 /end CHARACTERISTIC
/begin CHARACTERISTIC KP_GLSKABSP86 "Proportionalfaktor PID-Regler GLS" VALUE 0x26DDC6 kw_ui16_S6_S3 10000 UMR_MBARMINSEC__1_1_0_S6_S3 0 10000 /end CHARACTERISTIC
/begin CHARACTERISTIC KP_GLSKABSP86_EL "Proportionalfaktor PID-Regler GLS" VALUE 0x26DDC8 kw_ui16_S6_S3 10000 UMR_MBARMINSEC__1_1_0_S6_S3 0 10000 /end CHARACTERISTIC
/begin CHARACTERISTIC KL_TVGLSKZUCGSP86 "Verzoegerungszeit GLS-Beginn" CURVE 0x23B54C kl_ui8_S6_S3 2540 UMR_MSEC__10_1_0_S6_S3 0 2540
 /begin AXIS_DESCR STD_AXIS zff_atsys._.iSignale._.obj.sig_c_getr UMR_GRADC__1_1_M40_S6_S3 3 -40 150 DEPOSIT ABSOLUTE MONOTONY MON_INCREASE /end AXIS_DESCR
/end CHARACTERISTIC
/begin CHARACTERISTIC KL_POMTUMSCHKABGLSSP86 "Offset fuer p_fmin fuer Umschaltung Kab auf Kzu" CURVE 0x23B558 kl_si16_S6_S3 6.25 UMR_BAR__1_1000_0_S6_S3 0 6.25
 /begin AXIS_DESCR STD_AXIS zff_atsys._.iSignale._.obj.sig_m_t UMR_NM__1_1_0_S6_S3 6 -400 1640 DEPOSIT ABSOLUTE MONOTONY MON_INCREASE /end AXIS_DESCR
/end CHARACTERISTIC
/begin CHARACTERISTIC KL_MPT_WNGTGLS_INITSP86 "Filterkonstante Sollgradient PT1-Filter" CURVE 0x23B574 kl_si16_S6_S3 0.99 UMR___1_100_0_S6_S3 0.01 1
 /begin AXIS_DESCR STD_AXIS NO_INPUT_QUANTITY UMR_U_MINSEC_10000_32767_0_S6_S3 3 -9765.92303232 9765.92303232 DEPOSIT ABSOLUTE MONOTONY MON_INCREASE /end AXIS_DESCR
/end CHARACTERISTIC
/begin CHARACTERISTIC DKIS_RNDDNR "Drosselklappenschwelle Sofkt. bei RND bzw. DNR" VALUE 0x26E817 kw_ui8_S6_S3 100 UMR_PROZENT__20_51_0_S6_S3 0 100 /end CHARACTERISTIC
/begin CHARACTERISTIC NS_ABRNDDNR "Abtriebsdrehzahlschwelle Sofkt. bei RND bzw. DNR" VALUE 0x26DE18 kw_ui16_S6_S3 2500 UMR_U_MIN_1_1_0_S6_S3 0 2500 /end CHARACTERISTIC
/begin CHARACTERISTIC NS_MOTRNDDNR "Motordrehzahlschwelle Sofkt. bei RND bzw. DNR" VALUE 0x26DE1A kw_ui16_S6_S3 5000 UMR_U_MIN_1_1_0_S6_S3 0 5000 /end CHARACTERISTIC
/begin CHARACTERISTIC NS_TABBRRNDDNR "Turbinendrehzahlschwelle Abbruchgradient Sofkt. bei RND bzw. DNR" VALUE 0x26DE1C kw_ui16_S6_S3 8160 UMR_U_MIN_1_1_0_S6_S3 0 8160 /end CHARACTERISTIC
/begin CHARACTERISTIC TS_DNRRND_MAX_ZEIT "Abruchschwelle für Reversierrampen bei Neutralanforderung" VALUE 0x26E818 kw_ui8_S6_S3 2550 UMR_MSEC__10_1_0_S6_S3 0 2550 /end CHARACTERISTIC
/begin CHARACTERISTIC CS_RNDDNR "Temperaturschwelle Reversierfunktion" VALUE 0x26E819 kw_ui8_S6_S3 190 UMR_GRADC__1_1_M40_S6_S3 -40 150 /end CHARACTERISTIC
/begin CHARACTERISTIC PG_KABDNR "Druckgradient Kuppl. B KAB bei R-N-D" VALUE 0x26DE1E kw_si16_S6_S3 31900 UMR_MBAR_SEC_1_1_0_S6_S3 -32000 -100 /end CHARACTERISTIC
/begin CHARACTERISTIC PG_KABABBRDNR "Druckgradient Abbruch Kuppl. B Sofkt. KAB bei R-N-D" VALUE 0x26DE20 kw_si16_S6_S3 31900 UMR_MBAR_SEC_1_1_0_S6_S3 -32000 -100 /end CHARACTERISTIC
/begin CHARACTERISTIC KF_PKABNDNMOTNTCGDNR "Druckstartwert Sofkt. Kupplung B bei RND" MAP 0x24C38C kf_si16_S6_S3 2 UMR_BAR__1_1000_0_S6_S3 0 2
 /begin AXIS_DESCR STD_AXIS iSasZentr.nd_nmot_nt UMR_U_MIN_1_1_0_S6_S3 3 -16320 16320 DEPOSIT ABSOLUTE MONOTONY MON_INCREASE /end AXIS_DESCR
 /begin AXIS_DESCR STD_AXIS zff_atsys._.iSignale._.obj.sig_c_getr UMR_GRADC__1_1_M40_S6_S3 2 -40 150 DEPOSIT ABSOLUTE MONOTONY MON_INCREASE /end AXIS_DESCR
/end CHARACTERISTIC
/begin CHARACTERISTIC PG_KABRND "Druckgradient Kuppl. B KAB bei R-N-D" VALUE 0x26DE22 kw_si16_S6_S3 31900 UMR_MBAR_SEC_1_1_0_S6_S3 -32000 -100 /end CHARACTERISTIC
/begin CHARACTERISTIC PG_KABABBRRND "Druckgradient Abbruch Kuppl. B Sofkt. KAB bei R-N-D" VALUE 0x26DE24 kw_si16_S6_S3 31900 UMR_MBAR_SEC_1_1_0_S6_S3 -32000 -100 /end CHARACTERISTIC
/begin CHARACTERISTIC KF_PKABNDNMOTNTCGRND "Druckstartwert Sofkt. Kupplung B bei RND" MAP 0x24C3AC kf_si16_S6_S3 2 UMR_BAR__1_1000_0_S6_S3 0 2
 /begin AXIS_DESCR STD_AXIS iSasZentr.nd_nmot_nt UMR_U_MIN_1_1_0_S6_S3 3 -16320 16320 DEPOSIT ABSOLUTE MONOTONY MON_INCREASE /end AXIS_DESCR
 /begin AXIS_DESCR STD_AXIS zff_atsys._.iSignale._.obj.sig_c_getr UMR_GRADC__1_1_M40_S6_S3 2 -40 150 DEPOSIT ABSOLUTE MONOTONY MON_INCREASE /end AXIS_DESCR
/end CHARACTERISTIC
/begin CHARACTERISTIC PG_KABDNRV2 "Druckgradient Kuppl. B KAB bei R-N-D" VALUE 0x26DE26 kw_si16_S6_S3 31900 UMR_MBAR_SEC_1_1_0_S6_S3 -32000 -100 /end CHARACTERISTIC
/begin CHARACTERISTIC PG_KABABBRDNRV2 "Druckgradient Abbruch Kuppl. B Sofkt. KAB bei R-N-D" VALUE 0x26DE28 kw_si16_S6_S3 31900 UMR_MBAR_SEC_1_1_0_S6_S3 -32000 -100 /end CHARACTERISTIC
/begin CHARACTERISTIC KF_PKABNDNMOTNTCGDNRV2 "Druckstartwert Sofkt. Kupplung B bei RND" MAP 0x24C3CC kf_si16_S6_S3 2 UMR_BAR__1_1000_0_S6_S3 0 2
 /begin AXIS_DESCR STD_AXIS iSasZentr.nd_nmot_nt UMR_U_MIN_1_1_0_S6_S3 3 -16320 16320 DEPOSIT ABSOLUTE MONOTONY MON_INCREASE /end AXIS_DESCR
 /begin AXIS_DESCR STD_AXIS zff_atsys._.iSignale._.obj.sig_c_getr UMR_GRADC__1_1_M40_S6_S3 2 -40 150 DEPOSIT ABSOLUTE MONOTONY MON_INCREASE /end AXIS_DESCR
/end CHARACTERISTIC
/begin CHARACTERISTIC PG_KABRNDV2 "Druckgradient Kuppl. B KAB bei R-N-D" VALUE 0x26DE2A kw_si16_S6_S3 31900 UMR_MBAR_SEC_1_1_0_S6_S3 -32000 -100 /end CHARACTERISTIC
/begin CHARACTERISTIC PG_KABABBRRNDV2 "Druckgradient Abbruch Kuppl. B Sofkt. KAB bei R-N-D" VALUE 0x26DE2C kw_si16_S6_S3 31900 UMR_MBAR_SEC_1_1_0_S6_S3 -32000 -100 /end CHARACTERISTIC
/begin CHARACTERISTIC KF_PKABNDNMOTNTCGRNDV2 "Druckstartwert Sofkt. Kupplung B bei RND" MAP 0x24C3EC kf_si16_S6_S3 2 UMR_BAR__1_1000_0_S6_S3 0 2
 /begin AXIS_DESCR STD_AXIS iSasZentr.nd_nmot_nt UMR_U_MIN_1_1_0_S6_S3 3 -16320 16320 DEPOSIT ABSOLUTE MONOTONY MON_INCREASE /end AXIS_DESCR
 /begin AXIS_DESCR STD_AXIS zff_atsys._.iSignale._.obj.sig_c_getr UMR_GRADC__1_1_M40_S6_S3 2 -40 150 DEPOSIT ABSOLUTE MONOTONY MON_INCREASE /end AXIS_DESCR
/end CHARACTERISTIC
/begin CHARACTERISTIC PG_KABD2NR "Druckgradient Kuppl. B KAB bei R-N-D" VALUE 0x26DE2E kw_si16_S6_S3 31900 UMR_MBAR_SEC_1_1_0_S6_S3 -32000 -100 /end CHARACTERISTIC
/begin CHARACTERISTIC PG_KABABBRD2NR "Druckgradient Abbruch Kuppl. B Sofkt. KAB bei R-N-D" VALUE 0x26DE30 kw_si16_S6_S3 31900 UMR_MBAR_SEC_1_1_0_S6_S3 -32000 -100 /end CHARACTERISTIC
/begin CHARACTERISTIC KF_PKABNDNMOTNTCGD2NR "Druckstartwert Sofkt. Kupplung B bei RND" MAP 0x24C40C kf_si16_S6_S3 2 UMR_BAR__1_1000_0_S6_S3 0 2
 /begin AXIS_DESCR STD_AXIS iSasZentr.nd_nmot_nt UMR_U_MIN_1_1_0_S6_S3 3 -16320 16320 DEPOSIT ABSOLUTE MONOTONY MON_INCREASE /end AXIS_DESCR
 /begin AXIS_DESCR STD_AXIS zff_atsys._.iSignale._.obj.sig_c_getr UMR_GRADC__1_1_M40_S6_S3 2 -40 150 DEPOSIT ABSOLUTE MONOTONY MON_INCREASE /end AXIS_DESCR
/end CHARACTERISTIC
/begin CHARACTERISTIC CS_FUELLREDUN "Untere Temperaturschwelle zur Aktivierung der red. Befuellung" VALUE 0x26EA08 kw_ui8_S6_S3 190 UMR_GRADC__1_1_M40_S6_S3 -40 150 /end CHARACTERISTIC
/begin CHARACTERISTIC CS_FUELLREDOB "Obere Temperaturschwelle zur Aktivierung der red. Befuellung" VALUE 0x26EA09 kw_ui8_S6_S3 190 UMR_GRADC__1_1_M40_S6_S3 -40 150 /end CHARACTERISTIC
/begin CHARACTERISTIC TAB_REDFUELL "Tabelle zur generellen Aktivierung der Fuellred für jedes Schaltelement" CURVE 0x260884 tab_bool8_S6_S3 1 UMR___1_1_0_S6_S3 0 1
 /begin AXIS_DESCR FIX_AXIS NO_INPUT_QUANTITY UMR___1_1_0_S6_S3 6 0 5 FIX_AXIS_PAR_DIST 0 1 6 /end AXIS_DESCR
/end CHARACTERISTIC
/begin CHARACTERISTIC V_PUMPE "Pumpenvolumen pro Umdrehung" VALUE 0x26EA0A kw_ui8_S6_S3 20 UMR_CM3__1_10_0_S6_S3 0 20 /end CHARACTERISTIC
/begin CHARACTERISTIC Q_VERBR_KAB "Ölvolumen Druckregler abschaltendes Schaltelement" VALUE 0x26EA0B kw_ui8_S6_S3 20 UMR_LITER_MIN_1_10_0_S6_S3 0 20 /end CHARACTERISTIC
/begin CHARACTERISTIC Q_VERBR_SYS "Ölvolumen Systemdruckregler" VALUE 0x26EA0C kw_ui8_S6_S3 20 UMR_LITER_MIN_1_10_0_S6_S3 0 20 /end CHARACTERISTIC
/begin CHARACTERISTIC Q_VERBR_IAE "Ölvolumen Druckregler für IAE" VALUE 0x26EA0D kw_ui8_S6_S3 20 UMR_LITER_MIN_1_10_0_S6_S3 0 20 /end CHARACTERISTIC
/begin CHARACTERISTIC Q_VERBR_K0 "Ölvolumen Druckregler für Trennkupplung K0" VALUE 0x26EA0E kw_ui8_S6_S3 20 UMR_LITER_MIN_1_10_0_S6_S3 0 20 /end CHARACTERISTIC
/begin CHARACTERISTIC Q_FUELLRED_A "Grenze verfügbares Restölvolumen für die Aktivierung der Funktion red. Befüllung." VALUE 0x26EA0F kw_ui8_S6_S3 20 UMR_LITER_MIN_1_10_0_S6_S3 0 20 /end CHARACTERISTIC
/begin CHARACTERISTIC Q_FUELLRED_B "Grenze verfügbares Restölvolumen für die Aktivierung der Funktion red. Befüllung." VALUE 0x26EA10 kw_ui8_S6_S3 20 UMR_LITER_MIN_1_10_0_S6_S3 0 20 /end CHARACTERISTIC
/begin CHARACTERISTIC Q_FUELLRED_C "Grenze verfügbares Restölvolumen für die Aktivierung der Funktion red. Befüllung." VALUE 0x26EA11 kw_ui8_S6_S3 20 UMR_LITER_MIN_1_10_0_S6_S3 0 20 /end CHARACTERISTIC
/begin CHARACTERISTIC Q_FUELLRED_D "Grenze verfügbares Restölvolumen für die Aktivierung der Funktion red. Befüllung." VALUE 0x26EA12 kw_ui8_S6_S3 20 UMR_LITER_MIN_1_10_0_S6_S3 0 20 /end CHARACTERISTIC
/begin CHARACTERISTIC Q_FUELLRED_E "Grenze verfügbares Restölvolumen für die Aktivierung der Funktion red. Befüllung." VALUE 0x26EA13 kw_ui8_S6_S3 20 UMR_LITER_MIN_1_10_0_S6_S3 0 20 /end CHARACTERISTIC
/begin CHARACTERISTIC Q_FUELLRED_K0 "Grenze verfügbares Restölvolumen für die Aktivierung der Funktion red. Befüllung." VALUE 0x26EA14 kw_ui8_S6_S3 20 UMR_LITER_MIN_1_10_0_S6_S3 0 20 /end CHARACTERISTIC
/begin CHARACTERISTIC KL_QVERBR_KUEHL "Ölvolumen Druckregler bei Kuehloelanforderung" CURVE 0x260890 kl_si16_S6_S3 20 UMR_LITER_MIN_1_10_0_S6_S3 0 20
 /begin AXIS_DESCR STD_AXIS iIaeKuehl.p_kuehl_soll_iae UMR_BAR__1_1000_0_S6_S3 4 -8 8 DEPOSIT ABSOLUTE MONOTONY MON_INCREASE /end AXIS_DESCR
/end CHARACTERISTIC
/begin CHARACTERISTIC KF_QLECKAGE "Gesamtleckage des Getriebes" MAP 0x2608A4 kf_ui16_S6_S3 20 UMR_LITER_MIN_1_10_0_S6_S3 0 20
 /begin AXIS_DESCR STD_AXIS zff_atsys._.iSignale._.obj.sig_c_getr UMR_GRADC__1_1_M40_S6_S3 4 -40 150 DEPOSIT ABSOLUTE MONOTONY MON_INCREASE /end AXIS_DESCR
 /begin AXIS_DESCR STD_AXIS iSasPsyst.p_sys UMR_BAR__1_1000_0_S6_S3 6 0 20 DEPOSIT ABSOLUTE MONOTONY MON_INCREASE /end AXIS_DESCR
/end CHARACTERISTIC
/begin CHARACTERISTIC CS_FUELLOPTUN "Untere Temperaturschwelle zur Aktivierung der opt. Befuellung" VALUE 0x26EA15 kw_ui8_S6_S3 190 UMR_GRADC__1_1_M40_S6_S3 -40 150 /end CHARACTERISTIC
/begin CHARACTERISTIC CS_FUELLOPTOB "Obere Temperaturschwelle zur Aktivierung der opt. Befuellung" VALUE 0x26EA16 kw_ui8_S6_S3 190 UMR_GRADC__1_1_M40_S6_S3 -40 150 /end CHARACTERISTIC
/begin CHARACTERISTIC TAB_SWIFUELLOPT "Schalter in abhaengigkeit von z_kurze_schaltung" CURVE 0x2608F0 tab_bool8_S6_S3 1 UMR___1_1_0_S6_S3 0 1
 /begin AXIS_DESCR FIX_AXIS iSasZentr.iSchaltend.z_kurze_schaltung UMR___1_1_0_S6_S3 8 0 7 FIX_AXIS_PAR_DIST 0 1 8 /end AXIS_DESCR
/end CHARACTERISTIC
/begin CHARACTERISTIC NS_MOTFUELLOPT "Drehzahlschwelle zur Aktivierung der opt. Befuellung" VALUE 0x26DF8E kw_ui16_S6_S3 8000 UMR_U_MIN_1_1_0_S6_S3 0 8000 /end CHARACTERISTIC
/begin CHARACTERISTIC KL_TSNABESTARTSTART "Aktivierungszeit Fenster für Sonderfunktion MSA Start" CURVE 0x2608FC kl_ui16_S6_S3 10000 UMR_MSEC__10_1_0_S6_S3 0 10000
 /begin AXIS_DESCR STD_AXIS zff_atsys._.iSignale._.obj.sig_n_ab UMR_U_MIN_1_1_0_S6_S3 4 0 8160 DEPOSIT ABSOLUTE MONOTONY MON_INCREASE /end AXIS_DESCR
/end CHARACTERISTIC
/begin CHARACTERISTIC NS_ESTART "E Maschine Drehzahlschwelle zum Start der SFKT Leerlauf Kolben E nach E-Maschinen Start" VALUE 0x26DF90 kw_ui16_S6_S3 8000 UMR_U_MIN_1_1_0_S6_S3 0 8000 /end CHARACTERISTIC
/begin CHARACTERISTIC TS_ESTART "Zeitschwelle zum Einstieg der Sonderfunktion Kolben E" VALUE 0x26DF92 kw_ui16_S6_S3 10000 UMR_MSEC__10_1_0_S6_S3 0 10000 /end CHARACTERISTIC
/begin CHARACTERISTIC NS_ESTARTHYS "Hysterese für E Maschinen Drehzahlschwelle zum Start der Sonderfunktion" VALUE 0x26DF94 kw_ui16_S6_S3 8000 UMR_U_MIN_1_1_0_S6_S3 0 8000 /end CHARACTERISTIC
/begin CHARACTERISTIC SWI_BGB_AKTIV "Schalter zur Aktivierung der bedarfsgerchten Bestromung" VALUE 0x26E9FD kw_bool8_S6_S3 1 UMR___1_1_0_S6_S3 0 1 /end CHARACTERISTIC
/begin CHARACTERISTIC SWI_BGB_IEP_AKTIV "Schalter zur Aktivierung der bedarfsgerchten Bestromung während der IEP-Aufwärmfunktion" VALUE 0x26E9FE kw_bool8_S6_S3 1 UMR___1_1_0_S6_S3 0 1 /end CHARACTERISTIC
/begin CHARACTERISTIC PO_KUP_BEDARF_SCHALT "Offset während Schaltung auf Kupplungsdruck zur Sicherstellung der Übertragungsfähigkeit" VALUE 0x26DF52 kw_ui16_S6_S3 22 UMR_BAR__1_1000_0_S6_S3 0 22 /end CHARACTERISTIC
/begin CHARACTERISTIC KL_F_P_KUP_BEDARF "Faktor auf Kupplungsdruck zur Sicherstellung der Übertragungsfähigkeit" CURVE 0x2606F8 kl_ui8_S6_S3 2 UMR___1_100_0_S6_S3 0 2
 /begin AXIS_DESCR STD_AXIS zff_atsys._.iSignale._.obj.sig_c_getr UMR_GRADC__1_1_M40_S6_S3 6 -40 150 DEPOSIT ABSOLUTE MONOTONY MON_INCREASE /end AXIS_DESCR
/end CHARACTERISTIC
/begin CHARACTERISTIC CS_KUPPLPSYS_EFF "Schwelle für Kupplungstemperatur für Zugriff auf Effizienzkennfelder" VALUE 0x26DF54 kw_si16_S6_S3 540 UMR_GRADC__1_1_0_S6_S3 -40 500 /end CHARACTERISTIC
/begin CHARACTERISTIC CS_KUPPLPSYS_HYS_EFF "Hysterese für Kupplungstemperatur für Zugriff auf Effizienzkennfelder" VALUE 0x26E9FF kw_ui8_S6_S3 100 UMR_GRADC__1_1_0_S6_S3 0 100 /end CHARACTERISTIC
/begin CHARACTERISTIC CS_PSYS_EFF_UN "Untere Schwelle für Getriebeöltemperatur für Zugriff auf Effizienzkennfelder" VALUE 0x26EA00 kw_ui8_S6_S3 240 UMR_GRADC__1_1_M40_S6_S3 -40 200 /end CHARACTERISTIC
/begin CHARACTERISTIC CS_PSYS_EFF_OB "Obere Schwelle für Getriebeöltemperatur für Zugriff auf Effizienzkennfelder" VALUE 0x26EA01 kw_ui8_S6_S3 240 UMR_GRADC__1_1_M40_S6_S3 -40 200 /end CHARACTERISTIC
/begin CHARACTERISTIC CS_PSYS_HYS_EFF "Hysterese für Getriebeöltemperatur für Zugriff auf Effizienzkennfelder" VALUE 0x26EA02 kw_ui8_S6_S3 100 UMR_GRADC__1_1_0_S6_S3 0 100 /end CHARACTERISTIC
/begin CHARACTERISTIC T_PSYSMASS_EFF "Zeit für Wiedereinstieg für Zugriff auf Effizienzkennfelder" VALUE 0x26DF56 kw_ui16_S6_S3 650000 UMR_MSEC__10_1_0_S6_S3 0 650000 /end CHARACTERISTIC
/begin CHARACTERISTIC P_SYSMINPULS "Mindestsystemdruck während Pulspruefung" VALUE 0x26DF58 kw_ui16_S6_S3 9 UMR_BAR__1_1000_0_S6_S3 0 9 /end CHARACTERISTIC
/begin CHARACTERISTIC MG_PSYSMINPULS "Gradient zur Systemdruckanhebung durch Pulsadaption" VALUE 0x26DF5A kw_si16_S6_S3 100 UMR_BAR_SEC_1_1_0_S6_S3 0 100 /end CHARACTERISTIC
/begin CHARACTERISTIC P_SYSMINSTADA "Mindestdruck STADA" VALUE 0x26DF5C kw_ui16_S6_S3 9 UMR_BAR__1_1000_0_S6_S3 0 9 /end CHARACTERISTIC
/begin CHARACTERISTIC P_SYSMINPOSV "Mindestsystemdruck während Positionsventilüberwachung" VALUE 0x26DF5E kw_ui16_S6_S3 10 UMR_BAR__1_1000_0_S6_S3 0 10 /end CHARACTERISTIC
/begin CHARACTERISTIC CGT_PSYSIAE "Getriebeöltemperaturschwelle für FKt. Reduzierung Hochlastschudder IAE" VALUE 0x26EA03 kw_ui8_S6_S3 190 UMR_GRADC__1_1_M40_S6_S3 -40 150 /end CHARACTERISTIC
/begin CHARACTERISTIC CGT_PSYSIAEHYS "Hysterese für Getriebeöltemperatur für FKt. Reduzierung Hochlastschudder IAE" VALUE 0x26EA04 kw_ui8_S6_S3 100 UMR_GRADC__1_1_0_S6_S3 0 100 /end CHARACTERISTIC
/begin CHARACTERISTIC MS_TPSYSIAEHYS "Hysterese für Turbinenmoment für FKt. Reduzierung Hochlastschudder IAE" VALUE 0x26DF60 kw_si16_S6_S3 100 UMR_NM__1_1_0_S6_S3 0 100 /end CHARACTERISTIC
/begin CHARACTERISTIC MS_TPSYSIAEOB "Obere Turbinenmomentschwelle für FKt. Reduzierung Hochlastschudder IAE" VALUE 0x26DF62 kw_si16_S6_S3 2040 UMR_NM__1_1_0_S6_S3 -400 1640 /end CHARACTERISTIC
/begin CHARACTERISTIC MS_TPSYSIAEUN "Untere Turbinenmomentschwelle für FKt. Reduzierung Hochlastschudder IAE" VALUE 0x26DF64 kw_si16_S6_S3 2040 UMR_NM__1_1_0_S6_S3 -400 1640 /end CHARACTERISTIC
/begin CHARACTERISTIC NS_TPSYSIAEHYS "Hysterese für Turbinendrehzahl für FKt. Reduzierung Hochlastschudder IAE" VALUE 0x26DF66 kw_ui16_S6_S3 1000 UMR_U_MIN_1_1_0_S6_S3 0 1000 /end CHARACTERISTIC
/begin CHARACTERISTIC NS_TPSYSIAEOB "Obere Turbinendrehzahlschwelle für FKt. Reduzierung Hochlastschudder IAE" VALUE 0x26DF68 kw_ui16_S6_S3 8000 UMR_U_MIN_1_1_0_S6_S3 0 8000 /end CHARACTERISTIC
/begin CHARACTERISTIC NS_TPSYSIAEUN "Untere Turbinendrehzahlschwelle für FKt. Reduzierung Hochlastschudder IAE" VALUE 0x26DF6A kw_ui16_S6_S3 8000 UMR_U_MIN_1_1_0_S6_S3 0 8000 /end CHARACTERISTIC
/begin CHARACTERISTIC P_SYSIAE_INC "Druckerhöhung/Task für die Fkt. Reduzierung Hochlastschudder IAE" VALUE 0x26DF6C kw_si16_S6_S3 100 UMR_BAR_SEC_1_10_0_S6_S3 0 100 /end CHARACTERISTIC
/begin CHARACTERISTIC CS_UNMAXPSYS "Getriebeöltemperaturschwelle für Ansteuerung max. Systemdruck" VALUE 0x26EA05 kw_ui8_S6_S3 190 UMR_GRADC__1_1_M40_S6_S3 -40 150 /end CHARACTERISTIC
/begin CHARACTERISTIC N_MOTMAXPSYS "Motordrehzahlschwelle für Ansteuerung max. Systemdruck" VALUE 0x26DF6E kw_ui16_S6_S3 8200 UMR_U_MIN_1_1_0_S6_S3 0 8200 /end CHARACTERISTIC
/begin CHARACTERISTIC T_FPSYS "Filterzeit für Systemdruck" VALUE 0x26DF70 kw_ui16_S6_S3 2540 UMR_MSEC__1_1_0_S6_S3 0 2540 /end CHARACTERISTIC
/begin CHARACTERISTIC P_SYSMIN_D "Mindestsystemdruck während Gangeinlegen nach D" VALUE 0x26DF72 kw_ui16_S6_S3 9 UMR_BAR__1_1000_0_S6_S3 0 9 /end CHARACTERISTIC
/begin CHARACTERISTIC P_SYSMIN_R "Mindestsystemdruck während Gangeinlegen nach R" VALUE 0x26DF74 kw_ui16_S6_S3 9 UMR_BAR__1_1000_0_S6_S3 0 9 /end CHARACTERISTIC
/begin CHARACTERISTIC P_SYSMINFUELLRED_D "Mindestsystemdruck während Gangeinlegen nach D bei red Befüllung" VALUE 0x26DF76 kw_ui16_S6_S3 9 UMR_BAR__1_1000_0_S6_S3 0 9 /end CHARACTERISTIC
/begin CHARACTERISTIC P_SYSMINFUELLRED_R "Mindestsystemdruck während Gangeinlegen nach R bei red Befüllung" VALUE 0x26DF78 kw_ui16_S6_S3 9 UMR_BAR__1_1000_0_S6_S3 0 9 /end CHARACTERISTIC
/begin CHARACTERISTIC P_SYSMIN_EFF_D "Mindestsystemdruck während Schaltungen, Gangein- und auslegen" VALUE 0x26DF7A kw_ui16_S6_S3 9 UMR_BAR__1_1000_0_S6_S3 0 9 /end CHARACTERISTIC
/begin CHARACTERISTIC P_SYSMIN_EFF_R "Mindestsystemdruck während Schaltungen, Gangein- und auslegen" VALUE 0x26DF7C kw_ui16_S6_S3 9 UMR_BAR__1_1000_0_S6_S3 0 9 /end CHARACTERISTIC
/begin CHARACTERISTIC P_SYSMINFUELLRED_K0 "Mindestsystemdruck während Gangeinlegen bei red Befüllung" VALUE 0x26DF7E kw_ui16_S6_S3 9 UMR_BAR__1_1000_0_S6_S3 0 9 /end CHARACTERISTIC
/begin CHARACTERISTIC P_SYSMIN_TRANSPORTMODE "Mindestsystemdruck während Transportmode" VALUE 0x26DF80 kw_ui16_S6_S3 22 UMR_BAR__1_1000_0_S6_S3 0 22 /end CHARACTERISTIC
/begin CHARACTERISTIC KL_TMAXPSYS "Zeit für Ansteuerung max. Systemdruck zur Vermeidung f. Druckeinbrüchen" CURVE 0x260708 kl_ui16_S6_S3 100 UMR_MSEC__10_1_0_S6_S3 0 100
 /begin AXIS_DESCR STD_AXIS zff_atsys._.iSignale._.obj.sig_n_mot UMR_U_MIN_1_1_0_S6_S3 4 0 8160 DEPOSIT ABSOLUTE MONOTONY MON_INCREASE /end AXIS_DESCR
/end CHARACTERISTIC
/begin CHARACTERISTIC KL_POSYSCG_DR "Druckoffset auf Systemdruck in Abh. der Getriebeoeltemperatur in kraftschluessigen Positionen" CURVE 0x26071C kl_si16_S6_S3 20 UMR_BAR__1_1000_0_S6_S3 -10 10
 /begin AXIS_DESCR STD_AXIS zff_atsys._.iSignale._.obj.sig_c_getr UMR_GRADC__1_1_M40_S6_S3 8 -40 150 DEPOSIT ABSOLUTE MONOTONY MON_INCREASE /end AXIS_DESCR
/end CHARACTERISTIC
/begin CHARACTERISTIC KL_POSYSCG_PN "Druckoffset auf Systemdruck in Abh. der Getriebeoeltemperatur in nichtkraftschluessigen Positionen" CURVE 0x260740 kl_si16_S6_S3 20 UMR_BAR__1_1000_0_S6_S3 -10 10
 /begin AXIS_DESCR STD_AXIS zff_atsys._.iSignale._.obj.sig_c_getr UMR_GRADC__1_1_M40_S6_S3 8 -40 150 DEPOSIT ABSOLUTE MONOTONY MON_INCREASE /end AXIS_DESCR
/end CHARACTERISTIC
/begin CHARACTERISTIC KF_PSYSN "Systemdruckkennfeld in Position N" MAP 0x260764 kf_ui16_S6_S3 22 UMR_BAR__1_1000_0_S6_S3 0 22
 /begin AXIS_DESCR STD_AXIS zff_atsys._.iSignale._.obj.sig_n_mot UMR_U_MIN_1_1_0_S6_S3 3 0 8160 DEPOSIT ABSOLUTE MONOTONY MON_INCREASE /end AXIS_DESCR
 /begin AXIS_DESCR STD_AXIS zff_atsys._.iSignale._.obj.sig_n_ab UMR_U_MIN_1_1_0_S6_S3 3 0 8160 DEPOSIT ABSOLUTE MONOTONY MON_INCREASE /end AXIS_DESCR
/end CHARACTERISTIC
/begin CHARACTERISTIC KF_PSYS_K0 "Systemdruckkennfeld K0" MAP 0x26078C kf_si16_S6_S3 22 UMR_BAR__1_1000_0_S6_S3 0 22
 /begin AXIS_DESCR STD_AXIS NO_INPUT_QUANTITY UMR_NM__1_1_0_S6_S3 6 0 2000 DEPOSIT ABSOLUTE MONOTONY MON_INCREASE /end AXIS_DESCR
 /begin AXIS_DESCR STD_AXIS zff_atsys._.iSignale._.obj.sig_n_mot UMR_U_MIN_1_1_0_S6_S3 3 0 8160 DEPOSIT ABSOLUTE MONOTONY MON_INCREASE /end AXIS_DESCR
/end CHARACTERISTIC
/begin CHARACTERISTIC P_SYSMINK0 "Mindestsystemdruck für K0S während Befüllung K0" VALUE 0x26DF82 kw_ui16_S6_S3 9 UMR_BAR__1_1000_0_S6_S3 0 9 /end CHARACTERISTIC
/begin CHARACTERISTIC P_SYSMINFUELLOPT_K0 "Mindestsystemdruck bei Funktion optimierte Befuellung wenn K0 aktiv" VALUE 0x26DF84 kw_ui16_S6_S3 9 UMR_BAR__1_1000_0_S6_S3 0 9 /end CHARACTERISTIC
/begin CHARACTERISTIC CS_KUPPLPSYS "Kupplungstemperaturschwelle für Systemdruckanforderung" VALUE 0x26DF86 kw_ui16_S6_S3 500 UMR_GRADC__1_1_0_S6_S3 0 500 /end CHARACTERISTIC
/begin CHARACTERISTIC HYS_CKUPPLPSYS "Hysterese für Kupplungstemperatur" VALUE 0x26EA06 kw_ui8_S6_S3 100 UMR_GRADC__1_1_0_S6_S3 0 100 /end CHARACTERISTIC
/begin CHARACTERISTIC P_SYSMINCKUPL "Systemdruck zur Sicherstellung Kühlbedingungen" VALUE 0x26DF88 kw_ui16_S6_S3 9 UMR_BAR__1_1000_0_S6_S3 0 9 /end CHARACTERISTIC
/begin CHARACTERISTIC CS_PSYSIEP "Temperaturschwelle für Mindestsystemdruck für zusaetzliche Leckage für IEP" VALUE 0x26EA07 kw_ui8_S6_S3 190 UMR_GRADC__1_1_M40_S6_S3 -40 150 /end CHARACTERISTIC
/begin CHARACTERISTIC P_SYSMINIEP "Mindestsystemdruck für zusaetzliche Leckage für IEP" VALUE 0x26DF8A kw_ui16_S6_S3 9 UMR_BAR__1_1000_0_S6_S3 0 9 /end CHARACTERISTIC
/begin CHARACTERISTIC P_SYSMINPSAUS "Mindestsystemdruck zum Auslegen der Parksperre" VALUE 0x26DF8C kw_ui16_S6_S3 22 UMR_BAR__1_1000_0_S6_S3 0 22 /end CHARACTERISTIC
/begin CHARACTERISTIC KL_TPSYSCGPSAUS "Maximalzeit für Systemdruckanst. bei fehlerhaften Sensorsignal" CURVE 0x2607CC kl_ui16_S6_S3 10000 UMR_MSEC__10_1_0_S6_S3 0 10000
 /begin AXIS_DESCR STD_AXIS zff_atsys._.iSignale._.obj.sig_c_getr UMR_GRADC__1_1_M40_S6_S3 6 -40 150 DEPOSIT ABSOLUTE MONOTONY MON_INCREASE /end AXIS_DESCR
/end CHARACTERISTIC
/begin CHARACTERISTIC KL_TFPSYSIST "Filterzeit für Systemistdruck" CURVE 0x2607E8 kl_ui16_S6_S3 2540 UMR_MSEC__1_1_0_S6_S3 0 2540
 /begin AXIS_DESCR STD_AXIS zff_atsys._.iSignale._.obj.sig_c_getr UMR_GRADC__1_1_M40_S6_S3 3 -40 150 DEPOSIT ABSOLUTE MONOTONY MON_INCREASE /end AXIS_DESCR
/end CHARACTERISTIC
/begin CHARACTERISTIC KL_PPUMPE_SYS "p_pumpe_sys für Minauswahl mit psys-gefiltert für p_sysist" CURVE 0x2607F8 kl_ui16_S6_S3 22 UMR_BAR__1_1000_0_S6_S3 0 22
 /begin AXIS_DESCR STD_AXIS zff_atsys._.iSignale._.obj.sig_n_mot UMR_U_MIN_1_1_0_S6_S3 4 0 8160 DEPOSIT ABSOLUTE MONOTONY MON_INCREASE /end AXIS_DESCR
/end CHARACTERISTIC
/begin CHARACTERISTIC KF_PIEP_SYS "Druck aus IEP zur Bestimmung des Systemdrucks" MAP 0x26080C kf_ui16_S6_S3 22 UMR_BAR__1_1000_0_S6_S3 0 22
 /begin AXIS_DESCR STD_AXIS zff_atsys._.iSignale._.obj.sig_c_getr UMR_GRADC__1_1_M40_S6_S3 6 -40 150 DEPOSIT ABSOLUTE MONOTONY MON_INCREASE /end AXIS_DESCR
 /begin AXIS_DESCR STD_AXIS NO_INPUT_QUANTITY UMR___1_1_0_S6_S3 5 0 4 DEPOSIT ABSOLUTE MONOTONY MON_INCREASE /end AXIS_DESCR
/end CHARACTERISTIC
/begin CHARACTERISTIC KL_F_PIEP_SYS "Faktor auf Druck aus IEP zur Bestimmung des Systemdrucks" CURVE 0x260868 kl_ui16_S6_S3 1 UMR_BAR__1_1000_0_S6_S3 0 1
 /begin AXIS_DESCR STD_AXIS iItfInput.cdd_u_supply_iep UMR_VOLT__1_10_0_S6_S3 6 0 25 DEPOSIT ABSOLUTE MONOTONY MON_INCREASE /end AXIS_DESCR
/end CHARACTERISTIC
/begin CHARACTERISTIC KF_PSYS_R "Systemdruck gangabhängig" MAP 0x260278 kf_si16_S6_S3 22 UMR_BAR__1_1000_0_S6_S3 0 22
 /begin AXIS_DESCR STD_AXIS iKorSaste.m_t_mepos UMR_NM__1_1_0_S6_S3 6 -400 1640 DEPOSIT ABSOLUTE MONOTONY MON_INCREASE /end AXIS_DESCR
 /begin AXIS_DESCR STD_AXIS zff_atsys._.iSignale._.obj.sig_n_mot UMR_U_MIN_1_1_0_S6_S3 3 0 8160 DEPOSIT ABSOLUTE MONOTONY MON_INCREASE /end AXIS_DESCR
/end CHARACTERISTIC
/begin CHARACTERISTIC KF_PSYS_EFF_R "Effizientsystemdruckkennfeld gangabhängig" MAP 0x2602B8 kf_si16_S6_S3 22 UMR_BAR__1_1000_0_S6_S3 0 22
 /begin AXIS_DESCR STD_AXIS iKorSaste.m_t_mepos UMR_NM__1_1_0_S6_S3 6 -400 1640 DEPOSIT ABSOLUTE MONOTONY MON_INCREASE /end AXIS_DESCR
 /begin AXIS_DESCR STD_AXIS zff_atsys._.iSignale._.obj.sig_n_mot UMR_U_MIN_1_1_0_S6_S3 3 0 8160 DEPOSIT ABSOLUTE MONOTONY MON_INCREASE /end AXIS_DESCR
/end CHARACTERISTIC
/begin CHARACTERISTIC P_SYSMIN_IAE_R "minimaler Systemdruck zu Reduzierung Hochlastschudder IAE" VALUE 0x26DE78 kw_ui16_S6_S3 22 UMR_BAR__1_1000_0_S6_S3 0 22 /end CHARACTERISTIC
/begin CHARACTERISTIC KF_PSYS_1 "Systemdruck gangabhängig" MAP 0x2602F8 kf_si16_S6_S3 22 UMR_BAR__1_1000_0_S6_S3 0 22
 /begin AXIS_DESCR STD_AXIS iKorSaste.m_t_mepos UMR_NM__1_1_0_S6_S3 6 -400 1640 DEPOSIT ABSOLUTE MONOTONY MON_INCREASE /end AXIS_DESCR
 /begin AXIS_DESCR STD_AXIS zff_atsys._.iSignale._.obj.sig_n_mot UMR_U_MIN_1_1_0_S6_S3 3 0 8160 DEPOSIT ABSOLUTE MONOTONY MON_INCREASE /end AXIS_DESCR
/end CHARACTERISTIC
/begin CHARACTERISTIC KF_PSYS_EFF_1 "Effizientsystemdruckkennfeld gangabhängig" MAP 0x260338 kf_si16_S6_S3 22 UMR_BAR__1_1000_0_S6_S3 0 22
 /begin AXIS_DESCR STD_AXIS iKorSaste.m_t_mepos UMR_NM__1_1_0_S6_S3 6 -400 1640 DEPOSIT ABSOLUTE MONOTONY MON_INCREASE /end AXIS_DESCR
 /begin AXIS_DESCR STD_AXIS zff_atsys._.iSignale._.obj.sig_n_mot UMR_U_MIN_1_1_0_S6_S3 3 0 8160 DEPOSIT ABSOLUTE MONOTONY MON_INCREASE /end AXIS_DESCR
/end CHARACTERISTIC
/begin CHARACTERISTIC P_SYSMIN_IAE_1 "minimaler Systemdruck zu Reduzierung Hochlastschudder IAE" VALUE 0x26DE7A kw_ui16_S6_S3 22 UMR_BAR__1_1000_0_S6_S3 0 22 /end CHARACTERISTIC
/begin CHARACTERISTIC KF_PSYS_2 "Systemdruck gangabhängig" MAP 0x260378 kf_si16_S6_S3 22 UMR_BAR__1_1000_0_S6_S3 0 22
 /begin AXIS_DESCR STD_AXIS iKorSaste.m_t_mepos UMR_NM__1_1_0_S6_S3 6 -400 1640 DEPOSIT ABSOLUTE MONOTONY MON_INCREASE /end AXIS_DESCR
 /begin AXIS_DESCR STD_AXIS zff_atsys._.iSignale._.obj.sig_n_mot UMR_U_MIN_1_1_0_S6_S3 3 0 8160 DEPOSIT ABSOLUTE MONOTONY MON_INCREASE /end AXIS_DESCR
/end CHARACTERISTIC
/begin CHARACTERISTIC KF_PSYS_EFF_2 "Effizientsystemdruckkennfeld gangabhängig" MAP 0x2603B8 kf_si16_S6_S3 22 UMR_BAR__1_1000_0_S6_S3 0 22
 /begin AXIS_DESCR STD_AXIS iKorSaste.m_t_mepos UMR_NM__1_1_0_S6_S3 6 -400 1640 DEPOSIT ABSOLUTE MONOTONY MON_INCREASE /end AXIS_DESCR
 /begin AXIS_DESCR STD_AXIS zff_atsys._.iSignale._.obj.sig_n_mot UMR_U_MIN_1_1_0_S6_S3 3 0 8160 DEPOSIT ABSOLUTE MONOTONY MON_INCREASE /end AXIS_DESCR
/end CHARACTERISTIC
/begin CHARACTERISTIC P_SYSMIN_IAE_2 "minimaler Systemdruck zu Reduzierung Hochlastschudder IAE" VALUE 0x26DE7C kw_ui16_S6_S3 22 UMR_BAR__1_1000_0_S6_S3 0 22 /end CHARACTERISTIC
/begin CHARACTERISTIC KF_PSYS_3 "Systemdruck gangabhängig" MAP 0x2603F8 kf_si16_S6_S3 22 UMR_BAR__1_1000_0_S6_S3 0 22
 /begin AXIS_DESCR STD_AXIS iKorSaste.m_t_mepos UMR_NM__1_1_0_S6_S3 6 -400 1640 DEPOSIT ABSOLUTE MONOTONY MON_INCREASE /end AXIS_DESCR
 /begin AXIS_DESCR STD_AXIS zff_atsys._.iSignale._.obj.sig_n_mot UMR_U_MIN_1_1_0_S6_S3 3 0 8160 DEPOSIT ABSOLUTE MONOTONY MON_INCREASE /end AXIS_DESCR
/end CHARACTERISTIC
/begin CHARACTERISTIC KF_PSYS_EFF_3 "Effizientsystemdruckkennfeld gangabhängig" MAP 0x260438 kf_si16_S6_S3 22 UMR_BAR__1_1000_0_S6_S3 0 22
 /begin AXIS_DESCR STD_AXIS iKorSaste.m_t_mepos UMR_NM__1_1_0_S6_S3 6 -400 1640 DEPOSIT ABSOLUTE MONOTONY MON_INCREASE /end AXIS_DESCR
 /begin AXIS_DESCR STD_AXIS zff_atsys._.iSignale._.obj.sig_n_mot UMR_U_MIN_1_1_0_S6_S3 3 0 8160 DEPOSIT ABSOLUTE MONOTONY MON_INCREASE /end AXIS_DESCR
/end CHARACTERISTIC
/begin CHARACTERISTIC KF_PSYS_4 "Systemdruck gangabhängig" MAP 0x260478 kf_si16_S6_S3 22 UMR_BAR__1_1000_0_S6_S3 0 22
 /begin AXIS_DESCR STD_AXIS iKorSaste.m_t_mepos UMR_NM__1_1_0_S6_S3 6 -400 1640 DEPOSIT ABSOLUTE MONOTONY MON_INCREASE /end AXIS_DESCR
 /begin AXIS_DESCR STD_AXIS zff_atsys._.iSignale._.obj.sig_n_mot UMR_U_MIN_1_1_0_S6_S3 3 0 8160 DEPOSIT ABSOLUTE MONOTONY MON_INCREASE /end AXIS_DESCR
/end CHARACTERISTIC
/begin CHARACTERISTIC KF_PSYS_EFF_4 "Effizientsystemdruckkennfeld gangabhängig" MAP 0x2604B8 kf_si16_S6_S3 22 UMR_BAR__1_1000_0_S6_S3 0 22
 /begin AXIS_DESCR STD_AXIS iKorSaste.m_t_mepos UMR_NM__1_1_0_S6_S3 6 -400 1640 DEPOSIT ABSOLUTE MONOTONY MON_INCREASE /end AXIS_DESCR
 /begin AXIS_DESCR STD_AXIS zff_atsys._.iSignale._.obj.sig_n_mot UMR_U_MIN_1_1_0_S6_S3 3 0 8160 DEPOSIT ABSOLUTE MONOTONY MON_INCREASE /end AXIS_DESCR
/end CHARACTERISTIC
/begin CHARACTERISTIC KF_PSYS_5 "Systemdruck gangabhängig" MAP 0x2604F8 kf_si16_S6_S3 22 UMR_BAR__1_1000_0_S6_S3 0 22
 /begin AXIS_DESCR STD_AXIS iKorSaste.m_t_mepos UMR_NM__1_1_0_S6_S3 6 -400 1640 DEPOSIT ABSOLUTE MONOTONY MON_INCREASE /end AXIS_DESCR
 /begin AXIS_DESCR STD_AXIS zff_atsys._.iSignale._.obj.sig_n_mot UMR_U_MIN_1_1_0_S6_S3 3 0 8160 DEPOSIT ABSOLUTE MONOTONY MON_INCREASE /end AXIS_DESCR
/end CHARACTERISTIC
/begin CHARACTERISTIC KF_PSYS_EFF_5 "Effizientsystemdruckkennfeld gangabhängig" MAP 0x260538 kf_si16_S6_S3 22 UMR_BAR__1_1000_0_S6_S3 0 22
 /begin AXIS_DESCR STD_AXIS iKorSaste.m_t_mepos UMR_NM__1_1_0_S6_S3 6 -400 1640 DEPOSIT ABSOLUTE MONOTONY MON_INCREASE /end AXIS_DESCR
 /begin AXIS_DESCR STD_AXIS zff_atsys._.iSignale._.obj.sig_n_mot UMR_U_MIN_1_1_0_S6_S3 3 0 8160 DEPOSIT ABSOLUTE MONOTONY MON_INCREASE /end AXIS_DESCR
/end CHARACTERISTIC
/begin CHARACTERISTIC KF_PSYS_6 "Systemdruck gangabhängig" MAP 0x260578 kf_si16_S6_S3 22 UMR_BAR__1_1000_0_S6_S3 0 22
 /begin AXIS_DESCR STD_AXIS iKorSaste.m_t_mepos UMR_NM__1_1_0_S6_S3 6 -400 1640 DEPOSIT ABSOLUTE MONOTONY MON_INCREASE /end AXIS_DESCR
 /begin AXIS_DESCR STD_AXIS zff_atsys._.iSignale._.obj.sig_n_mot UMR_U_MIN_1_1_0_S6_S3 3 0 8160 DEPOSIT ABSOLUTE MONOTONY MON_INCREASE /end AXIS_DESCR
/end CHARACTERISTIC
/begin CHARACTERISTIC KF_PSYS_EFF_6 "Effizientsystemdruckkennfeld gangabhängig" MAP 0x2605B8 kf_si16_S6_S3 22 UMR_BAR__1_1000_0_S6_S3 0 22
 /begin AXIS_DESCR STD_AXIS iKorSaste.m_t_mepos UMR_NM__1_1_0_S6_S3 6 -400 1640 DEPOSIT ABSOLUTE MONOTONY MON_INCREASE /end AXIS_DESCR
 /begin AXIS_DESCR STD_AXIS zff_atsys._.iSignale._.obj.sig_n_mot UMR_U_MIN_1_1_0_S6_S3 3 0 8160 DEPOSIT ABSOLUTE MONOTONY MON_INCREASE /end AXIS_DESCR
/end CHARACTERISTIC
/begin CHARACTERISTIC KF_PSYS_7 "Systemdruck gangabhängig" MAP 0x2605F8 kf_si16_S6_S3 22 UMR_BAR__1_1000_0_S6_S3 0 22
 /begin AXIS_DESCR STD_AXIS iKorSaste.m_t_mepos UMR_NM__1_1_0_S6_S3 6 -400 1640 DEPOSIT ABSOLUTE MONOTONY MON_INCREASE /end AXIS_DESCR
 /begin AXIS_DESCR STD_AXIS zff_atsys._.iSignale._.obj.sig_n_mot UMR_U_MIN_1_1_0_S6_S3 3 0 8160 DEPOSIT ABSOLUTE MONOTONY MON_INCREASE /end AXIS_DESCR
/end CHARACTERISTIC
/begin CHARACTERISTIC KF_PSYS_EFF_7 "Effizientsystemdruckkennfeld gangabhängig" MAP 0x260638 kf_si16_S6_S3 22 UMR_BAR__1_1000_0_S6_S3 0 22
 /begin AXIS_DESCR STD_AXIS iKorSaste.m_t_mepos UMR_NM__1_1_0_S6_S3 6 -400 1640 DEPOSIT ABSOLUTE MONOTONY MON_INCREASE /end AXIS_DESCR
 /begin AXIS_DESCR STD_AXIS zff_atsys._.iSignale._.obj.sig_n_mot UMR_U_MIN_1_1_0_S6_S3 3 0 8160 DEPOSIT ABSOLUTE MONOTONY MON_INCREASE /end AXIS_DESCR
/end CHARACTERISTIC
/begin CHARACTERISTIC KF_PSYS_8 "Systemdruck gangabhängig" MAP 0x260678 kf_si16_S6_S3 22 UMR_BAR__1_1000_0_S6_S3 0 22
 /begin AXIS_DESCR STD_AXIS iKorSaste.m_t_mepos UMR_NM__1_1_0_S6_S3 6 -400 1640 DEPOSIT ABSOLUTE MONOTONY MON_INCREASE /end AXIS_DESCR
 /begin AXIS_DESCR STD_AXIS zff_atsys._.iSignale._.obj.sig_n_mot UMR_U_MIN_1_1_0_S6_S3 3 0 8160 DEPOSIT ABSOLUTE MONOTONY MON_INCREASE /end AXIS_DESCR
/end CHARACTERISTIC
/begin CHARACTERISTIC KF_PSYS_EFF_8 "Effizientsystemdruckkennfeld gangabhängig" MAP 0x2606B8 kf_si16_S6_S3 22 UMR_BAR__1_1000_0_S6_S3 0 22
 /begin AXIS_DESCR STD_AXIS iKorSaste.m_t_mepos UMR_NM__1_1_0_S6_S3 6 -400 1640 DEPOSIT ABSOLUTE MONOTONY MON_INCREASE /end AXIS_DESCR
 /begin AXIS_DESCR STD_AXIS zff_atsys._.iSignale._.obj.sig_n_mot UMR_U_MIN_1_1_0_S6_S3 3 0 8160 DEPOSIT ABSOLUTE MONOTONY MON_INCREASE /end AXIS_DESCR
/end CHARACTERISTIC
/begin CHARACTERISTIC P_SYSMIN12 "Mindestsystemdruck waehrend Hochschaltungen" VALUE 0x26DE7E kw_ui16_S6_S3 9 UMR_BAR__1_1000_0_S6_S3 0 9 /end CHARACTERISTIC
/begin CHARACTERISTIC P_SYSMINFUELLOPT12 "Mindestsystemdruck waehrend Hochschaltungen, bei aktiver Fkt. optimierte Befuellung" VALUE 0x26DE80 kw_ui16_S6_S3 9 UMR_BAR__1_1000_0_S6_S3 0 9 /end CHARACTERISTIC
/begin CHARACTERISTIC P_SYSMINFUELLRED12 "Mindestsystemdruck waehrend Hochschaltungen bei red Befüllung" VALUE 0x26DE82 kw_ui16_S6_S3 9 UMR_BAR__1_1000_0_S6_S3 0 9 /end CHARACTERISTIC
/begin CHARACTERISTIC P_SYSMIN_EFF12 "Mindestsystemdruck waehrend Hochschaltungen bei Zugriff auf Effizienzkennfelder" VALUE 0x26DE84 kw_ui16_S6_S3 9 UMR_BAR__1_1000_0_S6_S3 0 9 /end CHARACTERISTIC
/begin CHARACTERISTIC P_SYSMIN23 "Mindestsystemdruck waehrend Hochschaltungen" VALUE 0x26DE86 kw_ui16_S6_S3 9 UMR_BAR__1_1000_0_S6_S3 0 9 /end CHARACTERISTIC
/begin CHARACTERISTIC P_SYSMINFUELLOPT23 "Mindestsystemdruck waehrend Hochschaltungen, bei aktiver Fkt. optimierte Befuellung" VALUE 0x26DE88 kw_ui16_S6_S3 9 UMR_BAR__1_1000_0_S6_S3 0 9 /end CHARACTERISTIC
/begin CHARACTERISTIC P_SYSMINFUELLRED23 "Mindestsystemdruck waehrend Hochschaltungen bei red Befüllung" VALUE 0x26DE8A kw_ui16_S6_S3 9 UMR_BAR__1_1000_0_S6_S3 0 9 /end CHARACTERISTIC
/begin CHARACTERISTIC P_SYSMIN_EFF23 "Mindestsystemdruck waehrend Hochschaltungen bei Zugriff auf Effizienzkennfelder" VALUE 0x26DE8C kw_ui16_S6_S3 9 UMR_BAR__1_1000_0_S6_S3 0 9 /end CHARACTERISTIC
/begin CHARACTERISTIC P_SYSMIN34 "Mindestsystemdruck waehrend Hochschaltungen" VALUE 0x26DE8E kw_ui16_S6_S3 9 UMR_BAR__1_1000_0_S6_S3 0 9 /end CHARACTERISTIC
/begin CHARACTERISTIC P_SYSMINFUELLOPT34 "Mindestsystemdruck waehrend Hochschaltungen, bei aktiver Fkt. optimierte Befuellung" VALUE 0x26DE90 kw_ui16_S6_S3 9 UMR_BAR__1_1000_0_S6_S3 0 9 /end CHARACTERISTIC
/begin CHARACTERISTIC P_SYSMINFUELLRED34 "Mindestsystemdruck waehrend Hochschaltungen bei red Befüllung" VALUE 0x26DE92 kw_ui16_S6_S3 9 UMR_BAR__1_1000_0_S6_S3 0 9 /end CHARACTERISTIC
/begin CHARACTERISTIC P_SYSMIN_EFF34 "Mindestsystemdruck waehrend Hochschaltungen bei Zugriff auf Effizienzkennfelder" VALUE 0x26DE94 kw_ui16_S6_S3 9 UMR_BAR__1_1000_0_S6_S3 0 9 /end CHARACTERISTIC
/begin CHARACTERISTIC P_SYSMIN45 "Mindestsystemdruck waehrend Hochschaltungen" VALUE 0x26DE96 kw_ui16_S6_S3 9 UMR_BAR__1_1000_0_S6_S3 0 9 /end CHARACTERISTIC
/begin CHARACTERISTIC P_SYSMINFUELLOPT45 "Mindestsystemdruck waehrend Hochschaltungen, bei aktiver Fkt. optimierte Befuellung" VALUE 0x26DE98 kw_ui16_S6_S3 9 UMR_BAR__1_1000_0_S6_S3 0 9 /end CHARACTERISTIC
/begin CHARACTERISTIC P_SYSMINFUELLRED45 "Mindestsystemdruck waehrend Hochschaltungen bei red Befüllung" VALUE 0x26DE9A kw_ui16_S6_S3 9 UMR_BAR__1_1000_0_S6_S3 0 9 /end CHARACTERISTIC
/begin CHARACTERISTIC P_SYSMIN_EFF45 "Mindestsystemdruck waehrend Hochschaltungen bei Zugriff auf Effizienzkennfelder" VALUE 0x26DE9C kw_ui16_S6_S3 9 UMR_BAR__1_1000_0_S6_S3 0 9 /end CHARACTERISTIC
/begin CHARACTERISTIC P_SYSMIN56 "Mindestsystemdruck waehrend Hochschaltungen" VALUE 0x26DE9E kw_ui16_S6_S3 9 UMR_BAR__1_1000_0_S6_S3 0 9 /end CHARACTERISTIC
/begin CHARACTERISTIC P_SYSMINFUELLOPT56 "Mindestsystemdruck waehrend Hochschaltungen, bei aktiver Fkt. optimierte Befuellung" VALUE 0x26DEA0 kw_ui16_S6_S3 9 UMR_BAR__1_1000_0_S6_S3 0 9 /end CHARACTERISTIC
/begin CHARACTERISTIC P_SYSMINFUELLRED56 "Mindestsystemdruck waehrend Hochschaltungen bei red Befüllung" VALUE 0x26DEA2 kw_ui16_S6_S3 9 UMR_BAR__1_1000_0_S6_S3 0 9 /end CHARACTERISTIC
/begin CHARACTERISTIC P_SYSMIN_EFF56 "Mindestsystemdruck waehrend Hochschaltungen bei Zugriff auf Effizienzkennfelder" VALUE 0x26DEA4 kw_ui16_S6_S3 9 UMR_BAR__1_1000_0_S6_S3 0 9 /end CHARACTERISTIC
/begin CHARACTERISTIC P_SYSMIN67 "Mindestsystemdruck waehrend Hochschaltungen" VALUE 0x26DEA6 kw_ui16_S6_S3 9 UMR_BAR__1_1000_0_S6_S3 0 9 /end CHARACTERISTIC
/begin CHARACTERISTIC P_SYSMINFUELLOPT67 "Mindestsystemdruck waehrend Hochschaltungen, bei aktiver Fkt. optimierte Befuellung" VALUE 0x26DEA8 kw_ui16_S6_S3 9 UMR_BAR__1_1000_0_S6_S3 0 9 /end CHARACTERISTIC
/begin CHARACTERISTIC P_SYSMINFUELLRED67 "Mindestsystemdruck waehrend Hochschaltungen bei red Befüllung" VALUE 0x26DEAA kw_ui16_S6_S3 9 UMR_BAR__1_1000_0_S6_S3 0 9 /end CHARACTERISTIC
/begin CHARACTERISTIC P_SYSMIN_EFF67 "Mindestsystemdruck waehrend Hochschaltungen bei Zugriff auf Effizienzkennfelder" VALUE 0x26DEAC kw_ui16_S6_S3 9 UMR_BAR__1_1000_0_S6_S3 0 9 /end CHARACTERISTIC
/begin CHARACTERISTIC P_SYSMIN78 "Mindestsystemdruck waehrend Hochschaltungen" VALUE 0x26DEAE kw_ui16_S6_S3 9 UMR_BAR__1_1000_0_S6_S3 0 9 /end CHARACTERISTIC
/begin CHARACTERISTIC P_SYSMINFUELLOPT78 "Mindestsystemdruck waehrend Hochschaltungen, bei aktiver Fkt. optimierte Befuellung" VALUE 0x26DEB0 kw_ui16_S6_S3 9 UMR_BAR__1_1000_0_S6_S3 0 9 /end CHARACTERISTIC
/begin CHARACTERISTIC P_SYSMINFUELLRED78 "Mindestsystemdruck waehrend Hochschaltungen bei red Befüllung" VALUE 0x26DEB2 kw_ui16_S6_S3 9 UMR_BAR__1_1000_0_S6_S3 0 9 /end CHARACTERISTIC
/begin CHARACTERISTIC P_SYSMIN_EFF78 "Mindestsystemdruck waehrend Hochschaltungen bei Zugriff auf Effizienzkennfelder" VALUE 0x26DEB4 kw_ui16_S6_S3 9 UMR_BAR__1_1000_0_S6_S3 0 9 /end CHARACTERISTIC
/begin CHARACTERISTIC P_SYSMIN13 "Mindestsystemdruck waehrend Hochschaltungen" VALUE 0x26DEB6 kw_ui16_S6_S3 9 UMR_BAR__1_1000_0_S6_S3 0 9 /end CHARACTERISTIC
/begin CHARACTERISTIC P_SYSMINFUELLOPT13 "Mindestsystemdruck waehrend Hochschaltungen, bei aktiver Fkt. optimierte Befuellung" VALUE 0x26DEB8 kw_ui16_S6_S3 9 UMR_BAR__1_1000_0_S6_S3 0 9 /end CHARACTERISTIC
/begin CHARACTERISTIC P_SYSMINFUELLRED13 "Mindestsystemdruck waehrend Hochschaltungen bei red Befüllung" VALUE 0x26DEBA kw_ui16_S6_S3 9 UMR_BAR__1_1000_0_S6_S3 0 9 /end CHARACTERISTIC
/begin CHARACTERISTIC P_SYSMIN_EFF13 "Mindestsystemdruck waehrend Hochschaltungen bei Zugriff auf Effizienzkennfelder" VALUE 0x26DEBC kw_ui16_S6_S3 9 UMR_BAR__1_1000_0_S6_S3 0 9 /end CHARACTERISTIC
/begin CHARACTERISTIC P_SYSMIN24 "Mindestsystemdruck waehrend Hochschaltungen" VALUE 0x26DEBE kw_ui16_S6_S3 9 UMR_BAR__1_1000_0_S6_S3 0 9 /end CHARACTERISTIC
/begin CHARACTERISTIC P_SYSMINFUELLOPT24 "Mindestsystemdruck waehrend Hochschaltungen, bei aktiver Fkt. optimierte Befuellung" VALUE 0x26DEC0 kw_ui16_S6_S3 9 UMR_BAR__1_1000_0_S6_S3 0 9 /end CHARACTERISTIC
/begin CHARACTERISTIC P_SYSMINFUELLRED24 "Mindestsystemdruck waehrend Hochschaltungen bei red Befüllung" VALUE 0x26DEC2 kw_ui16_S6_S3 9 UMR_BAR__1_1000_0_S6_S3 0 9 /end CHARACTERISTIC
/begin CHARACTERISTIC P_SYSMIN_EFF24 "Mindestsystemdruck waehrend Hochschaltungen bei Zugriff auf Effizienzkennfelder" VALUE 0x26DEC4 kw_ui16_S6_S3 9 UMR_BAR__1_1000_0_S6_S3 0 9 /end CHARACTERISTIC
/begin CHARACTERISTIC P_SYSMIN35 "Mindestsystemdruck waehrend Hochschaltungen" VALUE 0x26DEC6 kw_ui16_S6_S3 9 UMR_BAR__1_1000_0_S6_S3 0 9 /end CHARACTERISTIC
/begin CHARACTERISTIC P_SYSMINFUELLOPT35 "Mindestsystemdruck waehrend Hochschaltungen, bei aktiver Fkt. optimierte Befuellung" VALUE 0x26DEC8 kw_ui16_S6_S3 9 UMR_BAR__1_1000_0_S6_S3 0 9 /end CHARACTERISTIC
/begin CHARACTERISTIC P_SYSMINFUELLRED35 "Mindestsystemdruck waehrend Hochschaltungen bei red Befüllung" VALUE 0x26DECA kw_ui16_S6_S3 9 UMR_BAR__1_1000_0_S6_S3 0 9 /end CHARACTERISTIC
/begin CHARACTERISTIC P_SYSMIN_EFF35 "Mindestsystemdruck waehrend Hochschaltungen bei Zugriff auf Effizienzkennfelder" VALUE 0x26DECC kw_ui16_S6_S3 9 UMR_BAR__1_1000_0_S6_S3 0 9 /end CHARACTERISTIC
/begin CHARACTERISTIC P_SYSMIN46 "Mindestsystemdruck waehrend Hochschaltungen" VALUE 0x26DECE kw_ui16_S6_S3 9 UMR_BAR__1_1000_0_S6_S3 0 9 /end CHARACTERISTIC
/begin CHARACTERISTIC P_SYSMINFUELLOPT46 "Mindestsystemdruck waehrend Hochschaltungen, bei aktiver Fkt. optimierte Befuellung" VALUE 0x26DED0 kw_ui16_S6_S3 9 UMR_BAR__1_1000_0_S6_S3 0 9 /end CHARACTERISTIC
/begin CHARACTERISTIC P_SYSMINFUELLRED46 "Mindestsystemdruck waehrend Hochschaltungen bei red Befüllung" VALUE 0x26DED2 kw_ui16_S6_S3 9 UMR_BAR__1_1000_0_S6_S3 0 9 /end CHARACTERISTIC
/begin CHARACTERISTIC P_SYSMIN_EFF46 "Mindestsystemdruck waehrend Hochschaltungen bei Zugriff auf Effizienzkennfelder" VALUE 0x26DED4 kw_ui16_S6_S3 9 UMR_BAR__1_1000_0_S6_S3 0 9 /end CHARACTERISTIC
/begin CHARACTERISTIC P_SYSMIN57 "Mindestsystemdruck waehrend Hochschaltungen" VALUE 0x26DED6 kw_ui16_S6_S3 9 UMR_BAR__1_1000_0_S6_S3 0 9 /end CHARACTERISTIC
/begin CHARACTERISTIC P_SYSMINFUELLOPT57 "Mindestsystemdruck waehrend Hochschaltungen, bei aktiver Fkt. optimierte Befuellung" VALUE 0x26DED8 kw_ui16_S6_S3 9 UMR_BAR__1_1000_0_S6_S3 0 9 /end CHARACTERISTIC
/begin CHARACTERISTIC P_SYSMINFUELLRED57 "Mindestsystemdruck waehrend Hochschaltungen bei red Befüllung" VALUE 0x26DEDA kw_ui16_S6_S3 9 UMR_BAR__1_1000_0_S6_S3 0 9 /end CHARACTERISTIC
/begin CHARACTERISTIC P_SYSMIN_EFF57 "Mindestsystemdruck waehrend Hochschaltungen bei Zugriff auf Effizienzkennfelder" VALUE 0x26DEDC kw_ui16_S6_S3 9 UMR_BAR__1_1000_0_S6_S3 0 9 /end CHARACTERISTIC
/begin CHARACTERISTIC P_SYSMIN68 "Mindestsystemdruck waehrend Hochschaltungen" VALUE 0x26DEDE kw_ui16_S6_S3 9 UMR_BAR__1_1000_0_S6_S3 0 9 /end CHARACTERISTIC
/begin CHARACTERISTIC P_SYSMINFUELLOPT68 "Mindestsystemdruck waehrend Hochschaltungen, bei aktiver Fkt. optimierte Befuellung" VALUE 0x26DEE0 kw_ui16_S6_S3 9 UMR_BAR__1_1000_0_S6_S3 0 9 /end CHARACTERISTIC
/begin CHARACTERISTIC P_SYSMINFUELLRED68 "Mindestsystemdruck waehrend Hochschaltungen bei red Befüllung" VALUE 0x26DEE2 kw_ui16_S6_S3 9 UMR_BAR__1_1000_0_S6_S3 0 9 /end CHARACTERISTIC
/begin CHARACTERISTIC P_SYSMIN_EFF68 "Mindestsystemdruck waehrend Hochschaltungen bei Zugriff auf Effizienzkennfelder" VALUE 0x26DEE4 kw_ui16_S6_S3 9 UMR_BAR__1_1000_0_S6_S3 0 9 /end CHARACTERISTIC
/begin CHARACTERISTIC P_SYSMIN21 "Mindestsystemdruck waehrend Rueckschaltungen" VALUE 0x26DEE6 kw_ui16_S6_S3 9 UMR_BAR__1_1000_0_S6_S3 0 9 /end CHARACTERISTIC
/begin CHARACTERISTIC P_SYSMINFUELLRED21 "Mindestsystemdruck waehrend Rueckschaltungen bei red Befüllung" VALUE 0x26DEE8 kw_ui16_S6_S3 9 UMR_BAR__1_1000_0_S6_S3 0 9 /end CHARACTERISTIC
/begin CHARACTERISTIC P_SYSMIN_EFF21 "Mindestsystemdruck waehrend Rueckschaltungen bei Zugriff auf Effizienzkennfelder" VALUE 0x26DEEA kw_ui16_S6_S3 9 UMR_BAR__1_1000_0_S6_S3 0 9 /end CHARACTERISTIC
/begin CHARACTERISTIC P_SYSMIN32 "Mindestsystemdruck waehrend Rueckschaltungen" VALUE 0x26DEEC kw_ui16_S6_S3 9 UMR_BAR__1_1000_0_S6_S3 0 9 /end CHARACTERISTIC
/begin CHARACTERISTIC P_SYSMINFUELLRED32 "Mindestsystemdruck waehrend Rueckschaltungen bei red Befüllung" VALUE 0x26DEEE kw_ui16_S6_S3 9 UMR_BAR__1_1000_0_S6_S3 0 9 /end CHARACTERISTIC
/begin CHARACTERISTIC P_SYSMIN_EFF32 "Mindestsystemdruck waehrend Rueckschaltungen bei Zugriff auf Effizienzkennfelder" VALUE 0x26DEF0 kw_ui16_S6_S3 9 UMR_BAR__1_1000_0_S6_S3 0 9 /end CHARACTERISTIC
/begin CHARACTERISTIC P_SYSMIN43 "Mindestsystemdruck waehrend Rueckschaltungen" VALUE 0x26DEF2 kw_ui16_S6_S3 9 UMR_BAR__1_1000_0_S6_S3 0 9 /end CHARACTERISTIC
/begin CHARACTERISTIC P_SYSMINFUELLRED43 "Mindestsystemdruck waehrend Rueckschaltungen bei red Befüllung" VALUE 0x26DEF4 kw_ui16_S6_S3 9 UMR_BAR__1_1000_0_S6_S3 0 9 /end CHARACTERISTIC
/begin CHARACTERISTIC P_SYSMIN_EFF43 "Mindestsystemdruck waehrend Rueckschaltungen bei Zugriff auf Effizienzkennfelder" VALUE 0x26DEF6 kw_ui16_S6_S3 9 UMR_BAR__1_1000_0_S6_S3 0 9 /end CHARACTERISTIC
/begin CHARACTERISTIC P_SYSMIN54 "Mindestsystemdruck waehrend Rueckschaltungen" VALUE 0x26DEF8 kw_ui16_S6_S3 9 UMR_BAR__1_1000_0_S6_S3 0 9 /end CHARACTERISTIC
/begin CHARACTERISTIC P_SYSMINFUELLRED54 "Mindestsystemdruck waehrend Rueckschaltungen bei red Befüllung" VALUE 0x26DEFA kw_ui16_S6_S3 9 UMR_BAR__1_1000_0_S6_S3 0 9 /end CHARACTERISTIC
/begin CHARACTERISTIC P_SYSMIN_EFF54 "Mindestsystemdruck waehrend Rueckschaltungen bei Zugriff auf Effizienzkennfelder" VALUE 0x26DEFC kw_ui16_S6_S3 9 UMR_BAR__1_1000_0_S6_S3 0 9 /end CHARACTERISTIC
/begin CHARACTERISTIC P_SYSMIN65 "Mindestsystemdruck waehrend Rueckschaltungen" VALUE 0x26DEFE kw_ui16_S6_S3 9 UMR_BAR__1_1000_0_S6_S3 0 9 /end CHARACTERISTIC
/begin CHARACTERISTIC P_SYSMINFUELLRED65 "Mindestsystemdruck waehrend Rueckschaltungen bei red Befüllung" VALUE 0x26DF00 kw_ui16_S6_S3 9 UMR_BAR__1_1000_0_S6_S3 0 9 /end CHARACTERISTIC
/begin CHARACTERISTIC P_SYSMIN_EFF65 "Mindestsystemdruck waehrend Rueckschaltungen bei Zugriff auf Effizienzkennfelder" VALUE 0x26DF02 kw_ui16_S6_S3 9 UMR_BAR__1_1000_0_S6_S3 0 9 /end CHARACTERISTIC
/begin CHARACTERISTIC P_SYSMIN76 "Mindestsystemdruck waehrend Rueckschaltungen" VALUE 0x26DF04 kw_ui16_S6_S3 9 UMR_BAR__1_1000_0_S6_S3 0 9 /end CHARACTERISTIC
/begin CHARACTERISTIC P_SYSMINFUELLRED76 "Mindestsystemdruck waehrend Rueckschaltungen bei red Befüllung" VALUE 0x26DF06 kw_ui16_S6_S3 9 UMR_BAR__1_1000_0_S6_S3 0 9 /end CHARACTERISTIC
/begin CHARACTERISTIC P_SYSMIN_EFF76 "Mindestsystemdruck waehrend Rueckschaltungen bei Zugriff auf Effizienzkennfelder" VALUE 0x26DF08 kw_ui16_S6_S3 9 UMR_BAR__1_1000_0_S6_S3 0 9 /end CHARACTERISTIC
/begin CHARACTERISTIC P_SYSMIN87 "Mindestsystemdruck waehrend Rueckschaltungen" VALUE 0x26DF0A kw_ui16_S6_S3 9 UMR_BAR__1_1000_0_S6_S3 0 9 /end CHARACTERISTIC
/begin CHARACTERISTIC P_SYSMINFUELLRED87 "Mindestsystemdruck waehrend Rueckschaltungen bei red Befüllung" VALUE 0x26DF0C kw_ui16_S6_S3 9 UMR_BAR__1_1000_0_S6_S3 0 9 /end CHARACTERISTIC
/begin CHARACTERISTIC P_SYSMIN_EFF87 "Mindestsystemdruck waehrend Rueckschaltungen bei Zugriff auf Effizienzkennfelder" VALUE 0x26DF0E kw_ui16_S6_S3 9 UMR_BAR__1_1000_0_S6_S3 0 9 /end CHARACTERISTIC
/begin CHARACTERISTIC P_SYSMINSP31 "Mindestsystemdruck waehrend Rueckschaltungen" VALUE 0x26DF10 kw_ui16_S6_S3 9 UMR_BAR__1_1000_0_S6_S3 0 9 /end CHARACTERISTIC
/begin CHARACTERISTIC P_SYSMINFUELLREDSP31 "Mindestsystemdruck waehrend Rueckschaltungen bei red Befüllung" VALUE 0x26DF12 kw_ui16_S6_S3 9 UMR_BAR__1_1000_0_S6_S3 0 9 /end CHARACTERISTIC
/begin CHARACTERISTIC P_SYSMIN_EFFSP31 "Mindestsystemdruck waehrend Rueckschaltungen bei Zugriff auf Effizienzkennfelder" VALUE 0x26DF14 kw_ui16_S6_S3 9 UMR_BAR__1_1000_0_S6_S3 0 9 /end CHARACTERISTIC
/begin CHARACTERISTIC P_SYSMINSP42 "Mindestsystemdruck waehrend Rueckschaltungen" VALUE 0x26DF16 kw_ui16_S6_S3 9 UMR_BAR__1_1000_0_S6_S3 0 9 /end CHARACTERISTIC
/begin CHARACTERISTIC P_SYSMINFUELLREDSP42 "Mindestsystemdruck waehrend Rueckschaltungen bei red Befüllung" VALUE 0x26DF18 kw_ui16_S6_S3 9 UMR_BAR__1_1000_0_S6_S3 0 9 /end CHARACTERISTIC
/begin CHARACTERISTIC P_SYSMIN_EFFSP42 "Mindestsystemdruck waehrend Rueckschaltungen bei Zugriff auf Effizienzkennfelder" VALUE 0x26DF1A kw_ui16_S6_S3 9 UMR_BAR__1_1000_0_S6_S3 0 9 /end CHARACTERISTIC
/begin CHARACTERISTIC P_SYSMINSP53 "Mindestsystemdruck waehrend Rueckschaltungen" VALUE 0x26DF1C kw_ui16_S6_S3 9 UMR_BAR__1_1000_0_S6_S3 0 9 /end CHARACTERISTIC
/begin CHARACTERISTIC P_SYSMINFUELLREDSP53 "Mindestsystemdruck waehrend Rueckschaltungen bei red Befüllung" VALUE 0x26DF1E kw_ui16_S6_S3 9 UMR_BAR__1_1000_0_S6_S3 0 9 /end CHARACTERISTIC
/begin CHARACTERISTIC P_SYSMIN_EFFSP53 "Mindestsystemdruck waehrend Rueckschaltungen bei Zugriff auf Effizienzkennfelder" VALUE 0x26DF20 kw_ui16_S6_S3 9 UMR_BAR__1_1000_0_S6_S3 0 9 /end CHARACTERISTIC
/begin CHARACTERISTIC P_SYSMINSP64 "Mindestsystemdruck waehrend Rueckschaltungen" VALUE 0x26DF22 kw_ui16_S6_S3 9 UMR_BAR__1_1000_0_S6_S3 0 9 /end CHARACTERISTIC
/begin CHARACTERISTIC P_SYSMINFUELLREDSP64 "Mindestsystemdruck waehrend Rueckschaltungen bei red Befüllung" VALUE 0x26DF24 kw_ui16_S6_S3 9 UMR_BAR__1_1000_0_S6_S3 0 9 /end CHARACTERISTIC
/begin CHARACTERISTIC P_SYSMIN_EFFSP64 "Mindestsystemdruck waehrend Rueckschaltungen bei Zugriff auf Effizienzkennfelder" VALUE 0x26DF26 kw_ui16_S6_S3 9 UMR_BAR__1_1000_0_S6_S3 0 9 /end CHARACTERISTIC
/begin CHARACTERISTIC P_SYSMINSP75 "Mindestsystemdruck waehrend Rueckschaltungen" VALUE 0x26DF28 kw_ui16_S6_S3 9 UMR_BAR__1_1000_0_S6_S3 0 9 /end CHARACTERISTIC
/begin CHARACTERISTIC P_SYSMINFUELLREDSP75 "Mindestsystemdruck waehrend Rueckschaltungen bei red Befüllung" VALUE 0x26DF2A kw_ui16_S6_S3 9 UMR_BAR__1_1000_0_S6_S3 0 9 /end CHARACTERISTIC
/begin CHARACTERISTIC P_SYSMIN_EFFSP75 "Mindestsystemdruck waehrend Rueckschaltungen bei Zugriff auf Effizienzkennfelder" VALUE 0x26DF2C kw_ui16_S6_S3 9 UMR_BAR__1_1000_0_S6_S3 0 9 /end CHARACTERISTIC
/begin CHARACTERISTIC P_SYSMINSP86 "Mindestsystemdruck waehrend Rueckschaltungen" VALUE 0x26DF2E kw_ui16_S6_S3 9 UMR_BAR__1_1000_0_S6_S3 0 9 /end CHARACTERISTIC
/begin CHARACTERISTIC P_SYSMINFUELLREDSP86 "Mindestsystemdruck waehrend Rueckschaltungen bei red Befüllung" VALUE 0x26DF30 kw_ui16_S6_S3 9 UMR_BAR__1_1000_0_S6_S3 0 9 /end CHARACTERISTIC
/begin CHARACTERISTIC P_SYSMIN_EFFSP86 "Mindestsystemdruck waehrend Rueckschaltungen bei Zugriff auf Effizienzkennfelder" VALUE 0x26DF32 kw_ui16_S6_S3 9 UMR_BAR__1_1000_0_S6_S3 0 9 /end CHARACTERISTIC
/begin CHARACTERISTIC P_SYSMINSP51 "Mindestsystemdruck waehrend Rueckschaltungen" VALUE 0x26DF34 kw_ui16_S6_S3 9 UMR_BAR__1_1000_0_S6_S3 0 9 /end CHARACTERISTIC
/begin CHARACTERISTIC P_SYSMINFUELLREDSP51 "Mindestsystemdruck waehrend Rueckschaltungen bei red Befüllung" VALUE 0x26DF36 kw_ui16_S6_S3 9 UMR_BAR__1_1000_0_S6_S3 0 9 /end CHARACTERISTIC
/begin CHARACTERISTIC P_SYSMIN_EFFSP51 "Mindestsystemdruck waehrend Rueckschaltungen bei Zugriff auf Effizienzkennfelder" VALUE 0x26DF38 kw_ui16_S6_S3 9 UMR_BAR__1_1000_0_S6_S3 0 9 /end CHARACTERISTIC
/begin CHARACTERISTIC P_SYSMINSP63 "Mindestsystemdruck waehrend Rueckschaltungen" VALUE 0x26DF3A kw_ui16_S6_S3 9 UMR_BAR__1_1000_0_S6_S3 0 9 /end CHARACTERISTIC
/begin CHARACTERISTIC P_SYSMINFUELLREDSP63 "Mindestsystemdruck waehrend Rueckschaltungen bei red Befüllung" VALUE 0x26DF3C kw_ui16_S6_S3 9 UMR_BAR__1_1000_0_S6_S3 0 9 /end CHARACTERISTIC
/begin CHARACTERISTIC P_SYSMIN_EFFSP63 "Mindestsystemdruck waehrend Rueckschaltungen bei Zugriff auf Effizienzkennfelder" VALUE 0x26DF3E kw_ui16_S6_S3 9 UMR_BAR__1_1000_0_S6_S3 0 9 /end CHARACTERISTIC
/begin CHARACTERISTIC P_SYSMINSP71 "Mindestsystemdruck waehrend Rueckschaltungen" VALUE 0x26DF40 kw_ui16_S6_S3 9 UMR_BAR__1_1000_0_S6_S3 0 9 /end CHARACTERISTIC
/begin CHARACTERISTIC P_SYSMINFUELLREDSP71 "Mindestsystemdruck waehrend Rueckschaltungen bei red Befüllung" VALUE 0x26DF42 kw_ui16_S6_S3 9 UMR_BAR__1_1000_0_S6_S3 0 9 /end CHARACTERISTIC
/begin CHARACTERISTIC P_SYSMIN_EFFSP71 "Mindestsystemdruck waehrend Rueckschaltungen bei Zugriff auf Effizienzkennfelder" VALUE 0x26DF44 kw_ui16_S6_S3 9 UMR_BAR__1_1000_0_S6_S3 0 9 /end CHARACTERISTIC
/begin CHARACTERISTIC P_SYSMINSP82 "Mindestsystemdruck waehrend Rueckschaltungen" VALUE 0x26DF46 kw_ui16_S6_S3 9 UMR_BAR__1_1000_0_S6_S3 0 9 /end CHARACTERISTIC
/begin CHARACTERISTIC P_SYSMINFUELLREDSP82 "Mindestsystemdruck waehrend Rueckschaltungen bei red Befüllung" VALUE 0x26DF48 kw_ui16_S6_S3 9 UMR_BAR__1_1000_0_S6_S3 0 9 /end CHARACTERISTIC
/begin CHARACTERISTIC P_SYSMIN_EFFSP82 "Mindestsystemdruck waehrend Rueckschaltungen bei Zugriff auf Effizienzkennfelder" VALUE 0x26DF4A kw_ui16_S6_S3 9 UMR_BAR__1_1000_0_S6_S3 0 9 /end CHARACTERISTIC
/begin CHARACTERISTIC P_SYSMINSP84 "Mindestsystemdruck waehrend Rueckschaltungen" VALUE 0x26DF4C kw_ui16_S6_S3 9 UMR_BAR__1_1000_0_S6_S3 0 9 /end CHARACTERISTIC
/begin CHARACTERISTIC P_SYSMINFUELLREDSP84 "Mindestsystemdruck waehrend Rueckschaltungen bei red Befüllung" VALUE 0x26DF4E kw_ui16_S6_S3 9 UMR_BAR__1_1000_0_S6_S3 0 9 /end CHARACTERISTIC
/begin CHARACTERISTIC P_SYSMIN_EFFSP84 "Mindestsystemdruck waehrend Rueckschaltungen bei Zugriff auf Effizienzkennfelder" VALUE 0x26DF50 kw_ui16_S6_S3 9 UMR_BAR__1_1000_0_S6_S3 0 9 /end CHARACTERISTIC
/begin CHARACTERISTIC TAB_MVG_CGETR "Klassengrenzen fuer Getriebetemperatur MvG" CURVE 0x234BD4 tab_ui8_S6_S3 255 UMR_GRADC__1_1_M40_S6_S3 -40 215
 /begin AXIS_DESCR FIX_AXIS NO_INPUT_QUANTITY UMR___1_1_0_S6_S3 7 0 6 FIX_AXIS_PAR_DIST 0 1 7 /end AXIS_DESCR
/end CHARACTERISTIC
/begin CHARACTERISTIC TAB_MVG_NT "Klassengrenzen fuer NT-Betriebspunkt MvG" CURVE 0x234BE0 tab_ui16_S6_S3 8200 UMR_U_MIN_1_1_0_S6_S3 0 8200
 /begin AXIS_DESCR FIX_AXIS NO_INPUT_QUANTITY UMR___1_1_0_S6_S3 5 0 4 FIX_AXIS_PAR_DIST 0 1 5 /end AXIS_DESCR
/end CHARACTERISTIC
/begin CHARACTERISTIC TAB_MVG_MT "Klassengrenzen fuer MT-Betriebspunkt MvG" CURVE 0x234BF0 tab_si16_S6_S3 1700 UMR_NM__1_1_0_S6_S3 -200 1500
 /begin AXIS_DESCR FIX_AXIS NO_INPUT_QUANTITY UMR___1_1_0_S6_S3 7 0 6 FIX_AXIS_PAR_DIST 0 1 7 /end AXIS_DESCR
/end CHARACTERISTIC
/begin CHARACTERISTIC TAB_MVG_MOTSTART "Klassengrenzen fuer Motorstart Temp MvG" CURVE 0x234C04 tab_ui8_S6_S3 255 UMR_GRADC__1_1_M40_S6_S3 -40 215
 /begin AXIS_DESCR FIX_AXIS NO_INPUT_QUANTITY UMR___1_1_0_S6_S3 7 0 6 FIX_AXIS_PAR_DIST 0 1 7 /end AXIS_DESCR
/end CHARACTERISTIC
/begin CHARACTERISTIC TS_MVG_DATENREF "Standard-Quantisierung fuer MvG" VALUE 0x26D86A kw_ui16_S6_S3 7620 UMR___10_1_0_S6_S3 30 7650 /end CHARACTERISTIC
/begin CHARACTERISTIC TS_MVG_CGETR "Temperatur-Quantisierung fuer MvG" VALUE 0x26D86C kw_ui16_S6_S3 7620 UMR___10_1_0_S6_S3 30 7650 /end CHARACTERISTIC
/begin CHARACTERISTIC SWI_MVG_AKT "Aktivieren von MvG" VALUE 0x26E619 kw_ui8_S6_S3 1 UMR___1_1_0_S6_S3 0 1 /end CHARACTERISTIC
/begin CHARACTERISTIC SWI_MVG_LOESCH "Loeschen von allen MvG-Daten beim Wechsel von 0->1" VALUE 0x26E61A kw_ui8_S6_S3 1 UMR___1_1_0_S6_S3 0 1 /end CHARACTERISTIC
/begin CHARACTERISTIC VERSION_MVG "Versions-Nr des MvG - wird mit abgespeichertem EEPROM-Wert verglichen und loescht falls ungleich den MvG Speicher" VALUE 0x26E61B kw_ui8_S6_S3 255 UMR___1_1_0_S6_S3 0 255 /end CHARACTERISTIC
/begin CHARACTERISTIC SWI_MVGIEPLOESCH "Loeschen der IEP MvG-Daten beim Wechsel von 0->1" VALUE 0x26E61C kw_ui8_S6_S3 1 UMR___1_1_0_S6_S3 0 1 /end CHARACTERISTIC
/begin CHARACTERISTIC SWI_MVGIEPRES "Loeschen der IEP-Werte erlauben" VALUE 0x26E61D kw_ui8_S6_S3 1 UMR___1_1_0_S6_S3 0 1 /end CHARACTERISTIC
/begin CHARACTERISTIC C_GETUWIG_GANG "Getriebetemperaturschwelle fuer Symptomerkennung UWIG (Gang, Gangeinlegen)" VALUE 0x26EA17 kw_ui8_S6_S3 190 UMR_GRADC__1_1_M40_S6_S3 -40 150 /end CHARACTERISTIC
/begin CHARACTERISTIC C_GETUWIG_SCHALT "Getriebetemperaturschwelle fuer Symptomerkennung UWIG (Schaltung)" VALUE 0x26EA18 kw_ui8_S6_S3 190 UMR_GRADC__1_1_M40_S6_S3 -40 150 /end CHARACTERISTIC
/begin CHARACTERISTIC DKI_MAXUWIG_GE "maximales Drosselklappendelta fuer Ueberwachung Gangeinlegen" VALUE 0x26EA19 kw_ui8_S6_S3 100 UMR_PROZENT__20_51_0_S6_S3 0 100 /end CHARACTERISTIC
/begin CHARACTERISTIC DKI_UWIGRNF "Drosselklappenschwelle fuer Rueckkehr zur Normalfunktion UWIG" VALUE 0x26EA1A kw_ui8_S6_S3 100 UMR_PROZENT__20_51_0_S6_S3 0 100 /end CHARACTERISTIC
/begin CHARACTERISTIC MAX_STOER_GANG "Maximale Anzahl Stoerungen im Gang UWIG" VALUE 0x26EA1B kw_ui8_S6_S3 254 UMR___1_1_0_S6_S3 1 255 /end CHARACTERISTIC
/begin CHARACTERISTIC MAX_STOER_GE "Maximale Anzahl Stoerungen waehrend Gangeinlegen UWIG" VALUE 0x26EA1C kw_ui8_S6_S3 254 UMR___1_1_0_S6_S3 1 255 /end CHARACTERISTIC
/begin CHARACTERISTIC MAX_STOER_SCHALT "Maximale Anzahl Stoerungen waehrend Schaltung UWIG" VALUE 0x26EA1D kw_ui8_S6_S3 254 UMR___1_1_0_S6_S3 1 255 /end CHARACTERISTIC
/begin CHARACTERISTIC MAX_SYMUWIG_GANG "Maximale Anzahl Symptome UWIG" VALUE 0x26EA1E kw_ui8_S6_S3 254 UMR___1_1_0_S6_S3 1 255 /end CHARACTERISTIC
/begin CHARACTERISTIC MGS_MOTSOLLUWIG "Motorsollmomentgradientenschwelle fuer die Erhoehung des Stoerzaehlers" VALUE 0x26DF96 kw_si16_S6_S3 2550 UMR_NM_SEC_1_1_0_S6_S3 0 2550 /end CHARACTERISTIC
/begin CHARACTERISTIC MIN_ERFOLGE_GE "Minimale Anzahl Erfolge waehrend Gangeinlegen bei kleiner n_ab UWIG" VALUE 0x26EA1F kw_ui8_S6_S3 254 UMR___1_1_0_S6_S3 1 255 /end CHARACTERISTIC
/begin CHARACTERISTIC N_ABUWIGRNF "Abtriebsdrehzahlschwelle fuer Rueckkehr zur Normalfunktion UWIG" VALUE 0x26DF98 kw_ui16_S6_S3 8160 UMR_U_MIN_1_1_0_S6_S3 0 8160 /end CHARACTERISTIC
/begin CHARACTERISTIC ND_UWIG "Differenzdrehzahl fuer Ueberwachung ausserhalb Schaltung bei kleinen n_ab" VALUE 0x26DF9A kw_ui16_S6_S3 8000 UMR_U_MIN_1_1_0_S6_S3 0 8000 /end CHARACTERISTIC
/begin CHARACTERISTIC ND_UWIGERS "Differenzdrehzahl fuer Ueberwachung ausserhalb Schaltung mit Ersatzwerten bei kleinen n_ab" VALUE 0x26DF9C kw_ui16_S6_S3 8000 UMR_U_MIN_1_1_0_S6_S3 0 8000 /end CHARACTERISTIC
/begin CHARACTERISTIC NGT_MAXUWIG_GE "maximaler Turbinendrehzahlgradient fuer Ueberwachung Gangeinlegen" VALUE 0x26DF9E kw_si16_S6_S3 10000 UMR_U_MINSEC_1_1_0_S6_S3 0 10000 /end CHARACTERISTIC
/begin CHARACTERISTIC NS_ABUWIG "Abtriebsdrehzahlschwelle fuer Symptomerkennung" VALUE 0x26DFA0 kw_ui16_S6_S3 8160 UMR_U_MIN_1_1_0_S6_S3 0 8160 /end CHARACTERISTIC
/begin CHARACTERISTIC NS_ABUWIG2 "Abtriebsdrehzahlschwelle fuer Symptomerkennung bei n_mot kleiner NS_MOTUWIG" VALUE 0x26DFA2 kw_ui16_S6_S3 8160 UMR_U_MIN_1_1_0_S6_S3 0 8160 /end CHARACTERISTIC
/begin CHARACTERISTIC NS_MOTUWIGHYB "Motordrehzahlschwelle zur Symptomerkennung UIG-Ueberwachung (Hybrid)" VALUE 0x26DFA4 kw_ui16_S6_S3 8000 UMR_U_MIN_1_1_0_S6_S3 0 8000 /end CHARACTERISTIC
/begin CHARACTERISTIC NS_TUWIG "Pruefbedinung Turbinendrehzahlschwelle fuer die Symptomerkennung" VALUE 0x26DFA6 kw_ui16_S6_S3 9999 UMR_U_MIN_1_1_0_S6_S3 0 9999 /end CHARACTERISTIC
/begin CHARACTERISTIC SWI_UWIG "Schalter Uebersetzungsueberwachung" VALUE 0x26EA20 kw_ui8_S6_S3 1 UMR___1_1_0_S6_S3 0 1 /end CHARACTERISTIC
/begin CHARACTERISTIC SWI_UWIG_GE "Schalter Uebersetzungsueberwachung waehrend Gangeinlegen" VALUE 0x26EA21 kw_ui8_S6_S3 1 UMR___1_1_0_S6_S3 0 1 /end CHARACTERISTIC
/begin CHARACTERISTIC T_UWIG_GE_D "Maximale Ueberwachungszeit waehrend Gangeinlegen bei kleiner n_ab" VALUE 0x26EA22 kw_ui8_S6_S3 2540 UMR_MSEC__10_1_0_S6_S3 0 2540 /end CHARACTERISTIC
/begin CHARACTERISTIC T_UWIGRNF "Verzoegerungszeit fuer Pruefung auf Rueckkehr zur Normalfuntkion" VALUE 0x26DFA8 kw_ui16_S6_S3 650000 UMR_MSEC__10_1_0_S6_S3 0 650000 /end CHARACTERISTIC
/begin CHARACTERISTIC T_UWIGSAS "Zeit wie lange eine Stoerung der Schaltung zugeordnet wird" VALUE 0x26DFAA kw_ui16_S6_S3 655350 UMR_MSEC__10_1_0_S6_S3 0 655350 /end CHARACTERISTIC
/begin CHARACTERISTIC T_VUWIG "Verzoegerungszeit nach Ende Gangein- und auslegen SBC UWIG" VALUE 0x26EA23 kw_ui8_S6_S3 2540 UMR_MSEC__10_1_0_S6_S3 0 2540 /end CHARACTERISTIC
/begin CHARACTERISTIC T_VUWIGSYM "Verzoegerungszeit nach schwarz/weiss Schaltung durch Symptom UWIG" VALUE 0x26EA24 kw_ui8_S6_S3 800 UMR_MSEC__10_1_0_S6_S3 200 1000 /end CHARACTERISTIC
/begin CHARACTERISTIC TS_RZNUWIG "Zeitschwelle Rueckkehr zur Normalfunktion UWIG" VALUE 0x26DFAC kw_ui16_S6_S3 650000 UMR_MSEC__10_1_0_S6_S3 0 650000 /end CHARACTERISTIC
/begin CHARACTERISTIC T_FMGMOTSOLLUWIG "Filterzeit fuer Motorsollmomentgradient" VALUE 0x26DFAE kw_ui16_S6_S3 999 UMR_MSEC__1_1_0_S6_S3 1 1000 /end CHARACTERISTIC
/begin CHARACTERISTIC KL_N_SYMOFNEUGETR "Offset fuer Symptomzaehler in Abhaengigkeit von der Kilometerlaufleistung." CURVE 0x260910 kl_ui16_S6_S3 20 UMR___1_1_0_S6_S3 0 20
 /begin AXIS_DESCR STD_AXIS NO_INPUT_QUANTITY UMR_KM_H_1_1_0_S6_S3 6 0 65535 DEPOSIT ABSOLUTE MONOTONY MON_INCREASE /end AXIS_DESCR
/end CHARACTERISTIC
/begin CHARACTERISTIC N_DIF_IAE_UWIG "Schwelle für den reellen Bauteilschlupf von Kupplung B (auf Getriebeeingang bezogen)." VALUE 0x26DFB0 kw_si16_S6_S3 2540 UMR_U_MIN_1_1_0_S6_S3 0 2540 /end CHARACTERISTIC
/begin CHARACTERISTIC KL_TVERZSYMIEP "Verzögerungszeit die zum Hochfahren der E-Maschine und zur Druckversorgung benötigt wird" CURVE 0x26092C kl_ui8_S6_S3 2550 UMR_MSEC__10_1_0_S6_S3 0 2550
 /begin AXIS_DESCR STD_AXIS zff_atsys._.iSignale._.obj.sig_c_getr UMR_GRADC__1_1_M40_S6_S3 5 -40 215 DEPOSIT ABSOLUTE MONOTONY MON_INCREASE /end AXIS_DESCR
/end CHARACTERISTIC
/begin CHARACTERISTIC KL_TMAXSYMIEP "Zeitdauer innerhalb der bei keiner Erkennung eines Symptoms die IEP als defekt erkannt wird" CURVE 0x26093C kl_ui8_S6_S3 2550 UMR_MSEC__10_1_0_S6_S3 0 2550
 /begin AXIS_DESCR STD_AXIS zff_atsys._.iSignale._.obj.sig_c_getr UMR_GRADC__1_1_M40_S6_S3 5 -40 215 DEPOSIT ABSOLUTE MONOTONY MON_INCREASE /end AXIS_DESCR
/end CHARACTERISTIC
/begin CHARACTERISTIC NS_EMIEPUWIG "Drehzahlschwelle der EM zur Erkennung eines IEP-Symptoms" VALUE 0x26DFB2 kw_ui16_S6_S3 8160 UMR_U_MIN_1_1_0_S6_S3 0 8160 /end CHARACTERISTIC
/begin CHARACTERISTIC NS_EMIEPUWIGMIN "Überwachungsschwelle für EM-Drehzahl" VALUE 0x26DFB4 kw_ui16_S6_S3 1200 UMR_U_MIN_1_1_0_S6_S3 0 1200 /end CHARACTERISTIC
/begin CHARACTERISTIC NS_ABIEPUWIG "Drehzahlschwelle des Betriebs zur Erkennung eines IEP-Symptoms" VALUE 0x26DFB6 kw_ui16_S6_S3 1200 UMR_U_MIN_1_1_0_S6_S3 0 1200 /end CHARACTERISTIC
/begin COMPU_METHOD SAB_C_CEL_M58_S2_S3 "int = ((phys * 1) / 1) - (-58) Grad Celsius" RAT_FUNC "%2.0" "Grad Celsius" COEFFS 0 1 58 0 0 1 /end COMPU_METHOD
/begin COMPU_METHOD SAB_C_1CEL_M60_S2_S3 "int = ((phys * 1) / 1) - (-60) Grad Celsius" RAT_FUNC "%2.0" "Grad Celsius" COEFFS 0 1 60 0 0 1 /end COMPU_METHOD
/begin COMPU_METHOD SAB_C_CEL100_M40_S2_S3 "int = ((phys * 100) / 1) - (-4000) Grad Celsius" RAT_FUNC "%5.3" "Grad Celsius" COEFFS 0 100 4000 0 0 1 /end COMPU_METHOD
/begin COMPU_METHOD SAB_C_CGT_CEL100_M4000_S2_S3 "int = ((phys * 100) / 1) - (-4000) Grad Celsius" RAT_FUNC "%5.3" "Grad Celsius" COEFFS 0 100 4000 0 0 1 /end COMPU_METHOD
/begin COMPU_METHOD SAB_C_CGT_1000CEL_M40000_S2_S3 "int = ((phys * 1000) / 1) - (-40000) Grad Celsius" RAT_FUNC "%5.3" "Grad Celsius" COEFFS 0 1000 40000 0 0 1 /end COMPU_METHOD
/begin COMPU_METHOD SAB_C_1CEL_M50_S2_S3 "int = ((phys * 1) / 1) - (-50) Grad Celsius" RAT_FUNC "%2.0" "Grad Celsius" COEFFS 0 1 50 0 0 1 /end COMPU_METHOD
/begin COMPU_METHOD SAB_C_1CEL_M58_S2_S3 "int = ((phys * 1) / 1) - (-58) Grad Celsius" RAT_FUNC "%2.0" "Grad Celsius" COEFFS 0 1 58 0 0 1 /end COMPU_METHOD
/begin COMPU_METHOD SAB_C_CGT_1CEL_M50_S2_S3 "int = ((phys * 1) / 1) - (-50) Grad Celsius" RAT_FUNC "%2.0" "Grad Celsius" COEFFS 0 1 50 0 0 1 /end COMPU_METHOD
/begin COMPU_METHOD SAB_C_TEMPEXTERN_CEL2_M50_S2_S3 "int = ((phys * 2) / 1) - (-100) Grad Celsius" RAT_FUNC "%5.3" "Grad Celsius" COEFFS 0 2 100 0 0 1 /end COMPU_METHOD
/begin COMPU_METHOD SAB_C_TEMPEXTERN_CEL4_M128_S2_S3 "int = ((phys * 4) / 1) - (-512) Grad Celsius" RAT_FUNC "%5.3" "Grad Celsius" COEFFS 0 4 512 0 0 1 /end COMPU_METHOD
/begin COMPU_METHOD SAB_C_CEL32_M273_S2_S3 "int = ((phys * 32) / 1) - (-8736) Grad Celsius" RAT_FUNC "%5.3" "Grad Celsius" COEFFS 0 32 8736 0 0 1 /end COMPU_METHOD
/begin COMPU_METHOD UMR___1_100_0_S6_S3 "int = ((phys * 100) / 1) - (0) [-]" RAT_FUNC "%4.2" "[-]" COEFFS 0 100 -0 0 0 1 /end COMPU_METHOD
/begin COMPU_METHOD UMR___1_1_0_S6_S3 "int = ((phys * 1) / 1) - (0) [-]" RAT_FUNC "%2.0" "[-]" COEFFS 0 1 -0 0 0 1 /end COMPU_METHOD
/begin COMPU_METHOD UMR___10_1_0_S6_S3 "int = ((phys * 1) / 10) - (0) [-]" RAT_FUNC "%2.0" "[-]" COEFFS 0 1 -0 0 0 10 /end COMPU_METHOD
/begin COMPU_METHOD UMR_NM__1_1_0_S6_S3 "int = ((phys * 1) / 1) - (0) [Nm]" RAT_FUNC "%2.0" "[Nm]" COEFFS 0 1 -0 0 0 1 /end COMPU_METHOD
/begin COMPU_METHOD UMR_NM_SEC_1_1_0_S6_S3 "int = ((phys * 1) / 1) - (0) [Nm/s]" RAT_FUNC "%2.0" "[Nm/s]" COEFFS 0 1 -0 0 0 1 /end COMPU_METHOD
/begin COMPU_METHOD UMR_BAR__1_1000_0_S6_S3 "int = ((phys * 1000) / 1) - (0) [bar]" RAT_FUNC "%5.3" "[bar]" COEFFS 0 1000 -0 0 0 1 /end COMPU_METHOD
/begin COMPU_METHOD UMR_MBAR_SEC_1_1_0_S6_S3 "int = ((phys * 1) / 1) - (0) [mbar/s]" RAT_FUNC "%2.0" "[mbar/s]" COEFFS 0 1 -0 0 0 1 /end COMPU_METHOD
/begin COMPU_METHOD UMR_BAR_SEC_1_10_0_S6_S3 "int = ((phys * 10) / 1) - (0) [bar/s]" RAT_FUNC "%3.1" "[bar/s]" COEFFS 0 10 -0 0 0 1 /end COMPU_METHOD
/begin COMPU_METHOD UMR_BAR_SEC_1_1_0_S6_S3 "int = ((phys * 1) / 1) - (0) [bar/s]" RAT_FUNC "%2.0" "[bar/s]" COEFFS 0 1 -0 0 0 1 /end COMPU_METHOD
/begin COMPU_METHOD UMR_U_MIN_1_1_0_S6_S3 "int = ((phys * 1) / 1) - (0) [U/min]" RAT_FUNC "%2.0" "[U/min]" COEFFS 0 1 -0 0 0 1 /end COMPU_METHOD
/begin COMPU_METHOD UMR_U_MINSEC_1_1_0_S6_S3 "int = ((phys * 1) / 1) - (0) [U/(min*s)]" RAT_FUNC "%2.0" "[U/(min*s)]" COEFFS 0 1 -0 0 0 1 /end COMPU_METHOD
/begin COMPU_METHOD UMR_U_MINSEC_10000_32767_0_S6_S3 "int = ((phys * 32767) / 10000) - (0) [U/(min*s)]" RAT_FUNC "%6.4" "[U/(min*s)]" COEFFS 0 32767 -0 0 0 10000 /end COMPU_METHOD
/begin COMPU_METHOD UMR_U_MINSEC2_1_1_0_S6_S3 "int = ((phys * 1) / 1) - (0) [U/(min*s^2)]" RAT_FUNC "%2.0" "[U/(min*s^2)]" COEFFS 0 1 -0 0 0 1 /end COMPU_METHOD
/begin COMPU_METHOD UMR_MSEC__1_1_0_S6_S3 "int = ((phys * 1) / 1) - (0) [ms]" RAT_FUNC "%2.0" "[ms]" COEFFS 0 1 -0 0 0 1 /end COMPU_METHOD
/begin COMPU_METHOD UMR_MSEC__10_1_0_S6_S3 "int = ((phys * 1) / 10) - (0) [ms]" RAT_FUNC "%2.0" "[ms]" COEFFS 0 1 -0 0 0 10 /end COMPU_METHOD
/begin COMPU_METHOD UMR_GRADC__1_1_0_S6_S3 "int = ((phys * 1) / 1) - (0) [°C]" RAT_FUNC "%2.0" "[°C]" COEFFS 0 1 -0 0 0 1 /end COMPU_METHOD
/begin COMPU_METHOD UMR_GRADC__1_1_M40_S6_S3 "int = ((phys * 1) / 1) - (-40) [°C]" RAT_FUNC "%2.0" "[°C]" COEFFS 0 1 40 0 0 1 /end COMPU_METHOD
/begin COMPU_METHOD UMR_PROZENT__20_51_0_S6_S3 "int = ((phys * 51) / 20) - (0) [%]" RAT_FUNC "%6.4" "[%]" COEFFS 0 51 -0 0 0 20 /end COMPU_METHOD
/begin COMPU_METHOD UMR_MBARMINSEC__1_1_0_S6_S3 "int = ((phys * 1) / 1) - (0) [0,02mbar/(1/(min*s))]" RAT_FUNC "%2.0" "[0,02mbar/(1/(min*s))]" COEFFS 0 1 -0 0 0 1 /end COMPU_METHOD
/begin COMPU_METHOD UMR_MBARMINSEC_10MSEC_1_1_0_S6_S3 "int = ((phys * 1) / 1) - (0) [0,00031mbar/(10ms/(min*s))]" RAT_FUNC "%2.0" "[0,00031mbar/(10ms/(min*s))]" COEFFS 0 1 -0 0 0 1 /end COMPU_METHOD
/begin COMPU_METHOD UMR_VOLT__1_10_0_S6_S3 "int = ((phys * 10) / 1) - (0) [Volt]" RAT_FUNC "%3.1" "[Volt]" COEFFS 0 10 -0 0 0 1 /end COMPU_METHOD
/begin COMPU_METHOD UMR_KM_H_1_1_0_S6_S3 "int = ((phys * 1) / 1) - (0) [km/h]" RAT_FUNC "%2.0" "[km/h]" COEFFS 0 1 -0 0 0 1 /end COMPU_METHOD
/begin COMPU_METHOD UMR_CM3__1_10_0_S6_S3 "int = ((phys * 10) / 1) - (0) [cm^3]" RAT_FUNC "%3.1" "[cm^3]" COEFFS 0 10 -0 0 0 1 /end COMPU_METHOD
/begin COMPU_METHOD UMR_LITER_MIN_1_10_0_S6_S3 "int = ((phys * 10) / 1) - (0) [Liter/min]" RAT_FUNC "%3.1" "[Liter/min]" COEFFS 0 10 -0 0 0 1 /end COMPU_METHOD
/begin FUNCTION jSasGlsHSS35_Fktn "Applikationesgroessen Instanz jSasGlsHSS35"
 /begin DEF_CHARACTERISTIC KF_NGTGLSHS35 KI_GLSKAB35 KI_GLSKZU35 KL_MPT_WNGTGLS_INIT35 KL_NDGLSNEGHS35 KL_NDGLSPOSHS35 KL_TVGLSKABCG35 KL_UMSCHGLSKZU35 KP_GLSKAB35 KP_GLSKZU35 K_WNGGRGLSPKAB35 K_WNGGRGLSPKZU35 K_WNGKLGLSPKAB35 K_WNGKLGLSPKZU35 TD_STOLGLS35 T_FNGTGLSENDE35 W_NGTGLSENDE35 /end DEF_CHARACTERISTIC
/end FUNCTION
/begin FUNCTION jSasGlsHSS46_Fktn "Applikationesgroessen Instanz jSasGlsHSS46"
 /begin DEF_CHARACTERISTIC KF_NGTGLSHS46 KI_GLSKAB46 KI_GLSKZU46 KL_MPT_WNGTGLS_INIT46 KL_NDGLSNEGHS46 KL_NDGLSPOSHS46 KL_TVGLSKABCG46 KL_UMSCHGLSKZU46 KP_GLSKAB46 KP_GLSKZU46 K_WNGGRGLSPKAB46 K_WNGGRGLSPKZU46 K_WNGKLGLSPKAB46 K_WNGKLGLSPKZU46 TD_STOLGLS46 T_FNGTGLSENDE46 W_NGTGLSENDE46 /end DEF_CHARACTERISTIC
/end FUNCTION
/begin FUNCTION jSasGlsHSS57_Fktn "Applikationesgroessen Instanz jSasGlsHSS57"
 /begin DEF_CHARACTERISTIC KF_NGTGLSHS57 KI_GLSKAB57 KI_GLSKZU57 KL_MPT_WNGTGLS_INIT57 KL_NDGLSNEGHS57 KL_NDGLSPOSHS57 KL_TVGLSKABCG57 KL_UMSCHGLSKZU57 KP_GLSKAB57 KP_GLSKZU57 K_WNGGRGLSPKAB57 K_WNGGRGLSPKZU57 K_WNGKLGLSPKAB57 K_WNGKLGLSPKZU57 TD_STOLGLS57 T_FNGTGLSENDE57 W_NGTGLSENDE57 /end DEF_CHARACTERISTIC
/end FUNCTION
/begin FUNCTION jSasGlsHSS68_Fktn "Applikationesgroessen Instanz jSasGlsHSS68"
 /begin DEF_CHARACTERISTIC KF_NGTGLSHS68 KI_GLSKAB68 KI_GLSKZU68 KL_MPT_WNGTGLS_INIT68 KL_NDGLSNEGHS68 KL_NDGLSPOSHS68 KL_TVGLSKABCG68 KL_UMSCHGLSKZU68 KP_GLSKAB68 KP_GLSKZU68 K_WNGGRGLSPKAB68 K_WNGGRGLSPKZU68 K_WNGKLGLSPKAB68 K_WNGKLGLSPKZU68 TD_STOLGLS68 T_FNGTGLSENDE68 W_NGTGLSENDE68 /end DEF_CHARACTERISTIC
/end FUNCTION
/begin FUNCTION dSasGlsRSS_Fktn "Applikationesgroessen der Komponente dSasGlsRSS"
 /begin SUB_FUNCTION jSasGlsRSS21_Fktn jSasGlsRSS32_Fktn jSasGlsRSS43_Fktn jSasGlsRSS54_Fktn jSasGlsRSS65_Fktn jSasGlsRSS76_Fktn jSasGlsRSS87_Fktn jSasGlsRSS31_Fktn jSasGlsRSS42_Fktn jSasGlsRSS51_Fktn jSasGlsRSS53_Fktn jSasGlsRSS63_Fktn jSasGlsRSS64_Fktn jSasGlsRSS71_Fktn jSasGlsRSS75_Fktn jSasGlsRSS82_Fktn jSasGlsRSS84_Fktn jSasGlsRSS86_Fktn /end SUB_FUNCTION
/end FUNCTION
/begin FUNCTION jSasGlsRSS21_Fktn "Applikationesgroessen Instanz jSasGlsRSS21"
 /begin DEF_CHARACTERISTIC KI_GLSKAB21 KI_GLSKAB21_EL KI_GLSKZU21 KI_GLSKZU21_EL KL_MPT_WNGTGLS_INIT21 KL_POMTUMSCHKABGLS21 KL_TVGLSKZUCG21 KL_UMSCHGLSKAB21 KP_GLSKAB21 KP_GLSKAB21_EL KP_GLSKZU21 KP_GLSKZU21_EL K_WNGGRGLSPKAB21 K_WNGGRGLSPKAB21_EL K_WNGGRGLSPKZU21 K_WNGGRGLSPKZU21_EL K_WNGKLGLSPKAB21 K_WNGKLGLSPKAB21_EL K_WNGKLGLSPKZU21 K_WNGKLGLSPKZU21_EL ND_GLSRS21 TD_STOLGLS21 TD_STOLGLS21_EL /end DEF_CHARACTERISTIC
/end FUNCTION
/begin FUNCTION jSasGlsRSS32_Fktn "Applikationesgroessen Instanz jSasGlsRSS32"
 /begin DEF_CHARACTERISTIC KI_GLSKAB32 KI_GLSKAB32_EL KI_GLSKZU32 KI_GLSKZU32_EL KL_MPT_WNGTGLS_INIT32 KL_POMTUMSCHKABGLS32 KL_TVGLSKZUCG32 KL_UMSCHGLSKAB32 KP_GLSKAB32 KP_GLSKAB32_EL KP_GLSKZU32 KP_GLSKZU32_EL K_WNGGRGLSPKAB32 K_WNGGRGLSPKAB32_EL K_WNGGRGLSPKZU32 K_WNGGRGLSPKZU32_EL K_WNGKLGLSPKAB32 K_WNGKLGLSPKAB32_EL K_WNGKLGLSPKZU32 K_WNGKLGLSPKZU32_EL ND_GLSRS32 TD_STOLGLS32 TD_STOLGLS32_EL /end DEF_CHARACTERISTIC
/end FUNCTION
/begin FUNCTION jSasGlsRSS43_Fktn "Applikationesgroessen Instanz jSasGlsRSS43"
 /begin DEF_CHARACTERISTIC KI_GLSKAB43 KI_GLSKAB43_EL KI_GLSKZU43 KI_GLSKZU43_EL KL_MPT_WNGTGLS_INIT43 KL_POMTUMSCHKABGLS43 KL_TVGLSKZUCG43 KL_UMSCHGLSKAB43 KP_GLSKAB43 KP_GLSKAB43_EL KP_GLSKZU43 KP_GLSKZU43_EL K_WNGGRGLSPKAB43 K_WNGGRGLSPKAB43_EL K_WNGGRGLSPKZU43 K_WNGGRGLSPKZU43_EL K_WNGKLGLSPKAB43 K_WNGKLGLSPKAB43_EL K_WNGKLGLSPKZU43 K_WNGKLGLSPKZU43_EL ND_GLSRS43 TD_STOLGLS43 TD_STOLGLS43_EL /end DEF_CHARACTERISTIC
/end FUNCTION
/begin FUNCTION jSasGlsRSS54_Fktn "Applikationesgroessen Instanz jSasGlsRSS54"
 /begin DEF_CHARACTERISTIC KI_GLSKAB54 KI_GLSKAB54_EL KI_GLSKZU54 KI_GLSKZU54_EL KL_MPT_WNGTGLS_INIT54 KL_POMTUMSCHKABGLS54 KL_TVGLSKZUCG54 KL_UMSCHGLSKAB54 KP_GLSKAB54 KP_GLSKAB54_EL KP_GLSKZU54 KP_GLSKZU54_EL K_WNGGRGLSPKAB54 K_WNGGRGLSPKAB54_EL K_WNGGRGLSPKZU54 K_WNGGRGLSPKZU54_EL K_WNGKLGLSPKAB54 K_WNGKLGLSPKAB54_EL K_WNGKLGLSPKZU54 K_WNGKLGLSPKZU54_EL ND_GLSRS54 TD_STOLGLS54 TD_STOLGLS54_EL /end DEF_CHARACTERISTIC
/end FUNCTION
/begin FUNCTION jSasGlsRSS65_Fktn "Applikationesgroessen Instanz jSasGlsRSS65"
 /begin DEF_CHARACTERISTIC KI_GLSKAB65 KI_GLSKAB65_EL KI_GLSKZU65 KI_GLSKZU65_EL KL_MPT_WNGTGLS_INIT65 KL_POMTUMSCHKABGLS65 KL_TVGLSKZUCG65 KL_UMSCHGLSKAB65 KP_GLSKAB65 KP_GLSKAB65_EL KP_GLSKZU65 KP_GLSKZU65_EL K_WNGGRGLSPKAB65 K_WNGGRGLSPKAB65_EL K_WNGGRGLSPKZU65 K_WNGGRGLSPKZU65_EL K_WNGKLGLSPKAB65 K_WNGKLGLSPKAB65_EL K_WNGKLGLSPKZU65 K_WNGKLGLSPKZU65_EL ND_GLSRS65 TD_STOLGLS65 TD_STOLGLS65_EL /end DEF_CHARACTERISTIC
/end FUNCTION
/begin FUNCTION jSasGlsRSS76_Fktn "Applikationesgroessen Instanz jSasGlsRSS76"
 /begin DEF_CHARACTERISTIC KI_GLSKAB76 KI_GLSKAB76_EL KI_GLSKZU76 KI_GLSKZU76_EL KL_MPT_WNGTGLS_INIT76 KL_POMTUMSCHKABGLS76 KL_TVGLSKZUCG76 KL_UMSCHGLSKAB76 KP_GLSKAB76 KP_GLSKAB76_EL KP_GLSKZU76 KP_GLSKZU76_EL K_WNGGRGLSPKAB76 K_WNGGRGLSPKAB76_EL K_WNGGRGLSPKZU76 K_WNGGRGLSPKZU76_EL K_WNGKLGLSPKAB76 K_WNGKLGLSPKAB76_EL K_WNGKLGLSPKZU76 K_WNGKLGLSPKZU76_EL ND_GLSRS76 TD_STOLGLS76 TD_STOLGLS76_EL /end DEF_CHARACTERISTIC
/end FUNCTION
/begin FUNCTION jSasGlsRSS87_Fktn "Applikationesgroessen Instanz jSasGlsRSS87"
 /begin DEF_CHARACTERISTIC KI_GLSKAB87 KI_GLSKAB87_EL KI_GLSKZU87 KI_GLSKZU87_EL KL_MPT_WNGTGLS_INIT87 KL_POMTUMSCHKABGLS87 KL_TVGLSKZUCG87 KL_UMSCHGLSKAB87 KP_GLSKAB87 KP_GLSKAB87_EL KP_GLSKZU87 KP_GLSKZU87_EL K_WNGGRGLSPKAB87 K_WNGGRGLSPKAB87_EL K_WNGGRGLSPKZU87 K_WNGGRGLSPKZU87_EL K_WNGKLGLSPKAB87 K_WNGKLGLSPKAB87_EL K_WNGKLGLSPKZU87 K_WNGKLGLSPKZU87_EL ND_GLSRS87 TD_STOLGLS87 TD_STOLGLS87_EL /end DEF_CHARACTERISTIC
/end FUNCTION
/begin FUNCTION jSasGlsRSS31_Fktn "Applikationesgroessen Instanz jSasGlsRSS31"
 /begin DEF_CHARACTERISTIC KI_GLSKABSP31 KI_GLSKABSP31_EL KI_GLSKZUSP31 KI_GLSKZUSP31_EL KL_MPT_WNGTGLS_INITSP31 KL_POMTUMSCHKABGLSSP31 KL_TVGLSKZUCGSP31 KL_UMSCHGLSKABSP31 KP_GLSKABSP31 KP_GLSKABSP31_EL KP_GLSKZUSP31 KP_GLSKZUSP31_EL K_WNGGRGLSPKABSP31 K_WNGGRGLSPKABSP31_EL K_WNGGRGLSPKZUSP31 K_WNGGRGLSPKZUSP31_EL K_WNGKLGLSPKABSP31 K_WNGKLGLSPKABSP31_EL K_WNGKLGLSPKZUSP31 K_WNGKLGLSPKZUSP31_EL ND_GLSRSSP31 TD_STOLGLSSP31 TD_STOLGLSSP31_EL /end DEF_CHARACTERISTIC
/end FUNCTION
/begin FUNCTION jSasGlsRSS42_Fktn "Applikationesgroessen Instanz jSasGlsRSS42"
 /begin DEF_CHARACTERISTIC KI_GLSKABSP42 KI_GLSKABSP42_EL KI_GLSKZUSP42 KI_GLSKZUSP42_EL KL_MPT_WNGTGLS_INITSP42 KL_POMTUMSCHKABGLSSP42 KL_TVGLSKZUCGSP42 KL_UMSCHGLSKABSP42 KP_GLSKABSP42 KP_GLSKABSP42_EL KP_GLSKZUSP42 KP_GLSKZUSP42_EL K_WNGGRGLSPKABSP42 K_WNGGRGLSPKABSP42_EL K_WNGGRGLSPKZUSP42 K_WNGGRGLSPKZUSP42_EL K_WNGKLGLSPKABSP42 K_WNGKLGLSPKABSP42_EL K_WNGKLGLSPKZUSP42 K_WNGKLGLSPKZUSP42_EL ND_GLSRSSP42 TD_STOLGLSSP42 TD_STOLGLSSP42_EL /end DEF_CHARACTERISTIC
/end FUNCTION
/begin FUNCTION jSasGlsRSS51_Fktn "Applikationesgroessen Instanz jSasGlsRSS51"
 /begin DEF_CHARACTERISTIC KI_GLSKABSP51 KI_GLSKABSP51_EL KI_GLSKZUSP51 KI_GLSKZUSP51_EL KL_MPT_WNGTGLS_INITSP51 KL_POMTUMSCHKABGLSSP51 KL_TVGLSKZUCGSP51 KL_UMSCHGLSKABSP51 KP_GLSKABSP51 KP_GLSKABSP51_EL KP_GLSKZUSP51 KP_GLSKZUSP51_EL K_WNGGRGLSPKABSP51 K_WNGGRGLSPKABSP51_EL K_WNGGRGLSPKZUSP51 K_WNGGRGLSPKZUSP51_EL K_WNGKLGLSPKABSP51 K_WNGKLGLSPKABSP51_EL K_WNGKLGLSPKZUSP51 K_WNGKLGLSPKZUSP51_EL ND_GLSRSSP51 TD_STOLGLSSP51 TD_STOLGLSSP51_EL /end DEF_CHARACTERISTIC
/end FUNCTION
/begin FUNCTION jSasGlsRSS53_Fktn "Applikationesgroessen Instanz jSasGlsRSS53"
 /begin DEF_CHARACTERISTIC KI_GLSKABSP53 KI_GLSKABSP53_EL KI_GLSKZUSP53 KI_GLSKZUSP53_EL KL_MPT_WNGTGLS_INITSP53 KL_POMTUMSCHKABGLSSP53 KL_TVGLSKZUCGSP53 KL_UMSCHGLSKABSP53 KP_GLSKABSP53 KP_GLSKABSP53_EL KP_GLSKZUSP53 KP_GLSKZUSP53_EL K_WNGGRGLSPKABSP53 K_WNGGRGLSPKABSP53_EL K_WNGGRGLSPKZUSP53 K_WNGGRGLSPKZUSP53_EL K_WNGKLGLSPKABSP53 K_WNGKLGLSPKABSP53_EL K_WNGKLGLSPKZUSP53 K_WNGKLGLSPKZUSP53_EL ND_GLSRSSP53 TD_STOLGLSSP53 TD_STOLGLSSP53_EL /end DEF_CHARACTERISTIC
/end FUNCTION
/begin FUNCTION jSasGlsRSS63_Fktn "Applikationesgroessen Instanz jSasGlsRSS63"
 /begin DEF_CHARACTERISTIC KI_GLSKABSP63 KI_GLSKABSP63_EL KI_GLSKZUSP63 KI_GLSKZUSP63_EL KL_MPT_WNGTGLS_INITSP63 KL_POMTUMSCHKABGLSSP63 KL_TVGLSKZUCGSP63 KL_UMSCHGLSKABSP63 KP_GLSKABSP63 KP_GLSKABSP63_EL KP_GLSKZUSP63 KP_GLSKZUSP63_EL K_WNGGRGLSPKABSP63 K_WNGGRGLSPKABSP63_EL K_WNGGRGLSPKZUSP63 K_WNGGRGLSPKZUSP63_EL K_WNGKLGLSPKABSP63 K_WNGKLGLSPKABSP63_EL K_WNGKLGLSPKZUSP63 K_WNGKLGLSPKZUSP63_EL ND_GLSRSSP63 TD_STOLGLSSP63 TD_STOLGLSSP63_EL /end DEF_CHARACTERISTIC
/end FUNCTION
/begin FUNCTION jSasGlsRSS64_Fktn "Applikationesgroessen Instanz jSasGlsRSS64"
 /begin DEF_CHARACTERISTIC KI_GLSKABSP64 KI_GLSKABSP64_EL KI_GLSKZUSP64 KI_GLSKZUSP64_EL KL_MPT_WNGTGLS_INITSP64 KL_POMTUMSCHKABGLSSP64 KL_TVGLSKZUCGSP64 KL_UMSCHGLSKABSP64 KP_GLSKABSP64 KP_GLSKABSP64_EL KP_GLSKZUSP64 KP_GLSKZUSP64_EL K_WNGGRGLSPKABSP64 K_WNGGRGLSPKABSP64_EL K_WNGGRGLSPKZUSP64 K_WNGGRGLSPKZUSP64_EL K_WNGKLGLSPKABSP64 K_WNGKLGLSPKABSP64_EL K_WNGKLGLSPKZUSP64 K_WNGKLGLSPKZUSP64_EL ND_GLSRSSP64 TD_STOLGLSSP64 TD_STOLGLSSP64_EL /end DEF_CHARACTERISTIC
/end FUNCTION
/begin FUNCTION jSasGlsRSS71_Fktn "Applikationesgroessen Instanz jSasGlsRSS71"
 /begin DEF_CHARACTERISTIC KI_GLSKABSP71 KI_GLSKABSP71_EL KI_GLSKZUSP71 KI_GLSKZUSP71_EL KL_MPT_WNGTGLS_INITSP71 KL_POMTUMSCHKABGLSSP71 KL_TVGLSKZUCGSP71 KL_UMSCHGLSKABSP71 KP_GLSKABSP71 KP_GLSKABSP71_EL KP_GLSKZUSP71 KP_GLSKZUSP71_EL K_WNGGRGLSPKABSP71 K_WNGGRGLSPKABSP71_EL K_WNGGRGLSPKZUSP71 K_WNGGRGLSPKZUSP71_EL K_WNGKLGLSPKABSP71 K_WNGKLGLSPKABSP71_EL K_WNGKLGLSPKZUSP71 K_WNGKLGLSPKZUSP71_EL ND_GLSRSSP71 TD_STOLGLSSP71 TD_STOLGLSSP71_EL /end DEF_CHARACTERISTIC
/end FUNCTION
/begin FUNCTION jSasGlsRSS75_Fktn "Applikationesgroessen Instanz jSasGlsRSS75"
 /begin DEF_CHARACTERISTIC KI_GLSKABSP75 KI_GLSKABSP75_EL KI_GLSKZUSP75 KI_GLSKZUSP75_EL KL_MPT_WNGTGLS_INITSP75 KL_POMTUMSCHKABGLSSP75 KL_TVGLSKZUCGSP75 KL_UMSCHGLSKABSP75 KP_GLSKABSP75 KP_GLSKABSP75_EL KP_GLSKZUSP75 KP_GLSKZUSP75_EL K_WNGGRGLSPKABSP75 K_WNGGRGLSPKABSP75_EL K_WNGGRGLSPKZUSP75 K_WNGGRGLSPKZUSP75_EL K_WNGKLGLSPKABSP75 K_WNGKLGLSPKABSP75_EL K_WNGKLGLSPKZUSP75 K_WNGKLGLSPKZUSP75_EL ND_GLSRSSP75 TD_STOLGLSSP75 TD_STOLGLSSP75_EL /end DEF_CHARACTERISTIC
/end FUNCTION
/begin FUNCTION jSasGlsRSS82_Fktn "Applikationesgroessen Instanz jSasGlsRSS82"
 /begin DEF_CHARACTERISTIC KI_GLSKABSP82 KI_GLSKABSP82_EL KI_GLSKZUSP82 KI_GLSKZUSP82_EL KL_MPT_WNGTGLS_INITSP82 KL_POMTUMSCHKABGLSSP82 KL_TVGLSKZUCGSP82 KL_UMSCHGLSKABSP82 KP_GLSKABSP82 KP_GLSKABSP82_EL KP_GLSKZUSP82 KP_GLSKZUSP82_EL K_WNGGRGLSPKABSP82 K_WNGGRGLSPKABSP82_EL K_WNGGRGLSPKZUSP82 K_WNGGRGLSPKZUSP82_EL K_WNGKLGLSPKABSP82 K_WNGKLGLSPKABSP82_EL K_WNGKLGLSPKZUSP82 K_WNGKLGLSPKZUSP82_EL ND_GLSRSSP82 TD_STOLGLSSP82 TD_STOLGLSSP82_EL /end DEF_CHARACTERISTIC
/end FUNCTION
/begin FUNCTION jSasGlsRSS84_Fktn "Applikationesgroessen Instanz jSasGlsRSS84"
 /begin DEF_CHARACTERISTIC KI_GLSKABSP84 KI_GLSKABSP84_EL KI_GLSKZUSP84 KI_GLSKZUSP84_EL KL_MPT_WNGTGLS_INITSP84 KL_POMTUMSCHKABGLSSP84 KL_TVGLSKZUCGSP84 KL_UMSCHGLSKABSP84 KP_GLSKABSP84 KP_GLSKABSP84_EL KP_GLSKZUSP84 KP_GLSKZUSP84_EL K_WNGGRGLSPKABSP84 K_WNGGRGLSPKABSP84_EL K_WNGGRGLSPKZUSP84 K_WNGGRGLSPKZUSP84_EL K_WNGKLGLSPKABSP84 K_WNGKLGLSPKABSP84_EL K_WNGKLGLSPKZUSP84 K_WNGKLGLSPKZUSP84_EL ND_GLSRSSP84 TD_STOLGLSSP84 TD_STOLGLSSP84_EL /end DEF_CHARACTERISTIC
/end FUNCTION
/begin FUNCTION jSasGlsRSS86_Fktn "Applikationesgroessen Instanz jSasGlsRSS86"
 /begin DEF_CHARACTERISTIC KI_GLSKABSP86 KI_GLSKABSP86_EL KI_GLSKZUSP86 KI_GLSKZUSP86_EL KL_MPT_WNGTGLS_INITSP86 KL_POMTUMSCHKABGLSSP86 KL_TVGLSKZUCGSP86 KL_UMSCHGLSKABSP86 KP_GLSKABSP86 KP_GLSKABSP86_EL KP_GLSKZUSP86 KP_GLSKZUSP86_EL K_WNGGRGLSPKABSP86 K_WNGGRGLSPKABSP86_EL K_WNGGRGLSPKZUSP86 K_WNGGRGLSPKZUSP86_EL K_WNGKLGLSPKABSP86 K_WNGKLGLSPKABSP86_EL K_WNGKLGLSPKZUSP86 K_WNGKLGLSPKZUSP86_EL ND_GLSRSSP86 TD_STOLGLSSP86 TD_STOLGLSSP86_EL /end DEF_CHARACTERISTIC
/end FUNCTION
/begin FUNCTION dSasKflwe_Fktn "Applikationesgroessen der Komponente dSasKflwe" /begin SUB_FUNCTION jSasKflwe_Fktn /end SUB_FUNCTION /end FUNCTION
/begin FUNCTION jSasKflwe_Fktn "Applikationesgroessen Instanz jSasKflwe"
 /begin DEF_CHARACTERISTIC CS_RNDDNR DKIS_RNDDNR NS_ABRNDDNR NS_MOTRNDDNR NS_TABBRRNDDNR TS_DNRRND_MAX_ZEIT /end DEF_CHARACTERISTIC
/end FUNCTION
/begin FUNCTION dSasKflweW_Fktn "Applikationesgroessen der Komponente dSasKflweW"
 /begin SUB_FUNCTION jSasKflweWDNR_Fktn jSasKflweWRND_Fktn jSasKflweWDNRV2_Fktn jSasKflweWRNDV2_Fktn jSasKflweWD2NR_Fktn /end SUB_FUNCTION
/end FUNCTION
/begin FUNCTION jSasKflweWDNR_Fktn "Applikationesgroessen Instanz jSasKflweWDNR" /begin DEF_CHARACTERISTIC KF_PKABNDNMOTNTCGDNR PG_KABABBRDNR PG_KABDNR /end DEF_CHARACTERISTIC /end FUNCTION
/begin FUNCTION jSasKflweWRND_Fktn "Applikationesgroessen Instanz jSasKflweWRND" /begin DEF_CHARACTERISTIC KF_PKABNDNMOTNTCGRND PG_KABABBRRND PG_KABRND /end DEF_CHARACTERISTIC /end FUNCTION
/begin FUNCTION jSasKflweWDNRV2_Fktn "Applikationesgroessen Instanz jSasKflweWDNRV2" /begin DEF_CHARACTERISTIC KF_PKABNDNMOTNTCGDNRV2 PG_KABABBRDNRV2 PG_KABDNRV2 /end DEF_CHARACTERISTIC /end FUNCTION
/begin FUNCTION jSasKflweWRNDV2_Fktn "Applikationesgroessen Instanz jSasKflweWRNDV2" /begin DEF_CHARACTERISTIC KF_PKABNDNMOTNTCGRNDV2 PG_KABABBRRNDV2 PG_KABRNDV2 /end DEF_CHARACTERISTIC /end FUNCTION
/begin FUNCTION jSasKflweWD2NR_Fktn "Applikationesgroessen Instanz jSasKflweWD2NR" /begin DEF_CHARACTERISTIC KF_PKABNDNMOTNTCGD2NR PG_KABABBRD2NR PG_KABD2NR /end DEF_CHARACTERISTIC /end FUNCTION
/begin FUNCTION dSasStrat_Fktn "Applikationesgroessen der Komponente dSasStrat" /begin SUB_FUNCTION jSasStrat_Fktn /end SUB_FUNCTION /end FUNCTION
/begin FUNCTION jSasStrat_Fktn "Applikationesgroessen Instanz jSasStrat"
 /begin DEF_CHARACTERISTIC CS_FUELLOPTOB CS_FUELLOPTUN CS_FUELLREDOB CS_FUELLREDUN KF_QLECKAGE KL_QVERBR_KUEHL KL_TSNABESTARTSTART NS_ESTART NS_ESTARTHYS NS_MOTFUELLOPT Q_FUELLRED_A Q_FUELLRED_B Q_FUELLRED_C Q_FUELLRED_D Q_FUELLRED_E Q_FUELLRED_K0 Q_VERBR_IAE Q_VERBR_K0 Q_VERBR_KAB Q_VERBR_SYS TAB_REDFUELL TAB_SWIFUELLOPT TS_ESTART V_PUMPE /end DEF_CHARACTERISTIC
/end FUNCTION
/begin FUNCTION dSasPsyst_Fktn "Applikationesgroessen der Komponente dSasPsyst" /begin SUB_FUNCTION jSasPsyst_Fktn /end SUB_FUNCTION /end FUNCTION
/begin FUNCTION jSasPsyst_Fktn "Applikationesgroessen Instanz jSasPsyst"
 /begin DEF_CHARACTERISTIC CGT_PSYSIAE CGT_PSYSIAEHYS CS_KUPPLPSYS CS_KUPPLPSYS_EFF CS_KUPPLPSYS_HYS_EFF CS_PSYSIEP CS_PSYS_EFF_OB CS_PSYS_EFF_UN CS_PSYS_HYS_EFF CS_UNMAXPSYS HYS_CKUPPLPSYS KF_PIEP_SYS KF_PSYSN KF_PSYS_K0 KL_F_PIEP_SYS KL_F_P_KUP_BEDARF KL_POSYSCG_DR KL_POSYSCG_PN KL_PPUMPE_SYS KL_TFPSYSIST KL_TMAXPSYS KL_TPSYSCGPSAUS MG_PSYSMINPULS MS_TPSYSIAEHYS MS_TPSYSIAEOB MS_TPSYSIAEUN NS_TPSYSIAEHYS NS_TPSYSIAEOB NS_TPSYSIAEUN N_MOTMAXPSYS PO_KUP_BEDARF_SCHALT P_SYSIAE_INC P_SYSMINCKUPL P_SYSMINFUELLOPT_K0 P_SYSMINFUELLRED_D P_SYSMINFUELLRED_K0 P_SYSMINFUELLRED_R P_SYSMINIEP P_SYSMINK0 P_SYSMINPOSV P_SYSMINPSAUS P_SYSMINPULS P_SYSMINSTADA P_SYSMIN_D P_SYSMIN_EFF_D P_SYSMIN_EFF_R P_SYSMIN_R P_SYSMIN_TRANSPORTMODE SWI_BGB_AKTIV SWI_BGB_IEP_AKTIV T_FPSYS T_PSYSMASS_EFF /end DEF_CHARACTERISTIC
/end FUNCTION
/begin FUNCTION dSasPsyGeG_Fktn "Applikationesgroessen der Komponente dSasPsyGeG"
 /begin SUB_FUNCTION jSasPsyGeGR_Fktn jSasPsyGeG1_Fktn jSasPsyGeG2_Fktn jSasPsyGeG3_Fktn jSasPsyGeG4_Fktn jSasPsyGeG5_Fktn jSasPsyGeG6_Fktn jSasPsyGeG7_Fktn jSasPsyGeG8_Fktn /end SUB_FUNCTION
/end FUNCTION
/begin FUNCTION jSasPsyGeGR_Fktn "Applikationesgroessen Instanz jSasPsyGeGR" /begin DEF_CHARACTERISTIC KF_PSYS_EFF_R KF_PSYS_R P_SYSMIN_IAE_R /end DEF_CHARACTERISTIC /end FUNCTION
/begin FUNCTION jSasPsyGeG1_Fktn "Applikationesgroessen Instanz jSasPsyGeG1" /begin DEF_CHARACTERISTIC KF_PSYS_1 KF_PSYS_EFF_1 P_SYSMIN_IAE_1 /end DEF_CHARACTERISTIC /end FUNCTION
/begin FUNCTION jSasPsyGeG2_Fktn "Applikationesgroessen Instanz jSasPsyGeG2" /begin DEF_CHARACTERISTIC KF_PSYS_2 KF_PSYS_EFF_2 P_SYSMIN_IAE_2 /end DEF_CHARACTERISTIC /end FUNCTION
/begin FUNCTION jSasPsyGeG3_Fktn "Applikationesgroessen Instanz jSasPsyGeG3" /begin DEF_CHARACTERISTIC KF_PSYS_3 KF_PSYS_EFF_3 /end DEF_CHARACTERISTIC /end FUNCTION
/begin FUNCTION jSasPsyGeG4_Fktn "Applikationesgroessen Instanz jSasPsyGeG4" /begin DEF_CHARACTERISTIC KF_PSYS_4 KF_PSYS_EFF_4 /end DEF_CHARACTERISTIC /end FUNCTION
/begin FUNCTION jSasPsyGeG5_Fktn "Applikationesgroessen Instanz jSasPsyGeG5" /begin DEF_CHARACTERISTIC KF_PSYS_5 KF_PSYS_EFF_5 /end DEF_CHARACTERISTIC /end FUNCTION
/begin FUNCTION jSasPsyGeG6_Fktn "Applikationesgroessen Instanz jSasPsyGeG6" /begin DEF_CHARACTERISTIC KF_PSYS_6 KF_PSYS_EFF_6 /end DEF_CHARACTERISTIC /end FUNCTION
/begin FUNCTION jSasPsyGeG7_Fktn "Applikationesgroessen Instanz jSasPsyGeG7" /begin DEF_CHARACTERISTIC KF_PSYS_7 KF_PSYS_EFF_7 /end DEF_CHARACTERISTIC /end FUNCTION
/begin FUNCTION jSasPsyGeG8_Fktn "Applikationesgroessen Instanz jSasPsyGeG8" /begin DEF_CHARACTERISTIC KF_PSYS_8 KF_PSYS_EFF_8 /end DEF_CHARACTERISTIC /end FUNCTION
/begin FUNCTION dSasPsyHSS_Fktn "Applikationesgroessen der Komponente dSasPsyHSS"
 /begin SUB_FUNCTION jSasPsyHSS12_Fktn jSasPsyHSS23_Fktn jSasPsyHSS34_Fktn jSasPsyHSS45_Fktn jSasPsyHSS56_Fktn jSasPsyHSS67_Fktn jSasPsyHSS78_Fktn jSasPsyHSS13_Fktn jSasPsyHSS24_Fktn jSasPsyHSS35_Fktn jSasPsyHSS46_Fktn jSasPsyHSS57_Fktn jSasPsyHSS68_Fktn /end SUB_FUNCTION
/end FUNCTION
/begin FUNCTION jSasPsyHSS12_Fktn "Applikationesgroessen Instanz jSasPsyHSS12"
 /begin DEF_CHARACTERISTIC P_SYSMIN12 P_SYSMINFUELLOPT12 P_SYSMINFUELLRED12 P_SYSMIN_EFF12 /end DEF_CHARACTERISTIC
/end FUNCTION
/begin FUNCTION jSasPsyHSS23_Fktn "Applikationesgroessen Instanz jSasPsyHSS23"
 /begin DEF_CHARACTERISTIC P_SYSMIN23 P_SYSMINFUELLOPT23 P_SYSMINFUELLRED23 P_SYSMIN_EFF23 /end DEF_CHARACTERISTIC
/end FUNCTION
/begin FUNCTION jSasPsyHSS34_Fktn "Applikationesgroessen Instanz jSasPsyHSS34"
 /begin DEF_CHARACTERISTIC P_SYSMIN34 P_SYSMINFUELLOPT34 P_SYSMINFUELLRED34 P_SYSMIN_EFF34 /end DEF_CHARACTERISTIC
/end FUNCTION
/begin FUNCTION jSasPsyHSS45_Fktn "Applikationesgroessen Instanz jSasPsyHSS45"
 /begin DEF_CHARACTERISTIC P_SYSMIN45 P_SYSMINFUELLOPT45 P_SYSMINFUELLRED45 P_SYSMIN_EFF45 /end DEF_CHARACTERISTIC
/end FUNCTION
/begin FUNCTION jSasPsyHSS56_Fktn "Applikationesgroessen Instanz jSasPsyHSS56"
 /begin DEF_CHARACTERISTIC P_SYSMIN56 P_SYSMINFUELLOPT56 P_SYSMINFUELLRED56 P_SYSMIN_EFF56 /end DEF_CHARACTERISTIC
/end FUNCTION
/begin FUNCTION jSasPsyHSS67_Fktn "Applikationesgroessen Instanz jSasPsyHSS67"
 /begin DEF_CHARACTERISTIC P_SYSMIN67 P_SYSMINFUELLOPT67 P_SYSMINFUELLRED67 P_SYSMIN_EFF67 /end DEF_CHARACTERISTIC
/end FUNCTION
/begin FUNCTION jSasPsyHSS78_Fktn "Applikationesgroessen Instanz jSasPsyHSS78"
 /begin DEF_CHARACTERISTIC P_SYSMIN78 P_SYSMINFUELLOPT78 P_SYSMINFUELLRED78 P_SYSMIN_EFF78 /end DEF_CHARACTERISTIC
/end FUNCTION
/begin FUNCTION jSasPsyHSS13_Fktn "Applikationesgroessen Instanz jSasPsyHSS13"
 /begin DEF_CHARACTERISTIC P_SYSMIN13 P_SYSMINFUELLOPT13 P_SYSMINFUELLRED13 P_SYSMIN_EFF13 /end DEF_CHARACTERISTIC
/end FUNCTION
/begin FUNCTION jSasPsyHSS24_Fktn "Applikationesgroessen Instanz jSasPsyHSS24"
 /begin DEF_CHARACTERISTIC P_SYSMIN24 P_SYSMINFUELLOPT24 P_SYSMINFUELLRED24 P_SYSMIN_EFF24 /end DEF_CHARACTERISTIC
/end FUNCTION
/begin FUNCTION jSasPsyHSS35_Fktn "Applikationesgroessen Instanz jSasPsyHSS35"
 /begin DEF_CHARACTERISTIC P_SYSMIN35 P_SYSMINFUELLOPT35 P_SYSMINFUELLRED35 P_SYSMIN_EFF35 /end DEF_CHARACTERISTIC
/end FUNCTION
/begin FUNCTION jSasPsyHSS46_Fktn "Applikationesgroessen Instanz jSasPsyHSS46"
 /begin DEF_CHARACTERISTIC P_SYSMIN46 P_SYSMINFUELLOPT46 P_SYSMINFUELLRED46 P_SYSMIN_EFF46 /end DEF_CHARACTERISTIC
/end FUNCTION
/begin FUNCTION jSasPsyHSS57_Fktn "Applikationesgroessen Instanz jSasPsyHSS57"
 /begin DEF_CHARACTERISTIC P_SYSMIN57 P_SYSMINFUELLOPT57 P_SYSMINFUELLRED57 P_SYSMIN_EFF57 /end DEF_CHARACTERISTIC
/end FUNCTION
/begin FUNCTION jSasPsyHSS68_Fktn "Applikationesgroessen Instanz jSasPsyHSS68"
 /begin DEF_CHARACTERISTIC P_SYSMIN68 P_SYSMINFUELLOPT68 P_SYSMINFUELLRED68 P_SYSMIN_EFF68 /end DEF_CHARACTERISTIC
/end FUNCTION
/begin FUNCTION dSasPsyRSS_Fktn "Applikationesgroessen der Komponente dSasPsyRSS"
 /begin SUB_FUNCTION jSasPsyRSS21_Fktn jSasPsyRSS32_Fktn jSasPsyRSS43_Fktn jSasPsyRSS54_Fktn jSasPsyRSS65_Fktn jSasPsyRSS76_Fktn jSasPsyRSS87_Fktn jSasPsyRSS31_Fktn jSasPsyRSS42_Fktn jSasPsyRSS53_Fktn jSasPsyRSS64_Fktn jSasPsyRSS75_Fktn jSasPsyRSS86_Fktn jSasPsyRSS51_Fktn jSasPsyRSS63_Fktn jSasPsyRSS71_Fktn jSasPsyRSS82_Fktn jSasPsyRSS84_Fktn /end SUB_FUNCTION
/end FUNCTION
/begin FUNCTION jSasPsyRSS21_Fktn "Applikationesgroessen Instanz jSasPsyRSS21" /begin DEF_CHARACTERISTIC P_SYSMIN21 P_SYSMINFUELLRED21 P_SYSMIN_EFF21 /end DEF_CHARACTERISTIC /end FUNCTION
/begin FUNCTION jSasPsyRSS32_Fktn "Applikationesgroessen Instanz jSasPsyRSS32" /begin DEF_CHARACTERISTIC P_SYSMIN32 P_SYSMINFUELLRED32 P_SYSMIN_EFF32 /end DEF_CHARACTERISTIC /end FUNCTION
/begin FUNCTION jSasPsyRSS43_Fktn "Applikationesgroessen Instanz jSasPsyRSS43" /begin DEF_CHARACTERISTIC P_SYSMIN43 P_SYSMINFUELLRED43 P_SYSMIN_EFF43 /end DEF_CHARACTERISTIC /end FUNCTION
/begin FUNCTION jSasPsyRSS54_Fktn "Applikationesgroessen Instanz jSasPsyRSS54" /begin DEF_CHARACTERISTIC P_SYSMIN54 P_SYSMINFUELLRED54 P_SYSMIN_EFF54 /end DEF_CHARACTERISTIC /end FUNCTION
/begin FUNCTION jSasPsyRSS65_Fktn "Applikationesgroessen Instanz jSasPsyRSS65" /begin DEF_CHARACTERISTIC P_SYSMIN65 P_SYSMINFUELLRED65 P_SYSMIN_EFF65 /end DEF_CHARACTERISTIC /end FUNCTION
/begin FUNCTION jSasPsyRSS76_Fktn "Applikationesgroessen Instanz jSasPsyRSS76" /begin DEF_CHARACTERISTIC P_SYSMIN76 P_SYSMINFUELLRED76 P_SYSMIN_EFF76 /end DEF_CHARACTERISTIC /end FUNCTION
/begin FUNCTION jSasPsyRSS87_Fktn "Applikationesgroessen Instanz jSasPsyRSS87" /begin DEF_CHARACTERISTIC P_SYSMIN87 P_SYSMINFUELLRED87 P_SYSMIN_EFF87 /end DEF_CHARACTERISTIC /end FUNCTION
/begin FUNCTION jSasPsyRSS31_Fktn "Applikationesgroessen Instanz jSasPsyRSS31" /begin DEF_CHARACTERISTIC P_SYSMINFUELLREDSP31 P_SYSMINSP31 P_SYSMIN_EFFSP31 /end DEF_CHARACTERISTIC /end FUNCTION
/begin FUNCTION jSasPsyRSS42_Fktn "Applikationesgroessen Instanz jSasPsyRSS42" /begin DEF_CHARACTERISTIC P_SYSMINFUELLREDSP42 P_SYSMINSP42 P_SYSMIN_EFFSP42 /end DEF_CHARACTERISTIC /end FUNCTION
/begin FUNCTION jSasPsyRSS53_Fktn "Applikationesgroessen Instanz jSasPsyRSS53" /begin DEF_CHARACTERISTIC P_SYSMINFUELLREDSP53 P_SYSMINSP53 P_SYSMIN_EFFSP53 /end DEF_CHARACTERISTIC /end FUNCTION
/begin FUNCTION jSasPsyRSS64_Fktn "Applikationesgroessen Instanz jSasPsyRSS64" /begin DEF_CHARACTERISTIC P_SYSMINFUELLREDSP64 P_SYSMINSP64 P_SYSMIN_EFFSP64 /end DEF_CHARACTERISTIC /end FUNCTION
/begin FUNCTION jSasPsyRSS75_Fktn "Applikationesgroessen Instanz jSasPsyRSS75" /begin DEF_CHARACTERISTIC P_SYSMINFUELLREDSP75 P_SYSMINSP75 P_SYSMIN_EFFSP75 /end DEF_CHARACTERISTIC /end FUNCTION
/begin FUNCTION jSasPsyRSS86_Fktn "Applikationesgroessen Instanz jSasPsyRSS86" /begin DEF_CHARACTERISTIC P_SYSMINFUELLREDSP86 P_SYSMINSP86 P_SYSMIN_EFFSP86 /end DEF_CHARACTERISTIC /end FUNCTION
/begin FUNCTION jSasPsyRSS51_Fktn "Applikationesgroessen Instanz jSasPsyRSS51" /begin DEF_CHARACTERISTIC P_SYSMINFUELLREDSP51 P_SYSMINSP51 P_SYSMIN_EFFSP51 /end DEF_CHARACTERISTIC /end FUNCTION
/begin FUNCTION jSasPsyRSS63_Fktn "Applikationesgroessen Instanz jSasPsyRSS63" /begin DEF_CHARACTERISTIC P_SYSMINFUELLREDSP63 P_SYSMINSP63 P_SYSMIN_EFFSP63 /end DEF_CHARACTERISTIC /end FUNCTION
/begin FUNCTION jSasPsyRSS71_Fktn "Applikationesgroessen Instanz jSasPsyRSS71" /begin DEF_CHARACTERISTIC P_SYSMINFUELLREDSP71 P_SYSMINSP71 P_SYSMIN_EFFSP71 /end DEF_CHARACTERISTIC /end FUNCTION
/begin FUNCTION jSasPsyRSS82_Fktn "Applikationesgroessen Instanz jSasPsyRSS82" /begin DEF_CHARACTERISTIC P_SYSMINFUELLREDSP82 P_SYSMINSP82 P_SYSMIN_EFFSP82 /end DEF_CHARACTERISTIC /end FUNCTION
/begin FUNCTION jSasPsyRSS84_Fktn "Applikationesgroessen Instanz jSasPsyRSS84" /begin DEF_CHARACTERISTIC P_SYSMINFUELLREDSP84 P_SYSMINSP84 P_SYSMIN_EFFSP84 /end DEF_CHARACTERISTIC /end FUNCTION
/begin FUNCTION dMonMvGet_Fktn "Applikationesgroessen der Komponente dMonMvGet" /begin SUB_FUNCTION jMonMvGet_Fktn /end SUB_FUNCTION /end FUNCTION
/begin FUNCTION jMonMvGet_Fktn "Applikationesgroessen Instanz jMonMvGet"
 /begin DEF_CHARACTERISTIC SWI_MVGIEPLOESCH SWI_MVGIEPRES SWI_MVG_AKT SWI_MVG_LOESCH TAB_MVG_CGETR TAB_MVG_MOTSTART TAB_MVG_MT TAB_MVG_NT TS_MVG_CGETR TS_MVG_DATENREF VERSION_MVG /end DEF_CHARACTERISTIC
/end FUNCTION
/begin FUNCTION dUewIgetr_Fktn "Applikationesgroessen der Komponente dUewIgetr" /begin SUB_FUNCTION jUewIgetr_Fktn /end SUB_FUNCTION /end FUNCTION
/begin FUNCTION jUewIgetr_Fktn "Applikationesgroessen Instanz jUewIgetr"
 /begin DEF_CHARACTERISTIC C_GETUWIG_GANG C_GETUWIG_SCHALT DKI_MAXUWIG_GE DKI_UWIGRNF KL_N_SYMOFNEUGETR KL_TMAXSYMIEP KL_TVERZSYMIEP MAX_STOER_GANG MAX_STOER_GE MAX_STOER_SCHALT MAX_SYMUWIG_GANG MGS_MOTSOLLUWIG MIN_ERFOLGE_GE ND_UWIG ND_UWIGERS NGT_MAXUWIG_GE NS_ABIEPUWIG NS_ABUWIG NS_ABUWIG2 NS_EMIEPUWIG NS_EMIEPUWIGMIN NS_MOTUWIGHYB NS_TUWIG N_ABUWIGRNF N_DIF_IAE_UWIG SWI_UWIG SWI_UWIG_GE TS_RZNUWIG T_FMGMOTSOLLUWIG T_UWIGRNF T_UWIGSAS T_UWIG_GE_D T_VUWIG T_VUWIGSYM /end DEF_CHARACTERISTIC
/end FUNCTION
/begin FUNCTION dUewIgetrG_Fktn "Applikationesgroessen der Komponente dUewIgetrG"
 /begin SUB_FUNCTION jUewIgetrGR_Fktn jUewIgetrG1_Fktn jUewIgetrG2_Fktn jUewIgetrG3_Fktn jUewIgetrG4_Fktn jUewIgetrG5_Fktn jUewIgetrG6_Fktn jUewIgetrG7_Fktn jUewIgetrG8_Fktn /end SUB_FUNCTION
/end FUNCTION
/begin RECORD_LAYOUT kw_bool8_S6_S3 FNC_VALUES 1 UBYTE COLUMN_DIR DIRECT /end RECORD_LAYOUT
/begin RECORD_LAYOUT kw_ui8_S6_S3 FNC_VALUES 1 UBYTE COLUMN_DIR DIRECT /end RECORD_LAYOUT
/begin RECORD_LAYOUT kw_ui16_S6_S3 FNC_VALUES 1 UWORD COLUMN_DIR DIRECT /end RECORD_LAYOUT
/begin RECORD_LAYOUT kw_si16_S6_S3 FNC_VALUES 1 SWORD COLUMN_DIR DIRECT /end RECORD_LAYOUT
/begin RECORD_LAYOUT tab_bool8_S6_S3 FNC_VALUES 2 UBYTE COLUMN_DIR DIRECT NO_AXIS_PTS_X 1 ULONG /end RECORD_LAYOUT
/begin RECORD_LAYOUT tab_ui8_S6_S3 FNC_VALUES 2 UBYTE COLUMN_DIR DIRECT NO_AXIS_PTS_X 1 ULONG /end RECORD_LAYOUT
/begin RECORD_LAYOUT tab_ui16_S6_S3 FNC_VALUES 2 UWORD COLUMN_DIR DIRECT NO_AXIS_PTS_X 1 ULONG /end RECORD_LAYOUT
/begin RECORD_LAYOUT tab_si16_S6_S3 FNC_VALUES 2 SWORD COLUMN_DIR DIRECT NO_AXIS_PTS_X 1 ULONG /end RECORD_LAYOUT
/begin RECORD_LAYOUT kl_ui8_S6_S3 FNC_VALUES 3 UBYTE COLUMN_DIR DIRECT AXIS_PTS_X 2 UBYTE INDEX_INCR DIRECT NO_AXIS_PTS_X 1 ULONG /end RECORD_LAYOUT
/begin RECORD_LAYOUT kl_ui16_S6_S3 FNC_VALUES 3 UWORD COLUMN_DIR DIRECT AXIS_PTS_X 2 UWORD INDEX_INCR DIRECT NO_AXIS_PTS_X 1 ULONG /end RECORD_LAYOUT
/begin RECORD_LAYOUT kl_si16_S6_S3 FNC_VALUES 3 SWORD COLUMN_DIR DIRECT AXIS_PTS_X 2 SWORD INDEX_INCR DIRECT NO_AXIS_PTS_X 1 ULONG /end RECORD_LAYOUT
/begin RECORD_LAYOUT kf_ui16_S6_S3 FNC_VALUES 5 UWORD ROW_DIR DIRECT AXIS_PTS_X 3 UWORD INDEX_INCR DIRECT AXIS_PTS_Y 4 UWORD INDEX_INCR DIRECT NO_AXIS_PTS_X 1 ULONG NO_AXIS_PTS_Y 2 ULONG /end RECORD_LAYOUT
/begin RECORD_LAYOUT kf_si16_S6_S3 FNC_VALUES 5 SWORD ROW_DIR DIRECT AXIS_PTS_X 3 SWORD INDEX_INCR DIRECT AXIS_PTS_Y 4 SWORD INDEX_INCR DIRECT NO_AXIS_PTS_X 1 ULONG NO_AXIS_PTS_Y 2 ULONG /end RECORD_LAYOUT
/end MODULE
/end PROJECT
