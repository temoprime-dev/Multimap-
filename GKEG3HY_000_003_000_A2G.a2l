ASAP2_VERSION 1 51
/begin PROJECT _929_929 "Gen2_BMW_System_Supplier_Lib"
/begin HEADER "" VERSION "C_03_03" PROJECT_NO _929_929 /end HEADER
/begin MODULE DIM ""
/begin MOD_COMMON "" BYTE_ORDER MSB_FIRST ALIGNMENT_BYTE 1 ALIGNMENT_WORD 2 ALIGNMENT_LONG 4 ALIGNMENT_FLOAT32_IEEE 4 /end MOD_COMMON
/begin MEASUREMENT ZFFSAB._.DoorStatusIn.iv_DoorD "Input value driverdoor status" UBYTE SAB_STANDARD_S2_S3 1 100 0 3 DISPLAY_IDENTIFIER iv_DoorD.DoorStatusIn._.ZFFSAB ECU_ADDRESS 0xFFF8F5EC /end MEASUREMENT
/begin MEASUREMENT ZFFSAB._.DoorStatusIn.iv_DoorDSts "Input value message status of driverdoor status" UBYTE SAB_STANDARD_S2_S3 1 100 0 255 DISPLAY_IDENTIFIER iv_DoorDSts.DoorStatusIn._.ZFFSAB ECU_ADDRESS 0xFFF8F5ED /end MEASUREMENT
/begin MEASUREMENT ZFFSAB._.DoorStatusIn.iv_DoorD2 "Input value of second driverdoor status" UBYTE SAB_STANDARD_S2_S3 1 100 0 3 DISPLAY_IDENTIFIER iv_DoorD2.DoorStatusIn._.ZFFSAB ECU_ADDRESS 0xFFF8F5EE /end MEASUREMENT
/begin MEASUREMENT ZFFSAB._.DoorStatusIn.iv_DoorD2Sts "Input value message status of second driverdoor signal status" UBYTE SAB_STANDARD_S2_S3 1 100 0 255 DISPLAY_IDENTIFIER iv_DoorD2Sts.DoorStatusIn._.ZFFSAB ECU_ADDRESS 0xFFF8F5EF /end MEASUREMENT
/begin MEASUREMENT ZFFSAB._.DoorStatusIn.sv_DoorDSts "Output value signal status of driverdoor status" UBYTE SAB_STANDARD_S2_S3 1 100 0 2 DISPLAY_IDENTIFIER sv_DoorDSts.DoorStatusIn._.ZFFSAB ECU_ADDRESS 0xFFF8F5F0 /end MEASUREMENT
/begin MEASUREMENT ZFFSAB._.DoorStatusIn.sv_f_DoorD "Output value of driverdoor status" UBYTE SAB_STANDARD_S2_S3 1 100 0 1 DISPLAY_IDENTIFIER sv_f_DoorD.DoorStatusIn._.ZFFSAB ECU_ADDRESS 0xFFF8F5F1 /end MEASUREMENT
/begin MEASUREMENT ZFFSAB._.DoorStatusIn.f_DoorDErr "Error flag of driverdoor status" UBYTE SAB_STANDARD_S2_S3 1 100 0 1 DISPLAY_IDENTIFIER f_DoorDErr.DoorStatusIn._.ZFFSAB ECU_ADDRESS 0xFFF8F5F2 /end MEASUREMENT
/begin MEASUREMENT ZFFSAB._.TurbineSpeedVirtualIn.iv_ActualGear "Istgang" SBYTE SAB_STANDARD_S2_S3 1 100 -1 8 DISPLAY_IDENTIFIER iv_ActualGear.TurbineSpeedVirtualIn._.ZFFSAB ECU_ADDRESS 0xFFF8F688 /end MEASUREMENT
/begin MEASUREMENT ZFFSAB._.TurbineSpeedVirtualIn.iv_TargetGearInfo "Zielgang" SBYTE SAB_STANDARD_S2_S3 1 100 -1 8 DISPLAY_IDENTIFIER iv_TargetGearInfo.TurbineSpeedVirtualIn._.ZFFSAB ECU_ADDRESS 0xFFF8F689 /end MEASUREMENT
/begin MEASUREMENT ZFFSAB._.TurbineSpeedVirtualIn.iv_TargetGear "Input value for target gear" SBYTE SAB_STANDARD_S2_S3 1 100 -1 8 DISPLAY_IDENTIFIER iv_TargetGear.TurbineSpeedVirtualIn._.ZFFSAB ECU_ADDRESS 0xFFF8F68A /end MEASUREMENT
/begin MEASUREMENT ZFFSAB._.TurbineSpeedVirtualIn.iv_kraftschluss "signalizes if gearbox is kraftschluessig" UBYTE SAB_STANDARD_S2_S3 1 100 0 6 DISPLAY_IDENTIFIER iv_kraftschluss.TurbineSpeedVirtualIn._.ZFFSAB ECU_ADDRESS 0xFFF8F68B /end MEASUREMENT
/begin MEASUREMENT ZFFSAB._.TurbineSpeedVirtualIn.iv_Pos "Input value for position of GearLever" UBYTE SAB_STANDARD_S2_S3 1 100 0 255 DISPLAY_IDENTIFIER iv_Pos.TurbineSpeedVirtualIn._.ZFFSAB ECU_ADDRESS 0xFFF8F68C /end MEASUREMENT
/begin MEASUREMENT ZFFSAB._.TurbineSpeedVirtualIn.iv_st_IAE "IAE Kupplungsstatus" UBYTE SAB_STANDARD_S2_S3 1 100 0 255 DISPLAY_IDENTIFIER iv_st_IAE.TurbineSpeedVirtualIn._.ZFFSAB ECU_ADDRESS 0xFFF8F68D /end MEASUREMENT
/begin MEASUREMENT ZFFSAB._.TurbineSpeedVirtualIn.iv_z_modus_IAE "IAE modus" UBYTE SAB_STANDARD_S2_S3 1 100 0 255 DISPLAY_IDENTIFIER iv_z_modus_IAE.TurbineSpeedVirtualIn._.ZFFSAB ECU_ADDRESS 0xFFF8F68E /end MEASUREMENT
/begin MEASUREMENT ZFFSAB._.TurbineSpeedVirtualIn.sv_n_Dif_IAE_virt "Virtuelle Bauteildifferenzdrehzahl IAE" SWORD SAB_N_1RPM_S2_S3 1 100 -32768 32767 DISPLAY_IDENTIFIER sv_n_Dif_IAE_virt.TurbineSpeedVirtualIn._.ZFFSAB ECU_ADDRESS 0xFFF8F690 /end MEASUREMENT
/begin MEASUREMENT ZFFSAB._.TurbineSpeedVirtualIn.sv_n_Dif_IAEOpt "Optimierte Bauteildifferenzdrehzahl IAE" SWORD SAB_N_1RPM_S2_S3 1 100 -32768 32767 DISPLAY_IDENTIFIER sv_n_Dif_IAEOpt.TurbineSpeedVirtualIn._.ZFFSAB ECU_ADDRESS 0xFFF8F692 /end MEASUREMENT
/begin MEASUREMENT ZFFSAB._.TurbineSpeedVirtualIn.sv_n_TuVirtOpt "Optimierte Virtuelle Turbinendrehzahl" UWORD SAB_N_1RPM_S2_S3 1 100 0 65535 DISPLAY_IDENTIFIER sv_n_TuVirtOpt.TurbineSpeedVirtualIn._.ZFFSAB ECU_ADDRESS 0xFFF8F694 /end MEASUREMENT
/begin MEASUREMENT ZFFSAB._.TurbineSpeedVirtualIn.sv_n_TuVirt "Virtuelle Turbinendrehzahl" UWORD SAB_N_1RPM_S2_S3 1 100 0 65535 DISPLAY_IDENTIFIER sv_n_TuVirt.TurbineSpeedVirtualIn._.ZFFSAB ECU_ADDRESS 0xFFF8F696 /end MEASUREMENT
/begin MEASUREMENT ZFFSAB._.TurbineSpeedVirtualIn.sv_n6 "Drehzahl an der Baugruppe 6" UWORD SAB_N_1RPM_S2_S3 1 100 0 65535 DISPLAY_IDENTIFIER sv_n6.TurbineSpeedVirtualIn._.ZFFSAB ECU_ADDRESS 0xFFF8F698 /end MEASUREMENT
/begin MEASUREMENT ZFFSAB._.TurbineSpeedVirtualIn.sv_n6_Sts "Status Drehzahl an der Baugruppe 6" UBYTE SAB_STANDARD_S2_S3 1 100 0 2 DISPLAY_IDENTIFIER sv_n6_Sts.TurbineSpeedVirtualIn._.ZFFSAB ECU_ADDRESS 0xFFF8F69A /end MEASUREMENT
/begin MEASUREMENT ZFFSAB._.TurbineSpeedVirtualIn.iv_n6 "Drehzahl am Sensor n6" UWORD SAB_N_1RPM_S2_S3 1 100 0 65535 DISPLAY_IDENTIFIER iv_n6.TurbineSpeedVirtualIn._.ZFFSAB ECU_ADDRESS 0xFFF8F69C /end MEASUREMENT
/begin MEASUREMENT ZFFSAB._.TurbineSpeedVirtualIn.k_nmot "Parameter k_nmot" FLOAT32_IEEE SAB_STANDARD_S2_S3 1 100 -1.5 0 FORMAT "%5.3" DISPLAY_IDENTIFIER k_nmot.TurbineSpeedVirtualIn._.ZFFSAB ECU_ADDRESS 0xFFF8F6A0 /end MEASUREMENT
/begin MEASUREMENT ZFFSAB._.TurbineSpeedVirtualIn.k_nab "Parameter k_nab" FLOAT32_IEEE SAB_STANDARD_S2_S3 1 100 -4.945 4.6957 FORMAT "%5.3" DISPLAY_IDENTIFIER k_nab.TurbineSpeedVirtualIn._.ZFFSAB ECU_ADDRESS 0xFFF8F6A4 /end MEASUREMENT
/begin MEASUREMENT ZFFSAB._.TurbineSpeedVirtualIn.k_n6 "Parameter k_n6" FLOAT32_IEEE SAB_STANDARD_S2_S3 1 100 -2.196 7.4452 FORMAT "%5.3" DISPLAY_IDENTIFIER k_n6.TurbineSpeedVirtualIn._.ZFFSAB ECU_ADDRESS 0xFFF8F6A8 /end MEASUREMENT
/begin MEASUREMENT ZFFSAB._.TurbineSpeedVirtualIn.i_IstGang "Parameter i_IstGang" FLOAT32_IEEE SAB_STANDARD_S2_S3 1 100 0 4.696 FORMAT "%5.3" DISPLAY_IDENTIFIER i_IstGang.TurbineSpeedVirtualIn._.ZFFSAB ECU_ADDRESS 0xFFF8F6AC /end MEASUREMENT
/begin MEASUREMENT ZFFSAB._.TurbineSpeedVirtualIn.i_ZielGang "Parameter i_ZielGang" FLOAT32_IEEE SAB_STANDARD_S2_S3 1 100 0 4.696 FORMAT "%5.3" DISPLAY_IDENTIFIER i_ZielGang.TurbineSpeedVirtualIn._.ZFFSAB ECU_ADDRESS 0xFFF8F6B0 /end MEASUREMENT
/begin MEASUREMENT ZFFSAB._.TurbineSpeedVirtualIn.SF_n4_ig "Parameter SF_n4_ig" FLOAT32_IEEE SAB_STANDARD_S2_S3 1 100 0 2.464 FORMAT "%5.3" DISPLAY_IDENTIFIER SF_n4_ig.TurbineSpeedVirtualIn._.ZFFSAB ECU_ADDRESS 0xFFF8F6B4 /end MEASUREMENT
/begin MEASUREMENT ZFFSAB._.TurbineSpeedVirtualIn.SF_n4_zg "Parameter SF_n4_zg" FLOAT32_IEEE SAB_STANDARD_S2_S3 1 100 0 2.464 FORMAT "%5.3" DISPLAY_IDENTIFIER SF_n4_zg.TurbineSpeedVirtualIn._.ZFFSAB ECU_ADDRESS 0xFFF8F6B8 /end MEASUREMENT
/begin MEASUREMENT ZFFSAB._.TurbineSpeedVirtualIn.iv_in_Gear "Input value for gearRatio of actual gear" UWORD SAB_K1000_S2_S3 1 100 0 65.535 DISPLAY_IDENTIFIER iv_in_Gear.TurbineSpeedVirtualIn._.ZFFSAB ECU_ADDRESS 0xFFF8F6BC /end MEASUREMENT
/begin MEASUREMENT ZFFSAB._.TurbineSpeedVirtualIn.n_TuVirtOptSts "0 = alle anderen Faelle [k-Faktoren] 1 = waehrend Schaltung und IAE geschlossen [n_em] 2 = waehrend Schaltung und IAE im Schlupf [k-Faktoren] 3 = ausserhalb Schaltungen und Kraftschluss und kleiner 6. Gang [n_ab * i_Gang] 4 = ausserhalb Schaltungen und..." UBYTE SAB_STANDARD_S2_S3 1 100 0 255
 /begin ANNOTATION ANNOTATION_LABEL "Description"
  /begin ANNOTATION_TEXT "0 = alle anderen Faelle [k-Faktoren] 1 = waehrend Schaltung und IAE geschlossen [n_em] 2 = waehrend Schaltung und IAE im Schlupf [k-Faktoren] 3 = ausserhalb Schaltungen und Kraftschluss und kleiner 6. Gang [n_ab * i_Gang] 4 = ausserhalb Schaltungen und Kr" "aftschluss und groesser 6. Gang [n_ab * i_Gang] 5 = ausserhalb Schaltungen und ohne Kraftschluss [k-Faktoren]" /end ANNOTATION_TEXT
 /end ANNOTATION
 DISPLAY_IDENTIFIER n_TuVirtOptSts.TurbineSpeedVirtualIn._.ZFFSAB ECU_ADDRESS 0xFFF8F6BE /end MEASUREMENT
/begin MEASUREMENT ZFFSAB._.TurbineSpeedVirtualIn.sv_n_Dif_IAE "Bauteildifferenzdrehzahl IAE" SWORD SAB_N_1RPM_S2_S3 1 100 -32768 32767 DISPLAY_IDENTIFIER sv_n_Dif_IAE.TurbineSpeedVirtualIn._.ZFFSAB ECU_ADDRESS 0xFFF8F6C0 /end MEASUREMENT
/begin MEASUREMENT ZFFSAB._.TurbineSpeedVirtualIn.iv_n6_Dir "Drehrichtungsanzeige n6-Sensor" SBYTE SAB_STANDARD_S2_S3 1 100 -128 127 DISPLAY_IDENTIFIER iv_n6_Dir.TurbineSpeedVirtualIn._.ZFFSAB ECU_ADDRESS 0xFFF8F6C2 /end MEASUREMENT
/begin MEASUREMENT ZFFSAB._.TurbineSpeedVirtualIn.sv_n_Ab_Dir "Drehrichtungsanzeige n_ab-Sensor" SBYTE SAB_STANDARD_S2_S3 1 100 -128 127 DISPLAY_IDENTIFIER sv_n_Ab_Dir.TurbineSpeedVirtualIn._.ZFFSAB ECU_ADDRESS 0xFFF8F6C3 /end MEASUREMENT
/begin MEASUREMENT ZFFSAB._.TurbineSpeedVirtualIn.sv_n_Dif_IAE_Dir "Drehrichtungsanzeige Bauteildifferenzdrehzahl sv_n_Dif_IAE" SBYTE SAB_STANDARD_S2_S3 1 100 -128 127 DISPLAY_IDENTIFIER sv_n_Dif_IAE_Dir.TurbineSpeedVirtualIn._.ZFFSAB ECU_ADDRESS 0xFFF8F6C4 /end MEASUREMENT
/begin MEASUREMENT ZFFSAB._.TurbineSpeedVirtualIn.sv_n_Dif_IAE_Dir_alt "Drehrichtungsanzeige Bauteildifferenzdrehzahl sv_n_Dif_IAE des vorherigen Zyklus" SBYTE SAB_STANDARD_S2_S3 1 100 -128 127 DISPLAY_IDENTIFIER sv_n_Dif_IAE_Dir_alt.TurbineSpeedVirtualIn._.ZFFSAB ECU_ADDRESS 0xFFF8F6C5 /end MEASUREMENT
/begin MEASUREMENT ZFFSAB._.TurbineSpeedVirtualIn.sv_n_Dif_IAE_virt_Dir "Drehrichtungsanzeige virtuelle Differenzdrehzahl sv_n_Dif_IAE" SBYTE SAB_STANDARD_S2_S3 1 100 -128 127 DISPLAY_IDENTIFIER sv_n_Dif_IAE_virt_Dir.TurbineSpeedVirtualIn._.ZFFSAB ECU_ADDRESS 0xFFF8F6C6 /end MEASUREMENT
/begin MEASUREMENT ZFFSAB._.TurbineSpeedVirtualIn.sv_n_Dif_IAE_virt_Dir_alt "Drehrichtungsanzeige virtuelle Differenzdrehzahl sv_n_Dif_IAE des vorherigen Zyklus" SBYTE SAB_STANDARD_S2_S3 1 100 -128 127 DISPLAY_IDENTIFIER sv_n_Dif_IAE_virt_Dir_alt.TurbineSpeedVirtualIn._.ZFFSAB ECU_ADDRESS 0xFFF8F6C7 /end MEASUREMENT
/begin MEASUREMENT ZFFSAB._.TurbineSpeedVirtualIn.sv_n_Dif_IAE_virt_DirSts "Status der Drehrichtungsanzeige sv_n_Dif_IAE_virt_Dir der virtuellen Differenzdrehzahl sv_n_Dif_IAE_virt" UBYTE SAB_STANDARD_S2_S3 1 100 0 255 DISPLAY_IDENTIFIER sv_n_Dif_IAE_virt_DirSts.TurbineSpeedVirtualIn._.ZFFSAB ECU_ADDRESS 0xFFF8F6C8 /end MEASUREMENT
/begin MEASUREMENT ZFFSAB._.TurbineSpeedVirtualIn.sv_n_TuVirt_Dir "Drehrichtungsanzeige virtuelle Turbinendrehzahl sv_n_TuVirt" SBYTE SAB_STANDARD_S2_S3 1 100 -128 127 DISPLAY_IDENTIFIER sv_n_TuVirt_Dir.TurbineSpeedVirtualIn._.ZFFSAB ECU_ADDRESS 0xFFF8F6C9 /end MEASUREMENT
/begin MEASUREMENT ZFFSAB._.TurbineSpeedVirtualIn.sv_n_Dif_IAEFilt "Gefilterte Bauteildifferenzdrehzahl IAE fuer Vorzeichenbestimmung" SWORD SAB_N_1RPM_S2_S3 1 100 -32768 32767 DISPLAY_IDENTIFIER sv_n_Dif_IAEFilt.TurbineSpeedVirtualIn._.ZFFSAB ECU_ADDRESS 0xFFF8F6CA /end MEASUREMENT
/begin MEASUREMENT ZFFSAB._.TurbineSpeedVirtualIn.sv_n_TuVirtVz "Vorzeichenbehaftete virtuelle Turbinendrehzahl sv_n_TuVirtVz fuer Vorzeichenbestimmung" SWORD SAB_N_1RPM_S2_S3 1 100 -32768 32767 DISPLAY_IDENTIFIER sv_n_TuVirtVz.TurbineSpeedVirtualIn._.ZFFSAB ECU_ADDRESS 0xFFF8F6CC /end MEASUREMENT
/begin MEASUREMENT ZFFSAB._.TurbineSpeedVirtualIn.sv_n_TuVirtVzFilt "Gefilterte vorzeichenbehaftete virtuelle Turbinendrehzahl sv_n_TuVirtVz fuer Vorzeichenbestimmung" SWORD SAB_N_1RPM_S2_S3 1 100 -32768 32767 DISPLAY_IDENTIFIER sv_n_TuVirtVzFilt.TurbineSpeedVirtualIn._.ZFFSAB ECU_ADDRESS 0xFFF8F6CE /end MEASUREMENT
/begin MEASUREMENT ZFFSAB._.TurbineSpeedVirtualIn.f_nulldurchgang_sv_n_Dif_IAE "Zwischengroesse der Berechnung der Drehrichtungsanzeige sv_n_Dif_IAE_virt_Dir" UBYTE SAB_STANDARD_S2_S3 1 100 0 255 DISPLAY_IDENTIFIER f_nulldurchgang_sv_n_Dif_IAE.TurbineSpeedVirtualIn._.ZFFSAB ECU_ADDRESS 0xFFF8F6D0 /end MEASUREMENT
/begin MEASUREMENT ZFFSAB._.TurbineSpeedVirtualIn.f_gangnachfuehrung_aktiv "Flag zur Anzeige des Zustands Gangnachfuehrung bzw. Neutral" UBYTE SAB_STANDARD_S2_S3 1 100 0 255 DISPLAY_IDENTIFIER f_gangnachfuehrung_aktiv.TurbineSpeedVirtualIn._.ZFFSAB ECU_ADDRESS 0xFFF8F6D1 /end MEASUREMENT
/begin MEASUREMENT ZFFSAB._.TurbineSpeedVirtualIn.pos_fl "Gefiltertes Waehlhebelpositionssignal" UBYTE SAB_STANDARD_S2_S3 1 100 0 255 DISPLAY_IDENTIFIER pos_fl.TurbineSpeedVirtualIn._.ZFFSAB ECU_ADDRESS 0xFFF8F6D2 /end MEASUREMENT
/begin MEASUREMENT ZFFSAB._.TurbineSpeedVirtualIn.sv_n_EngTuVirtFilt "Gefilterte Getriebeingangsdrehzahl" UWORD SAB_N_1RPM_S2_S3 1 100 0 65535 DISPLAY_IDENTIFIER sv_n_EngTuVirtFilt.TurbineSpeedVirtualIn._.ZFFSAB ECU_ADDRESS 0xFFF8F6D4 /end MEASUREMENT
/begin MEASUREMENT ZFFSAB._.TurbineSpeedVirtualIn.sv_n_AbTuVirtFilt "Gefilterte Abtriebsdrehzahl" UWORD SAB_N_1RPM_S2_S3 1 100 0 65535 DISPLAY_IDENTIFIER sv_n_AbTuVirtFilt.TurbineSpeedVirtualIn._.ZFFSAB ECU_ADDRESS 0xFFF8F6D6 /end MEASUREMENT
/begin MEASUREMENT ZFFSAB._.TurbineSpeedVirtualIn.iv_n6TuVirtFilt "Gefilterte n6-Drehzahl" UWORD SAB_N_1RPM_S2_S3 1 100 0 65535 DISPLAY_IDENTIFIER iv_n6TuVirtFilt.TurbineSpeedVirtualIn._.ZFFSAB ECU_ADDRESS 0xFFF8F6D8 /end MEASUREMENT
/begin MEASUREMENT ZFFSAB._.TurbineSpeedVirtualIn.sv_n_EngTuVirtFiltSync "Gefilterte und synchronisierte Getriebeingangsdrehzahl" UWORD SAB_N_1RPM_S2_S3 1 100 0 65535 DISPLAY_IDENTIFIER sv_n_EngTuVirtFiltSync.TurbineSpeedVirtualIn._.ZFFSAB ECU_ADDRESS 0xFFF8F6DA /end MEASUREMENT
/begin MEASUREMENT ZFFSAB._.TurbineSpeedVirtualIn.sv_n_AbTuVirtFiltSync "Gefilterte und synchronisierte Abtriebsdrehzahl" UWORD SAB_N_1RPM_S2_S3 1 100 0 65535 DISPLAY_IDENTIFIER sv_n_AbTuVirtFiltSync.TurbineSpeedVirtualIn._.ZFFSAB ECU_ADDRESS 0xFFF8F6DC /end MEASUREMENT
/begin MEASUREMENT ZFFSAB._.TurbineSpeedVirtualIn.iv_n6TuVirtFiltSync "Gefilterte und synchronisierte n6-Drehzahl" UWORD SAB_N_1RPM_S2_S3 1 100 0 65535 DISPLAY_IDENTIFIER iv_n6TuVirtFiltSync.TurbineSpeedVirtualIn._.ZFFSAB ECU_ADDRESS 0xFFF8F6DE /end MEASUREMENT
/begin MEASUREMENT ZFFSAB._.TurbineSpeedVirtualIn.f_VerschachtelungAktiv_ntOpt "Flag zur Anzeige einer verschachtelten Schaltung" UBYTE SAB_STANDARD_S2_S3 1 100 0 255 DISPLAY_IDENTIFIER f_VerschachtelungAktiv_ntOpt.TurbineSpeedVirtualIn._.ZFFSAB ECU_ADDRESS 0xFFF8F6E0 /end MEASUREMENT
/begin MEASUREMENT ZFFSAB._.GearLeverIn.iv_PS1_Raw "P-Sensor Signal Source 1" UBYTE SAB_STANDARD_S2_S3 1 100 0 255 DISPLAY_IDENTIFIER iv_PS1_Raw.GearLeverIn._.ZFFSAB ECU_ADDRESS 0xFFF8F9A0 /end MEASUREMENT
/begin MEASUREMENT ZFFSAB._.GearLeverIn.iv_PS1_Raw_ "complement of Parktaster" UBYTE SAB_STANDARD_S2_S3 1 100 0 255 DISPLAY_IDENTIFIER iv_PS1_Raw_.GearLeverIn._.ZFFSAB ECU_ADDRESS 0xFFF8F9A1 /end MEASUREMENT
/begin MEASUREMENT ZFFSAB._.GearLeverIn.iv_PS2_Raw "P-Sensor Signal Source 2" UBYTE SAB_STANDARD_S2_S3 1 100 0 255 DISPLAY_IDENTIFIER iv_PS2_Raw.GearLeverIn._.ZFFSAB ECU_ADDRESS 0xFFF8F9A2 /end MEASUREMENT
/begin MEASUREMENT ZFFSAB._.GearLeverIn.iv_PS2_Raw_ "complement of Parktaster signal from Source2" UBYTE SAB_STANDARD_S2_S3 1 100 0 255 DISPLAY_IDENTIFIER iv_PS2_Raw_.GearLeverIn._.ZFFSAB ECU_ADDRESS 0xFFF8F9A3 /end MEASUREMENT
/begin MEASUREMENT ZFFSAB._.GearLeverIn.iv_P1S1Raw "P1-Sensor Signal Source 1" UBYTE SAB_STANDARD_S2_S3 1 100 0 255 DISPLAY_IDENTIFIER iv_P1S1Raw.GearLeverIn._.ZFFSAB ECU_ADDRESS 0xFFF8F9A4 /end MEASUREMENT
/begin MEASUREMENT ZFFSAB._.GearLeverIn.iv_P1S2Raw "P1-Sensor Signal Source 2" UBYTE SAB_STANDARD_S2_S3 1 100 0 255 DISPLAY_IDENTIFIER iv_P1S2Raw.GearLeverIn._.ZFFSAB ECU_ADDRESS 0xFFF8F9A5 /end MEASUREMENT
/begin MEASUREMENT ZFFSAB._.GearLeverIn.iv_P2S1Raw "P2-Sensor Signal Source 1" UBYTE SAB_STANDARD_S2_S3 1 100 0 255 DISPLAY_IDENTIFIER iv_P2S1Raw.GearLeverIn._.ZFFSAB ECU_ADDRESS 0xFFF8F9A6 /end MEASUREMENT
/begin MEASUREMENT ZFFSAB._.GearLeverIn.iv_P2S2Raw "P2-Sensor Signal Source 2" UBYTE SAB_STANDARD_S2_S3 1 100 0 255 DISPLAY_IDENTIFIER iv_P2S2Raw.GearLeverIn._.ZFFSAB ECU_ADDRESS 0xFFF8F9A7 /end MEASUREMENT
/begin MEASUREMENT ZFFSAB._.GearLeverIn.iv_PosS1RawSts "status of gearlevers raw signal" UBYTE SAB_STANDARD_S2_S3 1 100 0 255 DISPLAY_IDENTIFIER iv_PosS1RawSts.GearLeverIn._.ZFFSAB ECU_ADDRESS 0xFFF8F9A8 /end MEASUREMENT
/begin MEASUREMENT ZFFSAB._.GearLeverIn.iv_PosS1RawSts_ "komplement of iv_PosS1RawSts" UBYTE SAB_STANDARD_S2_S3 1 100 0 255 DISPLAY_IDENTIFIER iv_PosS1RawSts_.GearLeverIn._.ZFFSAB ECU_ADDRESS 0xFFF8F9A9 /end MEASUREMENT
/begin MEASUREMENT ZFFSAB._.GearLeverIn.iv_PosRelS1Raw "relative input signal 1" UBYTE SAB_STANDARD_S2_S3 1 100 0 255 DISPLAY_IDENTIFIER iv_PosRelS1Raw.GearLeverIn._.ZFFSAB ECU_ADDRESS 0xFFF8F9AA /end MEASUREMENT
/begin MEASUREMENT ZFFSAB._.GearLeverIn.iv_PosRelS1Raw_ "complement of iv_PosRelS1Raw" UBYTE SAB_STANDARD_S2_S3 1 100 0 255 DISPLAY_IDENTIFIER iv_PosRelS1Raw_.GearLeverIn._.ZFFSAB ECU_ADDRESS 0xFFF8F9AB /end MEASUREMENT
/begin MEASUREMENT ZFFSAB._.GearLeverIn.iv_PosAbsS1Raw "absolute input signal 1" UBYTE SAB_STANDARD_S2_S3 1 100 0 255 DISPLAY_IDENTIFIER iv_PosAbsS1Raw.GearLeverIn._.ZFFSAB ECU_ADDRESS 0xFFF8F9AC /end MEASUREMENT
/begin MEASUREMENT ZFFSAB._.GearLeverIn.iv_PosAbsS1Raw_ "complement of iv_PosAbsS1Raw" UBYTE SAB_STANDARD_S2_S3 1 100 0 255 DISPLAY_IDENTIFIER iv_PosAbsS1Raw_.GearLeverIn._.ZFFSAB ECU_ADDRESS 0xFFF8F9AD /end MEASUREMENT
/begin MEASUREMENT ZFFSAB._.GearLeverIn.iv_PosS2RawSts "status of gearlevers raw signal" UBYTE SAB_STANDARD_S2_S3 1 100 0 255 DISPLAY_IDENTIFIER iv_PosS2RawSts.GearLeverIn._.ZFFSAB ECU_ADDRESS 0xFFF8F9AE /end MEASUREMENT
/begin MEASUREMENT ZFFSAB._.GearLeverIn.iv_PosS2RawSts_ "komplement of iv_PosS2RawSts" UBYTE SAB_STANDARD_S2_S3 1 100 0 255 DISPLAY_IDENTIFIER iv_PosS2RawSts_.GearLeverIn._.ZFFSAB ECU_ADDRESS 0xFFF8F9AF /end MEASUREMENT
/begin MEASUREMENT ZFFSAB._.GearLeverIn.iv_PosRelS2Raw "relative input raw signal" UBYTE SAB_STANDARD_S2_S3 1 100 0 255 DISPLAY_IDENTIFIER iv_PosRelS2Raw.GearLeverIn._.ZFFSAB ECU_ADDRESS 0xFFF8F9B0 /end MEASUREMENT
/begin MEASUREMENT ZFFSAB._.GearLeverIn.iv_PosRelS2Raw_ "complement of iv_PosRelS2Raw" UBYTE SAB_STANDARD_S2_S3 1 100 0 255 DISPLAY_IDENTIFIER iv_PosRelS2Raw_.GearLeverIn._.ZFFSAB ECU_ADDRESS 0xFFF8F9B1 /end MEASUREMENT
/begin MEASUREMENT ZFFSAB._.GearLeverIn.iv_PosAbsS2Raw "absolute input raw signal" UBYTE SAB_STANDARD_S2_S3 1 100 0 255 DISPLAY_IDENTIFIER iv_PosAbsS2Raw.GearLeverIn._.ZFFSAB ECU_ADDRESS 0xFFF8F9B2 /end MEASUREMENT
/begin MEASUREMENT ZFFSAB._.GearLeverIn.iv_PosAbsS2Raw_ "complement of iv_PosAbsS2Raw" UBYTE SAB_STANDARD_S2_S3 1 100 0 255 DISPLAY_IDENTIFIER iv_PosAbsS2Raw_.GearLeverIn._.ZFFSAB ECU_ADDRESS 0xFFF8F9B3 /end MEASUREMENT
/begin MEASUREMENT ZFFSAB._.GearLeverIn.sv_CtrlSignalSource "parameter to switch between S2 and S1" UBYTE SAB_STANDARD_S2_S3 1 100 0 2 DISPLAY_IDENTIFIER sv_CtrlSignalSource.GearLeverIn._.ZFFSAB ECU_ADDRESS 0xFFF8F9B4 /end MEASUREMENT
/begin MEASUREMENT ZFFSAB._.GearLeverIn.sv_CtrlSignalSourceSts "status of CtrlSignalSource" UBYTE SAB_STANDARD_S2_S3 1 100 0 2 DISPLAY_IDENTIFIER sv_CtrlSignalSourceSts.GearLeverIn._.ZFFSAB ECU_ADDRESS 0xFFF8F9B5 /end MEASUREMENT
/begin MEASUREMENT ZFFSAB._.GearLeverIn.sv_CtrlSignalSourceSts_ "complement CtrlSignalSource" UBYTE SAB_STANDARD_S2_S3 1 100 0 255 DISPLAY_IDENTIFIER sv_CtrlSignalSourceSts_.GearLeverIn._.ZFFSAB ECU_ADDRESS 0xFFF8F9B6 /end MEASUREMENT
/begin MEASUREMENT ZFFSAB._.GearLeverIn.sv_f_P12BadOpRaw "flag of bad operation" UBYTE SAB_STANDARD_S2_S3 1 100 0 7 DISPLAY_IDENTIFIER sv_f_P12BadOpRaw.GearLeverIn._.ZFFSAB ECU_ADDRESS 0xFFF8F9B7 /end MEASUREMENT
/begin MEASUREMENT ZFFSAB._.GearLeverIn.sv_f_P12Button "flag of park-button" UBYTE SAB_STANDARD_S2_S3 1 100 0 7 DISPLAY_IDENTIFIER sv_f_P12Button.GearLeverIn._.ZFFSAB ECU_ADDRESS 0xFFF8F9B8 /end MEASUREMENT
/begin MEASUREMENT ZFFSAB._.GearLeverIn.sv_f_P12Button_ "complement of sv_f_P12Button" UBYTE SAB_STANDARD_S2_S3 1 100 0 255 DISPLAY_IDENTIFIER sv_f_P12Button_.GearLeverIn._.ZFFSAB ECU_ADDRESS 0xFFF8F9B9 /end MEASUREMENT
/begin MEASUREMENT ZFFSAB._.GearLeverIn.sv_f_P12OneErr "defective park-button 1" UBYTE SAB_STANDARD_S2_S3 1 100 0 7 DISPLAY_IDENTIFIER sv_f_P12OneErr.GearLeverIn._.ZFFSAB ECU_ADDRESS 0xFFF8F9BA /end MEASUREMENT
/begin MEASUREMENT ZFFSAB._.GearLeverIn.sv_f_P12TwoErr "defective park-buttons2" UBYTE SAB_STANDARD_S2_S3 1 100 0 7 DISPLAY_IDENTIFIER sv_f_P12TwoErr.GearLeverIn._.ZFFSAB ECU_ADDRESS 0xFFF8F9BB /end MEASUREMENT
/begin MEASUREMENT ZFFSAB._.GearLeverIn.sv_f_PosS1Err "error-signal of position source 1" UBYTE SAB_STANDARD_S2_S3 1 100 0 1 DISPLAY_IDENTIFIER sv_f_PosS1Err.GearLeverIn._.ZFFSAB ECU_ADDRESS 0xFFF8F9BC /end MEASUREMENT
/begin MEASUREMENT ZFFSAB._.GearLeverIn.sv_f_PosS2Err "error-signal of position source 2" UBYTE SAB_STANDARD_S2_S3 1 100 0 1 DISPLAY_IDENTIFIER sv_f_PosS2Err.GearLeverIn._.ZFFSAB ECU_ADDRESS 0xFFF8F9BD /end MEASUREMENT
/begin MEASUREMENT ZFFSAB._.GearLeverIn.sv_f_SD_Button "flag for Sport-Drive" UBYTE SAB_STANDARD_S2_S3 1 100 0 1 DISPLAY_IDENTIFIER sv_f_SD_Button.GearLeverIn._.ZFFSAB ECU_ADDRESS 0xFFF8F9BE /end MEASUREMENT
/begin MEASUREMENT ZFFSAB._.GearLeverIn.sv_f_TipMinusSBW_Raw "output value of f_TipMinusSBW_Raw" UBYTE SAB_STANDARD_S2_S3 1 100 0 1 DISPLAY_IDENTIFIER sv_f_TipMinusSBW_Raw.GearLeverIn._.ZFFSAB ECU_ADDRESS 0xFFF8F9BF /end MEASUREMENT
/begin MEASUREMENT ZFFSAB._.GearLeverIn.sv_f_TipMinusSBW_Raw_ "output value of f_TipMinusSBW_Raw_" UBYTE SAB_STANDARD_S2_S3 1 100 0 255 DISPLAY_IDENTIFIER sv_f_TipMinusSBW_Raw_.GearLeverIn._.ZFFSAB ECU_ADDRESS 0xFFF8F9C0 /end MEASUREMENT
/begin MEASUREMENT ZFFSAB._.GearLeverIn.sv_f_TipMinusSBWErr "depends on CtrlSignalSourceSts" UBYTE SAB_STANDARD_S2_S3 1 100 0 1 DISPLAY_IDENTIFIER sv_f_TipMinusSBWErr.GearLeverIn._.ZFFSAB ECU_ADDRESS 0xFFF8F9C1 /end MEASUREMENT
/begin MEASUREMENT ZFFSAB._.GearLeverIn.sv_f_TipPlusSBW_Raw "output value of f_TipPlusSBW_Raw" UBYTE SAB_STANDARD_S2_S3 1 100 0 1 DISPLAY_IDENTIFIER sv_f_TipPlusSBW_Raw.GearLeverIn._.ZFFSAB ECU_ADDRESS 0xFFF8F9C2 /end MEASUREMENT
/begin MEASUREMENT ZFFSAB._.GearLeverIn.sv_f_TipPlusSBW_Raw_ "output value of f_TipPlusSBW_Raw_" UBYTE SAB_STANDARD_S2_S3 1 100 0 255 DISPLAY_IDENTIFIER sv_f_TipPlusSBW_Raw_.GearLeverIn._.ZFFSAB ECU_ADDRESS 0xFFF8F9C3 /end MEASUREMENT
/begin MEASUREMENT ZFFSAB._.GearLeverIn.sv_SWILeverType "Get method for SWI_LeverType" UBYTE SAB_STANDARD_S2_S3 1 100 0 2 DISPLAY_IDENTIFIER sv_SWILeverType.GearLeverIn._.ZFFSAB ECU_ADDRESS 0xFFF8F9C4 /end MEASUREMENT
/begin MEASUREMENT ZFFSAB._.GearLeverIn.sv_SWILeverTypeKomp "Get method for SWI_LeverTypeKomp" UBYTE SAB_STANDARD_S2_S3 1 100 0 255 DISPLAY_IDENTIFIER sv_SWILeverTypeKomp.GearLeverIn._.ZFFSAB ECU_ADDRESS 0xFFF8F9C5 /end MEASUREMENT
/begin MEASUREMENT ZFFSAB._.GearLeverIn.sv_SWISignalSource "Get method for SWI_SignalSource" UBYTE SAB_STANDARD_S2_S3 1 100 0 3 DISPLAY_IDENTIFIER sv_SWISignalSource.GearLeverIn._.ZFFSAB ECU_ADDRESS 0xFFF8F9C6 /end MEASUREMENT
/begin MEASUREMENT ZFFSAB._.GearLeverIn.sv_GatePosition "output value gate position" UBYTE SAB_STANDARD_S2_S3 1 100 0 255 DISPLAY_IDENTIFIER sv_GatePosition.GearLeverIn._.ZFFSAB ECU_ADDRESS 0xFFF8F9C7 /end MEASUREMENT
/begin MEASUREMENT ZFFSAB._.GearLeverIn.sv_GatePosition_ "output complement value gate position" UBYTE SAB_STANDARD_S2_S3 1 100 0 255 DISPLAY_IDENTIFIER sv_GatePosition_.GearLeverIn._.ZFFSAB ECU_ADDRESS 0xFFF8F9C8 /end MEASUREMENT
/begin MEASUREMENT ZFFSAB._.GearLeverIn.sv_PosRaw "position signal S1 or S2" UBYTE SAB_STANDARD_S2_S3 1 100 0 255 DISPLAY_IDENTIFIER sv_PosRaw.GearLeverIn._.ZFFSAB ECU_ADDRESS 0xFFF8F9C9 /end MEASUREMENT
/begin MEASUREMENT ZFFSAB._.GearLeverIn.sv_PosRaw_ "complement of PosRaw" UBYTE SAB_STANDARD_S2_S3 1 100 0 255 DISPLAY_IDENTIFIER sv_PosRaw_.GearLeverIn._.ZFFSAB ECU_ADDRESS 0xFFF8F9CA /end MEASUREMENT
/begin MEASUREMENT ZFFSAB._.GearLeverIn.sv_AGS_LeverPos "Output signal of gear lever for Layer AGS" UBYTE SAB_STANDARD_S2_S3 1 100 0 3 DISPLAY_IDENTIFIER sv_AGS_LeverPos.GearLeverIn._.ZFFSAB ECU_ADDRESS 0xFFF8F9CB /end MEASUREMENT
/begin MEASUREMENT ZFFSAB._.GearLeverIn.P1_Raw "Input signal of alternate P-Taster 1" UBYTE SAB_STANDARD_S2_S3 1 100 0 1 DISPLAY_IDENTIFIER P1_Raw.GearLeverIn._.ZFFSAB ECU_ADDRESS 0xFFF8F9CC /end MEASUREMENT
/begin MEASUREMENT ZFFSAB._.GearLeverIn.P2_Raw "Input signal of alternate P-Taster 2" UBYTE SAB_STANDARD_S2_S3 1 100 0 1 DISPLAY_IDENTIFIER P2_Raw.GearLeverIn._.ZFFSAB ECU_ADDRESS 0xFFF8F9CD /end MEASUREMENT
/begin MEASUREMENT ZFFSAB._.GearLeverIn.P1Act "park-button 1" UBYTE SAB_STANDARD_S2_S3 1 100 0 7 DISPLAY_IDENTIFIER P1Act.GearLeverIn._.ZFFSAB ECU_ADDRESS 0xFFF8F9CE /end MEASUREMENT
/begin MEASUREMENT ZFFSAB._.GearLeverIn.P2Act "park-button 2 calculation" UBYTE SAB_STANDARD_S2_S3 1 100 0 7 DISPLAY_IDENTIFIER P2Act.GearLeverIn._.ZFFSAB ECU_ADDRESS 0xFFF8F9CF /end MEASUREMENT
/begin MEASUREMENT ZFFSAB._.GearLeverIn.P1Sts "park-button 1 status calculation" UBYTE SAB_STANDARD_S2_S3 1 100 0 7 DISPLAY_IDENTIFIER P1Sts.GearLeverIn._.ZFFSAB ECU_ADDRESS 0xFFF8F9D0 /end MEASUREMENT
/begin MEASUREMENT ZFFSAB._.GearLeverIn.P2Sts "park-button 2 status calculation" UBYTE SAB_STANDARD_S2_S3 1 100 0 7 DISPLAY_IDENTIFIER P2Sts.GearLeverIn._.ZFFSAB ECU_ADDRESS 0xFFF8F9D1 /end MEASUREMENT
/begin MEASUREMENT ZFFSAB._.GearLeverIn.P_Raw "Input signal of alternate P-Taster" UBYTE SAB_STANDARD_S2_S3 1 100 0 3 DISPLAY_IDENTIFIER P_Raw.GearLeverIn._.ZFFSAB ECU_ADDRESS 0xFFF8F9D2 /end MEASUREMENT
/begin MEASUREMENT ZFFSAB._.GearLeverIn.P_Raw_ "complement of P_Raw" UBYTE SAB_STANDARD_S2_S3 1 100 0 255 DISPLAY_IDENTIFIER P_Raw_.GearLeverIn._.ZFFSAB ECU_ADDRESS 0xFFF8F9D3 /end MEASUREMENT
/begin MEASUREMENT ZFFSAB._.GearLeverIn.GLI_SWI_LeverType "choice of the needed LeverType" UBYTE SAB_STANDARD_S2_S3 1 100 0 255 DISPLAY_IDENTIFIER GLI_SWI_LeverType.GearLeverIn._.ZFFSAB ECU_ADDRESS 0xFFF8F9D4 /end MEASUREMENT
/begin MEASUREMENT ZFFSAB._.GearLeverIn.PosS1Raw "input of gearlevers raw signal" UBYTE SAB_STANDARD_S2_S3 1 100 0 255 DISPLAY_IDENTIFIER PosS1Raw.GearLeverIn._.ZFFSAB ECU_ADDRESS 0xFFF8F9D5 /end MEASUREMENT
/begin MEASUREMENT ZFFSAB._.GearLeverIn.PosS1Raw_ "complement of iv_PosS1Raw" UBYTE SAB_STANDARD_S2_S3 1 100 0 255 DISPLAY_IDENTIFIER PosS1Raw_.GearLeverIn._.ZFFSAB ECU_ADDRESS 0xFFF8F9D6 /end MEASUREMENT
/begin MEASUREMENT ZFFSAB._.GearLeverIn.PosS2Raw "input of gearlevers raw signal" UBYTE SAB_STANDARD_S2_S3 1 100 0 255 DISPLAY_IDENTIFIER PosS2Raw.GearLeverIn._.ZFFSAB ECU_ADDRESS 0xFFF8F9D7 /end MEASUREMENT
/begin MEASUREMENT ZFFSAB._.GearLeverIn.PosS2Raw_ "complement of iv_PosS2Raw" UBYTE SAB_STANDARD_S2_S3 1 100 0 255 DISPLAY_IDENTIFIER PosS2Raw_.GearLeverIn._.ZFFSAB ECU_ADDRESS 0xFFF8F9D8 /end MEASUREMENT
/begin MEASUREMENT ZFFSAB._.GearLeverIn.Pos "internal position signal from S1 or S2" UBYTE SAB_STANDARD_S2_S3 1 100 0 255 DISPLAY_IDENTIFIER Pos.GearLeverIn._.ZFFSAB ECU_ADDRESS 0xFFF8F9D9 /end MEASUREMENT
/begin MEASUREMENT ZFFSAB._.GearLeverIn.Pos_ "internal complement of PosRaw" UBYTE SAB_STANDARD_S2_S3 1 100 0 255 DISPLAY_IDENTIFIER Pos_.GearLeverIn._.ZFFSAB ECU_ADDRESS 0xFFF8F9DA /end MEASUREMENT
/begin MEASUREMENT ZFFSAB._.MSAIn.iv_STAT_MSA "Input value of MSA state" UBYTE SAB_STANDARD_S2_S3 1 100 0 3 DISPLAY_IDENTIFIER iv_STAT_MSA.MSAIn._.ZFFSAB ECU_ADDRESS 0xFFF8FA58 /end MEASUREMENT
/begin MEASUREMENT ZFFSAB._.MSAIn.iv_STAT_MSASts "Input value signal status of MSA state" UBYTE SAB_STANDARD_S2_S3 1 100 0 255 DISPLAY_IDENTIFIER iv_STAT_MSASts.MSAIn._.ZFFSAB ECU_ADDRESS 0xFFF8FA59 /end MEASUREMENT
/begin MEASUREMENT ZFFSAB._.MSAIn.sv_f_HIS_verbaut "Flag which informs about the HIS state: 0 = not installed 1 = installed" UBYTE SAB_STANDARD_S2_S3 1 100 0 1 DISPLAY_IDENTIFIER sv_f_HIS_verbaut.MSAIn._.ZFFSAB ECU_ADDRESS 0xFFF8FA5A /end MEASUREMENT
/begin MEASUREMENT ZFFSAB._.MSAIn.sv_AGS_MsaStat "Flag which informs about the HIS state: 0 = not installed 1 = installed" UBYTE SAB_STANDARD_S2_S3 1 100 0 1 DISPLAY_IDENTIFIER sv_AGS_MsaStat.MSAIn._.ZFFSAB ECU_ADDRESS 0xFFF8FA5B /end MEASUREMENT
/begin MEASUREMENT ZFFSAB._.MSAIn.f_HIS_gelernt "Flag which informs about the HIS learned state: 0 = not learned 1 = learned" UBYTE SAB_STANDARD_S2_S3 1 100 0 1 DISPLAY_IDENTIFIER f_HIS_gelernt.MSAIn._.ZFFSAB ECU_ADDRESS 0xFFF8FA5C /end MEASUREMENT
/begin MEASUREMENT ZFFSAB._.MSAIn.sv_DiOff "Output value of DI OFF state" UBYTE SAB_STANDARD_S2_S3 1 100 0 255 DISPLAY_IDENTIFIER sv_DiOff.MSAIn._.ZFFSAB ECU_ADDRESS 0xFFF8FA5D /end MEASUREMENT
/begin MEASUREMENT ZFFSAB._.MSAIn.sv_DiOff_ "Complement value of DI OFF state" UBYTE SAB_STANDARD_S2_S3 1 100 0 255 DISPLAY_IDENTIFIER sv_DiOff_.MSAIn._.ZFFSAB ECU_ADDRESS 0xFFF8FA5E /end MEASUREMENT
/begin MEASUREMENT ZFFSAB._.ParklockSensorIn.iv_PSens1 "position 1 of P_sensor" UBYTE SAB_STANDARD_S2_S3 1 100 0 1 DISPLAY_IDENTIFIER iv_PSens1.ParklockSensorIn._.ZFFSAB ECU_ADDRESS 0xFFF8FA6C /end MEASUREMENT
/begin MEASUREMENT ZFFSAB._.ParklockSensorIn.iv_PSens1_ "complement of iv_PSens1" UBYTE SAB_STANDARD_S2_S3 1 100 0 255 DISPLAY_IDENTIFIER iv_PSens1_.ParklockSensorIn._.ZFFSAB ECU_ADDRESS 0xFFF8FA6D /end MEASUREMENT
/begin MEASUREMENT ZFFSAB._.ParklockSensorIn.iv_PSens1FaultInfo "state of iv_PSens2" UBYTE SAB_STANDARD_S2_S3 1 100 0 7 DISPLAY_IDENTIFIER iv_PSens1FaultInfo.ParklockSensorIn._.ZFFSAB ECU_ADDRESS 0xFFF8FA6E /end MEASUREMENT
/begin MEASUREMENT ZFFSAB._.ParklockSensorIn.iv_PSens1FaultInfo_ "complement state of sensor" UBYTE SAB_STANDARD_S2_S3 1 100 0 255 DISPLAY_IDENTIFIER iv_PSens1FaultInfo_.ParklockSensorIn._.ZFFSAB ECU_ADDRESS 0xFFF8FA6F /end MEASUREMENT
/begin MEASUREMENT ZFFSAB._.ParklockSensorIn.iv_PSens2 "position 2 of P_sensor" UBYTE SAB_STANDARD_S2_S3 1 100 0 1 DISPLAY_IDENTIFIER iv_PSens2.ParklockSensorIn._.ZFFSAB ECU_ADDRESS 0xFFF8FA70 /end MEASUREMENT
/begin MEASUREMENT ZFFSAB._.ParklockSensorIn.iv_PSens2_ "complement of iv_PSens2" UBYTE SAB_STANDARD_S2_S3 1 100 0 255 DISPLAY_IDENTIFIER iv_PSens2_.ParklockSensorIn._.ZFFSAB ECU_ADDRESS 0xFFF8FA71 /end MEASUREMENT
/begin MEASUREMENT ZFFSAB._.ParklockSensorIn.iv_PSens2FaultInfo "state of sensor" UBYTE SAB_STANDARD_S2_S3 1 100 0 7 DISPLAY_IDENTIFIER iv_PSens2FaultInfo.ParklockSensorIn._.ZFFSAB ECU_ADDRESS 0xFFF8FA72 /end MEASUREMENT
/begin MEASUREMENT ZFFSAB._.ParklockSensorIn.iv_PSens2FaultInfo_ "complement state of sensor" UBYTE SAB_STANDARD_S2_S3 1 100 0 255 DISPLAY_IDENTIFIER iv_PSens2FaultInfo_.ParklockSensorIn._.ZFFSAB ECU_ADDRESS 0xFFF8FA73 /end MEASUREMENT
/begin MEASUREMENT ZFFSAB._.ParklockSensorIn.iv_u_SensESts "state of iv_u_SensESts" UBYTE SAB_STANDARD_S2_S3 1 100 0 255 DISPLAY_IDENTIFIER iv_u_SensESts.ParklockSensorIn._.ZFFSAB ECU_ADDRESS 0xFFF8FA74 /end MEASUREMENT
/begin MEASUREMENT ZFFSAB._.ParklockSensorIn.iv_u_SensESts_ "state of iv_u_SensESts_" UBYTE SAB_STANDARD_S2_S3 1 100 0 255 DISPLAY_IDENTIFIER iv_u_SensESts_.ParklockSensorIn._.ZFFSAB ECU_ADDRESS 0xFFF8FA75 /end MEASUREMENT
/begin MEASUREMENT ZFFSAB._.ParklockSensorIn.sv_PSens "calculated P-Sensor-Signal" UBYTE SAB_STANDARD_S2_S3 1 100 0 3 DISPLAY_IDENTIFIER sv_PSens.ParklockSensorIn._.ZFFSAB ECU_ADDRESS 0xFFF8FA76 /end MEASUREMENT
/begin MEASUREMENT ZFFSAB._.ParklockSensorIn.sv_PSens_ "complement of PSens" UBYTE SAB_STANDARD_S2_S3 1 100 0 255 DISPLAY_IDENTIFIER sv_PSens_.ParklockSensorIn._.ZFFSAB ECU_ADDRESS 0xFFF8FA77 /end MEASUREMENT
/begin MEASUREMENT ZFFSAB._.ParklockSensorIn.sv_PSensSts "state of calculated P-Sensor-Signal" UBYTE SAB_STANDARD_S2_S3 1 100 0 2 DISPLAY_IDENTIFIER sv_PSensSts.ParklockSensorIn._.ZFFSAB ECU_ADDRESS 0xFFF8FA78 /end MEASUREMENT
/begin MEASUREMENT ZFFSAB._.ParklockSensorIn.sv_PSensSts_ "state komplement of calculated P-Sensor-Signal" UBYTE SAB_STANDARD_S2_S3 1 100 0 255 DISPLAY_IDENTIFIER sv_PSensSts_.ParklockSensorIn._.ZFFSAB ECU_ADDRESS 0xFFF8FA79 /end MEASUREMENT
/begin MEASUREMENT ZFFSAB._.ParklockSensorIn.PSensFaultInfo "calculated signal" UBYTE SAB_STANDARD_S2_S3 1 100 0 31 DISPLAY_IDENTIFIER PSensFaultInfo.ParklockSensorIn._.ZFFSAB ECU_ADDRESS 0xFFF8FA7A /end MEASUREMENT
/begin MEASUREMENT ZFFSAB._.ParklockSensorIn.PSensFaultInfo_ "calculated complement signal" UBYTE SAB_STANDARD_S2_S3 1 100 0 31 DISPLAY_IDENTIFIER PSensFaultInfo_.ParklockSensorIn._.ZFFSAB ECU_ADDRESS 0xFFF8FA7B /end MEASUREMENT
/begin MEASUREMENT ZFFSAB._.ParklockStatusIn.iv_EmfP "Input value parklock status from CAN" UBYTE SAB_STANDARD_S2_S3 1 100 0 15 DISPLAY_IDENTIFIER iv_EmfP.ParklockStatusIn._.ZFFSAB ECU_ADDRESS 0xFFF900AE /end MEASUREMENT
/begin MEASUREMENT ZFFSAB._.ParklockStatusIn.iv_EmfPSts "Input value message status of parklock status" UBYTE SAB_STANDARD_S2_S3 1 100 0 255 DISPLAY_IDENTIFIER iv_EmfPSts.ParklockStatusIn._.ZFFSAB ECU_ADDRESS 0xFFF900AF /end MEASUREMENT
/begin MEASUREMENT ZFFSAB._.ParklockStatusIn.sv_EmfP "Output value of parklock status" UBYTE SAB_STANDARD_S2_S3 1 100 0 2 DISPLAY_IDENTIFIER sv_EmfP.ParklockStatusIn._.ZFFSAB ECU_ADDRESS 0xFFF900B0 /end MEASUREMENT
/begin MEASUREMENT ZFFSAB._.ParklockStatusIn.sv_EmfPSts "Output value signal status of parklock status" UBYTE SAB_STANDARD_S2_S3 1 100 0 2 DISPLAY_IDENTIFIER sv_EmfPSts.ParklockStatusIn._.ZFFSAB ECU_ADDRESS 0xFFF900B1 /end MEASUREMENT
/begin MEASUREMENT ZFFSAB._.ParklockStatusIn.f_EmfPErr "Error flag of parklock status" UBYTE SAB_STANDARD_S2_S3 1 100 0 1 DISPLAY_IDENTIFIER f_EmfPErr.ParklockStatusIn._.ZFFSAB ECU_ADDRESS 0xFFF900B2 /end MEASUREMENT
/begin MEASUREMENT ZFFSAB._.RPM_Diagnosis.iv_u_SensEStsRaw "state of sensor raw value" UBYTE SAB_STANDARD_S2_S3 1 100 0 255 DISPLAY_IDENTIFIER iv_u_SensEStsRaw.RPM_Diagnosis._.ZFFSAB ECU_ADDRESS 0xFFF8FE2C /end MEASUREMENT
/begin MEASUREMENT ZFFSAB._.RPM_Diagnosis.iv_u_Batt_Diag "actual battery voltage" UWORD SAB_U_1VOLT1000_S2_S3 1 100 0 65.535 DISPLAY_IDENTIFIER iv_u_Batt_Diag.RPM_Diagnosis._.ZFFSAB ECU_ADDRESS 0xFFF8FE2E /end MEASUREMENT
/begin MEASUREMENT ZFFSAB._.RPM_Diagnosis.iv_u_SensEStsRaw_ "state of sensor raw value complement" UBYTE SAB_STANDARD_S2_S3 1 100 0 255 DISPLAY_IDENTIFIER iv_u_SensEStsRaw_.RPM_Diagnosis._.ZFFSAB ECU_ADDRESS 0xFFF8FE30 /end MEASUREMENT
/begin MEASUREMENT ZFFSAB._.RPM_Diagnosis.iv_u_SensEStsRam "Ram value- used for testing complement monitoring of state of sensor" UBYTE SAB_STANDARD_S2_S3 1 100 0 255 DISPLAY_IDENTIFIER iv_u_SensEStsRam.RPM_Diagnosis._.ZFFSAB ECU_ADDRESS 0xFFF8FE31 /end MEASUREMENT
/begin MEASUREMENT ZFFSAB._.RPM_Diagnosis.iv_u_SensEStsRam_ "Ram value- used for testing complement monitoring of state of sensor" UBYTE SAB_STANDARD_S2_S3 1 100 0 255 DISPLAY_IDENTIFIER iv_u_SensEStsRam_.RPM_Diagnosis._.ZFFSAB ECU_ADDRESS 0xFFF8FE32 /end MEASUREMENT
/begin MEASUREMENT ZFFSAB._.RPM_Diagnosis.iv_u_SensESts "state of sensor" UBYTE SAB_STANDARD_S2_S3 1 100 0 255 DISPLAY_IDENTIFIER iv_u_SensESts.RPM_Diagnosis._.ZFFSAB ECU_ADDRESS 0xFFF8FE33 /end MEASUREMENT
/begin MEASUREMENT ZFFSAB._.RPM_Diagnosis.iv_u_SensESts_ "state of sensor complement" UBYTE SAB_STANDARD_S2_S3 1 100 0 255 DISPLAY_IDENTIFIER iv_u_SensESts_.RPM_Diagnosis._.ZFFSAB ECU_ADDRESS 0xFFF8FE34 /end MEASUREMENT
/begin MEASUREMENT ZFFSAB._.TurbineSpeedIn.TurbineSpeedIn_Fl.iv_u_SensESts_ "state of iv_PSens1 complement" FLOAT32_IEEE SAB_STANDARD_S2_S3 1 100 0 4294967295 FORMAT "%5.3" DISPLAY_IDENTIFIER iv_u_SensESts_.TurbineSpeedIn_Fl.TurbineSpeedIn._.ZFFSAB ECU_ADDRESS 0xFFF8FFC0 /end MEASUREMENT
/begin MEASUREMENT ZFFSAB._.TurbineSpeedIn.TurbineSpeedIn_Fl.iv_u_SensESts "state of iv_PSens1" FLOAT32_IEEE SAB_STANDARD_S2_S3 1 100 0 4294967295 FORMAT "%5.3" DISPLAY_IDENTIFIER iv_u_SensESts.TurbineSpeedIn_Fl.TurbineSpeedIn._.ZFFSAB ECU_ADDRESS 0xFFF8FFC4 /end MEASUREMENT
/begin MEASUREMENT ZFFSAB._.TurbineSpeedIn.TurbineSpeedIn_Fl.n_Tu_detected "loc variable to detect the first time a revolution (n_Tu) != 0 is received" FLOAT32_IEEE SAB_STANDARD_S2_S3 1 100 0 1 FORMAT "%5.3" DISPLAY_IDENTIFIER n_Tu_detected.TurbineSpeedIn_Fl.TurbineSpeedIn._.ZFFSAB ECU_ADDRESS 0xFFF8FFC8 /end MEASUREMENT
/begin MEASUREMENT ZFFSAB._.TurbineSpeedIn.TurbineSpeedIn_Fl.iv_n_Tu "Input value turbine Speed" FLOAT32_IEEE SAB_N_1RPM_S2_S3 1 100 0 65535 FORMAT "%5.3" DISPLAY_IDENTIFIER iv_n_Tu.TurbineSpeedIn_Fl.TurbineSpeedIn._.ZFFSAB ECU_ADDRESS 0xFFF8FFCC /end MEASUREMENT
/begin MEASUREMENT ZFFSAB._.TurbineSpeedIn.TurbineSpeedIn_Fl.iv_n_TuESts "Input CAN message status for turbine" FLOAT32_IEEE SAB_STANDARD_S2_S3 1 100 0 2 FORMAT "%5.3" DISPLAY_IDENTIFIER iv_n_TuESts.TurbineSpeedIn_Fl.TurbineSpeedIn._.ZFFSAB ECU_ADDRESS 0xFFF8FFD0 /end MEASUREMENT
/begin MEASUREMENT ZFFSAB._.TurbineSpeedIn.TurbineSpeedIn_Fl.iv_n_Tu_ "Input value turbine Speed complement" FLOAT32_IEEE SAB_N_1RPM_S2_S3 1 100 0 65535 FORMAT "%5.3" DISPLAY_IDENTIFIER iv_n_Tu_.TurbineSpeedIn_Fl.TurbineSpeedIn._.ZFFSAB ECU_ADDRESS 0xFFF8FFD4 /end MEASUREMENT
/begin MEASUREMENT ZFFSAB._.TurbineSpeedIn.TurbineSpeedIn_Fl.iv_n_TuESts_ "Input CAN message status for turbine complement" FLOAT32_IEEE SAB_STANDARD_S2_S3 1 100 0 2 FORMAT "%5.3" DISPLAY_IDENTIFIER iv_n_TuESts_.TurbineSpeedIn_Fl.TurbineSpeedIn._.ZFFSAB ECU_ADDRESS 0xFFF8FFD8 /end MEASUREMENT
/begin MEASUREMENT ZFFSAB._.TurbineSpeedIn.TurbineSpeedIn_Fl.n_Tu_Filt2 "filtered value turbine speed for CAN output" FLOAT32_IEEE SAB_N_1RPM_S2_S3 1 100 0 4294967295 FORMAT "%5.3" DISPLAY_IDENTIFIER n_Tu_Filt2.TurbineSpeedIn_Fl.TurbineSpeedIn._.ZFFSAB ECU_ADDRESS 0xFFF8FFDC /end MEASUREMENT
/begin MEASUREMENT ZFFSAB._.TurbineSpeedIn.TurbineSpeedIn_Fl.Tu_f_DirectionErr "Error flag of the direction-detection" FLOAT32_IEEE SAB_STANDARD_S2_S3 1 100 0 1 FORMAT "%5.3" DISPLAY_IDENTIFIER Tu_f_DirectionErr.TurbineSpeedIn_Fl.TurbineSpeedIn._.ZFFSAB ECU_ADDRESS 0xFFF8FFE0 /end MEASUREMENT
/begin MEASUREMENT ZFFSAB._.TurbineSpeedIn.TurbineSpeedIn_Fl.n_Tu_Filt_CAN "filtered value turbine speed for CAN output after CAN-Init filter" FLOAT32_IEEE SAB_N_1RPM_S2_S3 1 100 0 4294967295 FORMAT "%5.3" DISPLAY_IDENTIFIER n_Tu_Filt_CAN.TurbineSpeedIn_Fl.TurbineSpeedIn._.ZFFSAB ECU_ADDRESS 0xFFF8FFE4 /end MEASUREMENT
/begin MEASUREMENT ZFFSAB._.TurbineSpeedIn.TurbineSpeedIn_Fl.f_n_TuPlausiErr "local variable for the turbinespeed value plausibility flag" FLOAT32_IEEE SAB_STANDARD_S2_S3 1 100 0 1 FORMAT "%5.3" DISPLAY_IDENTIFIER f_n_TuPlausiErr.TurbineSpeedIn_Fl.TurbineSpeedIn._.ZFFSAB ECU_ADDRESS 0xFFF8FFE8 /end MEASUREMENT
/begin MEASUREMENT ZFFSAB._.TurbineSpeedIn.TurbineSpeedIn_Fl.f_OverallPlausiState "local variable for a overall state consisting of iv_u_SensESts sv_n_EngSts sv_PSensSts f_n_TuVirtPlausiErr f_n_TuPlausiErr f_n_AbPlausiErr f_n_TuPlausiErr_active 0=all valid 1= at least one faulty" FLOAT32_IEEE SAB_STANDARD_S2_S3 1 100 0 1 FORMAT "%5.3" DISPLAY_IDENTIFIER f_OverallPlausiState.TurbineSpeedIn_Fl.TurbineSpeedIn._.ZFFSAB ECU_ADDRESS 0xFFF8FFEC /end MEASUREMENT
/begin MEASUREMENT ZFFSAB._.TurbineSpeedIn.TurbineSpeedIn_Fl.n_EngLev2TSI "local variable for the engine speed substitute value" FLOAT32_IEEE SAB_STANDARD_S2_S3 1 100 0 65535 FORMAT "%5.3" DISPLAY_IDENTIFIER n_EngLev2TSI.TurbineSpeedIn_Fl.TurbineSpeedIn._.ZFFSAB ECU_ADDRESS 0xFFF8FFF0 /end MEASUREMENT
/begin MEASUREMENT ZFFSAB._.TurbineSpeedIn.TurbineSpeedIn_Fl.n_EngLev2TSISts "local variable for the engine speed status substitute value" FLOAT32_IEEE SAB_STANDARD_S2_S3 1 100 0 2 FORMAT "%5.3" DISPLAY_IDENTIFIER n_EngLev2TSISts.TurbineSpeedIn_Fl.TurbineSpeedIn._.ZFFSAB ECU_ADDRESS 0xFFF8FFF4 /end MEASUREMENT
/begin MEASUREMENT ZFFSAB._.TurbineSpeedIn.TurbineSpeedIn_Fl.f_n_Tu_PlausiErr_active "variable contains the information if KFC_NTUPLAUSILEV2 is active or not" FLOAT32_IEEE SAB_STANDARD_S2_S3 1 100 0 1 FORMAT "%5.3" DISPLAY_IDENTIFIER f_n_Tu_PlausiErr_active.TurbineSpeedIn_Fl.TurbineSpeedIn._.ZFFSAB ECU_ADDRESS 0xFFF8FFF8 /end MEASUREMENT
/begin MEASUREMENT ZFFSAB._.TurbineSpeedIn.TurbineSpeedIn_Fl.f_n_Tu_PlausiErr_active_ "variable contains the information if KFC_NTUPLAUSILEV2 is active or not (complement)" FLOAT32_IEEE SAB_STANDARD_S2_S3 1 100 0 255 FORMAT "%5.3" DISPLAY_IDENTIFIER f_n_Tu_PlausiErr_active_.TurbineSpeedIn_Fl.TurbineSpeedIn._.ZFFSAB ECU_ADDRESS 0xFFF8FFFC /end MEASUREMENT
/begin MEASUREMENT ZFFSAB._.TurbineSpeedIn.TurbineSpeedIn_Fl.sv_n_TuLev2 "Output value turbine speed lev2" FLOAT32_IEEE SAB_N_1RPM_S2_S3 1 100 0 65535 FORMAT "%5.3" DISPLAY_IDENTIFIER sv_n_TuLev2.TurbineSpeedIn_Fl.TurbineSpeedIn._.ZFFSAB ECU_ADDRESS 0xFFF90000 /end MEASUREMENT
/begin MEASUREMENT ZFFSAB._.TurbineSpeedIn.TurbineSpeedIn_Fl.sv_n_TuLev2Sts "Output value signal status of turbine speed lev2" FLOAT32_IEEE SAB_STANDARD_S2_S3 1 100 0 2 FORMAT "%5.3" DISPLAY_IDENTIFIER sv_n_TuLev2Sts.TurbineSpeedIn_Fl.TurbineSpeedIn._.ZFFSAB ECU_ADDRESS 0xFFF90004 /end MEASUREMENT
/begin MEASUREMENT ZFFSAB._.TurbineSpeedIn.iv_u_SensESts "state of iv_PSens1" UBYTE SAB_STANDARD_S2_S3 1 100 0 255 DISPLAY_IDENTIFIER iv_u_SensESts.TurbineSpeedIn._.ZFFSAB ECU_ADDRESS 0xFFF90024 /end MEASUREMENT
/begin MEASUREMENT ZFFSAB._.TurbineSpeedIn.iv_u_SensESts_ "state of iv_PSens1 complement" UBYTE SAB_STANDARD_S2_S3 1 100 0 255 DISPLAY_IDENTIFIER iv_u_SensESts_.TurbineSpeedIn._.ZFFSAB ECU_ADDRESS 0xFFF90025 /end MEASUREMENT
/begin MEASUREMENT ZFFSAB._.TurbineSpeedIn.sv_n_Tu "Output value turbine speed" UWORD SAB_N_1RPM_S2_S3 1 100 0 65535 DISPLAY_IDENTIFIER sv_n_Tu.TurbineSpeedIn._.ZFFSAB ECU_ADDRESS 0xFFF90026 /end MEASUREMENT
/begin MEASUREMENT ZFFSAB._.TurbineSpeedIn.sv_n_TuSts "Output value signal status of turbine speed" UBYTE SAB_STANDARD_S2_S3 1 100 0 2 DISPLAY_IDENTIFIER sv_n_TuSts.TurbineSpeedIn._.ZFFSAB ECU_ADDRESS 0xFFF90028 /end MEASUREMENT
/begin MEASUREMENT ZFFSAB._.TurbineSpeedIn.sv_n_TuLev2 "Output value turbine speed lev2" UWORD SAB_N_1RPM_S2_S3 1 100 0 65535 DISPLAY_IDENTIFIER sv_n_TuLev2.TurbineSpeedIn._.ZFFSAB ECU_ADDRESS 0xFFF9002A /end MEASUREMENT
/begin MEASUREMENT ZFFSAB._.TurbineSpeedIn.sv_n_TuLev2Sts "Output value signal status level2 of turbine speed" UBYTE SAB_STANDARD_S2_S3 1 100 0 2 DISPLAY_IDENTIFIER sv_n_TuLev2Sts.TurbineSpeedIn._.ZFFSAB ECU_ADDRESS 0xFFF9002C /end MEASUREMENT
/begin MEASUREMENT ZFFSAB._.TurbineSpeedIn.sv_n_TuLev2_ "Output value turbine speed (complement)" UWORD SAB_N_1RPM_S2_S3 1 100 0 65535 DISPLAY_IDENTIFIER sv_n_TuLev2_.TurbineSpeedIn._.ZFFSAB ECU_ADDRESS 0xFFF9002E /end MEASUREMENT
/begin MEASUREMENT ZFFSAB._.TurbineSpeedIn.sv_n_TuLev2Sts_ "Output value signal status level2 of turbine speed" UBYTE SAB_STANDARD_S2_S3 1 100 0 2 DISPLAY_IDENTIFIER sv_n_TuLev2Sts_.TurbineSpeedIn._.ZFFSAB ECU_ADDRESS 0xFFF90030 /end MEASUREMENT
/begin MEASUREMENT ZFFSAB._.TurbineSpeedIn.sv_n_TuFilt "Output value for filtered turbine speed" UWORD SAB_N_1RPM_S2_S3 1 100 0 65535 DISPLAY_IDENTIFIER sv_n_TuFilt.TurbineSpeedIn._.ZFFSAB ECU_ADDRESS 0xFFF90032 /end MEASUREMENT
/begin MEASUREMENT ZFFSAB._.TurbineSpeedIn.sv_n_Tu_Tx "Output value turbine speed send on CAN" UWORD SAB_N_RPM_M2000_S2_S3 1 100 -2000 14000 DISPLAY_IDENTIFIER sv_n_Tu_Tx.TurbineSpeedIn._.ZFFSAB ECU_ADDRESS 0xFFF90034 /end MEASUREMENT
/begin MEASUREMENT ZFFSAB._.TurbineSpeedIn.sv_n_Tu_Tx_ "Output value turbine speed send on CAN" UWORD SAB_N_RPM_M2000_S2_S3 1 100 -2000 14000 DISPLAY_IDENTIFIER sv_n_Tu_Tx_.TurbineSpeedIn._.ZFFSAB ECU_ADDRESS 0xFFF90036 /end MEASUREMENT
/begin MEASUREMENT ZFFSAB._.TurbineSpeedIn.sv_Tu_sts_Direction "Direction (FORWARD=forward BACKWARD=backward)" UBYTE SAB_STANDARD_S2_S3 1 100 0 255 DISPLAY_IDENTIFIER sv_Tu_sts_Direction.TurbineSpeedIn._.ZFFSAB ECU_ADDRESS 0xFFF90038 /end MEASUREMENT
/begin MEASUREMENT ZFFSAB._.TurbineSpeedIn.sv_Tu_sts_DirectionSts "Status of direction" UBYTE SAB_STANDARD_S2_S3 1 100 0 255 DISPLAY_IDENTIFIER sv_Tu_sts_DirectionSts.TurbineSpeedIn._.ZFFSAB ECU_ADDRESS 0xFFF90039 /end MEASUREMENT
/begin MEASUREMENT ZFFSAB._.TurbineSpeedIn.n_Tu_detected "loc variable to detect the first time a revolution (n_Tu) != 0 is received" UBYTE SAB_STANDARD_S2_S3 1 100 0 1 DISPLAY_IDENTIFIER n_Tu_detected.TurbineSpeedIn._.ZFFSAB ECU_ADDRESS 0xFFF9003A /end MEASUREMENT
/begin MEASUREMENT ZFFSAB._.TurbineSpeedIn.n_Tu_detected_ "loc variable to detect the first time a revolution (n_Tu) != 0 is received (complement)" UBYTE SAB_STANDARD_S2_S3 1 100 0 1 DISPLAY_IDENTIFIER n_Tu_detected_.TurbineSpeedIn._.ZFFSAB ECU_ADDRESS 0xFFF9003B /end MEASUREMENT
/begin MEASUREMENT ZFFSAB._.TurbineSpeedIn.iv_n_Tu "Input value turbine Speed" UWORD SAB_N_1RPM_S2_S3 1 100 0 65535 DISPLAY_IDENTIFIER iv_n_Tu.TurbineSpeedIn._.ZFFSAB ECU_ADDRESS 0xFFF9003C /end MEASUREMENT
/begin MEASUREMENT ZFFSAB._.TurbineSpeedIn.iv_n_TuESts "Input CAN message status for turbine" UBYTE SAB_STANDARD_S2_S3 1 100 0 4 DISPLAY_IDENTIFIER iv_n_TuESts.TurbineSpeedIn._.ZFFSAB ECU_ADDRESS 0xFFF9003E /end MEASUREMENT
/begin MEASUREMENT ZFFSAB._.TurbineSpeedIn.iv_n_Tu_ "Input value turbine Speed complement" UWORD SAB_N_1RPM_S2_S3 1 100 0 65535 DISPLAY_IDENTIFIER iv_n_Tu_.TurbineSpeedIn._.ZFFSAB ECU_ADDRESS 0xFFF90040 /end MEASUREMENT
/begin MEASUREMENT ZFFSAB._.TurbineSpeedIn.iv_n_TuESts_ "Input CAN message status for turbine complement" UBYTE SAB_STANDARD_S2_S3 1 100 0 255 DISPLAY_IDENTIFIER iv_n_TuESts_.TurbineSpeedIn._.ZFFSAB ECU_ADDRESS 0xFFF90042 /end MEASUREMENT
/begin MEASUREMENT ZFFSAB._.TurbineSpeedIn.n_Tu_Filt2 "filtered value turbine speed for CAN output" UWORD SAB_N_1RPM_S2_S3 1 100 0 65535 DISPLAY_IDENTIFIER n_Tu_Filt2.TurbineSpeedIn._.ZFFSAB ECU_ADDRESS 0xFFF90044 /end MEASUREMENT
/begin MEASUREMENT ZFFSAB._.TurbineSpeedIn.n_Tu_Filt2_ "filtered value turbine speed for CAN output (complement)" UWORD SAB_N_1RPM_S2_S3 1 100 0 65535 DISPLAY_IDENTIFIER n_Tu_Filt2_.TurbineSpeedIn._.ZFFSAB ECU_ADDRESS 0xFFF90046 /end MEASUREMENT
/begin MEASUREMENT ZFFSAB._.TurbineSpeedIn.Tu_f_DirectionErr "Error flag of the direction-detection" UBYTE SAB_STANDARD_S2_S3 1 100 0 1 DISPLAY_IDENTIFIER Tu_f_DirectionErr.TurbineSpeedIn._.ZFFSAB ECU_ADDRESS 0xFFF90048 /end MEASUREMENT
/begin MEASUREMENT ZFFSAB._.TurbineSpeedIn.n_Tu_Filt_CAN "filtered value turbine speed for CAN output after CAN-Init filter" UWORD SAB_N_1RPM_S2_S3 1 100 0 65535 DISPLAY_IDENTIFIER n_Tu_Filt_CAN.TurbineSpeedIn._.ZFFSAB ECU_ADDRESS 0xFFF9004A /end MEASUREMENT
/begin MEASUREMENT ZFFSAB._.TurbineSpeedIn.n_Tu_Filt_CAN_ "filtered value turbine speed for CAN output after CAN-Init filter(complement)" UWORD SAB_N_1RPM_S2_S3 1 100 0 65535 DISPLAY_IDENTIFIER n_Tu_Filt_CAN_.TurbineSpeedIn._.ZFFSAB ECU_ADDRESS 0xFFF9004C /end MEASUREMENT
/begin MEASUREMENT ZFFSAB._.TurbineSpeedIn.f_n_TuPlausiErr "local variable for the turbinespeed value plausibility flag" UBYTE SAB_STANDARD_S2_S3 1 100 0 1 DISPLAY_IDENTIFIER f_n_TuPlausiErr.TurbineSpeedIn._.ZFFSAB ECU_ADDRESS 0xFFF9004E /end MEASUREMENT
/begin MEASUREMENT ZFFSAB._.TurbineSpeedIn.n_EngLev2TSI "local variable for the engine speed substitute value" UWORD SAB_N_1RPM_S2_S3 1 100 0 65535 DISPLAY_IDENTIFIER n_EngLev2TSI.TurbineSpeedIn._.ZFFSAB ECU_ADDRESS 0xFFF90050 /end MEASUREMENT
/begin MEASUREMENT ZFFSAB._.TurbineSpeedIn.n_EngLev2TSISts "local variable for the engine speed status substitute value" UBYTE SAB_STANDARD_S2_S3 1 100 0 255 DISPLAY_IDENTIFIER n_EngLev2TSISts.TurbineSpeedIn._.ZFFSAB ECU_ADDRESS 0xFFF90052 /end MEASUREMENT
/begin MEASUREMENT ZFFSAB._.TurbineSpeedIn.n_EngLev2TSI_ "local variable for the engine speed substitute value (complement)" UWORD SAB_N_1RPM_S2_S3 1 100 0 65535 DISPLAY_IDENTIFIER n_EngLev2TSI_.TurbineSpeedIn._.ZFFSAB ECU_ADDRESS 0xFFF90054 /end MEASUREMENT
/begin MEASUREMENT ZFFSAB._.TurbineSpeedIn.n_EngLev2TSISts_ "local variable for the engine speed status substitute value (complement)" UBYTE SAB_STANDARD_S2_S3 1 100 0 255 DISPLAY_IDENTIFIER n_EngLev2TSISts_.TurbineSpeedIn._.ZFFSAB ECU_ADDRESS 0xFFF90056 /end MEASUREMENT
/begin MEASUREMENT ZFFSAB._.TurbineSpeedIn.f_n_Tu_PlausiErr_active "variable contains the information if KFC_NTUPLAUSILEV2 is active or not" UBYTE SAB_STANDARD_S2_S3 1 100 0 1 DISPLAY_IDENTIFIER f_n_Tu_PlausiErr_active.TurbineSpeedIn._.ZFFSAB ECU_ADDRESS 0xFFF90057 /end MEASUREMENT
/begin MEASUREMENT ZFFSAB._.TurbineSpeedIn.f_n_Tu_PlausiErr_active_ "variable contains the information if KFC_NTUPLAUSILEV2 is active or not (complement)" UBYTE SAB_STANDARD_S2_S3 1 100 0 255 DISPLAY_IDENTIFIER f_n_Tu_PlausiErr_active_.TurbineSpeedIn._.ZFFSAB ECU_ADDRESS 0xFFF90058 /end MEASUREMENT
/begin MEASUREMENT ZFFSAB._.TurbineSpeedIn.n_Tu_ "local variable contains" UWORD SAB_STANDARD_S2_S3 1 100 0 65535 DISPLAY_IDENTIFIER n_Tu_.TurbineSpeedIn._.ZFFSAB ECU_ADDRESS 0xFFF9005A /end MEASUREMENT
/begin MEASUREMENT ZFFSAB._.TurbineSpeedIn.n_TuSts_ "local variable contains information of complement the signal status" UBYTE SAB_STANDARD_S2_S3 1 100 0 255 DISPLAY_IDENTIFIER n_TuSts_.TurbineSpeedIn._.ZFFSAB ECU_ADDRESS 0xFFF9005C /end MEASUREMENT
/begin MEASUREMENT ZFFSAB._.TurbineSpeedIn.Tu_sts_DirectionDiag "local variable for the Turbine or N6 DirectionDiag State from RPM_Sensing" UBYTE SAB_STANDARD_S2_S3 1 100 0 5 DISPLAY_IDENTIFIER Tu_sts_DirectionDiag.TurbineSpeedIn._.ZFFSAB ECU_ADDRESS 0xFFF9005D /end MEASUREMENT
/begin MEASUREMENT ZFFSAB._.TurbineSpeedIn.Ab_sts_DirectionDiag "local variable for the Transmission DirectionDiag State from RPM_Sensing" UBYTE SAB_STANDARD_S2_S3 1 100 0 5 DISPLAY_IDENTIFIER Ab_sts_DirectionDiag.TurbineSpeedIn._.ZFFSAB ECU_ADDRESS 0xFFF9005E /end MEASUREMENT
/begin MEASUREMENT ZFFSAB._.TurbineSpeedIn.f_OverallPlausiState "local variable for a overall state consisting of iv_u_SensESts sv_n_EngSts sv_PSensSts f_n_TuVirtPlausiErr f_n_TuPlausiErr f_n_AbPlausiErr f_n_TuPlausiErr_active 0=all valid 1= at least one faulty" UBYTE SAB_STANDARD_S2_S3 1 100 0 1 DISPLAY_IDENTIFIER f_OverallPlausiState.TurbineSpeedIn._.ZFFSAB ECU_ADDRESS 0xFFF9005F /end MEASUREMENT
/begin MEASUREMENT ZFFSAB._.TurbineTorqueIn.iv_dc_Trq "Input raw signal from Turbine Torque Sensor" UWORD SAB_PROZENT10_S2_S3 1 100 0 100 DISPLAY_IDENTIFIER iv_dc_Trq.TurbineTorqueIn._.ZFFSAB ECU_ADDRESS 0xFFF976E0 /end MEASUREMENT
/begin MEASUREMENT ZFFSAB._.TurbineTorqueIn.iv_dc_TrqESts "Input raw signal status from Turbine Torque Sensor" UBYTE SAB_STANDARD_S2_S3 1 100 0 255 DISPLAY_IDENTIFIER iv_dc_TrqESts.TurbineTorqueIn._.ZFFSAB ECU_ADDRESS 0xFFF976E2 /end MEASUREMENT
/begin MEASUREMENT ZFFSAB._.TurbineTorqueIn.sv_dc_MotTrq "Output signal of Turbine Torque" UWORD SAB_PROZENT10_S2_S3 1 100 0 100 DISPLAY_IDENTIFIER sv_dc_MotTrq.TurbineTorqueIn._.ZFFSAB ECU_ADDRESS 0xFFF976E4 /end MEASUREMENT
/begin MEASUREMENT ZFFSAB._.TurbineTorqueIn.sv_dc_MotTrqSts "Output status signal of Turbine Torque" UBYTE SAB_STANDARD_S2_S3 1 100 0 2 DISPLAY_IDENTIFIER sv_dc_MotTrqSts.TurbineTorqueIn._.ZFFSAB ECU_ADDRESS 0xFFF976E6 /end MEASUREMENT
/begin MEASUREMENT ZFFSAB._.TurbineTorqueIn.dc_TrqFaultInfo "Error Info of DcTrq-signal xxxxxxx1 means problem on EGS side xxxxxx1x means problem on sensor side" UBYTE SAB_STANDARD_S2_S3 1 100 0 2 DISPLAY_IDENTIFIER dc_TrqFaultInfo.TurbineTorqueIn._.ZFFSAB ECU_ADDRESS 0xFFF976E7 /end MEASUREMENT
/begin MEASUREMENT ZFFSAB._.TractionControlIn.iv_EingriffTraktion "Input raw signal Traction Control" UBYTE SAB_STANDARD_S2_S3 1 100 0 15 DISPLAY_IDENTIFIER iv_EingriffTraktion.TractionControlIn._.ZFFSAB ECU_ADDRESS 0xFFF983E2 /end MEASUREMENT
/begin MEASUREMENT ZFFSAB._.TractionControlIn.iv_EingriffTraktionSts "Input CAN message status Traction Control" UBYTE SAB_STANDARD_S2_S3 1 100 0 255 DISPLAY_IDENTIFIER iv_EingriffTraktionSts.TractionControlIn._.ZFFSAB ECU_ADDRESS 0xFFF983E3 /end MEASUREMENT
/begin MEASUREMENT ZFFSAB._.TractionControlIn.sv_AGS_EingriffTraktion "Output signal of Traction Control" UBYTE SAB_STANDARD_S2_S3 1 100 0 3 DISPLAY_IDENTIFIER sv_AGS_EingriffTraktion.TractionControlIn._.ZFFSAB ECU_ADDRESS 0xFFF983E4 /end MEASUREMENT
/begin MEASUREMENT ZFFSAB._.TractionControlIn.sv_EingriffTraktionSts "Output value signal status of Traction Control" UBYTE SAB_STANDARD_S2_S3 1 100 0 2 DISPLAY_IDENTIFIER sv_EingriffTraktionSts.TractionControlIn._.ZFFSAB ECU_ADDRESS 0xFFF983E5 /end MEASUREMENT
/begin MEASUREMENT ZFFSAB._.TractionControlIn.f_EingriffTraktionErr "Error flag of EingriffTraktion-signal" UBYTE SAB_STANDARD_S2_S3 1 100 0 1 DISPLAY_IDENTIFIER f_EingriffTraktionErr.TractionControlIn._.ZFFSAB ECU_ADDRESS 0xFFF983E6 /end MEASUREMENT
/begin MEASUREMENT ZFFSAB._.SpeedometerSpeedIn.sv_v_Speedometer "Intermediate value of speedometer" UWORD SAB_V_KMH10_S2_S3 1 100 0 409.5 DISPLAY_IDENTIFIER sv_v_Speedometer.SpeedometerSpeedIn._.ZFFSAB ECU_ADDRESS 0xFFF9784C /end MEASUREMENT
/begin MEASUREMENT ZFFSAB._.SpeedometerSpeedIn.sv_v_SpeedometerSts "Intermediate value signal status of speedometer" UBYTE SAB_STANDARD_S2_S3 1 100 0 255 DISPLAY_IDENTIFIER sv_v_SpeedometerSts.SpeedometerSpeedIn._.ZFFSAB ECU_ADDRESS 0xFFF9784E /end MEASUREMENT
/begin MEASUREMENT ZFFSAB._.SpeedometerSpeedIn.iv_v_SpeedometerSts "Input value message status of speedometer" UBYTE SAB_STANDARD_S2_S3 1 100 0 255 DISPLAY_IDENTIFIER iv_v_SpeedometerSts.SpeedometerSpeedIn._.ZFFSAB ECU_ADDRESS 0xFFF9784F /end MEASUREMENT
/begin MEASUREMENT ZFFSAB._.SpeedometerSpeedIn.iv_v_Speedometer "Input value speedometer from CAN" UWORD SAB_V_KMH10_S2_S3 1 100 0 409.5 DISPLAY_IDENTIFIER iv_v_Speedometer.SpeedometerSpeedIn._.ZFFSAB ECU_ADDRESS 0xFFF97850 /end MEASUREMENT
/begin MEASUREMENT ZFFSAB._.SpeedometerSpeedIn.f_v_SpeedometerErr "Error flag of speedometer" UBYTE SAB_STANDARD_S2_S3 1 100 0 255 DISPLAY_IDENTIFIER f_v_SpeedometerErr.SpeedometerSpeedIn._.ZFFSAB ECU_ADDRESS 0xFFF97852 /end MEASUREMENT
/begin MEASUREMENT ZFFSAB._.InclinationIn.iv_SensErr "Extra error signal for inclination signal" UBYTE SAB_STANDARD_S2_S3 1 100 0 1 DISPLAY_IDENTIFIER iv_SensErr.InclinationIn._.ZFFSAB ECU_ADDRESS 0xFFF9786C /end MEASUREMENT
/begin MEASUREMENT ZFFSAB._.InclinationIn.iv_Sens "Input raw signal for inclination" UWORD SAB_PHI_SENS_1GRAD20_M1280_S2_S3 1 100 -64 140.75 DISPLAY_IDENTIFIER iv_Sens.InclinationIn._.ZFFSAB ECU_ADDRESS 0xFFF9786E /end MEASUREMENT
/begin MEASUREMENT ZFFSAB._.InclinationIn.iv_SensSts "Input CAN message status for inclination signal" UBYTE SAB_STANDARD_S2_S3 1 100 0 255 DISPLAY_IDENTIFIER iv_SensSts.InclinationIn._.ZFFSAB ECU_ADDRESS 0xFFF97870 /end MEASUREMENT
/begin MEASUREMENT ZFFSAB._.InclinationIn.sv_Sens "Output signal for inclination" UBYTE SAB_PHI_SENS_1GRAD3_M128_S2_S3 1 100 -42.6666666667 42.3333333333 DISPLAY_IDENTIFIER sv_Sens.InclinationIn._.ZFFSAB ECU_ADDRESS 0xFFF97871 /end MEASUREMENT
/begin MEASUREMENT ZFFSAB._.InclinationIn.sv_SensSts "Output status signal for inclination" UBYTE SAB_STANDARD_S2_S3 1 100 0 2 DISPLAY_IDENTIFIER sv_SensSts.InclinationIn._.ZFFSAB ECU_ADDRESS 0xFFF97872 /end MEASUREMENT
/begin MEASUREMENT ZFFSAB._.InclinationIn.sv_AGS_Acclivity "Output signal of inclination for AGS" UWORD SAB_PROZENT10_M2000_S2_S3 1 100 -200 200 DISPLAY_IDENTIFIER sv_AGS_Acclivity.InclinationIn._.ZFFSAB ECU_ADDRESS 0xFFF97874 /end MEASUREMENT
/begin MEASUREMENT ZFFSAB._.InclinationIn.f_SensErr "Error flag of Sens-signal" UBYTE SAB_STANDARD_S2_S3 1 100 0 1 DISPLAY_IDENTIFIER f_SensErr.InclinationIn._.ZFFSAB ECU_ADDRESS 0xFFF97876 /end MEASUREMENT
/begin MEASUREMENT ZFFSAB._.SportButtonIn.iv_DriveLogicRaw "Sport-Wippen Information" UBYTE SAB_STANDARD_S2_S3 1 100 0 255 DISPLAY_IDENTIFIER iv_DriveLogicRaw.SportButtonIn._.ZFFSAB ECU_ADDRESS 0xFFF9787C /end MEASUREMENT
/begin MEASUREMENT ZFFSAB._.SportButtonIn.iv_DriveLogicRawSts "state of iv_DriveLogicRaw" UBYTE SAB_STANDARD_S2_S3 1 100 0 255 DISPLAY_IDENTIFIER iv_DriveLogicRawSts.SportButtonIn._.ZFFSAB ECU_ADDRESS 0xFFF9787D /end MEASUREMENT
/begin MEASUREMENT ZFFSAB._.SportButtonIn.iv_GWS_S_ButtonRaw "sport taster information from CAN BN2" UBYTE SAB_STANDARD_S2_S3 1 100 0 255 DISPLAY_IDENTIFIER iv_GWS_S_ButtonRaw.SportButtonIn._.ZFFSAB ECU_ADDRESS 0xFFF9787E /end MEASUREMENT
/begin MEASUREMENT ZFFSAB._.SportButtonIn.iv_GWS_S_ButtonRawSts "status of iv_GWS_S_ButtonRaw" UBYTE SAB_STANDARD_S2_S3 1 100 0 255 DISPLAY_IDENTIFIER iv_GWS_S_ButtonRawSts.SportButtonIn._.ZFFSAB ECU_ADDRESS 0xFFF9787F /end MEASUREMENT
/begin MEASUREMENT ZFFSAB._.SportButtonIn.iv_DriveLogicS2 "Drive-Logic-Signal from Source 2" UBYTE SAB_STANDARD_S2_S3 1 100 0 255 DISPLAY_IDENTIFIER iv_DriveLogicS2.SportButtonIn._.ZFFSAB ECU_ADDRESS 0xFFF97880 /end MEASUREMENT
/begin MEASUREMENT ZFFSAB._.SportButtonIn.iv_DriveLogicS1 "Drive-Logic-Signal from Source 1" UBYTE SAB_STANDARD_S2_S3 1 100 0 255 DISPLAY_IDENTIFIER iv_DriveLogicS1.SportButtonIn._.ZFFSAB ECU_ADDRESS 0xFFF97881 /end MEASUREMENT
/begin MEASUREMENT ZFFSAB._.SportButtonIn.iv_DriveLogicStsS2 "Drive-Logic-Status from Source 2" UBYTE SAB_STANDARD_S2_S3 1 100 0 255 DISPLAY_IDENTIFIER iv_DriveLogicStsS2.SportButtonIn._.ZFFSAB ECU_ADDRESS 0xFFF97882 /end MEASUREMENT
/begin MEASUREMENT ZFFSAB._.SportButtonIn.iv_DriveLogicStsS1 "Drive-Logic-Status from Source 1" UBYTE SAB_STANDARD_S2_S3 1 100 0 255 DISPLAY_IDENTIFIER iv_DriveLogicStsS1.SportButtonIn._.ZFFSAB ECU_ADDRESS 0xFFF97883 /end MEASUREMENT
/begin MEASUREMENT ZFFSAB._.SportButtonIn.iv_GWS_S_ButtonS2 "S-Button-Signal from Source 2" UBYTE SAB_STANDARD_S2_S3 1 100 0 255 DISPLAY_IDENTIFIER iv_GWS_S_ButtonS2.SportButtonIn._.ZFFSAB ECU_ADDRESS 0xFFF97884 /end MEASUREMENT
/begin MEASUREMENT ZFFSAB._.SportButtonIn.iv_GWS_S_ButtonS1 "S-Button-Signal from Source 1" UBYTE SAB_STANDARD_S2_S3 1 100 0 255 DISPLAY_IDENTIFIER iv_GWS_S_ButtonS1.SportButtonIn._.ZFFSAB ECU_ADDRESS 0xFFF97885 /end MEASUREMENT
/begin MEASUREMENT ZFFSAB._.SportButtonIn.iv_GWS_S_ButtonStsS2 "S-Button-Status from Source 2" UBYTE SAB_STANDARD_S2_S3 1 100 0 255 DISPLAY_IDENTIFIER iv_GWS_S_ButtonStsS2.SportButtonIn._.ZFFSAB ECU_ADDRESS 0xFFF97886 /end MEASUREMENT
/begin MEASUREMENT ZFFSAB._.SportButtonIn.iv_GWS_S_ButtonStsS1 "S-Button-Status from Source 1" UBYTE SAB_STANDARD_S2_S3 1 100 0 255 DISPLAY_IDENTIFIER iv_GWS_S_ButtonStsS1.SportButtonIn._.ZFFSAB ECU_ADDRESS 0xFFF97887 /end MEASUREMENT
/begin MEASUREMENT ZFFSAB._.SportButtonIn.iv_ICM_S_ButtonRaw "drive dynmics information from CAN" UWORD SAB_STANDARD_S2_S3 1 100 0 65535 DISPLAY_IDENTIFIER iv_ICM_S_ButtonRaw.SportButtonIn._.ZFFSAB ECU_ADDRESS 0xFFF97888 /end MEASUREMENT
/begin MEASUREMENT ZFFSAB._.SportButtonIn.iv_ICM_S_ButtonRawSts "state of iv_ICM_S_ButtonRaw" UBYTE SAB_STANDARD_S2_S3 1 100 0 255 DISPLAY_IDENTIFIER iv_ICM_S_ButtonRawSts.SportButtonIn._.ZFFSAB ECU_ADDRESS 0xFFF9788A /end MEASUREMENT
/begin MEASUREMENT ZFFSAB._.SportButtonIn.sv_DriveDynamics "information about Drive Dynamics" UWORD SAB_STANDARD_S2_S3 1 100 0 65535 DISPLAY_IDENTIFIER sv_DriveDynamics.SportButtonIn._.ZFFSAB ECU_ADDRESS 0xFFF9788C /end MEASUREMENT
/begin MEASUREMENT ZFFSAB._.SportButtonIn.sv_DriveDynamicsSts "State of sv_DriveDynamics" UBYTE SAB_STANDARD_S2_S3 1 100 0 1 DISPLAY_IDENTIFIER sv_DriveDynamicsSts.SportButtonIn._.ZFFSAB ECU_ADDRESS 0xFFF9788E /end MEASUREMENT
/begin MEASUREMENT ZFFSAB._.SportButtonIn.sv_DriveLogic "Sport-Wippen Information" UBYTE SAB_STANDARD_S2_S3 1 100 0 255 DISPLAY_IDENTIFIER sv_DriveLogic.SportButtonIn._.ZFFSAB ECU_ADDRESS 0xFFF9788F /end MEASUREMENT
/begin MEASUREMENT ZFFSAB._.SportButtonIn.sv_S_Button "sport-button information" UBYTE SAB_STANDARD_S2_S3 1 100 0 255 DISPLAY_IDENTIFIER sv_S_Button.SportButtonIn._.ZFFSAB ECU_ADDRESS 0xFFF97890 /end MEASUREMENT
/begin MEASUREMENT ZFFSAB._.SportButtonIn.sv_SWI_GWS_Dlg "returns applicable SWI_GWS_DriveLogic" UBYTE SAB_STANDARD_S2_S3 1 100 0 1 DISPLAY_IDENTIFIER sv_SWI_GWS_Dlg.SportButtonIn._.ZFFSAB ECU_ADDRESS 0xFFF97891 /end MEASUREMENT
/begin MEASUREMENT ZFFSAB._.SportButtonIn.sv_SWI_GWS_S_Btn "returns applicable SWI_GWS_S_Button" UBYTE SAB_STANDARD_S2_S3 1 100 0 1 DISPLAY_IDENTIFIER sv_SWI_GWS_S_Btn.SportButtonIn._.ZFFSAB ECU_ADDRESS 0xFFF97892 /end MEASUREMENT
/begin MEASUREMENT ZFFSAB._.TipTasterIn.Out[0].f_TipPlus "intermediate value for the manual upshift request mapped on to the outbox1 and outbox2." UBYTE SAB_STANDARD_S2_S3 1 100 0 2 DISPLAY_IDENTIFIER f_TipPlus.Out[0].TipTasterIn._.ZFFSAB ECU_ADDRESS 0xFFF978A2 /end MEASUREMENT
/begin MEASUREMENT ZFFSAB._.TipTasterIn.Out[0].f_TipMinus "intermediate value for the manual downshift request mapped on to the outbox1 and outbox2." UBYTE SAB_STANDARD_S2_S3 1 100 0 2 DISPLAY_IDENTIFIER f_TipMinus.Out[0].TipTasterIn._.ZFFSAB ECU_ADDRESS 0xFFF978A3 /end MEASUREMENT
/begin MEASUREMENT ZFFSAB._.TipTasterIn.Out[0].f_TipPlusErr "intermediate value mapped on to the outboxes. Error flag for manual upshift request" UBYTE SAB_STANDARD_S2_S3 1 100 0 1 DISPLAY_IDENTIFIER f_TipPlusErr.Out[0].TipTasterIn._.ZFFSAB ECU_ADDRESS 0xFFF978A4 /end MEASUREMENT
/begin MEASUREMENT ZFFSAB._.TipTasterIn.Out[0].f_TipMinusErr "intermediate value mapped on to the outboxes. Error flag for manual downshift request" UBYTE SAB_STANDARD_S2_S3 1 100 0 1 DISPLAY_IDENTIFIER f_TipMinusErr.Out[0].TipTasterIn._.ZFFSAB ECU_ADDRESS 0xFFF978A5 /end MEASUREMENT
/begin MEASUREMENT ZFFSAB._.TipTasterIn.Out[0].sv_f_TipPlusRaw "provided output value for the manual upshift request mapped on to the outbox1 and outbox2." UBYTE SAB_STANDARD_S2_S3 1 100 0 2 DISPLAY_IDENTIFIER sv_f_TipPlusRaw.Out[0].TipTasterIn._.ZFFSAB ECU_ADDRESS 0xFFF978A6 /end MEASUREMENT
/begin MEASUREMENT ZFFSAB._.TipTasterIn.Out[0].sv_f_TipMinusRaw "provided output value for the manual downshift request mapped on to the outbox1 and outbox2." UBYTE SAB_STANDARD_S2_S3 1 100 0 2 DISPLAY_IDENTIFIER sv_f_TipMinusRaw.Out[0].TipTasterIn._.ZFFSAB ECU_ADDRESS 0xFFF978A7 /end MEASUREMENT
/begin MEASUREMENT ZFFSAB._.TipTasterIn.Out[0].sv_f_TipPlusErr "provided output value mapped on to the outboxes. Error flag for manual upshift request" UBYTE SAB_STANDARD_S2_S3 1 100 0 1 DISPLAY_IDENTIFIER sv_f_TipPlusErr.Out[0].TipTasterIn._.ZFFSAB ECU_ADDRESS 0xFFF978A8 /end MEASUREMENT
/begin MEASUREMENT ZFFSAB._.TipTasterIn.Out[0].sv_f_TipMinusErr "provided output value mapped on to the outboxes. Error flag for manual downshift request" UBYTE SAB_STANDARD_S2_S3 1 100 0 1 DISPLAY_IDENTIFIER sv_f_TipMinusErr.Out[0].TipTasterIn._.ZFFSAB ECU_ADDRESS 0xFFF978A9 /end MEASUREMENT
/begin MEASUREMENT ZFFSAB._.TipTasterIn.Out[1].f_TipPlus "intermediate value for the manual upshift request mapped on to the outbox1 and outbox2." UBYTE SAB_STANDARD_S2_S3 1 100 0 2 DISPLAY_IDENTIFIER f_TipPlus.Out[1].TipTasterIn._.ZFFSAB ECU_ADDRESS 0xFFF978AA /end MEASUREMENT
/begin MEASUREMENT ZFFSAB._.TipTasterIn.Out[1].f_TipMinus "intermediate value for the manual downshift request mapped on to the outbox1 and outbox2." UBYTE SAB_STANDARD_S2_S3 1 100 0 2 DISPLAY_IDENTIFIER f_TipMinus.Out[1].TipTasterIn._.ZFFSAB ECU_ADDRESS 0xFFF978AB /end MEASUREMENT
/begin MEASUREMENT ZFFSAB._.TipTasterIn.Out[1].f_TipPlusErr "intermediate value mapped on to the outboxes. Error flag for manual upshift request" UBYTE SAB_STANDARD_S2_S3 1 100 0 1 DISPLAY_IDENTIFIER f_TipPlusErr.Out[1].TipTasterIn._.ZFFSAB ECU_ADDRESS 0xFFF978AC /end MEASUREMENT
/begin MEASUREMENT ZFFSAB._.TipTasterIn.Out[1].f_TipMinusErr "intermediate value mapped on to the outboxes. Error flag for manual downshift request" UBYTE SAB_STANDARD_S2_S3 1 100 0 1 DISPLAY_IDENTIFIER f_TipMinusErr.Out[1].TipTasterIn._.ZFFSAB ECU_ADDRESS 0xFFF978AD /end MEASUREMENT
/begin MEASUREMENT ZFFSAB._.TipTasterIn.Out[1].sv_f_TipPlusRaw "provided output value for the manual upshift request mapped on to the outbox1 and outbox2." UBYTE SAB_STANDARD_S2_S3 1 100 0 2 DISPLAY_IDENTIFIER sv_f_TipPlusRaw.Out[1].TipTasterIn._.ZFFSAB ECU_ADDRESS 0xFFF978AE /end MEASUREMENT
/begin MEASUREMENT ZFFSAB._.TipTasterIn.Out[1].sv_f_TipMinusRaw "provided output value for the manual downshift request mapped on to the outbox1 and outbox2." UBYTE SAB_STANDARD_S2_S3 1 100 0 2 DISPLAY_IDENTIFIER sv_f_TipMinusRaw.Out[1].TipTasterIn._.ZFFSAB ECU_ADDRESS 0xFFF978AF /end MEASUREMENT
/begin MEASUREMENT ZFFSAB._.TipTasterIn.Out[1].sv_f_TipPlusErr "provided output value mapped on to the outboxes. Error flag for manual upshift request" UBYTE SAB_STANDARD_S2_S3 1 100 0 1 DISPLAY_IDENTIFIER sv_f_TipPlusErr.Out[1].TipTasterIn._.ZFFSAB ECU_ADDRESS 0xFFF978B0 /end MEASUREMENT
/begin MEASUREMENT ZFFSAB._.TipTasterIn.Out[1].sv_f_TipMinusErr "provided output value mapped on to the outboxes. Error flag for manual downshift request" UBYTE SAB_STANDARD_S2_S3 1 100 0 1 DISPLAY_IDENTIFIER sv_f_TipMinusErr.Out[1].TipTasterIn._.ZFFSAB ECU_ADDRESS 0xFFF978B1 /end MEASUREMENT
/begin MEASUREMENT ZFFSAB._.TipTasterIn.CAN.iv_f_TipMinus "Input value for the manual downshift request" UBYTE SAB_STANDARD_S2_S3 1 100 0 3 DISPLAY_IDENTIFIER iv_f_TipMinus.CAN.TipTasterIn._.ZFFSAB ECU_ADDRESS 0xFFF978B2 /end MEASUREMENT
/begin MEASUREMENT ZFFSAB._.TipTasterIn.CAN.iv_f_TipPlus "Input value for the manual upshift request" UBYTE SAB_STANDARD_S2_S3 1 100 0 3 DISPLAY_IDENTIFIER iv_f_TipPlus.CAN.TipTasterIn._.ZFFSAB ECU_ADDRESS 0xFFF978B3 /end MEASUREMENT
/begin MEASUREMENT ZFFSAB._.TipTasterIn.CAN.iv_f_TipMinusSts "Input value for status of the manual downshift Request" UBYTE SAB_STANDARD_S2_S3 1 100 0 1 DISPLAY_IDENTIFIER iv_f_TipMinusSts.CAN.TipTasterIn._.ZFFSAB ECU_ADDRESS 0xFFF978B4 /end MEASUREMENT
/begin MEASUREMENT ZFFSAB._.TipTasterIn.CAN.iv_f_TipPlusSts "Input value for status of the manual upshift Request" UBYTE SAB_STANDARD_S2_S3 1 100 0 1 DISPLAY_IDENTIFIER iv_f_TipPlusSts.CAN.TipTasterIn._.ZFFSAB ECU_ADDRESS 0xFFF978B5 /end MEASUREMENT
/begin MEASUREMENT ZFFSAB._.TipTasterIn.CAN.iv_Tip "Binary encoded input value for the manual downshift and upshift request" UBYTE SAB_STANDARD_S2_S3 1 100 0 255 DISPLAY_IDENTIFIER iv_Tip.CAN.TipTasterIn._.ZFFSAB ECU_ADDRESS 0xFFF978B6 /end MEASUREMENT
/begin MEASUREMENT ZFFSAB._.TipTasterIn.CAN.iv_TipSts "Binary encoded Input value for status of the manual downshift and manual upshift request" UBYTE SAB_STANDARD_S2_S3 1 100 0 255 DISPLAY_IDENTIFIER iv_TipSts.CAN.TipTasterIn._.ZFFSAB ECU_ADDRESS 0xFFF978B7 /end MEASUREMENT
/begin MEASUREMENT ZFFSAB._.TipTasterIn.CAN.f_TipPlus "Output value for the manual upshift request" UBYTE SAB_STANDARD_S2_S3 1 100 0 2 DISPLAY_IDENTIFIER f_TipPlus.CAN.TipTasterIn._.ZFFSAB ECU_ADDRESS 0xFFF978B8 /end MEASUREMENT
/begin MEASUREMENT ZFFSAB._.TipTasterIn.CAN.f_TipMinus "Output value for the manual downshift request" UBYTE SAB_STANDARD_S2_S3 1 100 0 2 DISPLAY_IDENTIFIER f_TipMinus.CAN.TipTasterIn._.ZFFSAB ECU_ADDRESS 0xFFF978B9 /end MEASUREMENT
/begin MEASUREMENT ZFFSAB._.TipTasterIn.CAN.f_TipPlusErr "Output value mapped on to the outboxes. Error flag for manual upshift request of the selected source." UBYTE SAB_STANDARD_S2_S3 1 100 0 1 DISPLAY_IDENTIFIER f_TipPlusErr.CAN.TipTasterIn._.ZFFSAB ECU_ADDRESS 0xFFF978BA /end MEASUREMENT
/begin MEASUREMENT ZFFSAB._.TipTasterIn.CAN.f_TipMinusErr "Output value mapped on to the outboxes. Error flag for manual downshift request of the selected source." UBYTE SAB_STANDARD_S2_S3 1 100 0 1 DISPLAY_IDENTIFIER f_TipMinusErr.CAN.TipTasterIn._.ZFFSAB ECU_ADDRESS 0xFFF978BB /end MEASUREMENT
/begin MEASUREMENT ZFFSAB._.TipTasterIn.CAN.f_TipErr "Output value mapped on to the outboxes. Error flag for manual shift requests of the selected source." UBYTE SAB_STANDARD_S2_S3 1 100 0 1 DISPLAY_IDENTIFIER f_TipErr.CAN.TipTasterIn._.ZFFSAB ECU_ADDRESS 0xFFF978BC /end MEASUREMENT
/begin MEASUREMENT ZFFSAB._.TipTasterIn.SBW.iv_f_TipMinus "Input value for the manual downshift request" UBYTE SAB_STANDARD_S2_S3 1 100 0 3 DISPLAY_IDENTIFIER iv_f_TipMinus.SBW.TipTasterIn._.ZFFSAB ECU_ADDRESS 0xFFF978BD /end MEASUREMENT
/begin MEASUREMENT ZFFSAB._.TipTasterIn.SBW.iv_f_TipPlus "Input value for the manual upshift request" UBYTE SAB_STANDARD_S2_S3 1 100 0 3 DISPLAY_IDENTIFIER iv_f_TipPlus.SBW.TipTasterIn._.ZFFSAB ECU_ADDRESS 0xFFF978BE /end MEASUREMENT
/begin MEASUREMENT ZFFSAB._.TipTasterIn.SBW.iv_f_TipMinusSts "Input value for status of the manual downshift Request" UBYTE SAB_STANDARD_S2_S3 1 100 0 1 DISPLAY_IDENTIFIER iv_f_TipMinusSts.SBW.TipTasterIn._.ZFFSAB ECU_ADDRESS 0xFFF978BF /end MEASUREMENT
/begin MEASUREMENT ZFFSAB._.TipTasterIn.SBW.iv_f_TipPlusSts "Input value for status of the manual upshift Request" UBYTE SAB_STANDARD_S2_S3 1 100 0 1 DISPLAY_IDENTIFIER iv_f_TipPlusSts.SBW.TipTasterIn._.ZFFSAB ECU_ADDRESS 0xFFF978C0 /end MEASUREMENT
/begin MEASUREMENT ZFFSAB._.TipTasterIn.SBW.iv_Tip "Binary encoded input value for the manual downshift and upshift request" UBYTE SAB_STANDARD_S2_S3 1 100 0 255 DISPLAY_IDENTIFIER iv_Tip.SBW.TipTasterIn._.ZFFSAB ECU_ADDRESS 0xFFF978C1 /end MEASUREMENT
/begin MEASUREMENT ZFFSAB._.TipTasterIn.SBW.iv_TipSts "Binary encoded Input value for status of the manual downshift and manual upshift request" UBYTE SAB_STANDARD_S2_S3 1 100 0 255 DISPLAY_IDENTIFIER iv_TipSts.SBW.TipTasterIn._.ZFFSAB ECU_ADDRESS 0xFFF978C2 /end MEASUREMENT
/begin MEASUREMENT ZFFSAB._.TipTasterIn.SBW.f_TipPlus "Output value for the manual upshift request" UBYTE SAB_STANDARD_S2_S3 1 100 0 2 DISPLAY_IDENTIFIER f_TipPlus.SBW.TipTasterIn._.ZFFSAB ECU_ADDRESS 0xFFF978C3 /end MEASUREMENT
/begin MEASUREMENT ZFFSAB._.TipTasterIn.SBW.f_TipMinus "Output value for the manual downshift request" UBYTE SAB_STANDARD_S2_S3 1 100 0 2 DISPLAY_IDENTIFIER f_TipMinus.SBW.TipTasterIn._.ZFFSAB ECU_ADDRESS 0xFFF978C4 /end MEASUREMENT
/begin MEASUREMENT ZFFSAB._.TipTasterIn.SBW.f_TipPlusErr "Output value mapped on to the outboxes. Error flag for manual upshift request of the selected source." UBYTE SAB_STANDARD_S2_S3 1 100 0 1 DISPLAY_IDENTIFIER f_TipPlusErr.SBW.TipTasterIn._.ZFFSAB ECU_ADDRESS 0xFFF978C5 /end MEASUREMENT
/begin MEASUREMENT ZFFSAB._.TipTasterIn.SBW.f_TipMinusErr "Output value mapped on to the outboxes. Error flag for manual downshift request of the selected source." UBYTE SAB_STANDARD_S2_S3 1 100 0 1 DISPLAY_IDENTIFIER f_TipMinusErr.SBW.TipTasterIn._.ZFFSAB ECU_ADDRESS 0xFFF978C6 /end MEASUREMENT
/begin MEASUREMENT ZFFSAB._.TipTasterIn.SBW.f_TipErr "Output value mapped on to the outboxes. Error flag for manual shift requests of the selected source." UBYTE SAB_STANDARD_S2_S3 1 100 0 1 DISPLAY_IDENTIFIER f_TipErr.SBW.TipTasterIn._.ZFFSAB ECU_ADDRESS 0xFFF978C7 /end MEASUREMENT
/begin MEASUREMENT ZFFSAB._.TipTasterIn.Analog.iv_f_TipMinus "Input value for the manual downshift request" UBYTE SAB_STANDARD_S2_S3 1 100 0 3 DISPLAY_IDENTIFIER iv_f_TipMinus.Analog.TipTasterIn._.ZFFSAB ECU_ADDRESS 0xFFF978C8 /end MEASUREMENT
/begin MEASUREMENT ZFFSAB._.TipTasterIn.Analog.iv_f_TipPlus "Input value for the manual upshift request" UBYTE SAB_STANDARD_S2_S3 1 100 0 3 DISPLAY_IDENTIFIER iv_f_TipPlus.Analog.TipTasterIn._.ZFFSAB ECU_ADDRESS 0xFFF978C9 /end MEASUREMENT
/begin MEASUREMENT ZFFSAB._.TipTasterIn.Analog.iv_f_TipMinusSts "Input value for status of the manual downshift Request" UBYTE SAB_STANDARD_S2_S3 1 100 0 1 DISPLAY_IDENTIFIER iv_f_TipMinusSts.Analog.TipTasterIn._.ZFFSAB ECU_ADDRESS 0xFFF978CA /end MEASUREMENT
/begin MEASUREMENT ZFFSAB._.TipTasterIn.Analog.iv_f_TipPlusSts "Input value for status of the manual upshift Request" UBYTE SAB_STANDARD_S2_S3 1 100 0 1 DISPLAY_IDENTIFIER iv_f_TipPlusSts.Analog.TipTasterIn._.ZFFSAB ECU_ADDRESS 0xFFF978CB /end MEASUREMENT
/begin MEASUREMENT ZFFSAB._.TipTasterIn.Analog.iv_Tip "Binary encoded input value for the manual downshift and upshift request" UBYTE SAB_STANDARD_S2_S3 1 100 0 255 DISPLAY_IDENTIFIER iv_Tip.Analog.TipTasterIn._.ZFFSAB ECU_ADDRESS 0xFFF978CC /end MEASUREMENT
/begin MEASUREMENT ZFFSAB._.TipTasterIn.Analog.iv_TipSts "Binary encoded Input value for status of the manual downshift and manual upshift request" UBYTE SAB_STANDARD_S2_S3 1 100 0 255 DISPLAY_IDENTIFIER iv_TipSts.Analog.TipTasterIn._.ZFFSAB ECU_ADDRESS 0xFFF978CD /end MEASUREMENT
/begin MEASUREMENT ZFFSAB._.TipTasterIn.Analog.f_TipPlus "Output value for the manual upshift request" UBYTE SAB_STANDARD_S2_S3 1 100 0 2 DISPLAY_IDENTIFIER f_TipPlus.Analog.TipTasterIn._.ZFFSAB ECU_ADDRESS 0xFFF978CE /end MEASUREMENT
/begin MEASUREMENT ZFFSAB._.TipTasterIn.Analog.f_TipMinus "Output value for the manual downshift request" UBYTE SAB_STANDARD_S2_S3 1 100 0 2 DISPLAY_IDENTIFIER f_TipMinus.Analog.TipTasterIn._.ZFFSAB ECU_ADDRESS 0xFFF978CF /end MEASUREMENT
/begin MEASUREMENT ZFFSAB._.TipTasterIn.Analog.f_TipPlusErr "Output value mapped on to the outboxes. Error flag for manual upshift request of the selected source." UBYTE SAB_STANDARD_S2_S3 1 100 0 1 DISPLAY_IDENTIFIER f_TipPlusErr.Analog.TipTasterIn._.ZFFSAB ECU_ADDRESS 0xFFF978D0 /end MEASUREMENT
/begin MEASUREMENT ZFFSAB._.TipTasterIn.Analog.f_TipMinusErr "Output value mapped on to the outboxes. Error flag for manual downshift request of the selected source." UBYTE SAB_STANDARD_S2_S3 1 100 0 1 DISPLAY_IDENTIFIER f_TipMinusErr.Analog.TipTasterIn._.ZFFSAB ECU_ADDRESS 0xFFF978D1 /end MEASUREMENT
/begin MEASUREMENT ZFFSAB._.TipTasterIn.Analog.f_TipErr "Output value mapped on to the outboxes. Error flag for manual shift requests of the selected source." UBYTE SAB_STANDARD_S2_S3 1 100 0 1 DISPLAY_IDENTIFIER f_TipErr.Analog.TipTasterIn._.ZFFSAB ECU_ADDRESS 0xFFF978D2 /end MEASUREMENT
/begin MEASUREMENT ZFFSAB._.TipTasterIn.iv_u_Batt_Diag "Filtered battery voltage used for test conditions" UWORD SAB_U_VOLT1000_S2_S3 1 100 0 65.535 DISPLAY_IDENTIFIER iv_u_Batt_Diag.TipTasterIn._.ZFFSAB ECU_ADDRESS 0xFFF9789C /end MEASUREMENT
/begin MEASUREMENT ZFFSAB._.TipTasterIn.sv_f_Tip1PlusRaw "provided output value for the manual upshift request" UBYTE SAB_STANDARD_S2_S3 1 100 0 1 DISPLAY_IDENTIFIER sv_f_Tip1PlusRaw.TipTasterIn._.ZFFSAB ECU_ADDRESS 0xFFF9789E /end MEASUREMENT
/begin MEASUREMENT ZFFSAB._.TipTasterIn.sv_f_Tip1MinusRaw "provided output value for the manual downshift request" UBYTE SAB_STANDARD_S2_S3 1 100 0 1 DISPLAY_IDENTIFIER sv_f_Tip1MinusRaw.TipTasterIn._.ZFFSAB ECU_ADDRESS 0xFFF9789F /end MEASUREMENT
/begin MEASUREMENT ZFFSAB._.TipTasterIn.sv_f_Tip2PlusRaw "provided output value for the manual upshift request" UBYTE SAB_STANDARD_S2_S3 1 100 0 1 DISPLAY_IDENTIFIER sv_f_Tip2PlusRaw.TipTasterIn._.ZFFSAB ECU_ADDRESS 0xFFF978A0 /end MEASUREMENT
/begin MEASUREMENT ZFFSAB._.TipTasterIn.sv_f_Tip2MinusRaw "provided output value for the manual downshift request" UBYTE SAB_STANDARD_S2_S3 1 100 0 1 DISPLAY_IDENTIFIER sv_f_Tip2MinusRaw.TipTasterIn._.ZFFSAB ECU_ADDRESS 0xFFF978A1 /end MEASUREMENT
/begin MEASUREMENT ZFFSAB._.CAN_Handling.CANMsg[0].Status "CAN Message status" UBYTE SAB_STANDARD_S2_S3 1 100 0 255 DISPLAY_IDENTIFIER Status.CANMsg[0].CAN_Handling._.ZFFSAB ECU_ADDRESS 0xFFF978DC /end MEASUREMENT
/begin MEASUREMENT ZFFSAB._.CAN_Handling.CANMsg[1].Status "CAN Message status" UBYTE SAB_STANDARD_S2_S3 1 100 0 255 DISPLAY_IDENTIFIER Status.CANMsg[1].CAN_Handling._.ZFFSAB ECU_ADDRESS 0xFFF978DD /end MEASUREMENT
/begin MEASUREMENT ZFFSAB._.CAN_Handling.CANMsg[2].Status "CAN Message status" UBYTE SAB_STANDARD_S2_S3 1 100 0 255 DISPLAY_IDENTIFIER Status.CANMsg[2].CAN_Handling._.ZFFSAB ECU_ADDRESS 0xFFF978DE /end MEASUREMENT
/begin MEASUREMENT ZFFSAB._.CAN_Handling.CANMsg[3].Status "CAN Message status" UBYTE SAB_STANDARD_S2_S3 1 100 0 255 DISPLAY_IDENTIFIER Status.CANMsg[3].CAN_Handling._.ZFFSAB ECU_ADDRESS 0xFFF978DF /end MEASUREMENT
/begin MEASUREMENT ZFFSAB._.CAN_Handling.CANMsg[4].Status "CAN Message status" UBYTE SAB_STANDARD_S2_S3 1 100 0 255 DISPLAY_IDENTIFIER Status.CANMsg[4].CAN_Handling._.ZFFSAB ECU_ADDRESS 0xFFF978E0 /end MEASUREMENT
/begin MEASUREMENT ZFFSAB._.CAN_Handling.CANMsg[5].Status "CAN Message status" UBYTE SAB_STANDARD_S2_S3 1 100 0 255 DISPLAY_IDENTIFIER Status.CANMsg[5].CAN_Handling._.ZFFSAB ECU_ADDRESS 0xFFF978E1 /end MEASUREMENT
/begin MEASUREMENT ZFFSAB._.CAN_Handling.CANMsg[6].Status "CAN Message status" UBYTE SAB_STANDARD_S2_S3 1 100 0 255 DISPLAY_IDENTIFIER Status.CANMsg[6].CAN_Handling._.ZFFSAB ECU_ADDRESS 0xFFF978E2 /end MEASUREMENT
/begin MEASUREMENT ZFFSAB._.CAN_Handling.CANMsg[7].Status "CAN Message status" UBYTE SAB_STANDARD_S2_S3 1 100 0 255 DISPLAY_IDENTIFIER Status.CANMsg[7].CAN_Handling._.ZFFSAB ECU_ADDRESS 0xFFF978E3 /end MEASUREMENT
/begin MEASUREMENT ZFFSAB._.CAN_Handling.CANMsg[8].Status "CAN Message status" UBYTE SAB_STANDARD_S2_S3 1 100 0 255 DISPLAY_IDENTIFIER Status.CANMsg[8].CAN_Handling._.ZFFSAB ECU_ADDRESS 0xFFF978E4 /end MEASUREMENT
/begin MEASUREMENT ZFFSAB._.CAN_Handling.CANMsg[9].Status "CAN Message status" UBYTE SAB_STANDARD_S2_S3 1 100 0 255 DISPLAY_IDENTIFIER Status.CANMsg[9].CAN_Handling._.ZFFSAB ECU_ADDRESS 0xFFF978E5 /end MEASUREMENT
/begin MEASUREMENT ZFFSAB._.CAN_Handling.CANMsg[10].Status "CAN Message status" UBYTE SAB_STANDARD_S2_S3 1 100 0 255 DISPLAY_IDENTIFIER Status.CANMsg[10].CAN_Handling._.ZFFSAB ECU_ADDRESS 0xFFF978E6 /end MEASUREMENT
/begin MEASUREMENT ZFFSAB._.CAN_Handling.CANMsg[11].Status "CAN Message status" UBYTE SAB_STANDARD_S2_S3 1 100 0 255 DISPLAY_IDENTIFIER Status.CANMsg[11].CAN_Handling._.ZFFSAB ECU_ADDRESS 0xFFF978E7 /end MEASUREMENT
/begin MEASUREMENT ZFFSAB._.CAN_Handling.CANMsg[12].Status "CAN Message status" UBYTE SAB_STANDARD_S2_S3 1 100 0 255 DISPLAY_IDENTIFIER Status.CANMsg[12].CAN_Handling._.ZFFSAB ECU_ADDRESS 0xFFF978E8 /end MEASUREMENT
/begin MEASUREMENT ZFFSAB._.CAN_Handling.CANMsg[13].Status "CAN Message status" UBYTE SAB_STANDARD_S2_S3 1 100 0 255 DISPLAY_IDENTIFIER Status.CANMsg[13].CAN_Handling._.ZFFSAB ECU_ADDRESS 0xFFF978E9 /end MEASUREMENT
/begin MEASUREMENT ZFFSAB._.CAN_Handling.CANMsg[14].Status "CAN Message status" UBYTE SAB_STANDARD_S2_S3 1 100 0 255 DISPLAY_IDENTIFIER Status.CANMsg[14].CAN_Handling._.ZFFSAB ECU_ADDRESS 0xFFF978EA /end MEASUREMENT
/begin MEASUREMENT ZFFSAB._.CAN_Handling.CANMsg[15].Status "CAN Message status" UBYTE SAB_STANDARD_S2_S3 1 100 0 255 DISPLAY_IDENTIFIER Status.CANMsg[15].CAN_Handling._.ZFFSAB ECU_ADDRESS 0xFFF978EB /end MEASUREMENT
/begin MEASUREMENT ZFFSAB._.CAN_Handling.CANMsg[16].Status "CAN Message status" UBYTE SAB_STANDARD_S2_S3 1 100 0 255 DISPLAY_IDENTIFIER Status.CANMsg[16].CAN_Handling._.ZFFSAB ECU_ADDRESS 0xFFF978EC /end MEASUREMENT
/begin MEASUREMENT ZFFSAB._.CAN_Handling.CANMsg[17].Status "CAN Message status" UBYTE SAB_STANDARD_S2_S3 1 100 0 255 DISPLAY_IDENTIFIER Status.CANMsg[17].CAN_Handling._.ZFFSAB ECU_ADDRESS 0xFFF978ED /end MEASUREMENT
/begin MEASUREMENT ZFFSAB._.CAN_Handling.CANMsg[18].Status "CAN Message status" UBYTE SAB_STANDARD_S2_S3 1 100 0 255 DISPLAY_IDENTIFIER Status.CANMsg[18].CAN_Handling._.ZFFSAB ECU_ADDRESS 0xFFF978EE /end MEASUREMENT
/begin MEASUREMENT ZFFSAB._.CAN_Handling.CANMsg[19].Status "CAN Message status" UBYTE SAB_STANDARD_S2_S3 1 100 0 255 DISPLAY_IDENTIFIER Status.CANMsg[19].CAN_Handling._.ZFFSAB ECU_ADDRESS 0xFFF978EF /end MEASUREMENT
/begin MEASUREMENT ZFFSAB._.CAN_Handling.CANMsg[20].Status "CAN Message status" UBYTE SAB_STANDARD_S2_S3 1 100 0 255 DISPLAY_IDENTIFIER Status.CANMsg[20].CAN_Handling._.ZFFSAB ECU_ADDRESS 0xFFF978F0 /end MEASUREMENT
/begin MEASUREMENT ZFFSAB._.CAN_Handling.CANMsg[21].Status "CAN Message status" UBYTE SAB_STANDARD_S2_S3 1 100 0 255 DISPLAY_IDENTIFIER Status.CANMsg[21].CAN_Handling._.ZFFSAB ECU_ADDRESS 0xFFF978F1 /end MEASUREMENT
/begin MEASUREMENT ZFFSAB._.CAN_Handling.CANMsg[22].Status "CAN Message status" UBYTE SAB_STANDARD_S2_S3 1 100 0 255 DISPLAY_IDENTIFIER Status.CANMsg[22].CAN_Handling._.ZFFSAB ECU_ADDRESS 0xFFF978F2 /end MEASUREMENT
/begin MEASUREMENT ZFFSAB._.CAN_Handling.CANMsg[23].Status "CAN Message status" UBYTE SAB_STANDARD_S2_S3 1 100 0 255 DISPLAY_IDENTIFIER Status.CANMsg[23].CAN_Handling._.ZFFSAB ECU_ADDRESS 0xFFF978F3 /end MEASUREMENT
/begin MEASUREMENT ZFFSAB._.CAN_Handling.CANMsg[24].Status "CAN Message status" UBYTE SAB_STANDARD_S2_S3 1 100 0 255 DISPLAY_IDENTIFIER Status.CANMsg[24].CAN_Handling._.ZFFSAB ECU_ADDRESS 0xFFF978F4 /end MEASUREMENT
/begin MEASUREMENT ZFFSAB._.CAN_Handling.CANMsg[25].Status "CAN Message status" UBYTE SAB_STANDARD_S2_S3 1 100 0 255 DISPLAY_IDENTIFIER Status.CANMsg[25].CAN_Handling._.ZFFSAB ECU_ADDRESS 0xFFF978F5 /end MEASUREMENT
/begin MEASUREMENT ZFFSAB._.CAN_Handling.CANMsg[26].Status "CAN Message status" UBYTE SAB_STANDARD_S2_S3 1 100 0 255 DISPLAY_IDENTIFIER Status.CANMsg[26].CAN_Handling._.ZFFSAB ECU_ADDRESS 0xFFF978F6 /end MEASUREMENT
/begin MEASUREMENT ZFFSAB._.CAN_Handling.CANMsg[27].Status "CAN Message status" UBYTE SAB_STANDARD_S2_S3 1 100 0 255 DISPLAY_IDENTIFIER Status.CANMsg[27].CAN_Handling._.ZFFSAB ECU_ADDRESS 0xFFF978F7 /end MEASUREMENT
/begin MEASUREMENT ZFFSAB._.CAN_Handling.CANMsg[28].Status "CAN Message status" UBYTE SAB_STANDARD_S2_S3 1 100 0 255 DISPLAY_IDENTIFIER Status.CANMsg[28].CAN_Handling._.ZFFSAB ECU_ADDRESS 0xFFF978F8 /end MEASUREMENT
/begin MEASUREMENT ZFFSAB._.CAN_Handling.CANMsg[29].Status "CAN Message status" UBYTE SAB_STANDARD_S2_S3 1 100 0 255 DISPLAY_IDENTIFIER Status.CANMsg[29].CAN_Handling._.ZFFSAB ECU_ADDRESS 0xFFF978F9 /end MEASUREMENT
/begin MEASUREMENT ZFFSAB._.CAN_Handling.CANMsg[30].Status "CAN Message status" UBYTE SAB_STANDARD_S2_S3 1 100 0 255 DISPLAY_IDENTIFIER Status.CANMsg[30].CAN_Handling._.ZFFSAB ECU_ADDRESS 0xFFF978FA /end MEASUREMENT
/begin MEASUREMENT ZFFSAB._.CAN_Handling.CANMsg[31].Status "CAN Message status" UBYTE SAB_STANDARD_S2_S3 1 100 0 255 DISPLAY_IDENTIFIER Status.CANMsg[31].CAN_Handling._.ZFFSAB ECU_ADDRESS 0xFFF978FB /end MEASUREMENT
/begin MEASUREMENT ZFFSAB._.CAN_Handling.CANMsg[32].Status "CAN Message status" UBYTE SAB_STANDARD_S2_S3 1 100 0 255 DISPLAY_IDENTIFIER Status.CANMsg[32].CAN_Handling._.ZFFSAB ECU_ADDRESS 0xFFF978FC /end MEASUREMENT
/begin MEASUREMENT ZFFSAB._.CAN_Handling.CANMsg[33].Status "CAN Message status" UBYTE SAB_STANDARD_S2_S3 1 100 0 255 DISPLAY_IDENTIFIER Status.CANMsg[33].CAN_Handling._.ZFFSAB ECU_ADDRESS 0xFFF978FD /end MEASUREMENT
/begin MEASUREMENT ZFFSAB._.CAN_Handling.CANMsg[34].Status "CAN Message status" UBYTE SAB_STANDARD_S2_S3 1 100 0 255 DISPLAY_IDENTIFIER Status.CANMsg[34].CAN_Handling._.ZFFSAB ECU_ADDRESS 0xFFF978FE /end MEASUREMENT
/begin MEASUREMENT ZFFSAB._.CAN_Handling.CANMsg[35].Status "CAN Message status" UBYTE SAB_STANDARD_S2_S3 1 100 0 255 DISPLAY_IDENTIFIER Status.CANMsg[35].CAN_Handling._.ZFFSAB ECU_ADDRESS 0xFFF978FF /end MEASUREMENT
/begin MEASUREMENT ZFFSAB._.CAN_Handling.CANMsg[36].Status "CAN Message status" UBYTE SAB_STANDARD_S2_S3 1 100 0 255 DISPLAY_IDENTIFIER Status.CANMsg[36].CAN_Handling._.ZFFSAB ECU_ADDRESS 0xFFF97900 /end MEASUREMENT
/begin MEASUREMENT ZFFSAB._.CAN_Handling.CANMsg[37].Status "CAN Message status" UBYTE SAB_STANDARD_S2_S3 1 100 0 255 DISPLAY_IDENTIFIER Status.CANMsg[37].CAN_Handling._.ZFFSAB ECU_ADDRESS 0xFFF97901 /end MEASUREMENT
/begin MEASUREMENT ZFFSAB._.CAN_Handling.CANMsg[38].Status "CAN Message status" UBYTE SAB_STANDARD_S2_S3 1 100 0 255 DISPLAY_IDENTIFIER Status.CANMsg[38].CAN_Handling._.ZFFSAB ECU_ADDRESS 0xFFF97902 /end MEASUREMENT
/begin MEASUREMENT ZFFSAB._.CAN_Handling.CANMsg[39].Status "CAN Message status" UBYTE SAB_STANDARD_S2_S3 1 100 0 255 DISPLAY_IDENTIFIER Status.CANMsg[39].CAN_Handling._.ZFFSAB ECU_ADDRESS 0xFFF97903 /end MEASUREMENT
/begin MEASUREMENT ZFFSAB._.CAN_Handling.CANMsg[40].Status "CAN Message status" UBYTE SAB_STANDARD_S2_S3 1 100 0 255 DISPLAY_IDENTIFIER Status.CANMsg[40].CAN_Handling._.ZFFSAB ECU_ADDRESS 0xFFF97904 /end MEASUREMENT
/begin MEASUREMENT ZFFSAB._.CAN_Handling.CANMsg[41].Status "CAN Message status" UBYTE SAB_STANDARD_S2_S3 1 100 0 255 DISPLAY_IDENTIFIER Status.CANMsg[41].CAN_Handling._.ZFFSAB ECU_ADDRESS 0xFFF97905 /end MEASUREMENT
/begin MEASUREMENT ZFFSAB._.CAN_Handling.CANMsg[42].Status "CAN Message status" UBYTE SAB_STANDARD_S2_S3 1 100 0 255 DISPLAY_IDENTIFIER Status.CANMsg[42].CAN_Handling._.ZFFSAB ECU_ADDRESS 0xFFF97906 /end MEASUREMENT
/begin MEASUREMENT ZFFSAB._.CAN_Handling.CANMsg[43].Status "CAN Message status" UBYTE SAB_STANDARD_S2_S3 1 100 0 255 DISPLAY_IDENTIFIER Status.CANMsg[43].CAN_Handling._.ZFFSAB ECU_ADDRESS 0xFFF97907 /end MEASUREMENT
/begin MEASUREMENT ZFFSAB._.CAN_Handling.CANMsg[44].Status "CAN Message status" UBYTE SAB_STANDARD_S2_S3 1 100 0 255 DISPLAY_IDENTIFIER Status.CANMsg[44].CAN_Handling._.ZFFSAB ECU_ADDRESS 0xFFF97908 /end MEASUREMENT
/begin MEASUREMENT ZFFSAB._.CAN_Handling.CANMsg[45].Status "CAN Message status" UBYTE SAB_STANDARD_S2_S3 1 100 0 255 DISPLAY_IDENTIFIER Status.CANMsg[45].CAN_Handling._.ZFFSAB ECU_ADDRESS 0xFFF97909 /end MEASUREMENT
/begin MEASUREMENT ZFFSAB._.CAN_Handling.CANMsg[46].Status "CAN Message status" UBYTE SAB_STANDARD_S2_S3 1 100 0 255 DISPLAY_IDENTIFIER Status.CANMsg[46].CAN_Handling._.ZFFSAB ECU_ADDRESS 0xFFF9790A /end MEASUREMENT
/begin MEASUREMENT ZFFSAB._.CAN_Handling.CANMsg[47].Status "CAN Message status" UBYTE SAB_STANDARD_S2_S3 1 100 0 255 DISPLAY_IDENTIFIER Status.CANMsg[47].CAN_Handling._.ZFFSAB ECU_ADDRESS 0xFFF9790B /end MEASUREMENT
/begin MEASUREMENT ZFFSAB._.CAN_Handling.CANMsg[48].Status "CAN Message status" UBYTE SAB_STANDARD_S2_S3 1 100 0 255 DISPLAY_IDENTIFIER Status.CANMsg[48].CAN_Handling._.ZFFSAB ECU_ADDRESS 0xFFF9790C /end MEASUREMENT
/begin MEASUREMENT ZFFSAB._.CAN_Handling.CANMsg[49].Status "CAN Message status" UBYTE SAB_STANDARD_S2_S3 1 100 0 255 DISPLAY_IDENTIFIER Status.CANMsg[49].CAN_Handling._.ZFFSAB ECU_ADDRESS 0xFFF9790D /end MEASUREMENT
/begin MEASUREMENT ZFFSAB._.CAN_Handling.iv_Busruhe "State of CAN Bus(0 = Bus active;1 = Bus not active because of flashing active)" UBYTE SAB_STANDARD_S2_S3 1 100 0 1 DISPLAY_IDENTIFIER iv_Busruhe.CAN_Handling._.ZFFSAB ECU_ADDRESS 0xFFF9791C /end MEASUREMENT
/begin MEASUREMENT ZFFSAB._.CAN_Handling.iv_u_BattFilt "Filtered battery voltage used for test conditions" UWORD SAB_U_1VOLT1000_S2_S3 1 100 0 65.535 DISPLAY_IDENTIFIER iv_u_BattFilt.CAN_Handling._.ZFFSAB ECU_ADDRESS 0xFFF9791E /end MEASUREMENT
/begin MEASUREMENT ZFFSAB._.CAN_Handling.f_AfterRunning "the system is in after running (Nachlauf)" UBYTE SAB_STANDARD_S2_S3 1 100 0 1 DISPLAY_IDENTIFIER f_AfterRunning.CAN_Handling._.ZFFSAB ECU_ADDRESS 0xFFF97920 /end MEASUREMENT
/begin MEASUREMENT ZFFSAB._.CAN_Handling.sts_Can1BusDisturbance "State of monitored disturbances of CAN Bus from local errorhandling" UBYTE SAB_STANDARD_S2_S3 1 100 0 1 DISPLAY_IDENTIFIER sts_Can1BusDisturbance.CAN_Handling._.ZFFSAB ECU_ADDRESS 0xFFF97921 /end MEASUREMENT
/begin MEASUREMENT ZFFSAB._.CAN_Handling.iv_st_Can1BusErr "State of CAN Bus from CAN-Controller(0=ok;1=BusOff;2=Error Active;4=Error Passive;128=channel not ok)" UBYTE SAB_STANDARD_S2_S3 1 100 0 255 DISPLAY_IDENTIFIER iv_st_Can1BusErr.CAN_Handling._.ZFFSAB ECU_ADDRESS 0xFFF97922 /end MEASUREMENT
/begin MEASUREMENT ZFFSAB._.CAN_Handling.f_AllTo "flag for Timeout (1 = all monitored signals in Timeout 0 = not all in Timeout)" UBYTE SAB_STANDARD_S2_S3 1 100 0 1 DISPLAY_IDENTIFIER f_AllTo.CAN_Handling._.ZFFSAB ECU_ADDRESS 0xFFF97923 /end MEASUREMENT
/begin MEASUREMENT ZFFSAB._.CAN_Handling.iv_st_Can2BusErr "State of A-CANBus from CAN-Controller (0=ok;1=BusOff;2=Error Active;4=Error Passive;128=channel not ok)" UBYTE SAB_STANDARD_S2_S3 1 100 0 255 DISPLAY_IDENTIFIER iv_st_Can2BusErr.CAN_Handling._.ZFFSAB ECU_ADDRESS 0xFFF97924 /end MEASUREMENT
/begin MEASUREMENT ZFFSAB._.CAN_Handling.sts_Can2BusDisturbance "State of monitored disturbances of A-CAN Bus from local errorhandling" UBYTE SAB_STANDARD_S2_S3 1 100 0 1 DISPLAY_IDENTIFIER sts_Can2BusDisturbance.CAN_Handling._.ZFFSAB ECU_ADDRESS 0xFFF97925 /end MEASUREMENT
/begin MEASUREMENT ZFFSAB._.CAN_Handling.f_FaultStatKFC_CANB1 "value = 1 if KFC_CANB1 is entered or in forward filtering" UBYTE SAB_STANDARD_S2_S3 1 100 0 1 DISPLAY_IDENTIFIER f_FaultStatKFC_CANB1.CAN_Handling._.ZFFSAB ECU_ADDRESS 0xFFF97926 /end MEASUREMENT
/begin MEASUREMENT ZFFSAB._.CAN_Handling.f_FaultStatKFC_CANB2 "value = 1 if KFC_CANB2 is entered or in forward filtering" UBYTE SAB_STANDARD_S2_S3 1 100 0 1 DISPLAY_IDENTIFIER f_FaultStatKFC_CANB2.CAN_Handling._.ZFFSAB ECU_ADDRESS 0xFFF97927 /end MEASUREMENT
/begin MEASUREMENT ZFFSAB._.CAN_Handling.f_AllTo1 "flag for Timeout (1 = all monitored signals A-CAN in Timeout 0 = not all in Timeout)" UBYTE SAB_STANDARD_S2_S3 1 100 0 1 DISPLAY_IDENTIFIER f_AllTo1.CAN_Handling._.ZFFSAB ECU_ADDRESS 0xFFF97928 /end MEASUREMENT
/begin MEASUREMENT ZFFSAB._.CAN_Handling.f_AllTo2 "flag for Timeout (1 = all monitored signals FA-CAN in Timeout 0 = not all in Timeout)" UBYTE SAB_STANDARD_S2_S3 1 100 0 1 DISPLAY_IDENTIFIER f_AllTo2.CAN_Handling._.ZFFSAB ECU_ADDRESS 0xFFF97929 /end MEASUREMENT
/begin MEASUREMENT ZFFSAB._.CAN_Handling.st_ACANMsgBitmask1 "bit is set if the corrisponding message is on the A CAN" ULONG SAB_STANDARD_S2_S3 1 100 0 4294967295 DISPLAY_IDENTIFIER st_ACANMsgBitmask1.CAN_Handling._.ZFFSAB ECU_ADDRESS 0xFFF9792C /end MEASUREMENT
/begin MEASUREMENT ZFFSAB._.CAN_Handling.st_ACANMsgBitmask2 "bit is set if the corrisponding message is on the A CAN" ULONG SAB_STANDARD_S2_S3 1 100 0 4294967295 DISPLAY_IDENTIFIER st_ACANMsgBitmask2.CAN_Handling._.ZFFSAB ECU_ADDRESS 0xFFF97930 /end MEASUREMENT
/begin MEASUREMENT ZFFSAB._.CAN_Handling.st_ConfigBitmaskCANMsg1 "every CAN message that is monitored (bit x = index of CAN message array)" ULONG SAB_STANDARD_S2_S3 1 100 0 4294967295 DISPLAY_IDENTIFIER st_ConfigBitmaskCANMsg1.CAN_Handling._.ZFFSAB ECU_ADDRESS 0xFFF97934 /end MEASUREMENT
/begin MEASUREMENT ZFFSAB._.CAN_Handling.st_ConfigBitmaskCANMsg2 "every CAN message that is monitored (bit x = index of CAN message array)" ULONG SAB_STANDARD_S2_S3 1 100 0 4294967295 DISPLAY_IDENTIFIER st_ConfigBitmaskCANMsg2.CAN_Handling._.ZFFSAB ECU_ADDRESS 0xFFF97938 /end MEASUREMENT
/begin MEASUREMENT ZFFSAB._.CAN_Handling.st_CANControlConfigBitmask1 "every CAN message that is monitored or learned (Bit x = 1)" ULONG SAB_STANDARD_S2_S3 1 100 0 4294967295 DISPLAY_IDENTIFIER st_CANControlConfigBitmask1.CAN_Handling._.ZFFSAB ECU_ADDRESS 0xFFF9793C /end MEASUREMENT
/begin MEASUREMENT ZFFSAB._.CAN_Handling.st_LearnedBitmaskCANMsg1 "every CAN message that is learned (Msg 0-31, Bit x = 1)" ULONG SAB_STANDARD_S2_S3 1 100 0 4294967295 DISPLAY_IDENTIFIER st_LearnedBitmaskCANMsg1.CAN_Handling._.ZFFSAB ECU_ADDRESS 0xFFF97940 /end MEASUREMENT
/begin MEASUREMENT ZFFSAB._.CAN_Handling.st_ToLearnBitmaskCANMsg1 "every CAN message that is to be learned" ULONG SAB_STANDARD_S2_S3 1 100 0 4294967295 DISPLAY_IDENTIFIER st_ToLearnBitmaskCANMsg1.CAN_Handling._.ZFFSAB ECU_ADDRESS 0xFFF97944 /end MEASUREMENT
/begin MEASUREMENT ZFFSAB._.CAN_Handling.st_CANControlConfigBitmask2 "every CAN message that is monitored or learned (Bit x = 1)" ULONG SAB_STANDARD_S2_S3 1 100 0 4294967295 DISPLAY_IDENTIFIER st_CANControlConfigBitmask2.CAN_Handling._.ZFFSAB ECU_ADDRESS 0xFFF97948 /end MEASUREMENT
/begin MEASUREMENT ZFFSAB._.CAN_Handling.st_LearnedBitmaskCANMsg2 "every CAN message that is learned (Msg 32 upside, Bit x = 1)" ULONG SAB_STANDARD_S2_S3 1 100 0 4294967295 DISPLAY_IDENTIFIER st_LearnedBitmaskCANMsg2.CAN_Handling._.ZFFSAB ECU_ADDRESS 0xFFF9794C /end MEASUREMENT
/begin MEASUREMENT ZFFSAB._.CAN_Handling.st_ToLearnBitmaskCANMsg2 "every CAN message that is to be learned" ULONG SAB_STANDARD_S2_S3 1 100 0 4294967295 DISPLAY_IDENTIFIER st_ToLearnBitmaskCANMsg2.CAN_Handling._.ZFFSAB ECU_ADDRESS 0xFFF97950 /end MEASUREMENT
/begin MEASUREMENT ZFFSAB._.CAN_Handling.iv_f_clear_learnedmsg "flag for learned messaeges (1=clear all, 0=not clear)" UBYTE SAB_STANDARD_S2_S3 1 100 0 1 DISPLAY_IDENTIFIER iv_f_clear_learnedmsg.CAN_Handling._.ZFFSAB ECU_ADDRESS 0xFFF97954 /end MEASUREMENT
/begin MEASUREMENT ZFFSAB._.CAN_Handling.f_CanMsgDiag "State of diagnosis test conditions for CAN (0 = not ok;1 = ok)" UBYTE SAB_STANDARD_S2_S3 1 100 0 1 DISPLAY_IDENTIFIER f_CanMsgDiag.CAN_Handling._.ZFFSAB ECU_ADDRESS 0xFFF97955 /end MEASUREMENT
/begin MEASUREMENT ZFFSAB._.CAN_Handling.f_Can1BusDiag "State of diagnosis test conditions for CAN Bus Off(0 = not ok;1 = ok)" UBYTE SAB_STANDARD_S2_S3 1 100 0 1 DISPLAY_IDENTIFIER f_Can1BusDiag.CAN_Handling._.ZFFSAB ECU_ADDRESS 0xFFF97956 /end MEASUREMENT
/begin MEASUREMENT ZFFSAB._.CAN_Handling.f_ACanMsgDiag "State of diagnosis test conditions for A-CAN (0 = not ok;1 = ok)" UBYTE SAB_STANDARD_S2_S3 1 100 0 1 DISPLAY_IDENTIFIER f_ACanMsgDiag.CAN_Handling._.ZFFSAB ECU_ADDRESS 0xFFF97957 /end MEASUREMENT
/begin MEASUREMENT ZFFSAB._.CAN_Handling.f_Can2BusDiag "State of diagnosis test conditions for the second CAN Bus Off(0 = not ok;1 = ok)" UBYTE SAB_STANDARD_S2_S3 1 100 0 1 DISPLAY_IDENTIFIER f_Can2BusDiag.CAN_Handling._.ZFFSAB ECU_ADDRESS 0xFFF97958 /end MEASUREMENT
/begin MEASUREMENT ZFFSAB._.CAN_Handling.iv_JumpstartAktiv "State of Jumpstart" UBYTE SAB_STANDARD_S2_S3 1 100 0 2 DISPLAY_IDENTIFIER iv_JumpstartAktiv.CAN_Handling._.ZFFSAB ECU_ADDRESS 0xFFF97959 /end MEASUREMENT
/begin MEASUREMENT ZFFSAB._.CAN_Handling.iv_f_FaultStatKFC_UBATTO "value = 1 if KFC_UBATTO is entered or in forward filtering" UBYTE SAB_STANDARD_S2_S3 1 100 0 1 DISPLAY_IDENTIFIER iv_f_FaultStatKFC_UBATTO.CAN_Handling._.ZFFSAB ECU_ADDRESS 0xFFF9795A /end MEASUREMENT
/begin MEASUREMENT ZFFSAB._.CAN_Handling.st_CanMsgErrorBitmask1 "Info bitmask for Ambient Conditions (SAB-UWB ID73). Bit for each Msg-No. Lowest index at LSB. (Msg 0-31) (0=i.O.; 1=Error)" ULONG SAB_STANDARD_S2_S3 1 100 0 4294967295 DISPLAY_IDENTIFIER st_CanMsgErrorBitmask1.CAN_Handling._.ZFFSAB ECU_ADDRESS 0xFFF9795C /end MEASUREMENT
/begin MEASUREMENT ZFFSAB._.CAN_Handling.st_CanMsgErrorBitmask2 "Info bitmask for Ambient Conditions (SAB-UWB ID73). Bit for each Msg-No. Lowest index at LSB. (Msg 32 upside)(0=i.O.; 1=Error)" ULONG SAB_STANDARD_S2_S3 1 100 0 4294967295 DISPLAY_IDENTIFIER st_CanMsgErrorBitmask2.CAN_Handling._.ZFFSAB ECU_ADDRESS 0xFFF97960 /end MEASUREMENT
/begin MEASUREMENT ZFFSAB._.MSAOut.iv_StatusMSAHAS "State of MSA HAS" UBYTE SAB_STANDARD_S2_S3 1 100 0 255 DISPLAY_IDENTIFIER iv_StatusMSAHAS.MSAOut._.ZFFSAB ECU_ADDRESS 0xFFF983EC /end MEASUREMENT
/begin MEASUREMENT ZFFSAB._.MSAOut.sv_MSA_Rq_Hyb_Grb "Signal approves the prevention for switch-on request of the combustion engine" UBYTE SAB_STANDARD_S2_S3 1 100 0 255 DISPLAY_IDENTIFIER sv_MSA_Rq_Hyb_Grb.MSAOut._.ZFFSAB ECU_ADDRESS 0xFFF983ED /end MEASUREMENT
/begin MEASUREMENT ZFFSAB._.MSAOut.sv_RqMSA_FnSlctn "signal for the switch-off/on request or the switch-off prevention" UBYTE SAB_STANDARD_S2_S3 1 100 0 255 DISPLAY_IDENTIFIER sv_RqMSA_FnSlctn.MSAOut._.ZFFSAB ECU_ADDRESS 0xFFF983EE /end MEASUREMENT
/begin MEASUREMENT ZFFSAB._.PowerdownIn.iv_f_PowDownEnable "1=SBW enables the powerdown 0=SBW disables the powerdown" UBYTE SAB_STANDARD_S2_S3 1 100 0 1 DISPLAY_IDENTIFIER iv_f_PowDownEnable.PowerdownIn._.ZFFSAB ECU_ADDRESS 0xFFF97973 /end MEASUREMENT
/begin MEASUREMENT ZFFSAB._.PowerdownIn.iv_f_EeStoreInProgress "1=EEPROM Storage is activ 0=EEPROM Storage is not activ" UBYTE SAB_STANDARD_S2_S3 1 100 0 1 DISPLAY_IDENTIFIER iv_f_EeStoreInProgress.PowerdownIn._.ZFFSAB ECU_ADDRESS 0xFFF97974 /end MEASUREMENT
/begin MEASUREMENT ZFFSAB._.PowerdownIn.iv_f_PowDownEnableAtsys "1=ATSYS enables the powerdown 0=ATSYS disables the powerdown" UBYTE SAB_STANDARD_S2_S3 1 100 0 1 DISPLAY_IDENTIFIER iv_f_PowDownEnableAtsys.PowerdownIn._.ZFFSAB ECU_ADDRESS 0xFFF97975 /end MEASUREMENT
/begin MEASUREMENT ZFFSAB._.PowerdownIn.iv_f_CanActive "1=bus communication is active 0=no bus communication" UBYTE SAB_STANDARD_S2_S3 1 100 0 1 DISPLAY_IDENTIFIER iv_f_CanActive.PowerdownIn._.ZFFSAB ECU_ADDRESS 0xFFF97976 /end MEASUREMENT
/begin MEASUREMENT ZFFSAB._.PowerdownIn.iv_f_LinActive "1=bus communication is active 0=no bus communication" UBYTE SAB_STANDARD_S2_S3 1 100 0 1 DISPLAY_IDENTIFIER iv_f_LinActive.PowerdownIn._.ZFFSAB ECU_ADDRESS 0xFFF97977 /end MEASUREMENT
/begin MEASUREMENT ZFFSAB._.PowerdownIn.sv_f_PowDownCondOk "1=signals the SBW to preparing powerdown" UBYTE SAB_STANDARD_S2_S3 1 100 0 1 DISPLAY_IDENTIFIER sv_f_PowDownCondOk.PowerdownIn._.ZFFSAB ECU_ADDRESS 0xFFF97978 /end MEASUREMENT
/begin MEASUREMENT ZFFSAB._.PowerdownIn.sv_f_ShutDown "signals the hardware layer to shutdown the ecu" UBYTE SAB_STANDARD_S2_S3 1 100 0 2 DISPLAY_IDENTIFIER sv_f_ShutDown.PowerdownIn._.ZFFSAB ECU_ADDRESS 0xFFF97979 /end MEASUREMENT
/begin MEASUREMENT ZFFSAB._.PowerdownIn.sv_f_CanComActive "1 = the ECU requests the Canbus 0 = the ECU does not need the Canbus for communication --NM may go to sleep know--." UBYTE SAB_STANDARD_S2_S3 1 100 0 1 DISPLAY_IDENTIFIER sv_f_CanComActive.PowerdownIn._.ZFFSAB ECU_ADDRESS 0xFFF9797A /end MEASUREMENT
/begin MEASUREMENT ZFFSAB._.PowerdownIn.sv_f_LinComActive "1 = the ECU requests the Linbus 0 = the ECU does not need the Linbus for communication --NM may go to sleep know--." UBYTE SAB_STANDARD_S2_S3 1 100 0 1 DISPLAY_IDENTIFIER sv_f_LinComActive.PowerdownIn._.ZFFSAB ECU_ADDRESS 0xFFF9797B /end MEASUREMENT
/begin MEASUREMENT ZFFSAB._.PowerdownIn.f_RapidPowerShutdown "flag for signalling a rapid power shutdown" UBYTE SAB_STANDARD_S2_S3 1 100 0 1 DISPLAY_IDENTIFIER f_RapidPowerShutdown.PowerdownIn._.ZFFSAB ECU_ADDRESS 0xFFF9797C /end MEASUREMENT
/begin MEASUREMENT ZFFSAB._.PowerdownIn.f_ResetByTester "flag for signalling a reset by tester" UBYTE SAB_STANDARD_S2_S3 1 100 0 1 DISPLAY_IDENTIFIER f_ResetByTester.PowerdownIn._.ZFFSAB ECU_ADDRESS 0xFFF9797D /end MEASUREMENT
/begin MEASUREMENT ZFFSAB._.PowerdownIn.f_EeStoreAllowed "1 = EEPROM data gets written during next shutdown 0 = writing of EEPROM data gets avoided during next shutdown" UBYTE SAB_STANDARD_S2_S3 1 100 0 1 DISPLAY_IDENTIFIER f_EeStoreAllowed.PowerdownIn._.ZFFSAB ECU_ADDRESS 0xFFF9797E /end MEASUREMENT
/begin MEASUREMENT ZFFSAB._.PowerdownIn.f_InternalWakeUp "1 = last CAN Wake Up was invoked by SBW N-Haltephase 0 = last CAN Wake Up was not invoked by SBW N-Haltephase" UBYTE SAB_STANDARD_S2_S3 1 100 0 1 DISPLAY_IDENTIFIER f_InternalWakeUp.PowerdownIn._.ZFFSAB ECU_ADDRESS 0xFFF9797F /end MEASUREMENT
/begin MEASUREMENT ZFFSAB._.PowerdownIn.f_IgnitionOn "this is a class specific reference to IgnitionStatusIn.sv_f_IgnOn" UBYTE SAB_STANDARD_S2_S3 1 100 0 1 DISPLAY_IDENTIFIER f_IgnitionOn.PowerdownIn._.ZFFSAB ECU_ADDRESS 0xFFF97980 /end MEASUREMENT
/begin MEASUREMENT ZFFSAB._.PowerdownIn.st_PowerdownMain "internal current state of the main state machine" UBYTE SAB_STANDARD_S2_S3 1 100 0 6 DISPLAY_IDENTIFIER st_PowerdownMain.PowerdownIn._.ZFFSAB ECU_ADDRESS 0xFFF97981 /end MEASUREMENT
/begin MEASUREMENT ZFFSAB._.PowerdownIn.st_Powerdown "internal current state of the state machine" UBYTE SAB_STANDARD_S2_S3 1 100 0 6 DISPLAY_IDENTIFIER st_Powerdown.PowerdownIn._.ZFFSAB ECU_ADDRESS 0xFFF97982 /end MEASUREMENT
/begin MEASUREMENT ZFFSAB._.PowerdownIn.f_Iep_Shutdown "parameter of last call to IEP for shutdown by the SAB" UBYTE SAB_STANDARD_S2_S3 1 100 0 1 DISPLAY_IDENTIFIER f_Iep_Shutdown.PowerdownIn._.ZFFSAB ECU_ADDRESS 0xFFF97983 /end MEASUREMENT
/begin MEASUREMENT ZFFSAB._.VoltageMonitoringOut.iv_Pos "position of gear-lever" UBYTE SAB_STANDARD_S2_S3 1 100 0 12 DISPLAY_IDENTIFIER iv_Pos.VoltageMonitoringOut._.ZFFSAB ECU_ADDRESS 0xFFF97990 /end MEASUREMENT
/begin MEASUREMENT ZFFSAB._.VoltageMonitoringOut.iv_u_Batt_Diag "actual U_Batt" UWORD SAB_U_1VOLT1000_S2_S3 1 100 0 65.535 DISPLAY_IDENTIFIER iv_u_Batt_Diag.VoltageMonitoringOut._.ZFFSAB ECU_ADDRESS 0xFFF97992 /end MEASUREMENT
/begin MEASUREMENT ZFFSAB._.VoltageMonitoringOut.iv_fet0_active "Input value for state of FET0" UBYTE SAB_STANDARD_S2_S3 1 100 0 255 DISPLAY_IDENTIFIER iv_fet0_active.VoltageMonitoringOut._.ZFFSAB ECU_ADDRESS 0xFFF97994 /end MEASUREMENT
/begin MEASUREMENT ZFFSAB._.VoltageMonitoringOut.sv_f_GetUndervoltageTC "signalizes if the Reset-Documentation is fullfilled" UBYTE SAB_STANDARD_S2_S3 1 100 0 1 DISPLAY_IDENTIFIER sv_f_GetUndervoltageTC.VoltageMonitoringOut._.ZFFSAB ECU_ADDRESS 0xFFF97995 /end MEASUREMENT
/begin MEASUREMENT ZFFSAB._.VoltageMonitoringOut.sv_f_JumpstartAktiv "signalizes if Jumpstart is active or not" UBYTE SAB_STANDARD_S2_S3 1 100 0 1 DISPLAY_IDENTIFIER sv_f_JumpstartAktiv.VoltageMonitoringOut._.ZFFSAB ECU_ADDRESS 0xFFF97996 /end MEASUREMENT
/begin MEASUREMENT ZFFSAB._.VoltageMonitoringOut.sv_sts_EDSMV "EDSMV-status to HPSYS" UBYTE SAB_STANDARD_S2_S3 1 100 0 7 DISPLAY_IDENTIFIER sv_sts_EDSMV.VoltageMonitoringOut._.ZFFSAB ECU_ADDRESS 0xFFF97997 /end MEASUREMENT
/begin MEASUREMENT ZFFSAB._.VoltageMonitoringOut.sv_f_FET1 "signalizes if FET1 shall be active or not" UBYTE SAB_STANDARD_S2_S3 1 100 0 1 DISPLAY_IDENTIFIER sv_f_FET1.VoltageMonitoringOut._.ZFFSAB ECU_ADDRESS 0xFFF97998 /end MEASUREMENT
/begin MEASUREMENT ZFFSAB._.VoltageMonitoringOut.sv_f_FET2 "signalizes if FET2 shall be active or not" UBYTE SAB_STANDARD_S2_S3 1 100 0 1 DISPLAY_IDENTIFIER sv_f_FET2.VoltageMonitoringOut._.ZFFSAB ECU_ADDRESS 0xFFF97999 /end MEASUREMENT
/begin MEASUREMENT ZFFSAB._.VoltageMonitoringOut.f_DiagActive_UBATTU "Flag is set if diagnose of KFC_UBATTU is active" UBYTE SAB_STANDARD_S2_S3 1 100 0 1 DISPLAY_IDENTIFIER f_DiagActive_UBATTU.VoltageMonitoringOut._.ZFFSAB ECU_ADDRESS 0xFFF9799A /end MEASUREMENT
/begin MEASUREMENT ZFFSAB._.VoltageMonitoringOut.f_DiagActive_UBATTL "Flag is set if diagnose of KFC_UBATTL is active" UBYTE SAB_STANDARD_S2_S3 1 100 0 1 DISPLAY_IDENTIFIER f_DiagActive_UBATTL.VoltageMonitoringOut._.ZFFSAB ECU_ADDRESS 0xFFF9799B /end MEASUREMENT
/begin MEASUREMENT ZFFSAB._.GearLimitation.sv_GearLimit "signalizes which gears must be suppressed" UBYTE SAB_STANDARD_S2_S3 1 100 0 255 DISPLAY_IDENTIFIER sv_GearLimit.GearLimitation._.ZFFSAB ECU_ADDRESS 0xFFF979A4 /end MEASUREMENT
/begin MEASUREMENT ZFFSAB._.GearLimitation.sv_f_GearLimitActive "flag which signalizes if gears must be suppressed" UBYTE SAB_STANDARD_S2_S3 1 100 0 1 DISPLAY_IDENTIFIER sv_f_GearLimitActive.GearLimitation._.ZFFSAB ECU_ADDRESS 0xFFF979A5 /end MEASUREMENT
/begin MEASUREMENT ZFFSAB._.GearLimitation.iv_f_GearLimitActive "flag which signalizes if gears must be suppressed" UBYTE SAB_STANDARD_S2_S3 1 100 0 1 DISPLAY_IDENTIFIER iv_f_GearLimitActive.GearLimitation._.ZFFSAB ECU_ADDRESS 0xFFF979A6 /end MEASUREMENT
/begin MEASUREMENT ZFFSAB._.EmergencyGearInfo.iv_ActualGear "Input value for actual gear" SBYTE SAB_STANDARD_S2_S3 1 100 -1 8 DISPLAY_IDENTIFIER iv_ActualGear.EmergencyGearInfo._.ZFFSAB ECU_ADDRESS 0xFFF979C0 /end MEASUREMENT
/begin MEASUREMENT ZFFSAB._.EmergencyGearInfo.iv_TargetGear "Input value for target gear" SBYTE SAB_STANDARD_S2_S3 1 100 -1 8 DISPLAY_IDENTIFIER iv_TargetGear.EmergencyGearInfo._.ZFFSAB ECU_ADDRESS 0xFFF979C1 /end MEASUREMENT
/begin MEASUREMENT ZFFSAB._.EmergencyGearInfo.iv_Pos "Input value for position of E-GearLever" UBYTE SAB_STANDARD_S2_S3 1 100 0 255 DISPLAY_IDENTIFIER iv_Pos.EmergencyGearInfo._.ZFFSAB ECU_ADDRESS 0xFFF979C2 /end MEASUREMENT
/begin MEASUREMENT ZFFSAB._.EmergencyGearInfo.iv_PosSts "Input value for status E-GearLever" UBYTE SAB_STANDARD_S2_S3 1 100 0 1 DISPLAY_IDENTIFIER iv_PosSts.EmergencyGearInfo._.ZFFSAB ECU_ADDRESS 0xFFF979C3 /end MEASUREMENT
/begin MEASUREMENT ZFFSAB._.EmergencyGearInfo.iv_LIN_EPumpErr "Bit coded error state of LIN-IEP 0: No Error 1:IEP temporary failure 2:IEP permanent failure 4:IEP communication failure" UBYTE SAB_STANDARD_S2_S3 1 100 0 4 DISPLAY_IDENTIFIER iv_LIN_EPumpErr.EmergencyGearInfo._.ZFFSAB ECU_ADDRESS 0xFFF979C4 /end MEASUREMENT
/begin MEASUREMENT ZFFSAB._.EmergencyGearInfo.sv_ctl_EmergencyGearInfoCpy "copy of Emergency gear info" UBYTE SAB_STANDARD_S2_S3 1 100 0 255 DISPLAY_IDENTIFIER sv_ctl_EmergencyGearInfoCpy.EmergencyGearInfo._.ZFFSAB ECU_ADDRESS 0xFFF979C5 /end MEASUREMENT
/begin MEASUREMENT ZFFSAB._.EmergencyGearInfo.sv_IEPsoll_subst "set value KO" UBYTE SAB_STANDARD_S2_S3 1 100 0 4 DISPLAY_IDENTIFIER sv_IEPsoll_subst.EmergencyGearInfo._.ZFFSAB ECU_ADDRESS 0xFFF979C6 /end MEASUREMENT
/begin MEASUREMENT ZFFSAB._.EmergencyGearInfo.sv_K0soll_subst "set value KO" UBYTE SAB_STANDARD_S2_S3 1 100 0 3 DISPLAY_IDENTIFIER sv_K0soll_subst.EmergencyGearInfo._.ZFFSAB ECU_ADDRESS 0xFFF979C7 /end MEASUREMENT
/begin MEASUREMENT ZFFSAB._.EmergencyGearInfo.f_IgnitionOff2On "Ignition Off to On" UBYTE SAB_STANDARD_S2_S3 1 100 0 1 DISPLAY_IDENTIFIER f_IgnitionOff2On.EmergencyGearInfo._.ZFFSAB ECU_ADDRESS 0xFFF979C8 /end MEASUREMENT
/begin MEASUREMENT ZFFSAB._.EmergencyGearInfo.f_3th_stepENPGx "3th step achieved" UBYTE SAB_STANDARD_S2_S3 1 100 0 1 DISPLAY_IDENTIFIER f_3th_stepENPGx.EmergencyGearInfo._.ZFFSAB ECU_ADDRESS 0xFFF979C9 /end MEASUREMENT
/begin MEASUREMENT ZFFSAB._.EmergencyGearInfo.KMN_active_last_call "active KMN last cycle" ULONG SAB_STANDARD_S2_S3 1 100 0 1 DISPLAY_IDENTIFIER KMN_active_last_call.EmergencyGearInfo._.ZFFSAB ECU_ADDRESS 0xFFF979CC /end MEASUREMENT
/begin MEASUREMENT ZFFSAB._.EmergencyGearInfo.KMN_High_active_last_call "active KMN high last cycle" ULONG SAB_STANDARD_S2_S3 1 100 0 1 DISPLAY_IDENTIFIER KMN_High_active_last_call.EmergencyGearInfo._.ZFFSAB ECU_ADDRESS 0xFFF979D0 /end MEASUREMENT
/begin MEASUREMENT ZFFSAB._.EmergencyGearInfo.st_ENPG1FIX "internal state of ENPG1FIX state machine" UBYTE SAB_STANDARD_S2_S3 1 100 0 255 DISPLAY_IDENTIFIER st_ENPG1FIX.EmergencyGearInfo._.ZFFSAB ECU_ADDRESS 0xFFF979D4 /end MEASUREMENT
/begin MEASUREMENT ZFFSAB._.EmergencyGearInfo.st_RD_ENPG1FIX "internal state of ENPG1FIX state machine" UBYTE SAB_STANDARD_S2_S3 1 100 0 255 DISPLAY_IDENTIFIER st_RD_ENPG1FIX.EmergencyGearInfo._.ZFFSAB ECU_ADDRESS 0xFFF979D5 /end MEASUREMENT
/begin MEASUREMENT ZFFSAB._.EmergencyGearInfo.st_RD_ENPG3_ENPG3 "internal state of ENPG3 state machine" UBYTE SAB_STANDARD_S2_S3 1 100 0 255 DISPLAY_IDENTIFIER st_RD_ENPG3_ENPG3.EmergencyGearInfo._.ZFFSAB ECU_ADDRESS 0xFFF979D6 /end MEASUREMENT
/begin MEASUREMENT ZFFSAB._.EmergencyGearInfo.st_RD_ENPG3_ENPG3FIX "internal state of ENPG3FIX state machine" UBYTE SAB_STANDARD_S2_S3 1 100 0 255 DISPLAY_IDENTIFIER st_RD_ENPG3_ENPG3FIX.EmergencyGearInfo._.ZFFSAB ECU_ADDRESS 0xFFF979D7 /end MEASUREMENT
/begin MEASUREMENT ZFFSAB._.EmergencyGearInfo.st_ENPG3 "internal state of ENPG3 state machine" UBYTE SAB_STANDARD_S2_S3 1 100 0 255 DISPLAY_IDENTIFIER st_ENPG3.EmergencyGearInfo._.ZFFSAB ECU_ADDRESS 0xFFF979D8 /end MEASUREMENT
/begin MEASUREMENT ZFFSAB._.EmergencyGearInfo.st_ENPG3FIX "internal state of ENPG3FIX state machine" UBYTE SAB_STANDARD_S2_S3 1 100 0 255 DISPLAY_IDENTIFIER st_ENPG3FIX.EmergencyGearInfo._.ZFFSAB ECU_ADDRESS 0xFFF979D9 /end MEASUREMENT
/begin MEASUREMENT ZFFSAB._.EmergencyGearInfo.loc_ConditionGear1 "intern test-variable only" UBYTE SAB_STANDARD_S2_S3 1 100 0 255 DISPLAY_IDENTIFIER loc_ConditionGear1.EmergencyGearInfo._.ZFFSAB ECU_ADDRESS 0xFFF979DA /end MEASUREMENT
/begin MEASUREMENT ZFFSAB._.EmergencyGearInfo.loc_ConditionGear2 "intern test-variable only" UBYTE SAB_STANDARD_S2_S3 1 100 0 255 DISPLAY_IDENTIFIER loc_ConditionGear2.EmergencyGearInfo._.ZFFSAB ECU_ADDRESS 0xFFF979DB /end MEASUREMENT
/begin MEASUREMENT ZFFSAB._.EmergencyGearInfo.loc_ConditionGear3 "intern test-variable only" UBYTE SAB_STANDARD_S2_S3 1 100 0 255 DISPLAY_IDENTIFIER loc_ConditionGear3.EmergencyGearInfo._.ZFFSAB ECU_ADDRESS 0xFFF979DC /end MEASUREMENT
/begin MEASUREMENT ZFFSAB._.EmergencyGearInfo.loc_ConditionGear4 "intern test-variable only" UBYTE SAB_STANDARD_S2_S3 1 100 0 255 DISPLAY_IDENTIFIER loc_ConditionGear4.EmergencyGearInfo._.ZFFSAB ECU_ADDRESS 0xFFF979DD /end MEASUREMENT
/begin MEASUREMENT ZFFSAB._.EmergencyGearInfo.loc_ConditionGear5 "intern test-variable only" UBYTE SAB_STANDARD_S2_S3 1 100 0 255 DISPLAY_IDENTIFIER loc_ConditionGear5.EmergencyGearInfo._.ZFFSAB ECU_ADDRESS 0xFFF979DE /end MEASUREMENT
/begin MEASUREMENT ZFFSAB._.EmergencyGearInfo.loc_ConditionGear6 "intern test-variable only" UBYTE SAB_STANDARD_S2_S3 1 100 0 255 DISPLAY_IDENTIFIER loc_ConditionGear6.EmergencyGearInfo._.ZFFSAB ECU_ADDRESS 0xFFF979DF /end MEASUREMENT
/begin MEASUREMENT ZFFSAB._.EmergencyGearInfo.loc_nAbFilt "intern test-variable only" UWORD SAB_STANDARD_S2_S3 1 100 0 65535 DISPLAY_IDENTIFIER loc_nAbFilt.EmergencyGearInfo._.ZFFSAB ECU_ADDRESS 0xFFF979E0 /end MEASUREMENT
/begin MEASUREMENT ZFFSAB._.EmergencyGearInfo.loc_nAbSts "intern test-variable only" UBYTE SAB_STANDARD_S2_S3 1 100 0 255 DISPLAY_IDENTIFIER loc_nAbSts.EmergencyGearInfo._.ZFFSAB ECU_ADDRESS 0xFFF979E2 /end MEASUREMENT
/begin MEASUREMENT ZFFSAB._.EmergencyGearInfo.loc_WheelActiveAvg "intern test-variable only" UWORD SAB_STANDARD_S2_S3 1 100 0 65535 DISPLAY_IDENTIFIER loc_WheelActiveAvg.EmergencyGearInfo._.ZFFSAB ECU_ADDRESS 0xFFF979E4 /end MEASUREMENT
/begin MEASUREMENT ZFFSAB._.EmergencyGearInfo.loc_WheelActiveAvgSts "intern test-variable only" UBYTE SAB_STANDARD_S2_S3 1 100 0 255 DISPLAY_IDENTIFIER loc_WheelActiveAvgSts.EmergencyGearInfo._.ZFFSAB ECU_ADDRESS 0xFFF979E6 /end MEASUREMENT
/begin MEASUREMENT ZFFSAB._.EmergencyGearInfo.loc_ConditionENPG1Fix "intern test-variable only" UBYTE SAB_STANDARD_S2_S3 1 100 0 255 DISPLAY_IDENTIFIER loc_ConditionENPG1Fix.EmergencyGearInfo._.ZFFSAB ECU_ADDRESS 0xFFF979E7 /end MEASUREMENT
/begin MEASUREMENT ZFFSAB._.EmergencyGearInfo.loc_ConditionENPG3Fix "intern test-variable only" UBYTE SAB_STANDARD_S2_S3 1 100 0 255 DISPLAY_IDENTIFIER loc_ConditionENPG3Fix.EmergencyGearInfo._.ZFFSAB ECU_ADDRESS 0xFFF979E8 /end MEASUREMENT
/begin MEASUREMENT ZFFSAB._.EmergencyGearInfo.iv_in_Gear1Act "Input value for gearRatio of first gear" UWORD SAB_K1000_S2_S3 1 100 0 65.535 DISPLAY_IDENTIFIER iv_in_Gear1Act.EmergencyGearInfo._.ZFFSAB ECU_ADDRESS 0xFFF979EA /end MEASUREMENT
/begin MEASUREMENT ZFFSAB._.EmergencyGearInfo.iv_in_Gear2Act "Input value for gearRatio of second gear" UWORD SAB_K1000_S2_S3 1 100 0 65.535 DISPLAY_IDENTIFIER iv_in_Gear2Act.EmergencyGearInfo._.ZFFSAB ECU_ADDRESS 0xFFF979EC /end MEASUREMENT
/begin MEASUREMENT ZFFSAB._.EmergencyGearInfo.iv_in_Gear3Act "Input value for gearRatio of third gear" UWORD SAB_K1000_S2_S3 1 100 0 65.535 DISPLAY_IDENTIFIER iv_in_Gear3Act.EmergencyGearInfo._.ZFFSAB ECU_ADDRESS 0xFFF979EE /end MEASUREMENT
/begin MEASUREMENT ZFFSAB._.EmergencyGearInfo.iv_in_Gear4Act "Input value for gearRatio of fourth gear" UWORD SAB_K1000_S2_S3 1 100 0 65.535 DISPLAY_IDENTIFIER iv_in_Gear4Act.EmergencyGearInfo._.ZFFSAB ECU_ADDRESS 0xFFF979F0 /end MEASUREMENT
/begin MEASUREMENT ZFFSAB._.EmergencyGearInfo.iv_in_Gear5Act "Input value for gearRatio of fifth gear" UWORD SAB_K1000_S2_S3 1 100 0 65.535 DISPLAY_IDENTIFIER iv_in_Gear5Act.EmergencyGearInfo._.ZFFSAB ECU_ADDRESS 0xFFF979F2 /end MEASUREMENT
/begin MEASUREMENT ZFFSAB._.EmergencyGearInfo.iv_in_Gear6Act "Input value for gearRatio of sixth gear" UWORD SAB_K1000_S2_S3 1 100 0 65.535 DISPLAY_IDENTIFIER iv_in_Gear6Act.EmergencyGearInfo._.ZFFSAB ECU_ADDRESS 0xFFF979F4 /end MEASUREMENT
/begin MEASUREMENT ZFFSAB._.EmergencyGearInfo.iv_in_GearAct "Input value for gearRatio of actual gear" UWORD SAB_K1000_S2_S3 1 100 0 65.535 DISPLAY_IDENTIFIER iv_in_GearAct.EmergencyGearInfo._.ZFFSAB ECU_ADDRESS 0xFFF979F6 /end MEASUREMENT
/begin MEASUREMENT ZFFSAB._.EmergencyGearInfo.iv_n_EnUTh "Input value for upper threshold of engine-RPM" UWORD SAB_N_1RPM_S2_S3 1 100 0 65535 DISPLAY_IDENTIFIER iv_n_EnUTh.EmergencyGearInfo._.ZFFSAB ECU_ADDRESS 0xFFF979F8 /end MEASUREMENT
/begin MEASUREMENT ZFFSAB._.EmergencyGearInfo.ctl_EmergencyGearInfo "information to Hpsys about EmergencyGearInfo" UBYTE SAB_STANDARD_S2_S3 1 100 0 36 DISPLAY_IDENTIFIER ctl_EmergencyGearInfo.EmergencyGearInfo._.ZFFSAB ECU_ADDRESS 0xFFF979FA /end MEASUREMENT
/begin MEASUREMENT ZFFSAB._.EmergencyGearInfo.n_AbUThGearSubst1 "Output value for calculated threshold" UWORD SAB_N_1RPM_S2_S3 1 100 0 65535 DISPLAY_IDENTIFIER n_AbUThGearSubst1.EmergencyGearInfo._.ZFFSAB ECU_ADDRESS 0xFFF979FC /end MEASUREMENT
/begin MEASUREMENT ZFFSAB._.EmergencyGearInfo.n_AbUThGearSubst2 "Output value for calculated threshold" UWORD SAB_N_1RPM_S2_S3 1 100 0 65535 DISPLAY_IDENTIFIER n_AbUThGearSubst2.EmergencyGearInfo._.ZFFSAB ECU_ADDRESS 0xFFF979FE /end MEASUREMENT
/begin MEASUREMENT ZFFSAB._.EmergencyGearInfo.n_AbUThGearSubst3 "Output value for calculated threshold" UWORD SAB_N_1RPM_S2_S3 1 100 0 65535 DISPLAY_IDENTIFIER n_AbUThGearSubst3.EmergencyGearInfo._.ZFFSAB ECU_ADDRESS 0xFFF97A00 /end MEASUREMENT
/begin MEASUREMENT ZFFSAB._.EmergencyGearInfo.n_AbUThGearSubst4 "Output value for calculated threshold" UWORD SAB_N_1RPM_S2_S3 1 100 0 65535 DISPLAY_IDENTIFIER n_AbUThGearSubst4.EmergencyGearInfo._.ZFFSAB ECU_ADDRESS 0xFFF97A02 /end MEASUREMENT
/begin MEASUREMENT ZFFSAB._.EmergencyGearInfo.n_AbUThGearSubst5 "Output value for calculated threshold" UWORD SAB_N_1RPM_S2_S3 1 100 0 65535 DISPLAY_IDENTIFIER n_AbUThGearSubst5.EmergencyGearInfo._.ZFFSAB ECU_ADDRESS 0xFFF97A04 /end MEASUREMENT
/begin MEASUREMENT ZFFSAB._.EmergencyGearInfo.n_AbUThGearSubst6 "Output value for calculated threshold" UWORD SAB_N_1RPM_S2_S3 1 100 0 65535 DISPLAY_IDENTIFIER n_AbUThGearSubst6.EmergencyGearInfo._.ZFFSAB ECU_ADDRESS 0xFFF97A06 /end MEASUREMENT
/begin MEASUREMENT ZFFSAB._.EmergencyGearInfo.st_KMN_GFIX_KFC_ERSATZ "internal state of GFIX_KFC_ERSATZ state machine" UBYTE SAB_STANDARD_S2_S3 1 100 0 255 DISPLAY_IDENTIFIER st_KMN_GFIX_KFC_ERSATZ.EmergencyGearInfo._.ZFFSAB ECU_ADDRESS 0xFFF97A08 /end MEASUREMENT
/begin MEASUREMENT ZFFSAB._.EmergencyGearInfo.loc_reg_for_GFIX_old "active KMN last cycle" ULONG SAB_STANDARD_S2_S3 1 100 0 1 DISPLAY_IDENTIFIER loc_reg_for_GFIX_old.EmergencyGearInfo._.ZFFSAB ECU_ADDRESS 0xFFF97A0C /end MEASUREMENT
/begin MEASUREMENT ZFFSAB._.EmergencyGearInfo.loc_reg_hi_for_GFIX_old "active KMN high last cycle" ULONG SAB_STANDARD_S2_S3 1 100 0 1 DISPLAY_IDENTIFIER loc_reg_hi_for_GFIX_old.EmergencyGearInfo._.ZFFSAB ECU_ADDRESS 0xFFF97A10 /end MEASUREMENT
/begin MEASUREMENT ZFFSAB._.EmergencyGearInfo.Gear_during_act_KMN_GFIX "Input value for actual gear during activation KMN GFIX" SBYTE SAB_STANDARD_S2_S3 1 100 -1 8 DISPLAY_IDENTIFIER Gear_during_act_KMN_GFIX.EmergencyGearInfo._.ZFFSAB ECU_ADDRESS 0xFFF97A14 /end MEASUREMENT
/begin MEASUREMENT ZFFSAB._.EmergencyGearInfo.KMN_GFIX_last_cycle "status KMN GFIX last cycle" ULONG SAB_STANDARD_S2_S3 1 100 0 1 DISPLAY_IDENTIFIER KMN_GFIX_last_cycle.EmergencyGearInfo._.ZFFSAB ECU_ADDRESS 0xFFF97A18 /end MEASUREMENT
/begin MEASUREMENT ZFFSAB._.EstVehicleWeightIn.iv_MassFzgEst "Input raw signal for estimated vehicle weight" UWORD SAB_M_20KG_S2_S3 1 100 0 8180 DISPLAY_IDENTIFIER iv_MassFzgEst.EstVehicleWeightIn._.ZFFSAB ECU_ADDRESS 0xFFF97A24 /end MEASUREMENT
/begin MEASUREMENT ZFFSAB._.EstVehicleWeightIn.iv_MassFzgEstErr "Qualifier signal for estimated vehicle weight signal" UBYTE SAB_STANDARD_S2_S3 1 100 0 255 DISPLAY_IDENTIFIER iv_MassFzgEstErr.EstVehicleWeightIn._.ZFFSAB ECU_ADDRESS 0xFFF97A26 /end MEASUREMENT
/begin MEASUREMENT ZFFSAB._.EstVehicleWeightIn.iv_MassFzgEstSts "Input signal message status of estimated vehicle weight" UBYTE SAB_STANDARD_S2_S3 1 100 0 255 DISPLAY_IDENTIFIER iv_MassFzgEstSts.EstVehicleWeightIn._.ZFFSAB ECU_ADDRESS 0xFFF97A27 /end MEASUREMENT
/begin MEASUREMENT ZFFSAB._.EstVehicleWeightIn.sv_MassFzgEst "Output signal of estimated vehicle weight" UWORD SAB_M_20KG_S2_S3 1 100 0 81900 DISPLAY_IDENTIFIER sv_MassFzgEst.EstVehicleWeightIn._.ZFFSAB ECU_ADDRESS 0xFFF97A28 /end MEASUREMENT
/begin MEASUREMENT ZFFSAB._.EstVehicleWeightIn.sv_MassFzgEstSts "Output status signal of estimated vehicle weight" UBYTE SAB_STANDARD_S2_S3 1 100 0 2 DISPLAY_IDENTIFIER sv_MassFzgEstSts.EstVehicleWeightIn._.ZFFSAB ECU_ADDRESS 0xFFF97A2A /end MEASUREMENT
/begin MEASUREMENT ZFFSAB._.EstVehicleWeightIn.f_MassFzgEstErr "Error flag of estimated vehicle weight signal" UBYTE SAB_STANDARD_S2_S3 1 100 0 1 DISPLAY_IDENTIFIER f_MassFzgEstErr.EstVehicleWeightIn._.ZFFSAB ECU_ADDRESS 0xFFF97A2B /end MEASUREMENT
/begin MEASUREMENT ZFFSAB._.CurWheelTrqIn.iv_M_RadIstQF "Input value qualifier of cross acceleration" UBYTE SAB_STANDARD_S2_S3 1 100 0 255 DISPLAY_IDENTIFIER iv_M_RadIstQF.CurWheelTrqIn._.ZFFSAB ECU_ADDRESS 0xFFF98498 /end MEASUREMENT
/begin MEASUREMENT ZFFSAB._.CurWheelTrqIn.iv_M_RadIst "Input value cross acceleration from CAN" UWORD SAB_M_1NM_M32000_S2_S3 1 100 -32000 33535 DISPLAY_IDENTIFIER iv_M_RadIst.CurWheelTrqIn._.ZFFSAB ECU_ADDRESS 0xFFF9849A /end MEASUREMENT
/begin MEASUREMENT ZFFSAB._.CurWheelTrqIn.iv_M_RadIstSts "Input value message status of cross acceleration" UBYTE SAB_STANDARD_S2_S3 1 100 0 255 DISPLAY_IDENTIFIER iv_M_RadIstSts.CurWheelTrqIn._.ZFFSAB ECU_ADDRESS 0xFFF9849C /end MEASUREMENT
/begin MEASUREMENT ZFFSAB._.CurWheelTrqIn.sv_M_RadIst "Output value cross acceleration" UWORD SAB_M_1NM_M32000_S2_S3 1 100 -32000 32000 DISPLAY_IDENTIFIER sv_M_RadIst.CurWheelTrqIn._.ZFFSAB ECU_ADDRESS 0xFFF9849E /end MEASUREMENT
/begin MEASUREMENT ZFFSAB._.CurWheelTrqIn.sv_M_RadIstSts "Output value signal status of cross acceleration" UBYTE SAB_STANDARD_S2_S3 1 100 0 2 DISPLAY_IDENTIFIER sv_M_RadIstSts.CurWheelTrqIn._.ZFFSAB ECU_ADDRESS 0xFFF984A0 /end MEASUREMENT
/begin MEASUREMENT ZFFSAB._.CurWheelTrqIn.f_M_RadIstErr "Error flag of cross acceleration" UBYTE SAB_STANDARD_S2_S3 1 100 0 1 DISPLAY_IDENTIFIER f_M_RadIstErr.CurWheelTrqIn._.ZFFSAB ECU_ADDRESS 0xFFF984A1 /end MEASUREMENT
/begin MEASUREMENT ZFFSAB._.TimeEGSOffIn.iv_Systime "Current system time" ULONG SAB_T_TIMER_1S_S2_S3 1 100 0 4294967295 DISPLAY_IDENTIFIER iv_Systime.TimeEGSOffIn._.ZFFSAB ECU_ADDRESS 0xFFF97A74 /end MEASUREMENT
/begin MEASUREMENT ZFFSAB._.TimeEGSOffIn.sv_TimeEGSOff "Output signal of EGSOff: time the EGS was switched off" ULONG SAB_T_TIMER_1S_S2_S3 1 100 0 4294967295 DISPLAY_IDENTIFIER sv_TimeEGSOff.TimeEGSOffIn._.ZFFSAB ECU_ADDRESS 0xFFF97A78 /end MEASUREMENT
/begin MEASUREMENT ZFFSAB._.TimeEGSOffIn.sv_TimeEGSOffSts "Output status of EGSOff: status of the EGS off time" UBYTE SAB_STANDARD_S2_S3 1 100 0 2 DISPLAY_IDENTIFIER sv_TimeEGSOffSts.TimeEGSOffIn._.ZFFSAB ECU_ADDRESS 0xFFF97A7C /end MEASUREMENT
/begin MEASUREMENT ZFFSAB._.TimeEGSOffIn.t_SystimeCurBuf "Contains the current valid system time to store into the EEPROM" ULONG SAB_T_TIMER_1S_S2_S3 1 100 0 4294967295 DISPLAY_IDENTIFIER t_SystimeCurBuf.TimeEGSOffIn._.ZFFSAB ECU_ADDRESS 0xFFF97A80 /end MEASUREMENT
/begin MEASUREMENT ZFFSAB._.TimeEGSOffIn.t_SystimeOldBuf "Contains the last valid system time read from the EEPROM at start" ULONG SAB_T_TIMER_1S_S2_S3 1 100 0 4294967295 DISPLAY_IDENTIFIER t_SystimeOldBuf.TimeEGSOffIn._.ZFFSAB ECU_ADDRESS 0xFFF97A84 /end MEASUREMENT
/begin MEASUREMENT ZFFSAB._.TimeEGSOffIn.f_TimeEGSOffCalculated "Flag for TimeEGSOff calculation (0=could not be done; 1=could be done)" UBYTE SAB_STANDARD_S2_S3 1 100 0 1 DISPLAY_IDENTIFIER f_TimeEGSOffCalculated.TimeEGSOffIn._.ZFFSAB ECU_ADDRESS 0xFFF97A88 /end MEASUREMENT
/begin MEASUREMENT ZFFSAB._.EEpromZentralHandler.eepromChannel[0].ZFFSAB._.cEEpromChannel._.cnt_GetEEpromValid "Call counter off function" UBYTE SAB_STANDARD_S2_S3 1 100 0 255 DISPLAY_IDENTIFIER cnt_GetEEpromValid._.cEEpromChannel._.ZFFSAB.eepromChannel[0].EEpromZentralHandler._.ZFFSAB ECU_ADDRESS 0xFFF97B28 /end MEASUREMENT
/begin MEASUREMENT ZFFSAB._.EEpromZentralHandler.eepromChannel[0].ZFFSAB._.cEEpromChannel._.ret_GetEEpromValid "Return value off function" UBYTE SAB_STANDARD_S2_S3 1 100 0 255 DISPLAY_IDENTIFIER ret_GetEEpromValid._.cEEpromChannel._.ZFFSAB.eepromChannel[0].EEpromZentralHandler._.ZFFSAB ECU_ADDRESS 0xFFF97B29 /end MEASUREMENT
/begin MEASUREMENT ZFFSAB._.EEpromZentralHandler.eepromChannel[0].ZFFSAB._.cEEpromChannel._.cnt_GetEEpromUpdate "Call counter off function" UBYTE SAB_STANDARD_S2_S3 1 100 0 255 DISPLAY_IDENTIFIER cnt_GetEEpromUpdate._.cEEpromChannel._.ZFFSAB.eepromChannel[0].EEpromZentralHandler._.ZFFSAB ECU_ADDRESS 0xFFF97B2A /end MEASUREMENT
/begin MEASUREMENT ZFFSAB._.EEpromZentralHandler.eepromChannel[0].ZFFSAB._.cEEpromChannel._.ret_GetEEpromUpdate "Return value off function" UBYTE SAB_STANDARD_S2_S3 1 100 0 255 DISPLAY_IDENTIFIER ret_GetEEpromUpdate._.cEEpromChannel._.ZFFSAB.eepromChannel[0].EEpromZentralHandler._.ZFFSAB ECU_ADDRESS 0xFFF97B2B /end MEASUREMENT
/begin MEASUREMENT ZFFSAB._.EEpromZentralHandler.eepromChannel[0].ZFFSAB._.cEEpromChannel._.cnt_SetEEpromInitZyklisch "Call counter off function" UBYTE SAB_STANDARD_S2_S3 1 100 0 255 DISPLAY_IDENTIFIER cnt_SetEEpromInitZyklisch._.cEEpromChannel._.ZFFSAB.eepromChannel[0].EEpromZentralHandler._.ZFFSAB ECU_ADDRESS 0xFFF97B2C /end MEASUREMENT
/begin MEASUREMENT ZFFSAB._.EEpromZentralHandler.eepromChannel[0].ZFFSAB._.cEEpromChannel._.ret_SetEEpromInitZyklisch "Return value off function" UBYTE SAB_STANDARD_S2_S3 1 100 0 255 DISPLAY_IDENTIFIER ret_SetEEpromInitZyklisch._.cEEpromChannel._.ZFFSAB.eepromChannel[0].EEpromZentralHandler._.ZFFSAB ECU_ADDRESS 0xFFF97B2D /end MEASUREMENT
/begin MEASUREMENT ZFFSAB._.EEpromZentralHandler.eepromChannel[0].ZFFSAB._.cEEpromChannel._.eeprom_info "argument of SetEEpromInitZyklisch" UBYTE SAB_STANDARD_S2_S3 1 100 0 255 DISPLAY_IDENTIFIER eeprom_info._.cEEpromChannel._.ZFFSAB.eepromChannel[0].EEpromZentralHandler._.ZFFSAB ECU_ADDRESS 0xFFF97B2E /end MEASUREMENT
/begin MEASUREMENT ZFFSAB._.EEpromZentralHandler.eepromChannel[0].ZFFSAB._.cEEpromChannel._.cnt_GetSizeofEEpromData "Call counter off function" UBYTE SAB_STANDARD_S2_S3 1 100 0 255 DISPLAY_IDENTIFIER cnt_GetSizeofEEpromData._.cEEpromChannel._.ZFFSAB.eepromChannel[0].EEpromZentralHandler._.ZFFSAB ECU_ADDRESS 0xFFF97B2F /end MEASUREMENT
/begin MEASUREMENT ZFFSAB._.EEpromZentralHandler.eepromChannel[0].ZFFSAB._.cEEpromChannel._.ret_GetSizeofEEpromData "Return value off function" UWORD SAB_STANDARD_S2_S3 1 100 0 65535 DISPLAY_IDENTIFIER ret_GetSizeofEEpromData._.cEEpromChannel._.ZFFSAB.eepromChannel[0].EEpromZentralHandler._.ZFFSAB ECU_ADDRESS 0xFFF97B30 /end MEASUREMENT
/begin MEASUREMENT ZFFSAB._.EEpromZentralHandler.eepromChannel[0].cnt_CallEEpromStoreImmediate "Call counter off function" UBYTE SAB_STANDARD_S2_S3 1 100 0 255 DISPLAY_IDENTIFIER cnt_CallEEpromStoreImmediate.eepromChannel[0].EEpromZentralHandler._.ZFFSAB ECU_ADDRESS 0xFFF97B32 /end MEASUREMENT
/begin MEASUREMENT ZFFSAB._.EEpromZentralHandler.eepromChannel[0].ret_CallEEpromStoreImmediate "Return value off function" UBYTE SAB_STANDARD_S2_S3 1 100 0 255 DISPLAY_IDENTIFIER ret_CallEEpromStoreImmediate.eepromChannel[0].EEpromZentralHandler._.ZFFSAB ECU_ADDRESS 0xFFF97B33 /end MEASUREMENT
/begin MEASUREMENT ZFFSAB._.EEpromZentralHandler.eepromChannel[0].cnt_CallEEpromLoadData "Call counter off function" UBYTE SAB_STANDARD_S2_S3 1 100 0 255 DISPLAY_IDENTIFIER cnt_CallEEpromLoadData.eepromChannel[0].EEpromZentralHandler._.ZFFSAB ECU_ADDRESS 0xFFF97B34 /end MEASUREMENT
/begin MEASUREMENT ZFFSAB._.EEpromZentralHandler.eepromChannel[0].ret_CallEEpromLoadData "Return value off function" UBYTE SAB_STANDARD_S2_S3 1 100 0 255 DISPLAY_IDENTIFIER ret_CallEEpromLoadData.eepromChannel[0].EEpromZentralHandler._.ZFFSAB ECU_ADDRESS 0xFFF97B35 /end MEASUREMENT
/begin MEASUREMENT ZFFSAB._.EEpromZentralHandler.eepromChannel[0].cnt_CallEEpromLoadDataState "Call counter off function" UBYTE SAB_STANDARD_S2_S3 1 100 0 255 DISPLAY_IDENTIFIER cnt_CallEEpromLoadDataState.eepromChannel[0].EEpromZentralHandler._.ZFFSAB ECU_ADDRESS 0xFFF97B36 /end MEASUREMENT
/begin MEASUREMENT ZFFSAB._.EEpromZentralHandler.eepromChannel[0].ret_CallEEpromLoadDataState "Return value off function" UBYTE SAB_STANDARD_S2_S3 1 100 0 255 DISPLAY_IDENTIFIER ret_CallEEpromLoadDataState.eepromChannel[0].EEpromZentralHandler._.ZFFSAB ECU_ADDRESS 0xFFF97B37 /end MEASUREMENT
/begin MEASUREMENT ZFFSAB._.EEpromZentralHandler.eepromChannel[0].mode "argument of SetEEpromInitZyklisch" UBYTE SAB_STANDARD_S2_S3 1 100 0 255 DISPLAY_IDENTIFIER mode.eepromChannel[0].EEpromZentralHandler._.ZFFSAB ECU_ADDRESS 0xFFF97B38 /end MEASUREMENT
/begin MEASUREMENT ZFFSAB._.EEpromZentralHandler.eepromChannel[0].cnt_SetEEpromWriteProtect "Call counter off function" UBYTE SAB_STANDARD_S2_S3 1 100 0 255 DISPLAY_IDENTIFIER cnt_SetEEpromWriteProtect.eepromChannel[0].EEpromZentralHandler._.ZFFSAB ECU_ADDRESS 0xFFF97B39 /end MEASUREMENT
/begin MEASUREMENT ZFFSAB._.EEpromZentralHandler.eepromChannel[10].ZFFSAB._.cEEpromChannel._.cnt_GetEEpromValid "Call counter off function" UBYTE SAB_STANDARD_S2_S3 1 100 0 255 DISPLAY_IDENTIFIER cnt_GetEEpromValid._.cEEpromChannel._.ZFFSAB.eepromChannel[10].EEpromZentralHandler._.ZFFSAB ECU_ADDRESS 0xFFF97BDC /end MEASUREMENT
/begin MEASUREMENT ZFFSAB._.EEpromZentralHandler.eepromChannel[10].ZFFSAB._.cEEpromChannel._.ret_GetEEpromValid "Return value off function" UBYTE SAB_STANDARD_S2_S3 1 100 0 255 DISPLAY_IDENTIFIER ret_GetEEpromValid._.cEEpromChannel._.ZFFSAB.eepromChannel[10].EEpromZentralHandler._.ZFFSAB ECU_ADDRESS 0xFFF97BDD /end MEASUREMENT
/begin MEASUREMENT ZFFSAB._.EEpromZentralHandler.eepromChannel[10].ZFFSAB._.cEEpromChannel._.cnt_GetEEpromUpdate "Call counter off function" UBYTE SAB_STANDARD_S2_S3 1 100 0 255 DISPLAY_IDENTIFIER cnt_GetEEpromUpdate._.cEEpromChannel._.ZFFSAB.eepromChannel[10].EEpromZentralHandler._.ZFFSAB ECU_ADDRESS 0xFFF97BDE /end MEASUREMENT
/begin MEASUREMENT ZFFSAB._.EEpromZentralHandler.eepromChannel[10].ZFFSAB._.cEEpromChannel._.ret_GetEEpromUpdate "Return value off function" UBYTE SAB_STANDARD_S2_S3 1 100 0 255 DISPLAY_IDENTIFIER ret_GetEEpromUpdate._.cEEpromChannel._.ZFFSAB.eepromChannel[10].EEpromZentralHandler._.ZFFSAB ECU_ADDRESS 0xFFF97BDF /end MEASUREMENT
/begin MEASUREMENT ZFFSAB._.EEpromZentralHandler.eepromChannel[10].ZFFSAB._.cEEpromChannel._.cnt_SetEEpromInitZyklisch "Call counter off function" UBYTE SAB_STANDARD_S2_S3 1 100 0 255 DISPLAY_IDENTIFIER cnt_SetEEpromInitZyklisch._.cEEpromChannel._.ZFFSAB.eepromChannel[10].EEpromZentralHandler._.ZFFSAB ECU_ADDRESS 0xFFF97BE0 /end MEASUREMENT
/begin MEASUREMENT ZFFSAB._.EEpromZentralHandler.eepromChannel[10].ZFFSAB._.cEEpromChannel._.ret_SetEEpromInitZyklisch "Return value off function" UBYTE SAB_STANDARD_S2_S3 1 100 0 255 DISPLAY_IDENTIFIER ret_SetEEpromInitZyklisch._.cEEpromChannel._.ZFFSAB.eepromChannel[10].EEpromZentralHandler._.ZFFSAB ECU_ADDRESS 0xFFF97BE1 /end MEASUREMENT
/begin MEASUREMENT ZFFSAB._.EEpromZentralHandler.eepromChannel[10].ZFFSAB._.cEEpromChannel._.eeprom_info "argument of SetEEpromInitZyklisch" UBYTE SAB_STANDARD_S2_S3 1 100 0 255 DISPLAY_IDENTIFIER eeprom_info._.cEEpromChannel._.ZFFSAB.eepromChannel[10].EEpromZentralHandler._.ZFFSAB ECU_ADDRESS 0xFFF97BE2 /end MEASUREMENT
/begin MEASUREMENT ZFFSAB._.EEpromZentralHandler.eepromChannel[10].ZFFSAB._.cEEpromChannel._.cnt_GetSizeofEEpromData "Call counter off function" UBYTE SAB_STANDARD_S2_S3 1 100 0 255 DISPLAY_IDENTIFIER cnt_GetSizeofEEpromData._.cEEpromChannel._.ZFFSAB.eepromChannel[10].EEpromZentralHandler._.ZFFSAB ECU_ADDRESS 0xFFF97BE3 /end MEASUREMENT
/begin MEASUREMENT ZFFSAB._.EEpromZentralHandler.eepromChannel[10].ZFFSAB._.cEEpromChannel._.ret_GetSizeofEEpromData "Return value off function" UWORD SAB_STANDARD_S2_S3 1 100 0 65535 DISPLAY_IDENTIFIER ret_GetSizeofEEpromData._.cEEpromChannel._.ZFFSAB.eepromChannel[10].EEpromZentralHandler._.ZFFSAB ECU_ADDRESS 0xFFF97BE4 /end MEASUREMENT
/begin MEASUREMENT ZFFSAB._.EEpromZentralHandler.eepromChannel[10].cnt_CallEEpromStoreImmediate "Call counter off function" UBYTE SAB_STANDARD_S2_S3 1 100 0 255 DISPLAY_IDENTIFIER cnt_CallEEpromStoreImmediate.eepromChannel[10].EEpromZentralHandler._.ZFFSAB ECU_ADDRESS 0xFFF97BE6 /end MEASUREMENT
/begin MEASUREMENT ZFFSAB._.EEpromZentralHandler.eepromChannel[10].ret_CallEEpromStoreImmediate "Return value off function" UBYTE SAB_STANDARD_S2_S3 1 100 0 255 DISPLAY_IDENTIFIER ret_CallEEpromStoreImmediate.eepromChannel[10].EEpromZentralHandler._.ZFFSAB ECU_ADDRESS 0xFFF97BE7 /end MEASUREMENT
/begin MEASUREMENT ZFFSAB._.EEpromZentralHandler.eepromChannel[10].cnt_CallEEpromLoadData "Call counter off function" UBYTE SAB_STANDARD_S2_S3 1 100 0 255 DISPLAY_IDENTIFIER cnt_CallEEpromLoadData.eepromChannel[10].EEpromZentralHandler._.ZFFSAB ECU_ADDRESS 0xFFF97BE8 /end MEASUREMENT
/begin MEASUREMENT ZFFSAB._.EEpromZentralHandler.eepromChannel[10].ret_CallEEpromLoadData "Return value off function" UBYTE SAB_STANDARD_S2_S3 1 100 0 255 DISPLAY_IDENTIFIER ret_CallEEpromLoadData.eepromChannel[10].EEpromZentralHandler._.ZFFSAB ECU_ADDRESS 0xFFF97BE9 /end MEASUREMENT
/begin MEASUREMENT ZFFSAB._.EEpromZentralHandler.eepromChannel[10].cnt_CallEEpromLoadDataState "Call counter off function" UBYTE SAB_STANDARD_S2_S3 1 100 0 255 DISPLAY_IDENTIFIER cnt_CallEEpromLoadDataState.eepromChannel[10].EEpromZentralHandler._.ZFFSAB ECU_ADDRESS 0xFFF97BEA /end MEASUREMENT
/begin MEASUREMENT ZFFSAB._.EEpromZentralHandler.eepromChannel[10].ret_CallEEpromLoadDataState "Return value off function" UBYTE SAB_STANDARD_S2_S3 1 100 0 255 DISPLAY_IDENTIFIER ret_CallEEpromLoadDataState.eepromChannel[10].EEpromZentralHandler._.ZFFSAB ECU_ADDRESS 0xFFF97BEB /end MEASUREMENT
/begin MEASUREMENT ZFFSAB._.EEpromZentralHandler.eepromChannel[10].mode "argument of SetEEpromInitZyklisch" UBYTE SAB_STANDARD_S2_S3 1 100 0 255 DISPLAY_IDENTIFIER mode.eepromChannel[10].EEpromZentralHandler._.ZFFSAB ECU_ADDRESS 0xFFF97BEC /end MEASUREMENT
/begin MEASUREMENT ZFFSAB._.EEpromZentralHandler.eepromChannel[10].cnt_SetEEpromWriteProtect "Call counter off function" UBYTE SAB_STANDARD_S2_S3 1 100 0 255 DISPLAY_IDENTIFIER cnt_SetEEpromWriteProtect.eepromChannel[10].EEpromZentralHandler._.ZFFSAB ECU_ADDRESS 0xFFF97BED /end MEASUREMENT
/begin MEASUREMENT ZFFSAB._.EEpromZentralHandler.eepromChannel[11].ZFFSAB._.cEEpromChannel._.cnt_GetEEpromValid "Call counter off function" UBYTE SAB_STANDARD_S2_S3 1 100 0 255 DISPLAY_IDENTIFIER cnt_GetEEpromValid._.cEEpromChannel._.ZFFSAB.eepromChannel[11].EEpromZentralHandler._.ZFFSAB ECU_ADDRESS 0xFFF97BEE /end MEASUREMENT
/begin MEASUREMENT ZFFSAB._.EEpromZentralHandler.eepromChannel[11].ZFFSAB._.cEEpromChannel._.ret_GetEEpromValid "Return value off function" UBYTE SAB_STANDARD_S2_S3 1 100 0 255 DISPLAY_IDENTIFIER ret_GetEEpromValid._.cEEpromChannel._.ZFFSAB.eepromChannel[11].EEpromZentralHandler._.ZFFSAB ECU_ADDRESS 0xFFF97BEF /end MEASUREMENT
/begin MEASUREMENT ZFFSAB._.EEpromZentralHandler.eepromChannel[11].ZFFSAB._.cEEpromChannel._.cnt_GetEEpromUpdate "Call counter off function" UBYTE SAB_STANDARD_S2_S3 1 100 0 255 DISPLAY_IDENTIFIER cnt_GetEEpromUpdate._.cEEpromChannel._.ZFFSAB.eepromChannel[11].EEpromZentralHandler._.ZFFSAB ECU_ADDRESS 0xFFF97BF0 /end MEASUREMENT
/begin MEASUREMENT ZFFSAB._.EEpromZentralHandler.eepromChannel[11].ZFFSAB._.cEEpromChannel._.ret_GetEEpromUpdate "Return value off function" UBYTE SAB_STANDARD_S2_S3 1 100 0 255 DISPLAY_IDENTIFIER ret_GetEEpromUpdate._.cEEpromChannel._.ZFFSAB.eepromChannel[11].EEpromZentralHandler._.ZFFSAB ECU_ADDRESS 0xFFF97BF1 /end MEASUREMENT
/begin MEASUREMENT ZFFSAB._.EEpromZentralHandler.eepromChannel[11].ZFFSAB._.cEEpromChannel._.cnt_SetEEpromInitZyklisch "Call counter off function" UBYTE SAB_STANDARD_S2_S3 1 100 0 255 DISPLAY_IDENTIFIER cnt_SetEEpromInitZyklisch._.cEEpromChannel._.ZFFSAB.eepromChannel[11].EEpromZentralHandler._.ZFFSAB ECU_ADDRESS 0xFFF97BF2 /end MEASUREMENT
/begin MEASUREMENT ZFFSAB._.EEpromZentralHandler.eepromChannel[11].ZFFSAB._.cEEpromChannel._.ret_SetEEpromInitZyklisch "Return value off function" UBYTE SAB_STANDARD_S2_S3 1 100 0 255 DISPLAY_IDENTIFIER ret_SetEEpromInitZyklisch._.cEEpromChannel._.ZFFSAB.eepromChannel[11].EEpromZentralHandler._.ZFFSAB ECU_ADDRESS 0xFFF97BF3 /end MEASUREMENT
/begin MEASUREMENT ZFFSAB._.EEpromZentralHandler.eepromChannel[11].ZFFSAB._.cEEpromChannel._.eeprom_info "argument of SetEEpromInitZyklisch" UBYTE SAB_STANDARD_S2_S3 1 100 0 255 DISPLAY_IDENTIFIER eeprom_info._.cEEpromChannel._.ZFFSAB.eepromChannel[11].EEpromZentralHandler._.ZFFSAB ECU_ADDRESS 0xFFF97BF4 /end MEASUREMENT
/begin MEASUREMENT ZFFSAB._.EEpromZentralHandler.eepromChannel[11].ZFFSAB._.cEEpromChannel._.cnt_GetSizeofEEpromData "Call counter off function" UBYTE SAB_STANDARD_S2_S3 1 100 0 255 DISPLAY_IDENTIFIER cnt_GetSizeofEEpromData._.cEEpromChannel._.ZFFSAB.eepromChannel[11].EEpromZentralHandler._.ZFFSAB ECU_ADDRESS 0xFFF97BF5 /end MEASUREMENT
/begin MEASUREMENT ZFFSAB._.EEpromZentralHandler.eepromChannel[11].ZFFSAB._.cEEpromChannel._.ret_GetSizeofEEpromData "Return value off function" UWORD SAB_STANDARD_S2_S3 1 100 0 65535 DISPLAY_IDENTIFIER ret_GetSizeofEEpromData._.cEEpromChannel._.ZFFSAB.eepromChannel[11].EEpromZentralHandler._.ZFFSAB ECU_ADDRESS 0xFFF97BF6 /end MEASUREMENT
/begin MEASUREMENT ZFFSAB._.EEpromZentralHandler.eepromChannel[11].cnt_CallEEpromStoreImmediate "Call counter off function" UBYTE SAB_STANDARD_S2_S3 1 100 0 255 DISPLAY_IDENTIFIER cnt_CallEEpromStoreImmediate.eepromChannel[11].EEpromZentralHandler._.ZFFSAB ECU_ADDRESS 0xFFF97BF8 /end MEASUREMENT
/begin MEASUREMENT ZFFSAB._.EEpromZentralHandler.eepromChannel[11].ret_CallEEpromStoreImmediate "Return value off function" UBYTE SAB_STANDARD_S2_S3 1 100 0 255 DISPLAY_IDENTIFIER ret_CallEEpromStoreImmediate.eepromChannel[11].EEpromZentralHandler._.ZFFSAB ECU_ADDRESS 0xFFF97BF9 /end MEASUREMENT
/begin MEASUREMENT ZFFSAB._.EEpromZentralHandler.eepromChannel[11].cnt_CallEEpromLoadData "Call counter off function" UBYTE SAB_STANDARD_S2_S3 1 100 0 255 DISPLAY_IDENTIFIER cnt_CallEEpromLoadData.eepromChannel[11].EEpromZentralHandler._.ZFFSAB ECU_ADDRESS 0xFFF97BFA /end MEASUREMENT
/begin MEASUREMENT ZFFSAB._.EEpromZentralHandler.eepromChannel[11].ret_CallEEpromLoadData "Return value off function" UBYTE SAB_STANDARD_S2_S3 1 100 0 255 DISPLAY_IDENTIFIER ret_CallEEpromLoadData.eepromChannel[11].EEpromZentralHandler._.ZFFSAB ECU_ADDRESS 0xFFF97BFB /end MEASUREMENT
/begin MEASUREMENT ZFFSAB._.EEpromZentralHandler.eepromChannel[11].cnt_CallEEpromLoadDataState "Call counter off function" UBYTE SAB_STANDARD_S2_S3 1 100 0 255 DISPLAY_IDENTIFIER cnt_CallEEpromLoadDataState.eepromChannel[11].EEpromZentralHandler._.ZFFSAB ECU_ADDRESS 0xFFF97BFC /end MEASUREMENT
/begin MEASUREMENT ZFFSAB._.EEpromZentralHandler.eepromChannel[11].ret_CallEEpromLoadDataState "Return value off function" UBYTE SAB_STANDARD_S2_S3 1 100 0 255 DISPLAY_IDENTIFIER ret_CallEEpromLoadDataState.eepromChannel[11].EEpromZentralHandler._.ZFFSAB ECU_ADDRESS 0xFFF97BFD /end MEASUREMENT
/begin MEASUREMENT ZFFSAB._.EEpromZentralHandler.eepromChannel[11].mode "argument of SetEEpromInitZyklisch" UBYTE SAB_STANDARD_S2_S3 1 100 0 255 DISPLAY_IDENTIFIER mode.eepromChannel[11].EEpromZentralHandler._.ZFFSAB ECU_ADDRESS 0xFFF97BFE /end MEASUREMENT
/begin MEASUREMENT ZFFSAB._.EEpromZentralHandler.eepromChannel[11].cnt_SetEEpromWriteProtect "Call counter off function" UBYTE SAB_STANDARD_S2_S3 1 100 0 255 DISPLAY_IDENTIFIER cnt_SetEEpromWriteProtect.eepromChannel[11].EEpromZentralHandler._.ZFFSAB ECU_ADDRESS 0xFFF97BFF /end MEASUREMENT
/begin MEASUREMENT ZFFSAB._.EEpromZentralHandler.eepromChannel[12].ZFFSAB._.cEEpromChannel._.cnt_GetEEpromValid "Call counter off function" UBYTE SAB_STANDARD_S2_S3 1 100 0 255 DISPLAY_IDENTIFIER cnt_GetEEpromValid._.cEEpromChannel._.ZFFSAB.eepromChannel[12].EEpromZentralHandler._.ZFFSAB ECU_ADDRESS 0xFFF97C00 /end MEASUREMENT
/begin MEASUREMENT ZFFSAB._.EEpromZentralHandler.eepromChannel[12].ZFFSAB._.cEEpromChannel._.ret_GetEEpromValid "Return value off function" UBYTE SAB_STANDARD_S2_S3 1 100 0 255 DISPLAY_IDENTIFIER ret_GetEEpromValid._.cEEpromChannel._.ZFFSAB.eepromChannel[12].EEpromZentralHandler._.ZFFSAB ECU_ADDRESS 0xFFF97C01 /end MEASUREMENT
/begin MEASUREMENT ZFFSAB._.EEpromZentralHandler.eepromChannel[12].ZFFSAB._.cEEpromChannel._.cnt_GetEEpromUpdate "Call counter off function" UBYTE SAB_STANDARD_S2_S3 1 100 0 255 DISPLAY_IDENTIFIER cnt_GetEEpromUpdate._.cEEpromChannel._.ZFFSAB.eepromChannel[12].EEpromZentralHandler._.ZFFSAB ECU_ADDRESS 0xFFF97C02 /end MEASUREMENT
/begin MEASUREMENT ZFFSAB._.EEpromZentralHandler.eepromChannel[12].ZFFSAB._.cEEpromChannel._.ret_GetEEpromUpdate "Return value off function" UBYTE SAB_STANDARD_S2_S3 1 100 0 255 DISPLAY_IDENTIFIER ret_GetEEpromUpdate._.cEEpromChannel._.ZFFSAB.eepromChannel[12].EEpromZentralHandler._.ZFFSAB ECU_ADDRESS 0xFFF97C03 /end MEASUREMENT
/begin MEASUREMENT ZFFSAB._.EEpromZentralHandler.eepromChannel[12].ZFFSAB._.cEEpromChannel._.cnt_SetEEpromInitZyklisch "Call counter off function" UBYTE SAB_STANDARD_S2_S3 1 100 0 255 DISPLAY_IDENTIFIER cnt_SetEEpromInitZyklisch._.cEEpromChannel._.ZFFSAB.eepromChannel[12].EEpromZentralHandler._.ZFFSAB ECU_ADDRESS 0xFFF97C04 /end MEASUREMENT
/begin MEASUREMENT ZFFSAB._.EEpromZentralHandler.eepromChannel[12].ZFFSAB._.cEEpromChannel._.ret_SetEEpromInitZyklisch "Return value off function" UBYTE SAB_STANDARD_S2_S3 1 100 0 255 DISPLAY_IDENTIFIER ret_SetEEpromInitZyklisch._.cEEpromChannel._.ZFFSAB.eepromChannel[12].EEpromZentralHandler._.ZFFSAB ECU_ADDRESS 0xFFF97C05 /end MEASUREMENT
/begin MEASUREMENT ZFFSAB._.EEpromZentralHandler.eepromChannel[12].ZFFSAB._.cEEpromChannel._.eeprom_info "argument of SetEEpromInitZyklisch" UBYTE SAB_STANDARD_S2_S3 1 100 0 255 DISPLAY_IDENTIFIER eeprom_info._.cEEpromChannel._.ZFFSAB.eepromChannel[12].EEpromZentralHandler._.ZFFSAB ECU_ADDRESS 0xFFF97C06 /end MEASUREMENT
/begin MEASUREMENT ZFFSAB._.EEpromZentralHandler.eepromChannel[12].ZFFSAB._.cEEpromChannel._.cnt_GetSizeofEEpromData "Call counter off function" UBYTE SAB_STANDARD_S2_S3 1 100 0 255 DISPLAY_IDENTIFIER cnt_GetSizeofEEpromData._.cEEpromChannel._.ZFFSAB.eepromChannel[12].EEpromZentralHandler._.ZFFSAB ECU_ADDRESS 0xFFF97C07 /end MEASUREMENT
/begin MEASUREMENT ZFFSAB._.EEpromZentralHandler.eepromChannel[12].ZFFSAB._.cEEpromChannel._.ret_GetSizeofEEpromData "Return value off function" UWORD SAB_STANDARD_S2_S3 1 100 0 65535 DISPLAY_IDENTIFIER ret_GetSizeofEEpromData._.cEEpromChannel._.ZFFSAB.eepromChannel[12].EEpromZentralHandler._.ZFFSAB ECU_ADDRESS 0xFFF97C08 /end MEASUREMENT
/begin MEASUREMENT ZFFSAB._.EEpromZentralHandler.eepromChannel[12].cnt_CallEEpromStoreImmediate "Call counter off function" UBYTE SAB_STANDARD_S2_S3 1 100 0 255 DISPLAY_IDENTIFIER cnt_CallEEpromStoreImmediate.eepromChannel[12].EEpromZentralHandler._.ZFFSAB ECU_ADDRESS 0xFFF97C0A /end MEASUREMENT
/begin MEASUREMENT ZFFSAB._.EEpromZentralHandler.eepromChannel[12].ret_CallEEpromStoreImmediate "Return value off function" UBYTE SAB_STANDARD_S2_S3 1 100 0 255 DISPLAY_IDENTIFIER ret_CallEEpromStoreImmediate.eepromChannel[12].EEpromZentralHandler._.ZFFSAB ECU_ADDRESS 0xFFF97C0B /end MEASUREMENT
/begin MEASUREMENT ZFFSAB._.EEpromZentralHandler.eepromChannel[12].cnt_CallEEpromLoadData "Call counter off function" UBYTE SAB_STANDARD_S2_S3 1 100 0 255 DISPLAY_IDENTIFIER cnt_CallEEpromLoadData.eepromChannel[12].EEpromZentralHandler._.ZFFSAB ECU_ADDRESS 0xFFF97C0C /end MEASUREMENT
/begin MEASUREMENT ZFFSAB._.EEpromZentralHandler.eepromChannel[12].ret_CallEEpromLoadData "Return value off function" UBYTE SAB_STANDARD_S2_S3 1 100 0 255 DISPLAY_IDENTIFIER ret_CallEEpromLoadData.eepromChannel[12].EEpromZentralHandler._.ZFFSAB ECU_ADDRESS 0xFFF97C0D /end MEASUREMENT
/begin MEASUREMENT ZFFSAB._.EEpromZentralHandler.eepromChannel[12].cnt_CallEEpromLoadDataState "Call counter off function" UBYTE SAB_STANDARD_S2_S3 1 100 0 255 DISPLAY_IDENTIFIER cnt_CallEEpromLoadDataState.eepromChannel[12].EEpromZentralHandler._.ZFFSAB ECU_ADDRESS 0xFFF97C0E /end MEASUREMENT
/begin MEASUREMENT ZFFSAB._.EEpromZentralHandler.eepromChannel[12].ret_CallEEpromLoadDataState "Return value off function" UBYTE SAB_STANDARD_S2_S3 1 100 0 255 DISPLAY_IDENTIFIER ret_CallEEpromLoadDataState.eepromChannel[12].EEpromZentralHandler._.ZFFSAB ECU_ADDRESS 0xFFF97C0F /end MEASUREMENT
/begin MEASUREMENT ZFFSAB._.EEpromZentralHandler.eepromChannel[12].mode "argument of SetEEpromInitZyklisch" UBYTE SAB_STANDARD_S2_S3 1 100 0 255 DISPLAY_IDENTIFIER mode.eepromChannel[12].EEpromZentralHandler._.ZFFSAB ECU_ADDRESS 0xFFF97C10 /end MEASUREMENT
/begin MEASUREMENT ZFFSAB._.EEpromZentralHandler.eepromChannel[12].cnt_SetEEpromWriteProtect "Call counter off function" UBYTE SAB_STANDARD_S2_S3 1 100 0 255 DISPLAY_IDENTIFIER cnt_SetEEpromWriteProtect.eepromChannel[12].EEpromZentralHandler._.ZFFSAB ECU_ADDRESS 0xFFF97C11 /end MEASUREMENT
/begin MEASUREMENT ZFFSAB._.EEpromZentralHandler.eepromChannel[13].ZFFSAB._.cEEpromChannel._.cnt_GetEEpromValid "Call counter off function" UBYTE SAB_STANDARD_S2_S3 1 100 0 255 DISPLAY_IDENTIFIER cnt_GetEEpromValid._.cEEpromChannel._.ZFFSAB.eepromChannel[13].EEpromZentralHandler._.ZFFSAB ECU_ADDRESS 0xFFF97C12 /end MEASUREMENT
/begin MEASUREMENT ZFFSAB._.EEpromZentralHandler.eepromChannel[13].ZFFSAB._.cEEpromChannel._.ret_GetEEpromValid "Return value off function" UBYTE SAB_STANDARD_S2_S3 1 100 0 255 DISPLAY_IDENTIFIER ret_GetEEpromValid._.cEEpromChannel._.ZFFSAB.eepromChannel[13].EEpromZentralHandler._.ZFFSAB ECU_ADDRESS 0xFFF97C13 /end MEASUREMENT
/begin MEASUREMENT ZFFSAB._.EEpromZentralHandler.eepromChannel[13].ZFFSAB._.cEEpromChannel._.cnt_GetEEpromUpdate "Call counter off function" UBYTE SAB_STANDARD_S2_S3 1 100 0 255 DISPLAY_IDENTIFIER cnt_GetEEpromUpdate._.cEEpromChannel._.ZFFSAB.eepromChannel[13].EEpromZentralHandler._.ZFFSAB ECU_ADDRESS 0xFFF97C14 /end MEASUREMENT
/begin MEASUREMENT ZFFSAB._.EEpromZentralHandler.eepromChannel[13].ZFFSAB._.cEEpromChannel._.ret_GetEEpromUpdate "Return value off function" UBYTE SAB_STANDARD_S2_S3 1 100 0 255 DISPLAY_IDENTIFIER ret_GetEEpromUpdate._.cEEpromChannel._.ZFFSAB.eepromChannel[13].EEpromZentralHandler._.ZFFSAB ECU_ADDRESS 0xFFF97C15 /end MEASUREMENT
/begin MEASUREMENT ZFFSAB._.EEpromZentralHandler.eepromChannel[13].ZFFSAB._.cEEpromChannel._.cnt_SetEEpromInitZyklisch "Call counter off function" UBYTE SAB_STANDARD_S2_S3 1 100 0 255 DISPLAY_IDENTIFIER cnt_SetEEpromInitZyklisch._.cEEpromChannel._.ZFFSAB.eepromChannel[13].EEpromZentralHandler._.ZFFSAB ECU_ADDRESS 0xFFF97C16 /end MEASUREMENT
/begin MEASUREMENT ZFFSAB._.EEpromZentralHandler.eepromChannel[13].ZFFSAB._.cEEpromChannel._.ret_SetEEpromInitZyklisch "Return value off function" UBYTE SAB_STANDARD_S2_S3 1 100 0 255 DISPLAY_IDENTIFIER ret_SetEEpromInitZyklisch._.cEEpromChannel._.ZFFSAB.eepromChannel[13].EEpromZentralHandler._.ZFFSAB ECU_ADDRESS 0xFFF97C17 /end MEASUREMENT
/begin MEASUREMENT ZFFSAB._.EEpromZentralHandler.eepromChannel[13].ZFFSAB._.cEEpromChannel._.eeprom_info "argument of SetEEpromInitZyklisch" UBYTE SAB_STANDARD_S2_S3 1 100 0 255 DISPLAY_IDENTIFIER eeprom_info._.cEEpromChannel._.ZFFSAB.eepromChannel[13].EEpromZentralHandler._.ZFFSAB ECU_ADDRESS 0xFFF97C18 /end MEASUREMENT
/begin MEASUREMENT ZFFSAB._.EEpromZentralHandler.eepromChannel[13].ZFFSAB._.cEEpromChannel._.cnt_GetSizeofEEpromData "Call counter off function" UBYTE SAB_STANDARD_S2_S3 1 100 0 255 DISPLAY_IDENTIFIER cnt_GetSizeofEEpromData._.cEEpromChannel._.ZFFSAB.eepromChannel[13].EEpromZentralHandler._.ZFFSAB ECU_ADDRESS 0xFFF97C19 /end MEASUREMENT
/begin MEASUREMENT ZFFSAB._.EEpromZentralHandler.eepromChannel[13].ZFFSAB._.cEEpromChannel._.ret_GetSizeofEEpromData "Return value off function" UWORD SAB_STANDARD_S2_S3 1 100 0 65535 DISPLAY_IDENTIFIER ret_GetSizeofEEpromData._.cEEpromChannel._.ZFFSAB.eepromChannel[13].EEpromZentralHandler._.ZFFSAB ECU_ADDRESS 0xFFF97C1A /end MEASUREMENT
/begin MEASUREMENT ZFFSAB._.EEpromZentralHandler.eepromChannel[13].cnt_CallEEpromStoreImmediate "Call counter off function" UBYTE SAB_STANDARD_S2_S3 1 100 0 255 DISPLAY_IDENTIFIER cnt_CallEEpromStoreImmediate.eepromChannel[13].EEpromZentralHandler._.ZFFSAB ECU_ADDRESS 0xFFF97C1C /end MEASUREMENT
/begin MEASUREMENT ZFFSAB._.EEpromZentralHandler.eepromChannel[13].ret_CallEEpromStoreImmediate "Return value off function" UBYTE SAB_STANDARD_S2_S3 1 100 0 255 DISPLAY_IDENTIFIER ret_CallEEpromStoreImmediate.eepromChannel[13].EEpromZentralHandler._.ZFFSAB ECU_ADDRESS 0xFFF97C1D /end MEASUREMENT
/begin MEASUREMENT ZFFSAB._.EEpromZentralHandler.eepromChannel[13].cnt_CallEEpromLoadData "Call counter off function" UBYTE SAB_STANDARD_S2_S3 1 100 0 255 DISPLAY_IDENTIFIER cnt_CallEEpromLoadData.eepromChannel[13].EEpromZentralHandler._.ZFFSAB ECU_ADDRESS 0xFFF97C1E /end MEASUREMENT
/begin MEASUREMENT ZFFSAB._.EEpromZentralHandler.eepromChannel[13].ret_CallEEpromLoadData "Return value off function" UBYTE SAB_STANDARD_S2_S3 1 100 0 255 DISPLAY_IDENTIFIER ret_CallEEpromLoadData.eepromChannel[13].EEpromZentralHandler._.ZFFSAB ECU_ADDRESS 0xFFF97C1F /end MEASUREMENT
/begin MEASUREMENT ZFFSAB._.EEpromZentralHandler.eepromChannel[13].cnt_CallEEpromLoadDataState "Call counter off function" UBYTE SAB_STANDARD_S2_S3 1 100 0 255 DISPLAY_IDENTIFIER cnt_CallEEpromLoadDataState.eepromChannel[13].EEpromZentralHandler._.ZFFSAB ECU_ADDRESS 0xFFF97C20 /end MEASUREMENT
/begin MEASUREMENT ZFFSAB._.EEpromZentralHandler.eepromChannel[13].ret_CallEEpromLoadDataState "Return value off function" UBYTE SAB_STANDARD_S2_S3 1 100 0 255 DISPLAY_IDENTIFIER ret_CallEEpromLoadDataState.eepromChannel[13].EEpromZentralHandler._.ZFFSAB ECU_ADDRESS 0xFFF97C21 /end MEASUREMENT
/begin MEASUREMENT ZFFSAB._.EEpromZentralHandler.eepromChannel[13].mode "argument of SetEEpromInitZyklisch" UBYTE SAB_STANDARD_S2_S3 1 100 0 255 DISPLAY_IDENTIFIER mode.eepromChannel[13].EEpromZentralHandler._.ZFFSAB ECU_ADDRESS 0xFFF97C22 /end MEASUREMENT
/begin MEASUREMENT ZFFSAB._.EEpromZentralHandler.eepromChannel[13].cnt_SetEEpromWriteProtect "Call counter off function" UBYTE SAB_STANDARD_S2_S3 1 100 0 255 DISPLAY_IDENTIFIER cnt_SetEEpromWriteProtect.eepromChannel[13].EEpromZentralHandler._.ZFFSAB ECU_ADDRESS 0xFFF97C23 /end MEASUREMENT
/begin MEASUREMENT ZFFSAB._.EEpromZentralHandler.eepromChannel[14].ZFFSAB._.cEEpromChannel._.cnt_GetEEpromValid "Call counter off function" UBYTE SAB_STANDARD_S2_S3 1 100 0 255 DISPLAY_IDENTIFIER cnt_GetEEpromValid._.cEEpromChannel._.ZFFSAB.eepromChannel[14].EEpromZentralHandler._.ZFFSAB ECU_ADDRESS 0xFFF97C24 /end MEASUREMENT
/begin MEASUREMENT ZFFSAB._.EEpromZentralHandler.eepromChannel[14].ZFFSAB._.cEEpromChannel._.cnt_GetEEpromUpdate "Call counter off function" UBYTE SAB_STANDARD_S2_S3 1 100 0 255 DISPLAY_IDENTIFIER cnt_GetEEpromUpdate._.cEEpromChannel._.ZFFSAB.eepromChannel[14].EEpromZentralHandler._.ZFFSAB ECU_ADDRESS 0xFFF97C26 /end MEASUREMENT
/begin MEASUREMENT ZFFSAB._.EEpromZentralHandler.eepromChannel[14].ZFFSAB._.cEEpromChannel._.ret_GetEEpromUpdate "Return value off function" UBYTE SAB_STANDARD_S2_S3 1 100 0 255 DISPLAY_IDENTIFIER ret_GetEEpromUpdate._.cEEpromChannel._.ZFFSAB.eepromChannel[14].EEpromZentralHandler._.ZFFSAB ECU_ADDRESS 0xFFF97C27 /end MEASUREMENT
/begin MEASUREMENT ZFFSAB._.EEpromZentralHandler.eepromChannel[14].ZFFSAB._.cEEpromChannel._.cnt_SetEEpromInitZyklisch "Call counter off function" UBYTE SAB_STANDARD_S2_S3 1 100 0 255 DISPLAY_IDENTIFIER cnt_SetEEpromInitZyklisch._.cEEpromChannel._.ZFFSAB.eepromChannel[14].EEpromZentralHandler._.ZFFSAB ECU_ADDRESS 0xFFF97C28 /end MEASUREMENT
/begin MEASUREMENT ZFFSAB._.EEpromZentralHandler.eepromChannel[14].ZFFSAB._.cEEpromChannel._.eeprom_info "argument of SetEEpromInitZyklisch" UBYTE SAB_STANDARD_S2_S3 1 100 0 255 DISPLAY_IDENTIFIER eeprom_info._.cEEpromChannel._.ZFFSAB.eepromChannel[14].EEpromZentralHandler._.ZFFSAB ECU_ADDRESS 0xFFF97C2A /end MEASUREMENT
/begin MEASUREMENT ZFFSAB._.EEpromZentralHandler.eepromChannel[14].ZFFSAB._.cEEpromChannel._.cnt_GetSizeofEEpromData "Call counter off function" UBYTE SAB_STANDARD_S2_S3 1 100 0 255 DISPLAY_IDENTIFIER cnt_GetSizeofEEpromData._.cEEpromChannel._.ZFFSAB.eepromChannel[14].EEpromZentralHandler._.ZFFSAB ECU_ADDRESS 0xFFF97C2B /end MEASUREMENT
/begin MEASUREMENT ZFFSAB._.EEpromZentralHandler.allEepromSummeryChannels.eepromSummaryChannel[0].cnt_GetEEpromValid "Call counter off function" UBYTE SAB_STANDARD_S2_S3 1 100 0 255 DISPLAY_IDENTIFIER cnt_GetEEpromValid.eepromSummaryChannel[0].allEepromSummeryChannels.EEpromZentralHandler._.ZFFSAB ECU_ADDRESS 0xFFF97FA8 /end MEASUREMENT
/begin MEASUREMENT ZFFSAB._.EEpromZentralHandler.allEepromSummeryChannels.eepromSummaryChannel[0].ret_GetEEpromValid "Return value off function" UBYTE SAB_STANDARD_S2_S3 1 100 0 255 DISPLAY_IDENTIFIER ret_GetEEpromValid.eepromSummaryChannel[0].allEepromSummeryChannels.EEpromZentralHandler._.ZFFSAB ECU_ADDRESS 0xFFF97FA9 /end MEASUREMENT
/begin MEASUREMENT ZFFSAB._.EEpromZentralHandler.allEepromSummeryChannels.eepromSummaryChannel[0].cnt_GetEEpromUpdate "Call counter off function" UBYTE SAB_STANDARD_S2_S3 1 100 0 255 DISPLAY_IDENTIFIER cnt_GetEEpromUpdate.eepromSummaryChannel[0].allEepromSummeryChannels.EEpromZentralHandler._.ZFFSAB ECU_ADDRESS 0xFFF97FAA /end MEASUREMENT
/begin MEASUREMENT ZFFSAB._.EEpromZentralHandler.allEepromSummeryChannels.eepromSummaryChannel[0].ret_GetEEpromUpdate "Return value off function" UBYTE SAB_STANDARD_S2_S3 1 100 0 255 DISPLAY_IDENTIFIER ret_GetEEpromUpdate.eepromSummaryChannel[0].allEepromSummeryChannels.EEpromZentralHandler._.ZFFSAB ECU_ADDRESS 0xFFF97FAB /end MEASUREMENT
/begin MEASUREMENT ZFFSAB._.EEpromZentralHandler.allEepromSummeryChannels.eepromSummaryChannel[0].cnt_SetEEpromInitZyklisch "Call counter off function" UBYTE SAB_STANDARD_S2_S3 1 100 0 255 DISPLAY_IDENTIFIER cnt_SetEEpromInitZyklisch.eepromSummaryChannel[0].allEepromSummeryChannels.EEpromZentralHandler._.ZFFSAB ECU_ADDRESS 0xFFF97FAC /end MEASUREMENT
/begin MEASUREMENT ZFFSAB._.EEpromZentralHandler.allEepromSummeryChannels.eepromSummaryChannel[0].ret_SetEEpromInitZyklisch "Return value off function" UBYTE SAB_STANDARD_S2_S3 1 100 0 255 DISPLAY_IDENTIFIER ret_SetEEpromInitZyklisch.eepromSummaryChannel[0].allEepromSummeryChannels.EEpromZentralHandler._.ZFFSAB ECU_ADDRESS 0xFFF97FAD /end MEASUREMENT
/begin MEASUREMENT ZFFSAB._.EEpromZentralHandler.allEepromSummeryChannels.eepromSummaryChannel[0].eeprom_info "argument of SetEEpromInitZyklisch" UBYTE SAB_STANDARD_S2_S3 1 100 0 255 DISPLAY_IDENTIFIER eeprom_info.eepromSummaryChannel[0].allEepromSummeryChannels.EEpromZentralHandler._.ZFFSAB ECU_ADDRESS 0xFFF97FAE /end MEASUREMENT
/begin MEASUREMENT ZFFSAB._.EEpromZentralHandler.allEepromSummeryChannels.eepromSummaryChannel[0].cnt_GetSizeofEEpromData "Call counter off function" UBYTE SAB_STANDARD_S2_S3 1 100 0 255 DISPLAY_IDENTIFIER cnt_GetSizeofEEpromData.eepromSummaryChannel[0].allEepromSummeryChannels.EEpromZentralHandler._.ZFFSAB ECU_ADDRESS 0xFFF97FAF /end MEASUREMENT
/begin MEASUREMENT ZFFSAB._.EEpromZentralHandler.allEepromSummeryChannels.eepromSummaryChannel[0].ret_GetSizeofEEpromData "Return value off function" UWORD SAB_STANDARD_S2_S3 1 100 0 65535 DISPLAY_IDENTIFIER ret_GetSizeofEEpromData.eepromSummaryChannel[0].allEepromSummeryChannels.EEpromZentralHandler._.ZFFSAB ECU_ADDRESS 0xFFF97FB0 /end MEASUREMENT
/begin MEASUREMENT ZFFSAB._.EEpromZentralHandler.allEepromSummeryChannels.eepromSummaryChannel[1].cnt_GetEEpromValid "Call counter off function" UBYTE SAB_STANDARD_S2_S3 1 100 0 255 DISPLAY_IDENTIFIER cnt_GetEEpromValid.eepromSummaryChannel[1].allEepromSummeryChannels.EEpromZentralHandler._.ZFFSAB ECU_ADDRESS 0xFFF97FB2 /end MEASUREMENT
/begin MEASUREMENT ZFFSAB._.EEpromZentralHandler.allEepromSummeryChannels.eepromSummaryChannel[1].ret_GetEEpromValid "Return value off function" UBYTE SAB_STANDARD_S2_S3 1 100 0 255 DISPLAY_IDENTIFIER ret_GetEEpromValid.eepromSummaryChannel[1].allEepromSummeryChannels.EEpromZentralHandler._.ZFFSAB ECU_ADDRESS 0xFFF97FB3 /end MEASUREMENT
/begin MEASUREMENT ZFFSAB._.EEpromZentralHandler.allEepromSummeryChannels.eepromSummaryChannel[1].cnt_GetEEpromUpdate "Call counter off function" UBYTE SAB_STANDARD_S2_S3 1 100 0 255 DISPLAY_IDENTIFIER cnt_GetEEpromUpdate.eepromSummaryChannel[1].allEepromSummeryChannels.EEpromZentralHandler._.ZFFSAB ECU_ADDRESS 0xFFF97FB4 /end MEASUREMENT
/begin MEASUREMENT ZFFSAB._.EEpromZentralHandler.allEepromSummeryChannels.eepromSummaryChannel[1].ret_GetEEpromUpdate "Return value off function" UBYTE SAB_STANDARD_S2_S3 1 100 0 255 DISPLAY_IDENTIFIER ret_GetEEpromUpdate.eepromSummaryChannel[1].allEepromSummeryChannels.EEpromZentralHandler._.ZFFSAB ECU_ADDRESS 0xFFF97FB5 /end MEASUREMENT
/begin MEASUREMENT ZFFSAB._.EEpromZentralHandler.allEepromSummeryChannels.eepromSummaryChannel[1].cnt_SetEEpromInitZyklisch "Call counter off function" UBYTE SAB_STANDARD_S2_S3 1 100 0 255 DISPLAY_IDENTIFIER cnt_SetEEpromInitZyklisch.eepromSummaryChannel[1].allEepromSummeryChannels.EEpromZentralHandler._.ZFFSAB ECU_ADDRESS 0xFFF97FB6 /end MEASUREMENT
/begin MEASUREMENT ZFFSAB._.EEpromZentralHandler.allEepromSummeryChannels.eepromSummaryChannel[1].ret_SetEEpromInitZyklisch "Return value off function" UBYTE SAB_STANDARD_S2_S3 1 100 0 255 DISPLAY_IDENTIFIER ret_SetEEpromInitZyklisch.eepromSummaryChannel[1].allEepromSummeryChannels.EEpromZentralHandler._.ZFFSAB ECU_ADDRESS 0xFFF97FB7 /end MEASUREMENT
/begin MEASUREMENT ZFFSAB._.EEpromZentralHandler.allEepromSummeryChannels.eepromSummaryChannel[1].eeprom_info "argument of SetEEpromInitZyklisch" UBYTE SAB_STANDARD_S2_S3 1 100 0 255 DISPLAY_IDENTIFIER eeprom_info.eepromSummaryChannel[1].allEepromSummeryChannels.EEpromZentralHandler._.ZFFSAB ECU_ADDRESS 0xFFF97FB8 /end MEASUREMENT
/begin MEASUREMENT ZFFSAB._.EEpromZentralHandler.allEepromSummeryChannels.eepromSummaryChannel[1].cnt_GetSizeofEEpromData "Call counter off function" UBYTE SAB_STANDARD_S2_S3 1 100 0 255 DISPLAY_IDENTIFIER cnt_GetSizeofEEpromData.eepromSummaryChannel[1].allEepromSummeryChannels.EEpromZentralHandler._.ZFFSAB ECU_ADDRESS 0xFFF97FB9 /end MEASUREMENT
/begin MEASUREMENT ZFFSAB._.EEpromZentralHandler.allEepromSummeryChannels.eepromSummaryChannel[1].ret_GetSizeofEEpromData "Return value off function" UWORD SAB_STANDARD_S2_S3 1 100 0 65535 DISPLAY_IDENTIFIER ret_GetSizeofEEpromData.eepromSummaryChannel[1].allEepromSummeryChannels.EEpromZentralHandler._.ZFFSAB ECU_ADDRESS 0xFFF97FBA /end MEASUREMENT
/begin MEASUREMENT ZFFSAB._.EEpromZentralHandler.allEepromSummeryChannels.eepromSummaryChannel[2].cnt_GetEEpromValid "Call counter off function" UBYTE SAB_STANDARD_S2_S3 1 100 0 255 DISPLAY_IDENTIFIER cnt_GetEEpromValid.eepromSummaryChannel[2].allEepromSummeryChannels.EEpromZentralHandler._.ZFFSAB ECU_ADDRESS 0xFFF97FBC /end MEASUREMENT
/begin MEASUREMENT ZFFSAB._.EEpromZentralHandler.allEepromSummeryChannels.eepromSummaryChannel[2].ret_GetEEpromValid "Return value off function" UBYTE SAB_STANDARD_S2_S3 1 100 0 255 DISPLAY_IDENTIFIER ret_GetEEpromValid.eepromSummaryChannel[2].allEepromSummeryChannels.EEpromZentralHandler._.ZFFSAB ECU_ADDRESS 0xFFF97FBD /end MEASUREMENT
/begin MEASUREMENT ZFFSAB._.EEpromZentralHandler.allEepromSummeryChannels.eepromSummaryChannel[2].cnt_GetEEpromUpdate "Call counter off function" UBYTE SAB_STANDARD_S2_S3 1 100 0 255 DISPLAY_IDENTIFIER cnt_GetEEpromUpdate.eepromSummaryChannel[2].allEepromSummeryChannels.EEpromZentralHandler._.ZFFSAB ECU_ADDRESS 0xFFF97FBE /end MEASUREMENT
/begin MEASUREMENT ZFFSAB._.EEpromZentralHandler.allEepromSummeryChannels.eepromSummaryChannel[2].ret_GetEEpromUpdate "Return value off function" UBYTE SAB_STANDARD_S2_S3 1 100 0 255 DISPLAY_IDENTIFIER ret_GetEEpromUpdate.eepromSummaryChannel[2].allEepromSummeryChannels.EEpromZentralHandler._.ZFFSAB ECU_ADDRESS 0xFFF97FBF /end MEASUREMENT
/begin MEASUREMENT ZFFSAB._.EEpromZentralHandler.allEepromSummeryChannels.eepromSummaryChannel[2].cnt_SetEEpromInitZyklisch "Call counter off function" UBYTE SAB_STANDARD_S2_S3 1 100 0 255 DISPLAY_IDENTIFIER cnt_SetEEpromInitZyklisch.eepromSummaryChannel[2].allEepromSummeryChannels.EEpromZentralHandler._.ZFFSAB ECU_ADDRESS 0xFFF97FC0 /end MEASUREMENT
/begin MEASUREMENT ZFFSAB._.EEpromZentralHandler.allEepromSummeryChannels.eepromSummaryChannel[2].ret_SetEEpromInitZyklisch "Return value off function" UBYTE SAB_STANDARD_S2_S3 1 100 0 255 DISPLAY_IDENTIFIER ret_SetEEpromInitZyklisch.eepromSummaryChannel[2].allEepromSummeryChannels.EEpromZentralHandler._.ZFFSAB ECU_ADDRESS 0xFFF97FC1 /end MEASUREMENT
/begin MEASUREMENT ZFFSAB._.EEpromZentralHandler.allEepromSummeryChannels.eepromSummaryChannel[2].eeprom_info "argument of SetEEpromInitZyklisch" UBYTE SAB_STANDARD_S2_S3 1 100 0 255 DISPLAY_IDENTIFIER eeprom_info.eepromSummaryChannel[2].allEepromSummeryChannels.EEpromZentralHandler._.ZFFSAB ECU_ADDRESS 0xFFF97FC2 /end MEASUREMENT
/begin MEASUREMENT ZFFSAB._.EEpromZentralHandler.allEepromSummeryChannels.eepromSummaryChannel[2].cnt_GetSizeofEEpromData "Call counter off function" UBYTE SAB_STANDARD_S2_S3 1 100 0 255 DISPLAY_IDENTIFIER cnt_GetSizeofEEpromData.eepromSummaryChannel[2].allEepromSummeryChannels.EEpromZentralHandler._.ZFFSAB ECU_ADDRESS 0xFFF97FC3 /end MEASUREMENT
/begin MEASUREMENT ZFFSAB._.EEpromZentralHandler.allEepromSummeryChannels.eepromSummaryChannel[2].ret_GetSizeofEEpromData "Return value off function" UWORD SAB_STANDARD_S2_S3 1 100 0 65535 DISPLAY_IDENTIFIER ret_GetSizeofEEpromData.eepromSummaryChannel[2].allEepromSummeryChannels.EEpromZentralHandler._.ZFFSAB ECU_ADDRESS 0xFFF97FC4 /end MEASUREMENT
/begin MEASUREMENT ZFFSAB._.EEpromZentralHandler.allEepromSummeryChannels.eepromSummaryChannel[3].cnt_GetEEpromValid "Call counter off function" UBYTE SAB_STANDARD_S2_S3 1 100 0 255 DISPLAY_IDENTIFIER cnt_GetEEpromValid.eepromSummaryChannel[3].allEepromSummeryChannels.EEpromZentralHandler._.ZFFSAB ECU_ADDRESS 0xFFF97FC6 /end MEASUREMENT
/begin MEASUREMENT ZFFSAB._.EEpromZentralHandler.allEepromSummeryChannels.eepromSummaryChannel[3].ret_GetEEpromValid "Return value off function" UBYTE SAB_STANDARD_S2_S3 1 100 0 255 DISPLAY_IDENTIFIER ret_GetEEpromValid.eepromSummaryChannel[3].allEepromSummeryChannels.EEpromZentralHandler._.ZFFSAB ECU_ADDRESS 0xFFF97FC7 /end MEASUREMENT
/begin MEASUREMENT ZFFSAB._.EEpromZentralHandler.allEepromSummeryChannels.eepromSummaryChannel[3].cnt_GetEEpromUpdate "Call counter off function" UBYTE SAB_STANDARD_S2_S3 1 100 0 255 DISPLAY_IDENTIFIER cnt_GetEEpromUpdate.eepromSummaryChannel[3].allEepromSummeryChannels.EEpromZentralHandler._.ZFFSAB ECU_ADDRESS 0xFFF97FC8 /end MEASUREMENT
/begin MEASUREMENT ZFFSAB._.EEpromZentralHandler.allEepromSummeryChannels.eepromSummaryChannel[3].ret_GetEEpromUpdate "Return value off function" UBYTE SAB_STANDARD_S2_S3 1 100 0 255 DISPLAY_IDENTIFIER ret_GetEEpromUpdate.eepromSummaryChannel[3].allEepromSummeryChannels.EEpromZentralHandler._.ZFFSAB ECU_ADDRESS 0xFFF97FC9 /end MEASUREMENT
/begin MEASUREMENT ZFFSAB._.EEpromZentralHandler.allEepromSummeryChannels.eepromSummaryChannel[3].cnt_SetEEpromInitZyklisch "Call counter off function" UBYTE SAB_STANDARD_S2_S3 1 100 0 255 DISPLAY_IDENTIFIER cnt_SetEEpromInitZyklisch.eepromSummaryChannel[3].allEepromSummeryChannels.EEpromZentralHandler._.ZFFSAB ECU_ADDRESS 0xFFF97FCA /end MEASUREMENT
/begin MEASUREMENT ZFFSAB._.EEpromZentralHandler.allEepromSummeryChannels.eepromSummaryChannel[3].ret_SetEEpromInitZyklisch "Return value off function" UBYTE SAB_STANDARD_S2_S3 1 100 0 255 DISPLAY_IDENTIFIER ret_SetEEpromInitZyklisch.eepromSummaryChannel[3].allEepromSummeryChannels.EEpromZentralHandler._.ZFFSAB ECU_ADDRESS 0xFFF97FCB /end MEASUREMENT
/begin MEASUREMENT ZFFSAB._.EEpromZentralHandler.allEepromSummeryChannels.eepromSummaryChannel[3].eeprom_info "argument of SetEEpromInitZyklisch" UBYTE SAB_STANDARD_S2_S3 1 100 0 255 DISPLAY_IDENTIFIER eeprom_info.eepromSummaryChannel[3].allEepromSummeryChannels.EEpromZentralHandler._.ZFFSAB ECU_ADDRESS 0xFFF97FCC /end MEASUREMENT
/begin MEASUREMENT ZFFSAB._.EEpromZentralHandler.allEepromSummeryChannels.eepromSummaryChannel[3].cnt_GetSizeofEEpromData "Call counter off function" UBYTE SAB_STANDARD_S2_S3 1 100 0 255 DISPLAY_IDENTIFIER cnt_GetSizeofEEpromData.eepromSummaryChannel[3].allEepromSummeryChannels.EEpromZentralHandler._.ZFFSAB ECU_ADDRESS 0xFFF97FCD /end MEASUREMENT
/begin MEASUREMENT ZFFSAB._.EEpromZentralHandler.allEepromSummeryChannels.eepromSummaryChannel[3].ret_GetSizeofEEpromData "Return value off function" UWORD SAB_STANDARD_S2_S3 1 100 0 65535 DISPLAY_IDENTIFIER ret_GetSizeofEEpromData.eepromSummaryChannel[3].allEepromSummeryChannels.EEpromZentralHandler._.ZFFSAB ECU_ADDRESS 0xFFF97FCE /end MEASUREMENT
/begin MEASUREMENT ZFFSAB._.EEpromZentralHandler.allEepromSummeryChannels.eepromSummaryChannel[4].cnt_GetEEpromValid "Call counter off function" UBYTE SAB_STANDARD_S2_S3 1 100 0 255 DISPLAY_IDENTIFIER cnt_GetEEpromValid.eepromSummaryChannel[4].allEepromSummeryChannels.EEpromZentralHandler._.ZFFSAB ECU_ADDRESS 0xFFF97FD0 /end MEASUREMENT
/begin MEASUREMENT ZFFSAB._.EEpromZentralHandler.allEepromSummeryChannels.eepromSummaryChannel[4].ret_GetEEpromValid "Return value off function" UBYTE SAB_STANDARD_S2_S3 1 100 0 255 DISPLAY_IDENTIFIER ret_GetEEpromValid.eepromSummaryChannel[4].allEepromSummeryChannels.EEpromZentralHandler._.ZFFSAB ECU_ADDRESS 0xFFF97FD1 /end MEASUREMENT
/begin MEASUREMENT ZFFSAB._.EEpromZentralHandler.allEepromSummeryChannels.eepromSummaryChannel[4].cnt_GetEEpromUpdate "Call counter off function" UBYTE SAB_STANDARD_S2_S3 1 100 0 255 DISPLAY_IDENTIFIER cnt_GetEEpromUpdate.eepromSummaryChannel[4].allEepromSummeryChannels.EEpromZentralHandler._.ZFFSAB ECU_ADDRESS 0xFFF97FD2 /end MEASUREMENT
/begin MEASUREMENT ZFFSAB._.EEpromZentralHandler.allEepromSummeryChannels.eepromSummaryChannel[4].ret_GetEEpromUpdate "Return value off function" UBYTE SAB_STANDARD_S2_S3 1 100 0 255 DISPLAY_IDENTIFIER ret_GetEEpromUpdate.eepromSummaryChannel[4].allEepromSummeryChannels.EEpromZentralHandler._.ZFFSAB ECU_ADDRESS 0xFFF97FD3 /end MEASUREMENT
/begin MEASUREMENT ZFFSAB._.EEpromZentralHandler.allEepromSummeryChannels.eepromSummaryChannel[4].cnt_SetEEpromInitZyklisch "Call counter off function" UBYTE SAB_STANDARD_S2_S3 1 100 0 255 DISPLAY_IDENTIFIER cnt_SetEEpromInitZyklisch.eepromSummaryChannel[4].allEepromSummeryChannels.EEpromZentralHandler._.ZFFSAB ECU_ADDRESS 0xFFF97FD4 /end MEASUREMENT
/begin MEASUREMENT ZFFSAB._.EEpromZentralHandler.allEepromSummeryChannels.eepromSummaryChannel[4].ret_SetEEpromInitZyklisch "Return value off function" UBYTE SAB_STANDARD_S2_S3 1 100 0 255 DISPLAY_IDENTIFIER ret_SetEEpromInitZyklisch.eepromSummaryChannel[4].allEepromSummeryChannels.EEpromZentralHandler._.ZFFSAB ECU_ADDRESS 0xFFF97FD5 /end MEASUREMENT
/begin MEASUREMENT ZFFSAB._.EEpromZentralHandler.allEepromSummeryChannels.eepromSummaryChannel[4].eeprom_info "argument of SetEEpromInitZyklisch" UBYTE SAB_STANDARD_S2_S3 1 100 0 255 DISPLAY_IDENTIFIER eeprom_info.eepromSummaryChannel[4].allEepromSummeryChannels.EEpromZentralHandler._.ZFFSAB ECU_ADDRESS 0xFFF97FD6 /end MEASUREMENT
/begin MEASUREMENT ZFFSAB._.EEpromZentralHandler.allEepromSummeryChannels.eepromSummaryChannel[4].cnt_GetSizeofEEpromData "Call counter off function" UBYTE SAB_STANDARD_S2_S3 1 100 0 255 DISPLAY_IDENTIFIER cnt_GetSizeofEEpromData.eepromSummaryChannel[4].allEepromSummeryChannels.EEpromZentralHandler._.ZFFSAB ECU_ADDRESS 0xFFF97FD7 /end MEASUREMENT
/begin MEASUREMENT ZFFSAB._.EEpromZentralHandler.allEepromSummeryChannels.eepromSummaryChannel[4].ret_GetSizeofEEpromData "Return value off function" UWORD SAB_STANDARD_S2_S3 1 100 0 65535 DISPLAY_IDENTIFIER ret_GetSizeofEEpromData.eepromSummaryChannel[4].allEepromSummeryChannels.EEpromZentralHandler._.ZFFSAB ECU_ADDRESS 0xFFF97FD8 /end MEASUREMENT
/begin COMPU_METHOD UMR_DREHMOMENT_1_1_0_S1_S3 "int = ((phys * 1) / 1) - (-32000) [Nm]" RAT_FUNC "%2.0" "[Nm]" COEFFS 0 1 32000 0 0 1 /end COMPU_METHOD
/begin COMPU_METHOD UMR_MBSE_MSEC_20_1_0_S1_S3 "Umrechnung von 20 msec in msec\\nint = ((phys * 1) / 20) - (0) msec" RAT_FUNC "%5.3" "msec" COEFFS 0 1 -0 0 0 20 /end COMPU_METHOD
/begin COMPU_METHOD UMR_MBSE_MSEC_30_1_0_S1_S3 "Umrechnung von 30 msec in msec\\nint = ((phys * 1) / 30) - (0) msec" RAT_FUNC "%5.3" "msec" COEFFS 0 1 -0 0 0 30 /end COMPU_METHOD
/begin COMPU_METHOD SAB_STANDARD_S2_S3 "int = ((phys * 1) / 1) - (0) -" RAT_FUNC "%2.0" "-" COEFFS 0 1 -0 0 0 1 /end COMPU_METHOD
/begin COMPU_METHOD SAB_PROZENT10_S2_S3 "int = ((phys * 10) / 1) - (0) %" RAT_FUNC "%5.3" "%" COEFFS 0 10 -0 0 0 1 /end COMPU_METHOD
/begin COMPU_METHOD SAB_PHI_SENS_1GRAD3_M128_S2_S3 "int = ((phys * 3) / 1) - (-128) grad" RAT_FUNC "%5.3" "grad" COEFFS 0 3 128 0 0 1 /end COMPU_METHOD
/begin COMPU_METHOD SAB_PHI_SENS_1GRAD20_M1280_S2_S3 "int = ((phys * 20) / 1) - (-1280) grad" RAT_FUNC "%5.3" "grad" COEFFS 0 20 1280 0 0 1 /end COMPU_METHOD
/begin COMPU_METHOD SAB_T_TIMER_1S_S2_S3 "int = ((phys * 1) / 1) - (0) s" RAT_FUNC "%2.0" "s" COEFFS 0 1 -0 0 0 1 /end COMPU_METHOD
/begin COMPU_METHOD SAB_N_1RPM_S2_S3 "int = ((phys * 1) / 1) - (0) 1/min" RAT_FUNC "%2.0" "1/min" COEFFS 0 1 -0 0 0 1 /end COMPU_METHOD
/begin COMPU_METHOD SAB_N_RPM_M2000_S2_S3 "int = ((phys * 1) / 1) - (-2000) 1/min" RAT_FUNC "%2.0" "1/min" COEFFS 0 1 2000 0 0 1 /end COMPU_METHOD
/begin COMPU_METHOD SAB_V_KMH10_S2_S3 "int = ((phys * 10) / 1) - (0) km/h" RAT_FUNC "%5.3" "km/h" COEFFS 0 10 -0 0 0 1 /end COMPU_METHOD
/begin COMPU_METHOD SAB_K1000_S2_S3 "int = ((phys * 1000) / 1) - (0) -" RAT_FUNC "%5.3" "-" COEFFS 0 1000 -0 0 0 1 /end COMPU_METHOD
/begin COMPU_METHOD SAB_M_1NM_M32000_S2_S3 "int = ((phys * 1) / 1) - (-32000) Nm" RAT_FUNC "%2.0" "Nm" COEFFS 0 1 32000 0 0 1 /end COMPU_METHOD
/begin COMPU_METHOD SAB_U_1VOLT1000_S2_S3 "int = ((phys * 1000) / 1) - (0) Volt" RAT_FUNC "%5.3" "Volt" COEFFS 0 1000 -0 0 0 1 /end COMPU_METHOD
/begin COMPU_METHOD SAB_U_VOLT1000_S2_S3 "int = ((phys * 1000) / 1) - (0) V" RAT_FUNC "%5.3" "V" COEFFS 0 1000 -0 0 0 1 /end COMPU_METHOD
/begin COMPU_METHOD SAB_PROZENT10_M2000_S2_S3 "int = ((phys * 10) / 1) - (-2000) %" RAT_FUNC "%5.3" "%" COEFFS 0 10 2000 0 0 1 /end COMPU_METHOD
/begin COMPU_METHOD SAB_M_20KG_S2_S3 "int = ((phys * 1) / 20) - (0) kg" RAT_FUNC "%5.3" "kg" COEFFS 0 1 -0 0 0 20 /end COMPU_METHOD
/begin FUNCTION zf_SAB_TurbineSpeedVirtualIn "desc_en"
 /begin LOC_MEASUREMENT ZFFSAB._.TurbineSpeedVirtualIn.SF_n4_ig ZFFSAB._.TurbineSpeedVirtualIn.SF_n4_zg ZFFSAB._.TurbineSpeedVirtualIn.f_VerschachtelungAktiv_ntOpt ZFFSAB._.TurbineSpeedVirtualIn.f_gangnachfuehrung_aktiv ZFFSAB._.TurbineSpeedVirtualIn.f_nulldurchgang_sv_n_Dif_IAE ZFFSAB._.TurbineSpeedVirtualIn.i_IstGang ZFFSAB._.TurbineSpeedVirtualIn.i_ZielGang ZFFSAB._.TurbineSpeedVirtualIn.iv_ActualGear ZFFSAB._.TurbineSpeedVirtualIn.iv_Pos ZFFSAB._.TurbineSpeedVirtualIn.iv_TargetGear ZFFSAB._.TurbineSpeedVirtualIn.iv_TargetGearInfo ZFFSAB._.TurbineSpeedVirtualIn.iv_in_Gear ZFFSAB._.TurbineSpeedVirtualIn.iv_kraftschluss ZFFSAB._.TurbineSpeedVirtualIn.iv_n6 ZFFSAB._.TurbineSpeedVirtualIn.iv_n6TuVirtFilt ZFFSAB._.TurbineSpeedVirtualIn.iv_n6TuVirtFiltSync ZFFSAB._.TurbineSpeedVirtualIn.iv_n6_Dir ZFFSAB._.TurbineSpeedVirtualIn.iv_st_IAE ZFFSAB._.TurbineSpeedVirtualIn.iv_z_modus_IAE ZFFSAB._.TurbineSpeedVirtualIn.k_n6 ZFFSAB._.TurbineSpeedVirtualIn.k_nab ZFFSAB._.TurbineSpeedVirtualIn.k_nmot ZFFSAB._.TurbineSpeedVirtualIn.n_TuVirtOptSts ZFFSAB._.TurbineSpeedVirtualIn.pos_fl ZFFSAB._.TurbineSpeedVirtualIn.sv_n6 ZFFSAB._.TurbineSpeedVirtualIn.sv_n6_Sts ZFFSAB._.TurbineSpeedVirtualIn.sv_n_AbTuVirtFilt ZFFSAB._.TurbineSpeedVirtualIn.sv_n_AbTuVirtFiltSync ZFFSAB._.TurbineSpeedVirtualIn.sv_n_Ab_Dir ZFFSAB._.TurbineSpeedVirtualIn.sv_n_Dif_IAE ZFFSAB._.TurbineSpeedVirtualIn.sv_n_Dif_IAEFilt ZFFSAB._.TurbineSpeedVirtualIn.sv_n_Dif_IAEOpt ZFFSAB._.TurbineSpeedVirtualIn.sv_n_Dif_IAE_Dir ZFFSAB._.TurbineSpeedVirtualIn.sv_n_Dif_IAE_Dir_alt ZFFSAB._.TurbineSpeedVirtualIn.sv_n_Dif_IAE_virt ZFFSAB._.TurbineSpeedVirtualIn.sv_n_Dif_IAE_virt_Dir ZFFSAB._.TurbineSpeedVirtualIn.sv_n_Dif_IAE_virt_DirSts ZFFSAB._.TurbineSpeedVirtualIn.sv_n_Dif_IAE_virt_Dir_alt ZFFSAB._.TurbineSpeedVirtualIn.sv_n_EngTuVirtFilt ZFFSAB._.TurbineSpeedVirtualIn.sv_n_EngTuVirtFiltSync ZFFSAB._.TurbineSpeedVirtualIn.sv_n_TuVirt ZFFSAB._.TurbineSpeedVirtualIn.sv_n_TuVirtOpt ZFFSAB._.TurbineSpeedVirtualIn.sv_n_TuVirtVz ZFFSAB._.TurbineSpeedVirtualIn.sv_n_TuVirtVzFilt ZFFSAB._.TurbineSpeedVirtualIn.sv_n_TuVirt_Dir /end LOC_MEASUREMENT
/end FUNCTION
/begin FUNCTION zf_SAB_TurbineSpeedIn "desc_en"
 /begin LOC_MEASUREMENT ZFFSAB._.TurbineSpeedIn.Ab_sts_DirectionDiag ZFFSAB._.TurbineSpeedIn.Tu_f_DirectionErr ZFFSAB._.TurbineSpeedIn.Tu_sts_DirectionDiag ZFFSAB._.TurbineSpeedIn.TurbineSpeedIn_Fl.Tu_f_DirectionErr ZFFSAB._.TurbineSpeedIn.TurbineSpeedIn_Fl.f_OverallPlausiState ZFFSAB._.TurbineSpeedIn.TurbineSpeedIn_Fl.f_n_TuPlausiErr ZFFSAB._.TurbineSpeedIn.TurbineSpeedIn_Fl.f_n_Tu_PlausiErr_active ZFFSAB._.TurbineSpeedIn.TurbineSpeedIn_Fl.f_n_Tu_PlausiErr_active_ ZFFSAB._.TurbineSpeedIn.TurbineSpeedIn_Fl.iv_n_Tu ZFFSAB._.TurbineSpeedIn.TurbineSpeedIn_Fl.iv_n_TuESts ZFFSAB._.TurbineSpeedIn.TurbineSpeedIn_Fl.iv_n_TuESts_ ZFFSAB._.TurbineSpeedIn.TurbineSpeedIn_Fl.iv_n_Tu_ ZFFSAB._.TurbineSpeedIn.TurbineSpeedIn_Fl.iv_u_SensESts ZFFSAB._.TurbineSpeedIn.TurbineSpeedIn_Fl.iv_u_SensESts_ ZFFSAB._.TurbineSpeedIn.TurbineSpeedIn_Fl.n_EngLev2TSI ZFFSAB._.TurbineSpeedIn.TurbineSpeedIn_Fl.n_EngLev2TSISts ZFFSAB._.TurbineSpeedIn.TurbineSpeedIn_Fl.n_Tu_Filt2 ZFFSAB._.TurbineSpeedIn.TurbineSpeedIn_Fl.n_Tu_Filt_CAN ZFFSAB._.TurbineSpeedIn.TurbineSpeedIn_Fl.n_Tu_detected ZFFSAB._.TurbineSpeedIn.TurbineSpeedIn_Fl.sv_n_TuLev2 ZFFSAB._.TurbineSpeedIn.TurbineSpeedIn_Fl.sv_n_TuLev2Sts ZFFSAB._.TurbineSpeedIn.f_OverallPlausiState ZFFSAB._.TurbineSpeedIn.f_n_TuPlausiErr ZFFSAB._.TurbineSpeedIn.f_n_Tu_PlausiErr_active ZFFSAB._.TurbineSpeedIn.f_n_Tu_PlausiErr_active_ ZFFSAB._.TurbineSpeedIn.iv_n_Tu ZFFSAB._.TurbineSpeedIn.iv_n_TuESts ZFFSAB._.TurbineSpeedIn.iv_n_TuESts_ ZFFSAB._.TurbineSpeedIn.iv_n_Tu_ ZFFSAB._.TurbineSpeedIn.iv_u_SensESts ZFFSAB._.TurbineSpeedIn.iv_u_SensESts_ ZFFSAB._.TurbineSpeedIn.n_EngLev2TSI ZFFSAB._.TurbineSpeedIn.n_EngLev2TSISts ZFFSAB._.TurbineSpeedIn.n_EngLev2TSISts_ ZFFSAB._.TurbineSpeedIn.n_EngLev2TSI_ ZFFSAB._.TurbineSpeedIn.n_TuSts_ ZFFSAB._.TurbineSpeedIn.n_Tu_ ZFFSAB._.TurbineSpeedIn.n_Tu_Filt2 ZFFSAB._.TurbineSpeedIn.n_Tu_Filt2_ ZFFSAB._.TurbineSpeedIn.n_Tu_Filt_CAN ZFFSAB._.TurbineSpeedIn.n_Tu_Filt_CAN_ ZFFSAB._.TurbineSpeedIn.n_Tu_detected ZFFSAB._.TurbineSpeedIn.n_Tu_detected_ ZFFSAB._.TurbineSpeedIn.sv_Tu_sts_Direction ZFFSAB._.TurbineSpeedIn.sv_Tu_sts_DirectionSts ZFFSAB._.TurbineSpeedIn.sv_n_Tu ZFFSAB._.TurbineSpeedIn.sv_n_TuFilt ZFFSAB._.TurbineSpeedIn.sv_n_TuLev2 ZFFSAB._.TurbineSpeedIn.sv_n_TuLev2Sts ZFFSAB._.TurbineSpeedIn.sv_n_TuLev2Sts_ ZFFSAB._.TurbineSpeedIn.sv_n_TuLev2_ ZFFSAB._.TurbineSpeedIn.sv_n_TuSts ZFFSAB._.TurbineSpeedIn.sv_n_Tu_Tx ZFFSAB._.TurbineSpeedIn.sv_n_Tu_Tx_ /end LOC_MEASUREMENT
/end FUNCTION
/begin FUNCTION zf_SAB_ParklockStatusIn "desc_en"
 /begin LOC_MEASUREMENT ZFFSAB._.ParklockStatusIn.f_EmfPErr ZFFSAB._.ParklockStatusIn.iv_EmfP ZFFSAB._.ParklockStatusIn.iv_EmfPSts ZFFSAB._.ParklockStatusIn.sv_EmfP ZFFSAB._.ParklockStatusIn.sv_EmfPSts /end LOC_MEASUREMENT
/end FUNCTION
/begin FUNCTION zf_SAB_ParklockSensorIn "desc_en"
 /begin LOC_MEASUREMENT ZFFSAB._.ParklockSensorIn.PSensFaultInfo ZFFSAB._.ParklockSensorIn.PSensFaultInfo_ ZFFSAB._.ParklockSensorIn.iv_PSens1 ZFFSAB._.ParklockSensorIn.iv_PSens1FaultInfo ZFFSAB._.ParklockSensorIn.iv_PSens1FaultInfo_ ZFFSAB._.ParklockSensorIn.iv_PSens1_ ZFFSAB._.ParklockSensorIn.iv_PSens2 ZFFSAB._.ParklockSensorIn.iv_PSens2FaultInfo ZFFSAB._.ParklockSensorIn.iv_PSens2FaultInfo_ ZFFSAB._.ParklockSensorIn.iv_PSens2_ ZFFSAB._.ParklockSensorIn.iv_u_SensESts ZFFSAB._.ParklockSensorIn.iv_u_SensESts_ ZFFSAB._.ParklockSensorIn.sv_PSens ZFFSAB._.ParklockSensorIn.sv_PSensSts ZFFSAB._.ParklockSensorIn.sv_PSensSts_ ZFFSAB._.ParklockSensorIn.sv_PSens_ /end LOC_MEASUREMENT
/end FUNCTION
/begin FUNCTION zf_SAB_TractionControlIn "desc_en"
 /begin LOC_MEASUREMENT ZFFSAB._.TractionControlIn.f_EingriffTraktionErr ZFFSAB._.TractionControlIn.iv_EingriffTraktion ZFFSAB._.TractionControlIn.iv_EingriffTraktionSts ZFFSAB._.TractionControlIn.sv_AGS_EingriffTraktion ZFFSAB._.TractionControlIn.sv_EingriffTraktionSts /end LOC_MEASUREMENT
/end FUNCTION
/begin FUNCTION zf_SAB_DoorStatusIn "desc_en"
 /begin LOC_MEASUREMENT ZFFSAB._.DoorStatusIn.f_DoorDErr ZFFSAB._.DoorStatusIn.iv_DoorD ZFFSAB._.DoorStatusIn.iv_DoorD2 ZFFSAB._.DoorStatusIn.iv_DoorD2Sts ZFFSAB._.DoorStatusIn.iv_DoorDSts ZFFSAB._.DoorStatusIn.sv_DoorDSts ZFFSAB._.DoorStatusIn.sv_f_DoorD /end LOC_MEASUREMENT
/end FUNCTION
/begin FUNCTION zf_SAB_SpeedometerSpeedIn "desc_en"
 /begin LOC_MEASUREMENT ZFFSAB._.SpeedometerSpeedIn.f_v_SpeedometerErr ZFFSAB._.SpeedometerSpeedIn.iv_v_Speedometer ZFFSAB._.SpeedometerSpeedIn.iv_v_SpeedometerSts ZFFSAB._.SpeedometerSpeedIn.sv_v_Speedometer ZFFSAB._.SpeedometerSpeedIn.sv_v_SpeedometerSts /end LOC_MEASUREMENT
/end FUNCTION
/begin FUNCTION zf_SAB_InclinationIn "desc_en"
 /begin LOC_MEASUREMENT ZFFSAB._.InclinationIn.f_SensErr ZFFSAB._.InclinationIn.iv_Sens ZFFSAB._.InclinationIn.iv_SensErr ZFFSAB._.InclinationIn.iv_SensSts ZFFSAB._.InclinationIn.sv_AGS_Acclivity ZFFSAB._.InclinationIn.sv_Sens ZFFSAB._.InclinationIn.sv_SensSts /end LOC_MEASUREMENT
/end FUNCTION
/begin FUNCTION zf_SAB_GearLeverIn "desc_en"
 /begin LOC_MEASUREMENT ZFFSAB._.GearLeverIn.GLI_SWI_LeverType ZFFSAB._.GearLeverIn.P1Act ZFFSAB._.GearLeverIn.P1Sts ZFFSAB._.GearLeverIn.P1_Raw ZFFSAB._.GearLeverIn.P2Act ZFFSAB._.GearLeverIn.P2Sts ZFFSAB._.GearLeverIn.P2_Raw ZFFSAB._.GearLeverIn.P_Raw ZFFSAB._.GearLeverIn.P_Raw_ ZFFSAB._.GearLeverIn.Pos ZFFSAB._.GearLeverIn.PosS1Raw ZFFSAB._.GearLeverIn.PosS1Raw_ ZFFSAB._.GearLeverIn.PosS2Raw ZFFSAB._.GearLeverIn.PosS2Raw_ ZFFSAB._.GearLeverIn.Pos_ ZFFSAB._.GearLeverIn.iv_P1S1Raw ZFFSAB._.GearLeverIn.iv_P1S2Raw ZFFSAB._.GearLeverIn.iv_P2S1Raw ZFFSAB._.GearLeverIn.iv_P2S2Raw ZFFSAB._.GearLeverIn.iv_PS1_Raw ZFFSAB._.GearLeverIn.iv_PS1_Raw_ ZFFSAB._.GearLeverIn.iv_PS2_Raw ZFFSAB._.GearLeverIn.iv_PS2_Raw_ ZFFSAB._.GearLeverIn.iv_PosAbsS1Raw ZFFSAB._.GearLeverIn.iv_PosAbsS1Raw_ ZFFSAB._.GearLeverIn.iv_PosAbsS2Raw ZFFSAB._.GearLeverIn.iv_PosAbsS2Raw_ ZFFSAB._.GearLeverIn.iv_PosRelS1Raw ZFFSAB._.GearLeverIn.iv_PosRelS1Raw_ ZFFSAB._.GearLeverIn.iv_PosRelS2Raw ZFFSAB._.GearLeverIn.iv_PosRelS2Raw_ ZFFSAB._.GearLeverIn.iv_PosS1RawSts ZFFSAB._.GearLeverIn.iv_PosS1RawSts_ ZFFSAB._.GearLeverIn.iv_PosS2RawSts ZFFSAB._.GearLeverIn.iv_PosS2RawSts_ ZFFSAB._.GearLeverIn.sv_AGS_LeverPos ZFFSAB._.GearLeverIn.sv_CtrlSignalSource ZFFSAB._.GearLeverIn.sv_CtrlSignalSourceSts ZFFSAB._.GearLeverIn.sv_CtrlSignalSourceSts_ ZFFSAB._.GearLeverIn.sv_GatePosition ZFFSAB._.GearLeverIn.sv_GatePosition_ ZFFSAB._.GearLeverIn.sv_PosRaw ZFFSAB._.GearLeverIn.sv_PosRaw_ ZFFSAB._.GearLeverIn.sv_SWILeverType ZFFSAB._.GearLeverIn.sv_SWILeverTypeKomp ZFFSAB._.GearLeverIn.sv_SWISignalSource ZFFSAB._.GearLeverIn.sv_f_P12BadOpRaw ZFFSAB._.GearLeverIn.sv_f_P12Button ZFFSAB._.GearLeverIn.sv_f_P12Button_ ZFFSAB._.GearLeverIn.sv_f_P12OneErr ZFFSAB._.GearLeverIn.sv_f_P12TwoErr ZFFSAB._.GearLeverIn.sv_f_PosS1Err ZFFSAB._.GearLeverIn.sv_f_PosS2Err ZFFSAB._.GearLeverIn.sv_f_SD_Button ZFFSAB._.GearLeverIn.sv_f_TipMinusSBWErr ZFFSAB._.GearLeverIn.sv_f_TipMinusSBW_Raw ZFFSAB._.GearLeverIn.sv_f_TipMinusSBW_Raw_ ZFFSAB._.GearLeverIn.sv_f_TipPlusSBW_Raw ZFFSAB._.GearLeverIn.sv_f_TipPlusSBW_Raw_ /end LOC_MEASUREMENT
/end FUNCTION
/begin FUNCTION zf_SAB_SportButtonIn "desc_en"
 /begin LOC_MEASUREMENT ZFFSAB._.SportButtonIn.iv_DriveLogicRaw ZFFSAB._.SportButtonIn.iv_DriveLogicRawSts ZFFSAB._.SportButtonIn.iv_DriveLogicS1 ZFFSAB._.SportButtonIn.iv_DriveLogicS2 ZFFSAB._.SportButtonIn.iv_DriveLogicStsS1 ZFFSAB._.SportButtonIn.iv_DriveLogicStsS2 ZFFSAB._.SportButtonIn.iv_GWS_S_ButtonRaw ZFFSAB._.SportButtonIn.iv_GWS_S_ButtonRawSts ZFFSAB._.SportButtonIn.iv_GWS_S_ButtonS1 ZFFSAB._.SportButtonIn.iv_GWS_S_ButtonS2 ZFFSAB._.SportButtonIn.iv_GWS_S_ButtonStsS1 ZFFSAB._.SportButtonIn.iv_GWS_S_ButtonStsS2 ZFFSAB._.SportButtonIn.iv_ICM_S_ButtonRaw ZFFSAB._.SportButtonIn.iv_ICM_S_ButtonRawSts ZFFSAB._.SportButtonIn.sv_DriveDynamics ZFFSAB._.SportButtonIn.sv_DriveDynamicsSts ZFFSAB._.SportButtonIn.sv_DriveLogic ZFFSAB._.SportButtonIn.sv_SWI_GWS_Dlg ZFFSAB._.SportButtonIn.sv_SWI_GWS_S_Btn ZFFSAB._.SportButtonIn.sv_S_Button /end LOC_MEASUREMENT
/end FUNCTION
/begin FUNCTION zf_SAB_VoltageMonitoringOut "desc_en"
 /begin LOC_MEASUREMENT ZFFSAB._.VoltageMonitoringOut.f_DiagActive_UBATTL ZFFSAB._.VoltageMonitoringOut.f_DiagActive_UBATTU ZFFSAB._.VoltageMonitoringOut.iv_Pos ZFFSAB._.VoltageMonitoringOut.iv_fet0_active ZFFSAB._.VoltageMonitoringOut.iv_u_Batt_Diag ZFFSAB._.VoltageMonitoringOut.sv_f_FET1 ZFFSAB._.VoltageMonitoringOut.sv_f_FET2 ZFFSAB._.VoltageMonitoringOut.sv_f_GetUndervoltageTC ZFFSAB._.VoltageMonitoringOut.sv_f_JumpstartAktiv ZFFSAB._.VoltageMonitoringOut.sv_sts_EDSMV /end LOC_MEASUREMENT
/end FUNCTION
/begin FUNCTION zf_SAB_CAN_Handling "desc_en"
 /begin LOC_MEASUREMENT ZFFSAB._.CAN_Handling.CANMsg[0].Status ZFFSAB._.CAN_Handling.CANMsg[10].Status ZFFSAB._.CAN_Handling.CANMsg[11].Status ZFFSAB._.CAN_Handling.CANMsg[12].Status ZFFSAB._.CAN_Handling.CANMsg[13].Status ZFFSAB._.CAN_Handling.CANMsg[14].Status ZFFSAB._.CAN_Handling.CANMsg[15].Status ZFFSAB._.CAN_Handling.CANMsg[16].Status ZFFSAB._.CAN_Handling.CANMsg[17].Status ZFFSAB._.CAN_Handling.CANMsg[18].Status ZFFSAB._.CAN_Handling.CANMsg[19].Status ZFFSAB._.CAN_Handling.CANMsg[1].Status ZFFSAB._.CAN_Handling.CANMsg[20].Status ZFFSAB._.CAN_Handling.CANMsg[21].Status ZFFSAB._.CAN_Handling.CANMsg[22].Status ZFFSAB._.CAN_Handling.CANMsg[23].Status ZFFSAB._.CAN_Handling.CANMsg[24].Status ZFFSAB._.CAN_Handling.CANMsg[25].Status ZFFSAB._.CAN_Handling.CANMsg[26].Status ZFFSAB._.CAN_Handling.CANMsg[27].Status ZFFSAB._.CAN_Handling.CANMsg[28].Status ZFFSAB._.CAN_Handling.CANMsg[29].Status ZFFSAB._.CAN_Handling.CANMsg[2].Status ZFFSAB._.CAN_Handling.CANMsg[30].Status ZFFSAB._.CAN_Handling.CANMsg[31].Status ZFFSAB._.CAN_Handling.CANMsg[32].Status ZFFSAB._.CAN_Handling.CANMsg[33].Status ZFFSAB._.CAN_Handling.CANMsg[34].Status ZFFSAB._.CAN_Handling.CANMsg[35].Status ZFFSAB._.CAN_Handling.CANMsg[36].Status ZFFSAB._.CAN_Handling.CANMsg[37].Status ZFFSAB._.CAN_Handling.CANMsg[38].Status ZFFSAB._.CAN_Handling.CANMsg[39].Status ZFFSAB._.CAN_Handling.CANMsg[3].Status ZFFSAB._.CAN_Handling.CANMsg[40].Status ZFFSAB._.CAN_Handling.CANMsg[41].Status ZFFSAB._.CAN_Handling.CANMsg[42].Status ZFFSAB._.CAN_Handling.CANMsg[43].Status ZFFSAB._.CAN_Handling.CANMsg[44].Status ZFFSAB._.CAN_Handling.CANMsg[45].Status ZFFSAB._.CAN_Handling.CANMsg[46].Status ZFFSAB._.CAN_Handling.CANMsg[47].Status ZFFSAB._.CAN_Handling.CANMsg[48].Status ZFFSAB._.CAN_Handling.CANMsg[49].Status ZFFSAB._.CAN_Handling.CANMsg[4].Status ZFFSAB._.CAN_Handling.CANMsg[5].Status ZFFSAB._.CAN_Handling.CANMsg[6].Status ZFFSAB._.CAN_Handling.CANMsg[7].Status ZFFSAB._.CAN_Handling.CANMsg[8].Status ZFFSAB._.CAN_Handling.CANMsg[9].Status ZFFSAB._.CAN_Handling.f_ACanMsgDiag ZFFSAB._.CAN_Handling.f_AfterRunning ZFFSAB._.CAN_Handling.f_AllTo ZFFSAB._.CAN_Handling.f_AllTo1 ZFFSAB._.CAN_Handling.f_AllTo2 ZFFSAB._.CAN_Handling.f_Can1BusDiag ZFFSAB._.CAN_Handling.f_Can2BusDiag ZFFSAB._.CAN_Handling.f_CanMsgDiag ZFFSAB._.CAN_Handling.f_FaultStatKFC_CANB1 ZFFSAB._.CAN_Handling.f_FaultStatKFC_CANB2 ZFFSAB._.CAN_Handling.iv_Busruhe ZFFSAB._.CAN_Handling.iv_JumpstartAktiv ZFFSAB._.CAN_Handling.iv_f_FaultStatKFC_UBATTO ZFFSAB._.CAN_Handling.iv_f_clear_learnedmsg ZFFSAB._.CAN_Handling.iv_st_Can1BusErr ZFFSAB._.CAN_Handling.iv_st_Can2BusErr ZFFSAB._.CAN_Handling.iv_u_BattFilt ZFFSAB._.CAN_Handling.st_ACANMsgBitmask1 ZFFSAB._.CAN_Handling.st_ACANMsgBitmask2 ZFFSAB._.CAN_Handling.st_CANControlConfigBitmask1 ZFFSAB._.CAN_Handling.st_CANControlConfigBitmask2 ZFFSAB._.CAN_Handling.st_CanMsgErrorBitmask1 ZFFSAB._.CAN_Handling.st_CanMsgErrorBitmask2 ZFFSAB._.CAN_Handling.st_ConfigBitmaskCANMsg1 ZFFSAB._.CAN_Handling.st_ConfigBitmaskCANMsg2 ZFFSAB._.CAN_Handling.st_LearnedBitmaskCANMsg1 ZFFSAB._.CAN_Handling.st_LearnedBitmaskCANMsg2 ZFFSAB._.CAN_Handling.st_ToLearnBitmaskCANMsg1 ZFFSAB._.CAN_Handling.st_ToLearnBitmaskCANMsg2 ZFFSAB._.CAN_Handling.sts_Can1BusDisturbance ZFFSAB._.CAN_Handling.sts_Can2BusDisturbance /end LOC_MEASUREMENT
/end FUNCTION
/begin FUNCTION zf_SAB_MSAIn "desc_en"
 /begin LOC_MEASUREMENT ZFFSAB._.MSAIn.f_HIS_gelernt ZFFSAB._.MSAIn.iv_STAT_MSA ZFFSAB._.MSAIn.iv_STAT_MSASts ZFFSAB._.MSAIn.sv_AGS_MsaStat ZFFSAB._.MSAIn.sv_DiOff ZFFSAB._.MSAIn.sv_DiOff_ ZFFSAB._.MSAIn.sv_f_HIS_verbaut /end LOC_MEASUREMENT
/end FUNCTION
/begin FUNCTION zf_SAB_MSAOut "desc_en"
 /begin LOC_MEASUREMENT ZFFSAB._.MSAOut.iv_StatusMSAHAS ZFFSAB._.MSAOut.sv_MSA_Rq_Hyb_Grb ZFFSAB._.MSAOut.sv_RqMSA_FnSlctn /end LOC_MEASUREMENT
/end FUNCTION
/begin FUNCTION zf_SAB_PowerdownIn "desc_en"
 /begin LOC_MEASUREMENT ZFFSAB._.PowerdownIn.f_EeStoreAllowed ZFFSAB._.PowerdownIn.f_Iep_Shutdown ZFFSAB._.PowerdownIn.f_IgnitionOn ZFFSAB._.PowerdownIn.f_InternalWakeUp ZFFSAB._.PowerdownIn.f_RapidPowerShutdown ZFFSAB._.PowerdownIn.f_ResetByTester ZFFSAB._.PowerdownIn.iv_f_CanActive ZFFSAB._.PowerdownIn.iv_f_EeStoreInProgress ZFFSAB._.PowerdownIn.iv_f_LinActive ZFFSAB._.PowerdownIn.iv_f_PowDownEnable ZFFSAB._.PowerdownIn.iv_f_PowDownEnableAtsys ZFFSAB._.PowerdownIn.st_Powerdown ZFFSAB._.PowerdownIn.st_PowerdownMain ZFFSAB._.PowerdownIn.sv_f_CanComActive ZFFSAB._.PowerdownIn.sv_f_LinComActive ZFFSAB._.PowerdownIn.sv_f_PowDownCondOk ZFFSAB._.PowerdownIn.sv_f_ShutDown /end LOC_MEASUREMENT
/end FUNCTION
/begin FUNCTION zf_SAB_TipTasterIn "desc_en"
 /begin LOC_MEASUREMENT ZFFSAB._.TipTasterIn.Analog.f_TipErr ZFFSAB._.TipTasterIn.Analog.f_TipMinus ZFFSAB._.TipTasterIn.Analog.f_TipMinusErr ZFFSAB._.TipTasterIn.Analog.f_TipPlus ZFFSAB._.TipTasterIn.Analog.f_TipPlusErr ZFFSAB._.TipTasterIn.Analog.iv_Tip ZFFSAB._.TipTasterIn.Analog.iv_TipSts ZFFSAB._.TipTasterIn.Analog.iv_f_TipMinus ZFFSAB._.TipTasterIn.Analog.iv_f_TipMinusSts ZFFSAB._.TipTasterIn.Analog.iv_f_TipPlus ZFFSAB._.TipTasterIn.Analog.iv_f_TipPlusSts ZFFSAB._.TipTasterIn.CAN.f_TipErr ZFFSAB._.TipTasterIn.CAN.f_TipMinus ZFFSAB._.TipTasterIn.CAN.f_TipMinusErr ZFFSAB._.TipTasterIn.CAN.f_TipPlus ZFFSAB._.TipTasterIn.CAN.f_TipPlusErr ZFFSAB._.TipTasterIn.CAN.iv_Tip ZFFSAB._.TipTasterIn.CAN.iv_TipSts ZFFSAB._.TipTasterIn.CAN.iv_f_TipMinus ZFFSAB._.TipTasterIn.CAN.iv_f_TipMinusSts ZFFSAB._.TipTasterIn.CAN.iv_f_TipPlus ZFFSAB._.TipTasterIn.CAN.iv_f_TipPlusSts ZFFSAB._.TipTasterIn.Out[0].f_TipMinus ZFFSAB._.TipTasterIn.Out[0].f_TipMinusErr ZFFSAB._.TipTasterIn.Out[0].f_TipPlus ZFFSAB._.TipTasterIn.Out[0].f_TipPlusErr ZFFSAB._.TipTasterIn.Out[0].sv_f_TipMinusErr ZFFSAB._.TipTasterIn.Out[0].sv_f_TipMinusRaw ZFFSAB._.TipTasterIn.Out[0].sv_f_TipPlusErr ZFFSAB._.TipTasterIn.Out[0].sv_f_TipPlusRaw ZFFSAB._.TipTasterIn.Out[1].f_TipMinus ZFFSAB._.TipTasterIn.Out[1].f_TipMinusErr ZFFSAB._.TipTasterIn.Out[1].f_TipPlus ZFFSAB._.TipTasterIn.Out[1].f_TipPlusErr ZFFSAB._.TipTasterIn.Out[1].sv_f_TipMinusErr ZFFSAB._.TipTasterIn.Out[1].sv_f_TipMinusRaw ZFFSAB._.TipTasterIn.Out[1].sv_f_TipPlusErr ZFFSAB._.TipTasterIn.Out[1].sv_f_TipPlusRaw ZFFSAB._.TipTasterIn.SBW.f_TipErr ZFFSAB._.TipTasterIn.SBW.f_TipMinus ZFFSAB._.TipTasterIn.SBW.f_TipMinusErr ZFFSAB._.TipTasterIn.SBW.f_TipPlus ZFFSAB._.TipTasterIn.SBW.f_TipPlusErr ZFFSAB._.TipTasterIn.SBW.iv_Tip ZFFSAB._.TipTasterIn.SBW.iv_TipSts ZFFSAB._.TipTasterIn.SBW.iv_f_TipMinus ZFFSAB._.TipTasterIn.SBW.iv_f_TipMinusSts ZFFSAB._.TipTasterIn.SBW.iv_f_TipPlus ZFFSAB._.TipTasterIn.SBW.iv_f_TipPlusSts ZFFSAB._.TipTasterIn.iv_u_Batt_Diag ZFFSAB._.TipTasterIn.sv_f_Tip1MinusRaw ZFFSAB._.TipTasterIn.sv_f_Tip1PlusRaw ZFFSAB._.TipTasterIn.sv_f_Tip2MinusRaw ZFFSAB._.TipTasterIn.sv_f_Tip2PlusRaw /end LOC_MEASUREMENT
/end FUNCTION
/begin FUNCTION zf_SAB_GearLimitation "desc_en"
 /begin LOC_MEASUREMENT ZFFSAB._.GearLimitation.iv_f_GearLimitActive ZFFSAB._.GearLimitation.sv_GearLimit ZFFSAB._.GearLimitation.sv_f_GearLimitActive /end LOC_MEASUREMENT
/end FUNCTION
/begin FUNCTION zf_SAB_EmergencyGearInfo "desc_en"
 /begin LOC_MEASUREMENT ZFFSAB._.EmergencyGearInfo.Gear_during_act_KMN_GFIX ZFFSAB._.EmergencyGearInfo.KMN_GFIX_last_cycle ZFFSAB._.EmergencyGearInfo.KMN_High_active_last_call ZFFSAB._.EmergencyGearInfo.KMN_active_last_call ZFFSAB._.EmergencyGearInfo.ctl_EmergencyGearInfo ZFFSAB._.EmergencyGearInfo.f_3th_stepENPGx ZFFSAB._.EmergencyGearInfo.f_IgnitionOff2On ZFFSAB._.EmergencyGearInfo.iv_ActualGear ZFFSAB._.EmergencyGearInfo.iv_LIN_EPumpErr ZFFSAB._.EmergencyGearInfo.iv_Pos ZFFSAB._.EmergencyGearInfo.iv_PosSts ZFFSAB._.EmergencyGearInfo.iv_TargetGear ZFFSAB._.EmergencyGearInfo.iv_in_Gear1Act ZFFSAB._.EmergencyGearInfo.iv_in_Gear2Act ZFFSAB._.EmergencyGearInfo.iv_in_Gear3Act ZFFSAB._.EmergencyGearInfo.iv_in_Gear4Act ZFFSAB._.EmergencyGearInfo.iv_in_Gear5Act ZFFSAB._.EmergencyGearInfo.iv_in_Gear6Act ZFFSAB._.EmergencyGearInfo.iv_in_GearAct ZFFSAB._.EmergencyGearInfo.iv_n_EnUTh ZFFSAB._.EmergencyGearInfo.loc_ConditionENPG1Fix ZFFSAB._.EmergencyGearInfo.loc_ConditionENPG3Fix ZFFSAB._.EmergencyGearInfo.loc_ConditionGear1 ZFFSAB._.EmergencyGearInfo.loc_ConditionGear2 ZFFSAB._.EmergencyGearInfo.loc_ConditionGear3 ZFFSAB._.EmergencyGearInfo.loc_ConditionGear4 ZFFSAB._.EmergencyGearInfo.loc_ConditionGear5 ZFFSAB._.EmergencyGearInfo.loc_ConditionGear6 ZFFSAB._.EmergencyGearInfo.loc_WheelActiveAvg ZFFSAB._.EmergencyGearInfo.loc_WheelActiveAvgSts ZFFSAB._.EmergencyGearInfo.loc_nAbFilt ZFFSAB._.EmergencyGearInfo.loc_nAbSts ZFFSAB._.EmergencyGearInfo.loc_reg_for_GFIX_old ZFFSAB._.EmergencyGearInfo.loc_reg_hi_for_GFIX_old ZFFSAB._.EmergencyGearInfo.n_AbUThGearSubst1 ZFFSAB._.EmergencyGearInfo.n_AbUThGearSubst2 ZFFSAB._.EmergencyGearInfo.n_AbUThGearSubst3 ZFFSAB._.EmergencyGearInfo.n_AbUThGearSubst4 ZFFSAB._.EmergencyGearInfo.n_AbUThGearSubst5 ZFFSAB._.EmergencyGearInfo.n_AbUThGearSubst6 ZFFSAB._.EmergencyGearInfo.st_ENPG1FIX ZFFSAB._.EmergencyGearInfo.st_ENPG3 ZFFSAB._.EmergencyGearInfo.st_ENPG3FIX ZFFSAB._.EmergencyGearInfo.st_KMN_GFIX_KFC_ERSATZ ZFFSAB._.EmergencyGearInfo.st_RD_ENPG1FIX ZFFSAB._.EmergencyGearInfo.st_RD_ENPG3_ENPG3 ZFFSAB._.EmergencyGearInfo.st_RD_ENPG3_ENPG3FIX ZFFSAB._.EmergencyGearInfo.sv_IEPsoll_subst ZFFSAB._.EmergencyGearInfo.sv_K0soll_subst ZFFSAB._.EmergencyGearInfo.sv_ctl_EmergencyGearInfoCpy /end LOC_MEASUREMENT
/end FUNCTION
/begin FUNCTION zf_SAB_RPM_Diagnosis "desc_en"
 /begin LOC_MEASUREMENT ZFFSAB._.RPM_Diagnosis.iv_u_Batt_Diag ZFFSAB._.RPM_Diagnosis.iv_u_SensESts ZFFSAB._.RPM_Diagnosis.iv_u_SensEStsRam ZFFSAB._.RPM_Diagnosis.iv_u_SensEStsRam_ ZFFSAB._.RPM_Diagnosis.iv_u_SensEStsRaw ZFFSAB._.RPM_Diagnosis.iv_u_SensEStsRaw_ ZFFSAB._.RPM_Diagnosis.iv_u_SensESts_ /end LOC_MEASUREMENT
/end FUNCTION
/begin FUNCTION zf_SAB_EstVehicleWeightIn "desc_en"
 /begin LOC_MEASUREMENT ZFFSAB._.EstVehicleWeightIn.f_MassFzgEstErr ZFFSAB._.EstVehicleWeightIn.iv_MassFzgEst ZFFSAB._.EstVehicleWeightIn.iv_MassFzgEstErr ZFFSAB._.EstVehicleWeightIn.iv_MassFzgEstSts ZFFSAB._.EstVehicleWeightIn.sv_MassFzgEst ZFFSAB._.EstVehicleWeightIn.sv_MassFzgEstSts /end LOC_MEASUREMENT
/end FUNCTION
/begin FUNCTION zf_SAB_CurWheelTrqIn "desc_en"
 /begin LOC_MEASUREMENT ZFFSAB._.CurWheelTrqIn.f_M_RadIstErr ZFFSAB._.CurWheelTrqIn.iv_M_RadIst ZFFSAB._.CurWheelTrqIn.iv_M_RadIstQF ZFFSAB._.CurWheelTrqIn.iv_M_RadIstSts ZFFSAB._.CurWheelTrqIn.sv_M_RadIst ZFFSAB._.CurWheelTrqIn.sv_M_RadIstSts /end LOC_MEASUREMENT
/end FUNCTION
/begin FUNCTION zf_SAB_TurbineTorqueIn "desc_en"
 /begin LOC_MEASUREMENT ZFFSAB._.TurbineTorqueIn.dc_TrqFaultInfo ZFFSAB._.TurbineTorqueIn.iv_dc_Trq ZFFSAB._.TurbineTorqueIn.iv_dc_TrqESts ZFFSAB._.TurbineTorqueIn.sv_dc_MotTrq ZFFSAB._.TurbineTorqueIn.sv_dc_MotTrqSts /end LOC_MEASUREMENT
/end FUNCTION
/begin FUNCTION zf_SAB_TimeEGSOffIn "desc_en"
 /begin LOC_MEASUREMENT ZFFSAB._.TimeEGSOffIn.f_TimeEGSOffCalculated ZFFSAB._.TimeEGSOffIn.iv_Systime ZFFSAB._.TimeEGSOffIn.sv_TimeEGSOff ZFFSAB._.TimeEGSOffIn.sv_TimeEGSOffSts ZFFSAB._.TimeEGSOffIn.t_SystimeCurBuf ZFFSAB._.TimeEGSOffIn.t_SystimeOldBuf /end LOC_MEASUREMENT
/end FUNCTION
/begin FUNCTION zf_SAB_EEpromZentralHandler "desc_en"
 /begin LOC_MEASUREMENT ZFFSAB._.EEpromZentralHandler.allEepromSummeryChannels.eepromSummaryChannel[0].cnt_GetEEpromUpdate ZFFSAB._.EEpromZentralHandler.allEepromSummeryChannels.eepromSummaryChannel[0].cnt_GetEEpromValid ZFFSAB._.EEpromZentralHandler.allEepromSummeryChannels.eepromSummaryChannel[0].cnt_GetSizeofEEpromData ZFFSAB._.EEpromZentralHandler.allEepromSummeryChannels.eepromSummaryChannel[0].cnt_SetEEpromInitZyklisch ZFFSAB._.EEpromZentralHandler.allEepromSummeryChannels.eepromSummaryChannel[0].eeprom_info ZFFSAB._.EEpromZentralHandler.allEepromSummeryChannels.eepromSummaryChannel[0].ret_GetEEpromUpdate ZFFSAB._.EEpromZentralHandler.allEepromSummeryChannels.eepromSummaryChannel[0].ret_GetEEpromValid ZFFSAB._.EEpromZentralHandler.allEepromSummeryChannels.eepromSummaryChannel[0].ret_GetSizeofEEpromData ZFFSAB._.EEpromZentralHandler.allEepromSummeryChannels.eepromSummaryChannel[0].ret_SetEEpromInitZyklisch ZFFSAB._.EEpromZentralHandler.allEepromSummeryChannels.eepromSummaryChannel[1].cnt_GetEEpromUpdate ZFFSAB._.EEpromZentralHandler.allEepromSummeryChannels.eepromSummaryChannel[1].cnt_GetEEpromValid ZFFSAB._.EEpromZentralHandler.allEepromSummeryChannels.eepromSummaryChannel[1].cnt_GetSizeofEEpromData ZFFSAB._.EEpromZentralHandler.allEepromSummeryChannels.eepromSummaryChannel[1].cnt_SetEEpromInitZyklisch ZFFSAB._.EEpromZentralHandler.allEepromSummeryChannels.eepromSummaryChannel[1].eeprom_info ZFFSAB._.EEpromZentralHandler.allEepromSummeryChannels.eepromSummaryChannel[1].ret_GetEEpromUpdate ZFFSAB._.EEpromZentralHandler.allEepromSummeryChannels.eepromSummaryChannel[1].ret_GetEEpromValid ZFFSAB._.EEpromZentralHandler.allEepromSummeryChannels.eepromSummaryChannel[1].ret_GetSizeofEEpromData ZFFSAB._.EEpromZentralHandler.allEepromSummeryChannels.eepromSummaryChannel[1].ret_SetEEpromInitZyklisch ZFFSAB._.EEpromZentralHandler.allEepromSummeryChannels.eepromSummaryChannel[2].cnt_GetEEpromUpdate ZFFSAB._.EEpromZentralHandler.allEepromSummeryChannels.eepromSummaryChannel[2].cnt_GetEEpromValid ZFFSAB._.EEpromZentralHandler.allEepromSummeryChannels.eepromSummaryChannel[2].cnt_GetSizeofEEpromData ZFFSAB._.EEpromZentralHandler.allEepromSummeryChannels.eepromSummaryChannel[2].cnt_SetEEpromInitZyklisch ZFFSAB._.EEpromZentralHandler.allEepromSummeryChannels.eepromSummaryChannel[2].eeprom_info ZFFSAB._.EEpromZentralHandler.allEepromSummeryChannels.eepromSummaryChannel[2].ret_GetEEpromUpdate ZFFSAB._.EEpromZentralHandler.allEepromSummeryChannels.eepromSummaryChannel[2].ret_GetEEpromValid ZFFSAB._.EEpromZentralHandler.allEepromSummeryChannels.eepromSummaryChannel[2].ret_GetSizeofEEpromData ZFFSAB._.EEpromZentralHandler.allEepromSummeryChannels.eepromSummaryChannel[2].ret_SetEEpromInitZyklisch ZFFSAB._.EEpromZentralHandler.allEepromSummeryChannels.eepromSummaryChannel[3].cnt_GetEEpromUpdate ZFFSAB._.EEpromZentralHandler.allEepromSummeryChannels.eepromSummaryChannel[3].cnt_GetEEpromValid ZFFSAB._.EEpromZentralHandler.allEepromSummeryChannels.eepromSummaryChannel[3].cnt_GetSizeofEEpromData ZFFSAB._.EEpromZentralHandler.allEepromSummeryChannels.eepromSummaryChannel[3].cnt_SetEEpromInitZyklisch ZFFSAB._.EEpromZentralHandler.allEepromSummeryChannels.eepromSummaryChannel[3].eeprom_info ZFFSAB._.EEpromZentralHandler.allEepromSummeryChannels.eepromSummaryChannel[3].ret_GetEEpromUpdate ZFFSAB._.EEpromZentralHandler.allEepromSummeryChannels.eepromSummaryChannel[3].ret_GetEEpromValid ZFFSAB._.EEpromZentralHandler.allEepromSummeryChannels.eepromSummaryChannel[3].ret_GetSizeofEEpromData ZFFSAB._.EEpromZentralHandler.allEepromSummeryChannels.eepromSummaryChannel[3].ret_SetEEpromInitZyklisch ZFFSAB._.EEpromZentralHandler.allEepromSummeryChannels.eepromSummaryChannel[4].cnt_GetEEpromUpdate ZFFSAB._.EEpromZentralHandler.allEepromSummeryChannels.eepromSummaryChannel[4].cnt_GetEEpromValid ZFFSAB._.EEpromZentralHandler.allEepromSummeryChannels.eepromSummaryChannel[4].cnt_GetSizeofEEpromData ZFFSAB._.EEpromZentralHandler.allEepromSummeryChannels.eepromSummaryChannel[4].cnt_SetEEpromInitZyklisch ZFFSAB._.EEpromZentralHandler.allEepromSummeryChannels.eepromSummaryChannel[4].eeprom_info ZFFSAB._.EEpromZentralHandler.allEepromSummeryChannels.eepromSummaryChannel[4].ret_GetEEpromUpdate ZFFSAB._.EEpromZentralHandler.allEepromSummeryChannels.eepromSummaryChannel[4].ret_GetEEpromValid ZFFSAB._.EEpromZentralHandler.allEepromSummeryChannels.eepromSummaryChannel[4].ret_GetSizeofEEpromData ZFFSAB._.EEpromZentralHandler.allEepromSummeryChannels.eepromSummaryChannel[4].ret_SetEEpromInitZyklisch ZFFSAB._.EEpromZentralHandler.eepromChannel[0].ZFFSAB._.cEEpromChannel._.cnt_GetEEpromUpdate ZFFSAB._.EEpromZentralHandler.eepromChannel[0].ZFFSAB._.cEEpromChannel._.cnt_GetEEpromValid ZFFSAB._.EEpromZentralHandler.eepromChannel[0].ZFFSAB._.cEEpromChannel._.cnt_GetSizeofEEpromData ZFFSAB._.EEpromZentralHandler.eepromChannel[0].ZFFSAB._.cEEpromChannel._.cnt_SetEEpromInitZyklisch ZFFSAB._.EEpromZentralHandler.eepromChannel[0].ZFFSAB._.cEEpromChannel._.eeprom_info ZFFSAB._.EEpromZentralHandler.eepromChannel[0].ZFFSAB._.cEEpromChannel._.ret_GetEEpromUpdate ZFFSAB._.EEpromZentralHandler.eepromChannel[0].ZFFSAB._.cEEpromChannel._.ret_GetEEpromValid ZFFSAB._.EEpromZentralHandler.eepromChannel[0].ZFFSAB._.cEEpromChannel._.ret_GetSizeofEEpromData ZFFSAB._.EEpromZentralHandler.eepromChannel[0].ZFFSAB._.cEEpromChannel._.ret_SetEEpromInitZyklisch ZFFSAB._.EEpromZentralHandler.eepromChannel[0].cnt_CallEEpromLoadData ZFFSAB._.EEpromZentralHandler.eepromChannel[0].cnt_CallEEpromLoadDataState ZFFSAB._.EEpromZentralHandler.eepromChannel[0].cnt_CallEEpromStoreImmediate ZFFSAB._.EEpromZentralHandler.eepromChannel[0].cnt_SetEEpromWriteProtect ZFFSAB._.EEpromZentralHandler.eepromChannel[0].mode ZFFSAB._.EEpromZentralHandler.eepromChannel[0].ret_CallEEpromLoadData ZFFSAB._.EEpromZentralHandler.eepromChannel[0].ret_CallEEpromLoadDataState ZFFSAB._.EEpromZentralHandler.eepromChannel[0].ret_CallEEpromStoreImmediate ZFFSAB._.EEpromZentralHandler.eepromChannel[10].ZFFSAB._.cEEpromChannel._.cnt_GetEEpromUpdate ZFFSAB._.EEpromZentralHandler.eepromChannel[10].ZFFSAB._.cEEpromChannel._.cnt_GetEEpromValid ZFFSAB._.EEpromZentralHandler.eepromChannel[10].ZFFSAB._.cEEpromChannel._.cnt_GetSizeofEEpromData ZFFSAB._.EEpromZentralHandler.eepromChannel[10].ZFFSAB._.cEEpromChannel._.cnt_SetEEpromInitZyklisch ZFFSAB._.EEpromZentralHandler.eepromChannel[10].ZFFSAB._.cEEpromChannel._.eeprom_info ZFFSAB._.EEpromZentralHandler.eepromChannel[10].ZFFSAB._.cEEpromChannel._.ret_GetEEpromUpdate ZFFSAB._.EEpromZentralHandler.eepromChannel[10].ZFFSAB._.cEEpromChannel._.ret_GetEEpromValid ZFFSAB._.EEpromZentralHandler.eepromChannel[10].ZFFSAB._.cEEpromChannel._.ret_GetSizeofEEpromData ZFFSAB._.EEpromZentralHandler.eepromChannel[10].ZFFSAB._.cEEpromChannel._.ret_SetEEpromInitZyklisch ZFFSAB._.EEpromZentralHandler.eepromChannel[10].cnt_CallEEpromLoadData ZFFSAB._.EEpromZentralHandler.eepromChannel[10].cnt_CallEEpromLoadDataState ZFFSAB._.EEpromZentralHandler.eepromChannel[10].cnt_CallEEpromStoreImmediate ZFFSAB._.EEpromZentralHandler.eepromChannel[10].cnt_SetEEpromWriteProtect ZFFSAB._.EEpromZentralHandler.eepromChannel[10].mode ZFFSAB._.EEpromZentralHandler.eepromChannel[10].ret_CallEEpromLoadData ZFFSAB._.EEpromZentralHandler.eepromChannel[10].ret_CallEEpromLoadDataState ZFFSAB._.EEpromZentralHandler.eepromChannel[10].ret_CallEEpromStoreImmediate ZFFSAB._.EEpromZentralHandler.eepromChannel[11].ZFFSAB._.cEEpromChannel._.cnt_GetEEpromUpdate ZFFSAB._.EEpromZentralHandler.eepromChannel[11].ZFFSAB._.cEEpromChannel._.cnt_GetEEpromValid ZFFSAB._.EEpromZentralHandler.eepromChannel[11].ZFFSAB._.cEEpromChannel._.cnt_GetSizeofEEpromData ZFFSAB._.EEpromZentralHandler.eepromChannel[11].ZFFSAB._.cEEpromChannel._.cnt_SetEEpromInitZyklisch ZFFSAB._.EEpromZentralHandler.eepromChannel[11].ZFFSAB._.cEEpromChannel._.eeprom_info ZFFSAB._.EEpromZentralHandler.eepromChannel[11].ZFFSAB._.cEEpromChannel._.ret_GetEEpromUpdate ZFFSAB._.EEpromZentralHandler.eepromChannel[11].ZFFSAB._.cEEpromChannel._.ret_GetEEpromValid ZFFSAB._.EEpromZentralHandler.eepromChannel[11].ZFFSAB._.cEEpromChannel._.ret_GetSizeofEEpromData ZFFSAB._.EEpromZentralHandler.eepromChannel[11].ZFFSAB._.cEEpromChannel._.ret_SetEEpromInitZyklisch ZFFSAB._.EEpromZentralHandler.eepromChannel[11].cnt_CallEEpromLoadData ZFFSAB._.EEpromZentralHandler.eepromChannel[11].cnt_CallEEpromLoadDataState ZFFSAB._.EEpromZentralHandler.eepromChannel[11].cnt_CallEEpromStoreImmediate ZFFSAB._.EEpromZentralHandler.eepromChannel[11].cnt_SetEEpromWriteProtect ZFFSAB._.EEpromZentralHandler.eepromChannel[11].mode ZFFSAB._.EEpromZentralHandler.eepromChannel[11].ret_CallEEpromLoadData ZFFSAB._.EEpromZentralHandler.eepromChannel[11].ret_CallEEpromLoadDataState ZFFSAB._.EEpromZentralHandler.eepromChannel[11].ret_CallEEpromStoreImmediate ZFFSAB._.EEpromZentralHandler.eepromChannel[12].ZFFSAB._.cEEpromChannel._.cnt_GetEEpromUpdate ZFFSAB._.EEpromZentralHandler.eepromChannel[12].ZFFSAB._.cEEpromChannel._.cnt_GetEEpromValid ZFFSAB._.EEpromZentralHandler.eepromChannel[12].ZFFSAB._.cEEpromChannel._.cnt_GetSizeofEEpromData ZFFSAB._.EEpromZentralHandler.eepromChannel[12].ZFFSAB._.cEEpromChannel._.cnt_SetEEpromInitZyklisch ZFFSAB._.EEpromZentralHandler.eepromChannel[12].ZFFSAB._.cEEpromChannel._.eeprom_info ZFFSAB._.EEpromZentralHandler.eepromChannel[12].ZFFSAB._.cEEpromChannel._.ret_GetEEpromUpdate ZFFSAB._.EEpromZentralHandler.eepromChannel[12].ZFFSAB._.cEEpromChannel._.ret_GetEEpromValid ZFFSAB._.EEpromZentralHandler.eepromChannel[12].ZFFSAB._.cEEpromChannel._.ret_GetSizeofEEpromData ZFFSAB._.EEpromZentralHandler.eepromChannel[12].ZFFSAB._.cEEpromChannel._.ret_SetEEpromInitZyklisch ZFFSAB._.EEpromZentralHandler.eepromChannel[12].cnt_CallEEpromLoadData ZFFSAB._.EEpromZentralHandler.eepromChannel[12].cnt_CallEEpromLoadDataState ZFFSAB._.EEpromZentralHandler.eepromChannel[12].cnt_CallEEpromStoreImmediate ZFFSAB._.EEpromZentralHandler.eepromChannel[12].cnt_SetEEpromWriteProtect ZFFSAB._.EEpromZentralHandler.eepromChannel[12].mode ZFFSAB._.EEpromZentralHandler.eepromChannel[12].ret_CallEEpromLoadData ZFFSAB._.EEpromZentralHandler.eepromChannel[12].ret_CallEEpromLoadDataState ZFFSAB._.EEpromZentralHandler.eepromChannel[12].ret_CallEEpromStoreImmediate ZFFSAB._.EEpromZentralHandler.eepromChannel[13].ZFFSAB._.cEEpromChannel._.cnt_GetEEpromUpdate ZFFSAB._.EEpromZentralHandler.eepromChannel[13].ZFFSAB._.cEEpromChannel._.cnt_GetEEpromValid ZFFSAB._.EEpromZentralHandler.eepromChannel[13].ZFFSAB._.cEEpromChannel._.cnt_GetSizeofEEpromData ZFFSAB._.EEpromZentralHandler.eepromChannel[13].ZFFSAB._.cEEpromChannel._.cnt_SetEEpromInitZyklisch ZFFSAB._.EEpromZentralHandler.eepromChannel[13].ZFFSAB._.cEEpromChannel._.eeprom_info ZFFSAB._.EEpromZentralHandler.eepromChannel[13].ZFFSAB._.cEEpromChannel._.ret_GetEEpromUpdate ZFFSAB._.EEpromZentralHandler.eepromChannel[13].ZFFSAB._.cEEpromChannel._.ret_GetEEpromValid ZFFSAB._.EEpromZentralHandler.eepromChannel[13].ZFFSAB._.cEEpromChannel._.ret_GetSizeofEEpromData ZFFSAB._.EEpromZentralHandler.eepromChannel[13].ZFFSAB._.cEEpromChannel._.ret_SetEEpromInitZyklisch ZFFSAB._.EEpromZentralHandler.eepromChannel[13].cnt_CallEEpromLoadData ZFFSAB._.EEpromZentralHandler.eepromChannel[13].cnt_CallEEpromLoadDataState ZFFSAB._.EEpromZentralHandler.eepromChannel[13].cnt_CallEEpromStoreImmediate ZFFSAB._.EEpromZentralHandler.eepromChannel[13].cnt_SetEEpromWriteProtect ZFFSAB._.EEpromZentralHandler.eepromChannel[13].mode ZFFSAB._.EEpromZentralHandler.eepromChannel[13].ret_CallEEpromLoadData ZFFSAB._.EEpromZentralHandler.eepromChannel[13].ret_CallEEpromLoadDataState ZFFSAB._.EEpromZentralHandler.eepromChannel[13].ret_CallEEpromStoreImmediate ZFFSAB._.EEpromZentralHandler.eepromChannel[14].ZFFSAB._.cEEpromChannel._.cnt_GetEEpromUpdate ZFFSAB._.EEpromZentralHandler.eepromChannel[14].ZFFSAB._.cEEpromChannel._.cnt_GetEEpromValid ZFFSAB._.EEpromZentralHandler.eepromChannel[14].ZFFSAB._.cEEpromChannel._.cnt_GetSizeofEEpromData ZFFSAB._.EEpromZentralHandler.eepromChannel[14].ZFFSAB._.cEEpromChannel._.cnt_SetEEpromInitZyklisch ZFFSAB._.EEpromZentralHandler.eepromChannel[14].ZFFSAB._.cEEpromChannel._.eeprom_info ZFFSAB._.EEpromZentralHandler.eepromChannel[14].ZFFSAB._.cEEpromChannel._.ret_GetEEpromUpdate /end LOC_MEASUREMENT
/end FUNCTION
/end MODULE
/end PROJECT
