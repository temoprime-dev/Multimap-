ASAP2_VERSION 1 51
/begin PROJECT _929_929 "Gen2_BMW_System_Supplier_Lib"
/begin HEADER "" VERSION "C_03_03" PROJECT_NO _929_929 /end HEADER
/begin MODULE DIM ""
/begin MOD_COMMON "" BYTE_ORDER MSB_FIRST ALIGNMENT_BYTE 1 ALIGNMENT_WORD 2 ALIGNMENT_LONG 4 ALIGNMENT_FLOAT32_IEEE 4 /end MOD_COMMON
/begin CHARACTERISTIC T_RAABVSP53 "Zeit Rampe auf Schaltdruck" VALUE 0x26E7F7 kw_ui8_S6_S3 2540 UMR_MSEC__10_1_0_S6_S3 0 2540 /end CHARACTERISTIC
/begin CHARACTERISTIC T_RAABVFOLNACHMRSSP53 "Zeit Rampe auf Schaltdruck" VALUE 0x26E7F8 kw_ui8_S6_S3 2540 UMR_MSEC__10_1_0_S6_S3 0 2540 /end CHARACTERISTIC
/begin CHARACTERISTIC KL_POKABVSP53 "Druckoffset Folgeschaltung in Abhaengigkeit von m_t" CURVE 0x24AE6C kl_si16_S6_S3 12 UMR_BAR__1_1000_0_S6_S3 -6 6
 /begin AXIS_DESCR STD_AXIS zff_atsys._.iSignale._.obj.sig_m_t UMR_NM__1_1_0_S6_S3 4 -400 1640 DEPOSIT ABSOLUTE MONOTONY MON_INCREASE /end AXIS_DESCR
/end CHARACTERISTIC
/begin CHARACTERISTIC KL_POKABVFOLNACHMRSSP53 "Druckoffset Folgeschaltung nach MRS in Abhaengigkeit von m_t" CURVE 0x24AE80 kl_si16_S6_S3 12 UMR_BAR__1_1000_0_S6_S3 -6 6
 /begin AXIS_DESCR STD_AXIS zff_atsys._.iSignale._.obj.sig_m_t UMR_NM__1_1_0_S6_S3 4 -400 1640 DEPOSIT ABSOLUTE MONOTONY MON_INCREASE /end AXIS_DESCR
/end CHARACTERISTIC
/begin CHARACTERISTIC KF_TSYNMTNTKABVFOLNACHMRSSP53 "Zeit vor sync. Ende Haltephase vorb. KAB" MAP 0x24AE94 kf_si16_S6_S3 5000 UMR_MSEC__10_1_0_S6_S3 -5000 0
 /begin AXIS_DESCR STD_AXIS zff_atsys._.iSignale._.obj.sig_m_t UMR_NM__1_1_0_S6_S3 4 -400 1640 DEPOSIT ABSOLUTE MONOTONY MON_INCREASE /end AXIS_DESCR
 /begin AXIS_DESCR STD_AXIS zff_atsys._.iSignale._.obj.sig_n_t UMR_U_MIN_1_1_0_S6_S3 6 0 8160 DEPOSIT ABSOLUTE MONOTONY MON_INCREASE /end AXIS_DESCR
/end CHARACTERISTIC
/begin CHARACTERISTIC KL_PGOKABFOLNACHRSSP53 "Druckgradient in Abhaengigkeit von m_t fuer Folgeschaltung" CURVE 0x24AEE0 kl_si16_S6_S3 200 UMR_BAR_SEC_1_10_0_S6_S3 -100 100
 /begin AXIS_DESCR STD_AXIS zff_atsys._.iSignale._.obj.sig_m_t UMR_NM__1_1_0_S6_S3 6 -400 1640 DEPOSIT ABSOLUTE MONOTONY MON_INCREASE /end AXIS_DESCR
/end CHARACTERISTIC
/begin CHARACTERISTIC KL_PGRASYNKABFOLNACHRSSP53 "Druckgradient Wegschalten KAB fuer Folgeschaltung" CURVE 0x24AEFC kl_si16_S6_S3 100 UMR_BAR_SEC_1_10_0_S6_S3 -100 0
 /begin AXIS_DESCR STD_AXIS zff_atsys._.iSignale._.obj.sig_m_t UMR_NM__1_1_0_S6_S3 6 -400 1640 DEPOSIT ABSOLUTE MONOTONY MON_INCREASE /end AXIS_DESCR
/end CHARACTERISTIC
/begin CHARACTERISTIC KF_PKABFOLSP53 "Schaltdruck ab.Kupplung fuer MRS Folgeschaltung" MAP 0x24AF18 kf_si16_S6_S3 12.75 UMR_BAR__1_1000_0_S6_S3 0 12.75
 /begin AXIS_DESCR STD_AXIS NO_INPUT_QUANTITY UMR_U_MIN_32_1_0_S6_S3 8 0 8160 DEPOSIT ABSOLUTE MONOTONY MON_INCREASE /end AXIS_DESCR
 /begin AXIS_DESCR STD_AXIS zff_atsys._.iSignale._.obj.sig_m_t UMR_NM__1_1_0_S6_S3 10 -400 1640 DEPOSIT ABSOLUTE MONOTONY MON_INCREASE /end AXIS_DESCR
/end CHARACTERISTIC
/begin CHARACTERISTIC TO_TSYNHINSYNSSP53 "Zeitoffset nach Synchron für Dauer Haltephase in Syn. KAB" VALUE 0x26E7F9 kw_ui8_S6_S3 2540 UMR_MSEC__10_1_0_S6_S3 0 2540 /end CHARACTERISTIC
/begin CHARACTERISTIC KL_POKABNGABSP53 "Druckoffset in Abhaengigkeit von ng_ab" CURVE 0x24AFE4 kl_si16_S6_S3 12 UMR_BAR__1_1000_0_S6_S3 -6 6
 /begin AXIS_DESCR STD_AXIS iItfInput.ng_ab UMR_U_MINSEC_1_1_0_S6_S3 4 -5000 1000 DEPOSIT ABSOLUTE MONOTONY MON_INCREASE /end AXIS_DESCR
/end CHARACTERISTIC
/begin CHARACTERISTIC T_SYNKABWSSP53 "Zeit vor sync. Ende Schaltdruck KAB bei Weiterschaltung" VALUE 0x26E7FA kw_ui8_S6_S3 1280 UMR_MSEC__10_1_M128_S6_S3 -1280 0 /end CHARACTERISTIC
/begin CHARACTERISTIC KL_FPOCGHINSYNKABSP53 "Temperaturabhängige Gewichtung des Haltedruckoffsets" CURVE 0x24AFF8 kl_ui8_S6_S3 1 UMR___1_100_0_S6_S3 0 1
 /begin AXIS_DESCR STD_AXIS zff_atsys._.iSignale._.obj.sig_c_getr UMR_GRADC__1_1_M40_S6_S3 4 -40 150 DEPOSIT ABSOLUTE MONOTONY MON_INCREASE /end AXIS_DESCR
/end CHARACTERISTIC
/begin CHARACTERISTIC KL_TOHKABCGSP53 "Zeit Offset Haltephase" CURVE 0x24B004 kl_ui8_S6_S3 1270 UMR_MSEC__10_1_0_S6_S3 0 1270
 /begin AXIS_DESCR STD_AXIS zff_atsys._.iSignale._.obj.sig_c_getr UMR_GRADC__1_1_M40_S6_S3 4 -40 190 DEPOSIT ABSOLUTE MONOTONY MON_INCREASE /end AXIS_DESCR
/end CHARACTERISTIC
/begin CHARACTERISTIC KL_PGRASYNKABSP53 "Druckgradient Wegschalten abschaltende Kupplung" CURVE 0x24B010 kl_si16_S6_S3 100 UMR_BAR_SEC_1_10_0_S6_S3 -100 0
 /begin AXIS_DESCR STD_AXIS zff_atsys._.iSignale._.obj.sig_m_t UMR_NM__1_1_0_S6_S3 6 -400 1640 DEPOSIT ABSOLUTE MONOTONY MON_INCREASE /end AXIS_DESCR
/end CHARACTERISTIC
/begin CHARACTERISTIC KL_PGRASYNKABWSSP53 "Druckgradient Wegschalten abschaltende Kupplung bei Weiterschaltung" CURVE 0x24B02C kl_si16_S6_S3 100 UMR_BAR_SEC_1_10_0_S6_S3 -100 0
 /begin AXIS_DESCR STD_AXIS zff_atsys._.iSignale._.obj.sig_m_t UMR_NM__1_1_0_S6_S3 6 -400 1640 DEPOSIT ABSOLUTE MONOTONY MON_INCREASE /end AXIS_DESCR
/end CHARACTERISTIC
/begin CHARACTERISTIC KF_POKABMTCGSP53 "Schaltdruckoffset" MAP 0x24B048 kf_si16_S6_S3 12.75 UMR_BAR__1_1000_0_S6_S3 -6.4 6.35
 /begin AXIS_DESCR STD_AXIS zff_atsys._.iSignale._.obj.sig_m_t UMR_NM__1_1_0_S6_S3 5 -400 1640 DEPOSIT ABSOLUTE MONOTONY MON_INCREASE /end AXIS_DESCR
 /begin AXIS_DESCR STD_AXIS zff_atsys._.iSignale._.obj.sig_c_getr UMR_GRADC__1_1_M40_S6_S3 10 -40 150 DEPOSIT ABSOLUTE MONOTONY MON_INCREASE /end AXIS_DESCR
/end CHARACTERISTIC
/begin CHARACTERISTIC KL_POKABMDMOTSOLLSP53 "Schaltdruckoffset in Abhaengigkeit von md_motsoll_sas" CURVE 0x24B0D4 kl_si16_S6_S3 12.75 UMR_BAR__1_1000_0_S6_S3 -6.4 6.35
 /begin AXIS_DESCR STD_AXIS NO_INPUT_QUANTITY UMR_NM__1_1_0_S6_S3 6 -2000 2000 DEPOSIT ABSOLUTE MONOTONY MON_INCREASE /end AXIS_DESCR
/end CHARACTERISTIC
/begin CHARACTERISTIC KF_TVKABMTNMOTRSSP53 "Verzögerungszeit abschaltende Kupplung bei RS" MAP 0x24B0F0 kf_ui8_S6_S3 2000 UMR_MSEC__10_1_0_S6_S3 0 2000
 /begin AXIS_DESCR STD_AXIS zff_atsys._.iSignale._.obj.sig_m_t8 UMR_NM__8_1_M50_S6_S3 4 -400 1640 DEPOSIT ABSOLUTE MONOTONY MON_INCREASE /end AXIS_DESCR
 /begin AXIS_DESCR STD_AXIS zff_atsys._.iSignale._.obj.sig_n_mot8 UMR_U_MIN_32_1_0_S6_S3 4 0 8160 DEPOSIT ABSOLUTE MONOTONY MON_INCREASE /end AXIS_DESCR
/end CHARACTERISTIC
/begin CHARACTERISTIC T_RAABVSP63 "Zeit Rampe auf Schaltdruck" VALUE 0x26E7FB kw_ui8_S6_S3 2540 UMR_MSEC__10_1_0_S6_S3 0 2540 /end CHARACTERISTIC
/begin CHARACTERISTIC T_RAABVFOLNACHMRSSP63 "Zeit Rampe auf Schaltdruck" VALUE 0x26E7FC kw_ui8_S6_S3 2540 UMR_MSEC__10_1_0_S6_S3 0 2540 /end CHARACTERISTIC
/begin CHARACTERISTIC KL_POKABVSP63 "Druckoffset Folgeschaltung in Abhaengigkeit von m_t" CURVE 0x24B110 kl_si16_S6_S3 12 UMR_BAR__1_1000_0_S6_S3 -6 6
 /begin AXIS_DESCR STD_AXIS zff_atsys._.iSignale._.obj.sig_m_t UMR_NM__1_1_0_S6_S3 4 -400 1640 DEPOSIT ABSOLUTE MONOTONY MON_INCREASE /end AXIS_DESCR
/end CHARACTERISTIC
/begin CHARACTERISTIC KL_POKABVFOLNACHMRSSP63 "Druckoffset Folgeschaltung nach MRS in Abhaengigkeit von m_t" CURVE 0x24B124 kl_si16_S6_S3 12 UMR_BAR__1_1000_0_S6_S3 -6 6
 /begin AXIS_DESCR STD_AXIS zff_atsys._.iSignale._.obj.sig_m_t UMR_NM__1_1_0_S6_S3 4 -400 1640 DEPOSIT ABSOLUTE MONOTONY MON_INCREASE /end AXIS_DESCR
/end CHARACTERISTIC
/begin CHARACTERISTIC KF_TSYNMTNTKABVFOLNACHMRSSP63 "Zeit vor sync. Ende Haltephase vorb. KAB" MAP 0x24B138 kf_si16_S6_S3 5000 UMR_MSEC__10_1_0_S6_S3 -5000 0
 /begin AXIS_DESCR STD_AXIS zff_atsys._.iSignale._.obj.sig_m_t UMR_NM__1_1_0_S6_S3 4 -400 1640 DEPOSIT ABSOLUTE MONOTONY MON_INCREASE /end AXIS_DESCR
 /begin AXIS_DESCR STD_AXIS zff_atsys._.iSignale._.obj.sig_n_t UMR_U_MIN_1_1_0_S6_S3 6 0 8160 DEPOSIT ABSOLUTE MONOTONY MON_INCREASE /end AXIS_DESCR
/end CHARACTERISTIC
/begin CHARACTERISTIC KL_PGOKABFOLNACHRSSP63 "Druckgradient in Abhaengigkeit von m_t fuer Folgeschaltung" CURVE 0x24B184 kl_si16_S6_S3 200 UMR_BAR_SEC_1_10_0_S6_S3 -100 100
 /begin AXIS_DESCR STD_AXIS zff_atsys._.iSignale._.obj.sig_m_t UMR_NM__1_1_0_S6_S3 6 -400 1640 DEPOSIT ABSOLUTE MONOTONY MON_INCREASE /end AXIS_DESCR
/end CHARACTERISTIC
/begin CHARACTERISTIC KL_PGRASYNKABFOLNACHRSSP63 "Druckgradient Wegschalten KAB fuer Folgeschaltung" CURVE 0x24B1A0 kl_si16_S6_S3 100 UMR_BAR_SEC_1_10_0_S6_S3 -100 0
 /begin AXIS_DESCR STD_AXIS zff_atsys._.iSignale._.obj.sig_m_t UMR_NM__1_1_0_S6_S3 6 -400 1640 DEPOSIT ABSOLUTE MONOTONY MON_INCREASE /end AXIS_DESCR
/end CHARACTERISTIC
/begin CHARACTERISTIC KF_PKABFOLSP63 "Schaltdruck ab.Kupplung fuer MRS Folgeschaltung" MAP 0x24B1BC kf_si16_S6_S3 12.75 UMR_BAR__1_1000_0_S6_S3 0 12.75
 /begin AXIS_DESCR STD_AXIS NO_INPUT_QUANTITY UMR_U_MIN_32_1_0_S6_S3 8 0 8160 DEPOSIT ABSOLUTE MONOTONY MON_INCREASE /end AXIS_DESCR
 /begin AXIS_DESCR STD_AXIS zff_atsys._.iSignale._.obj.sig_m_t UMR_NM__1_1_0_S6_S3 10 -400 1640 DEPOSIT ABSOLUTE MONOTONY MON_INCREASE /end AXIS_DESCR
/end CHARACTERISTIC
/begin CHARACTERISTIC TO_TSYNHINSYNSSP63 "Zeitoffset nach Synchron für Dauer Haltephase in Syn. KAB" VALUE 0x26E7FD kw_ui8_S6_S3 2540 UMR_MSEC__10_1_0_S6_S3 0 2540 /end CHARACTERISTIC
/begin CHARACTERISTIC KL_POKABNGABSP63 "Druckoffset in Abhaengigkeit von ng_ab" CURVE 0x24B288 kl_si16_S6_S3 12 UMR_BAR__1_1000_0_S6_S3 -6 6
 /begin AXIS_DESCR STD_AXIS iItfInput.ng_ab UMR_U_MINSEC_1_1_0_S6_S3 4 -5000 1000 DEPOSIT ABSOLUTE MONOTONY MON_INCREASE /end AXIS_DESCR
/end CHARACTERISTIC
/begin CHARACTERISTIC T_SYNKABWSSP63 "Zeit vor sync. Ende Schaltdruck KAB bei Weiterschaltung" VALUE 0x26E7FE kw_ui8_S6_S3 1280 UMR_MSEC__10_1_M128_S6_S3 -1280 0 /end CHARACTERISTIC
/begin CHARACTERISTIC KL_FPOCGHINSYNKABSP63 "Temperaturabhängige Gewichtung des Haltedruckoffsets" CURVE 0x24B29C kl_ui8_S6_S3 1 UMR___1_100_0_S6_S3 0 1
 /begin AXIS_DESCR STD_AXIS zff_atsys._.iSignale._.obj.sig_c_getr UMR_GRADC__1_1_M40_S6_S3 4 -40 150 DEPOSIT ABSOLUTE MONOTONY MON_INCREASE /end AXIS_DESCR
/end CHARACTERISTIC
/begin CHARACTERISTIC KL_TOHKABCGSP63 "Zeit Offset Haltephase" CURVE 0x24B2A8 kl_ui8_S6_S3 1270 UMR_MSEC__10_1_0_S6_S3 0 1270
 /begin AXIS_DESCR STD_AXIS zff_atsys._.iSignale._.obj.sig_c_getr UMR_GRADC__1_1_M40_S6_S3 4 -40 190 DEPOSIT ABSOLUTE MONOTONY MON_INCREASE /end AXIS_DESCR
/end CHARACTERISTIC
/begin CHARACTERISTIC KL_PGRASYNKABSP63 "Druckgradient Wegschalten abschaltende Kupplung" CURVE 0x24B2B4 kl_si16_S6_S3 100 UMR_BAR_SEC_1_10_0_S6_S3 -100 0
 /begin AXIS_DESCR STD_AXIS zff_atsys._.iSignale._.obj.sig_m_t UMR_NM__1_1_0_S6_S3 6 -400 1640 DEPOSIT ABSOLUTE MONOTONY MON_INCREASE /end AXIS_DESCR
/end CHARACTERISTIC
/begin CHARACTERISTIC KL_PGRASYNKABWSSP63 "Druckgradient Wegschalten abschaltende Kupplung bei Weiterschaltung" CURVE 0x24B2D0 kl_si16_S6_S3 100 UMR_BAR_SEC_1_10_0_S6_S3 -100 0
 /begin AXIS_DESCR STD_AXIS zff_atsys._.iSignale._.obj.sig_m_t UMR_NM__1_1_0_S6_S3 6 -400 1640 DEPOSIT ABSOLUTE MONOTONY MON_INCREASE /end AXIS_DESCR
/end CHARACTERISTIC
/begin CHARACTERISTIC KF_POKABMTCGSP63 "Schaltdruckoffset" MAP 0x24B2EC kf_si16_S6_S3 12.75 UMR_BAR__1_1000_0_S6_S3 -6.4 6.35
 /begin AXIS_DESCR STD_AXIS zff_atsys._.iSignale._.obj.sig_m_t UMR_NM__1_1_0_S6_S3 5 -400 1640 DEPOSIT ABSOLUTE MONOTONY MON_INCREASE /end AXIS_DESCR
 /begin AXIS_DESCR STD_AXIS zff_atsys._.iSignale._.obj.sig_c_getr UMR_GRADC__1_1_M40_S6_S3 10 -40 150 DEPOSIT ABSOLUTE MONOTONY MON_INCREASE /end AXIS_DESCR
/end CHARACTERISTIC
/begin CHARACTERISTIC KL_POKABMDMOTSOLLSP63 "Schaltdruckoffset in Abhaengigkeit von md_motsoll_sas" CURVE 0x24B378 kl_si16_S6_S3 12.75 UMR_BAR__1_1000_0_S6_S3 -6.4 6.35
 /begin AXIS_DESCR STD_AXIS NO_INPUT_QUANTITY UMR_NM__1_1_0_S6_S3 6 -2000 2000 DEPOSIT ABSOLUTE MONOTONY MON_INCREASE /end AXIS_DESCR
/end CHARACTERISTIC
/begin CHARACTERISTIC KF_TVKABMTNMOTRSSP63 "Verzögerungszeit abschaltende Kupplung bei RS" MAP 0x24B394 kf_ui8_S6_S3 2000 UMR_MSEC__10_1_0_S6_S3 0 2000
 /begin AXIS_DESCR STD_AXIS zff_atsys._.iSignale._.obj.sig_m_t8 UMR_NM__8_1_M50_S6_S3 4 -400 1640 DEPOSIT ABSOLUTE MONOTONY MON_INCREASE /end AXIS_DESCR
 /begin AXIS_DESCR STD_AXIS zff_atsys._.iSignale._.obj.sig_n_mot8 UMR_U_MIN_32_1_0_S6_S3 4 0 8160 DEPOSIT ABSOLUTE MONOTONY MON_INCREASE /end AXIS_DESCR
/end CHARACTERISTIC
/begin CHARACTERISTIC T_RAABVSP64 "Zeit Rampe auf Schaltdruck" VALUE 0x26E7FF kw_ui8_S6_S3 2540 UMR_MSEC__10_1_0_S6_S3 0 2540 /end CHARACTERISTIC
/begin CHARACTERISTIC T_RAABVFOLNACHMRSSP64 "Zeit Rampe auf Schaltdruck" VALUE 0x26E800 kw_ui8_S6_S3 2540 UMR_MSEC__10_1_0_S6_S3 0 2540 /end CHARACTERISTIC
/begin CHARACTERISTIC KL_POKABVSP64 "Druckoffset Folgeschaltung in Abhaengigkeit von m_t" CURVE 0x24B3B4 kl_si16_S6_S3 12 UMR_BAR__1_1000_0_S6_S3 -6 6
 /begin AXIS_DESCR STD_AXIS zff_atsys._.iSignale._.obj.sig_m_t UMR_NM__1_1_0_S6_S3 4 -400 1640 DEPOSIT ABSOLUTE MONOTONY MON_INCREASE /end AXIS_DESCR
/end CHARACTERISTIC
/begin CHARACTERISTIC KL_POKABVFOLNACHMRSSP64 "Druckoffset Folgeschaltung nach MRS in Abhaengigkeit von m_t" CURVE 0x24B3C8 kl_si16_S6_S3 12 UMR_BAR__1_1000_0_S6_S3 -6 6
 /begin AXIS_DESCR STD_AXIS zff_atsys._.iSignale._.obj.sig_m_t UMR_NM__1_1_0_S6_S3 4 -400 1640 DEPOSIT ABSOLUTE MONOTONY MON_INCREASE /end AXIS_DESCR
/end CHARACTERISTIC
/begin CHARACTERISTIC KF_TSYNMTNTKABVFOLNACHMRSSP64 "Zeit vor sync. Ende Haltephase vorb. KAB" MAP 0x24B3DC kf_si16_S6_S3 5000 UMR_MSEC__10_1_0_S6_S3 -5000 0
 /begin AXIS_DESCR STD_AXIS zff_atsys._.iSignale._.obj.sig_m_t UMR_NM__1_1_0_S6_S3 4 -400 1640 DEPOSIT ABSOLUTE MONOTONY MON_INCREASE /end AXIS_DESCR
 /begin AXIS_DESCR STD_AXIS zff_atsys._.iSignale._.obj.sig_n_t UMR_U_MIN_1_1_0_S6_S3 6 0 8160 DEPOSIT ABSOLUTE MONOTONY MON_INCREASE /end AXIS_DESCR
/end CHARACTERISTIC
/begin CHARACTERISTIC KL_PGOKABFOLNACHRSSP64 "Druckgradient in Abhaengigkeit von m_t fuer Folgeschaltung" CURVE 0x24B428 kl_si16_S6_S3 200 UMR_BAR_SEC_1_10_0_S6_S3 -100 100
 /begin AXIS_DESCR STD_AXIS zff_atsys._.iSignale._.obj.sig_m_t UMR_NM__1_1_0_S6_S3 6 -400 1640 DEPOSIT ABSOLUTE MONOTONY MON_INCREASE /end AXIS_DESCR
/end CHARACTERISTIC
/begin CHARACTERISTIC KL_PGRASYNKABFOLNACHRSSP64 "Druckgradient Wegschalten KAB fuer Folgeschaltung" CURVE 0x24B444 kl_si16_S6_S3 100 UMR_BAR_SEC_1_10_0_S6_S3 -100 0
 /begin AXIS_DESCR STD_AXIS zff_atsys._.iSignale._.obj.sig_m_t UMR_NM__1_1_0_S6_S3 6 -400 1640 DEPOSIT ABSOLUTE MONOTONY MON_INCREASE /end AXIS_DESCR
/end CHARACTERISTIC
/begin CHARACTERISTIC KF_PKABFOLSP64 "Schaltdruck ab.Kupplung fuer MRS Folgeschaltung" MAP 0x24B460 kf_si16_S6_S3 12.75 UMR_BAR__1_1000_0_S6_S3 0 12.75
 /begin AXIS_DESCR STD_AXIS NO_INPUT_QUANTITY UMR_U_MIN_32_1_0_S6_S3 8 0 8160 DEPOSIT ABSOLUTE MONOTONY MON_INCREASE /end AXIS_DESCR
 /begin AXIS_DESCR STD_AXIS zff_atsys._.iSignale._.obj.sig_m_t UMR_NM__1_1_0_S6_S3 10 -400 1640 DEPOSIT ABSOLUTE MONOTONY MON_INCREASE /end AXIS_DESCR
/end CHARACTERISTIC
/begin CHARACTERISTIC TO_TSYNHINSYNSSP64 "Zeitoffset nach Synchron für Dauer Haltephase in Syn. KAB" VALUE 0x26E801 kw_ui8_S6_S3 2540 UMR_MSEC__10_1_0_S6_S3 0 2540 /end CHARACTERISTIC
/begin CHARACTERISTIC KL_POKABNGABSP64 "Druckoffset in Abhaengigkeit von ng_ab" CURVE 0x24B52C kl_si16_S6_S3 12 UMR_BAR__1_1000_0_S6_S3 -6 6
 /begin AXIS_DESCR STD_AXIS iItfInput.ng_ab UMR_U_MINSEC_1_1_0_S6_S3 4 -5000 1000 DEPOSIT ABSOLUTE MONOTONY MON_INCREASE /end AXIS_DESCR
/end CHARACTERISTIC
/begin CHARACTERISTIC T_SYNKABWSSP64 "Zeit vor sync. Ende Schaltdruck KAB bei Weiterschaltung" VALUE 0x26E802 kw_ui8_S6_S3 1280 UMR_MSEC__10_1_M128_S6_S3 -1280 0 /end CHARACTERISTIC
/begin CHARACTERISTIC KL_FPOCGHINSYNKABSP64 "Temperaturabhängige Gewichtung des Haltedruckoffsets" CURVE 0x24B540 kl_ui8_S6_S3 1 UMR___1_100_0_S6_S3 0 1
 /begin AXIS_DESCR STD_AXIS zff_atsys._.iSignale._.obj.sig_c_getr UMR_GRADC__1_1_M40_S6_S3 4 -40 150 DEPOSIT ABSOLUTE MONOTONY MON_INCREASE /end AXIS_DESCR
/end CHARACTERISTIC
/begin CHARACTERISTIC KL_TOHKABCGSP64 "Zeit Offset Haltephase" CURVE 0x24B54C kl_ui8_S6_S3 1270 UMR_MSEC__10_1_0_S6_S3 0 1270
 /begin AXIS_DESCR STD_AXIS zff_atsys._.iSignale._.obj.sig_c_getr UMR_GRADC__1_1_M40_S6_S3 4 -40 190 DEPOSIT ABSOLUTE MONOTONY MON_INCREASE /end AXIS_DESCR
/end CHARACTERISTIC
/begin CHARACTERISTIC KL_PGRASYNKABSP64 "Druckgradient Wegschalten abschaltende Kupplung" CURVE 0x24B558 kl_si16_S6_S3 100 UMR_BAR_SEC_1_10_0_S6_S3 -100 0
 /begin AXIS_DESCR STD_AXIS zff_atsys._.iSignale._.obj.sig_m_t UMR_NM__1_1_0_S6_S3 6 -400 1640 DEPOSIT ABSOLUTE MONOTONY MON_INCREASE /end AXIS_DESCR
/end CHARACTERISTIC
/begin CHARACTERISTIC KL_PGRASYNKABWSSP64 "Druckgradient Wegschalten abschaltende Kupplung bei Weiterschaltung" CURVE 0x24B574 kl_si16_S6_S3 100 UMR_BAR_SEC_1_10_0_S6_S3 -100 0
 /begin AXIS_DESCR STD_AXIS zff_atsys._.iSignale._.obj.sig_m_t UMR_NM__1_1_0_S6_S3 6 -400 1640 DEPOSIT ABSOLUTE MONOTONY MON_INCREASE /end AXIS_DESCR
/end CHARACTERISTIC
/begin CHARACTERISTIC KF_POKABMTCGSP64 "Schaltdruckoffset" MAP 0x24B590 kf_si16_S6_S3 12.75 UMR_BAR__1_1000_0_S6_S3 -6.4 6.35
 /begin AXIS_DESCR STD_AXIS zff_atsys._.iSignale._.obj.sig_m_t UMR_NM__1_1_0_S6_S3 5 -400 1640 DEPOSIT ABSOLUTE MONOTONY MON_INCREASE /end AXIS_DESCR
 /begin AXIS_DESCR STD_AXIS zff_atsys._.iSignale._.obj.sig_c_getr UMR_GRADC__1_1_M40_S6_S3 10 -40 150 DEPOSIT ABSOLUTE MONOTONY MON_INCREASE /end AXIS_DESCR
/end CHARACTERISTIC
/begin CHARACTERISTIC KL_POKABMDMOTSOLLSP64 "Schaltdruckoffset in Abhaengigkeit von md_motsoll_sas" CURVE 0x24B61C kl_si16_S6_S3 12.75 UMR_BAR__1_1000_0_S6_S3 -6.4 6.35
 /begin AXIS_DESCR STD_AXIS NO_INPUT_QUANTITY UMR_NM__1_1_0_S6_S3 6 -2000 2000 DEPOSIT ABSOLUTE MONOTONY MON_INCREASE /end AXIS_DESCR
/end CHARACTERISTIC
/begin CHARACTERISTIC KF_TVKABMTNMOTRSSP64 "Verzögerungszeit abschaltende Kupplung bei RS" MAP 0x24B638 kf_ui8_S6_S3 2000 UMR_MSEC__10_1_0_S6_S3 0 2000
 /begin AXIS_DESCR STD_AXIS zff_atsys._.iSignale._.obj.sig_m_t8 UMR_NM__8_1_M50_S6_S3 4 -400 1640 DEPOSIT ABSOLUTE MONOTONY MON_INCREASE /end AXIS_DESCR
 /begin AXIS_DESCR STD_AXIS zff_atsys._.iSignale._.obj.sig_n_mot8 UMR_U_MIN_32_1_0_S6_S3 4 0 8160 DEPOSIT ABSOLUTE MONOTONY MON_INCREASE /end AXIS_DESCR
/end CHARACTERISTIC
/begin CHARACTERISTIC T_RAABVSP71 "Zeit Rampe auf Schaltdruck" VALUE 0x26E803 kw_ui8_S6_S3 2540 UMR_MSEC__10_1_0_S6_S3 0 2540 /end CHARACTERISTIC
/begin CHARACTERISTIC T_RAABVFOLNACHMRSSP71 "Zeit Rampe auf Schaltdruck" VALUE 0x26E804 kw_ui8_S6_S3 2540 UMR_MSEC__10_1_0_S6_S3 0 2540 /end CHARACTERISTIC
/begin CHARACTERISTIC KL_POKABVSP71 "Druckoffset Folgeschaltung in Abhaengigkeit von m_t" CURVE 0x24B658 kl_si16_S6_S3 12 UMR_BAR__1_1000_0_S6_S3 -6 6
 /begin AXIS_DESCR STD_AXIS zff_atsys._.iSignale._.obj.sig_m_t UMR_NM__1_1_0_S6_S3 4 -400 1640 DEPOSIT ABSOLUTE MONOTONY MON_INCREASE /end AXIS_DESCR
/end CHARACTERISTIC
/begin CHARACTERISTIC KL_POKABVFOLNACHMRSSP71 "Druckoffset Folgeschaltung nach MRS in Abhaengigkeit von m_t" CURVE 0x24B66C kl_si16_S6_S3 12 UMR_BAR__1_1000_0_S6_S3 -6 6
 /begin AXIS_DESCR STD_AXIS zff_atsys._.iSignale._.obj.sig_m_t UMR_NM__1_1_0_S6_S3 4 -400 1640 DEPOSIT ABSOLUTE MONOTONY MON_INCREASE /end AXIS_DESCR
/end CHARACTERISTIC
/begin CHARACTERISTIC KF_TSYNMTNTKABVFOLNACHMRSSP71 "Zeit vor sync. Ende Haltephase vorb. KAB" MAP 0x24B680 kf_si16_S6_S3 5000 UMR_MSEC__10_1_0_S6_S3 -5000 0
 /begin AXIS_DESCR STD_AXIS zff_atsys._.iSignale._.obj.sig_m_t UMR_NM__1_1_0_S6_S3 4 -400 1640 DEPOSIT ABSOLUTE MONOTONY MON_INCREASE /end AXIS_DESCR
 /begin AXIS_DESCR STD_AXIS zff_atsys._.iSignale._.obj.sig_n_t UMR_U_MIN_1_1_0_S6_S3 6 0 8160 DEPOSIT ABSOLUTE MONOTONY MON_INCREASE /end AXIS_DESCR
/end CHARACTERISTIC
/begin CHARACTERISTIC KL_PGOKABFOLNACHRSSP71 "Druckgradient in Abhaengigkeit von m_t fuer Folgeschaltung" CURVE 0x24B6CC kl_si16_S6_S3 200 UMR_BAR_SEC_1_10_0_S6_S3 -100 100
 /begin AXIS_DESCR STD_AXIS zff_atsys._.iSignale._.obj.sig_m_t UMR_NM__1_1_0_S6_S3 6 -400 1640 DEPOSIT ABSOLUTE MONOTONY MON_INCREASE /end AXIS_DESCR
/end CHARACTERISTIC
/begin CHARACTERISTIC KL_PGRASYNKABFOLNACHRSSP71 "Druckgradient Wegschalten KAB fuer Folgeschaltung" CURVE 0x24B6E8 kl_si16_S6_S3 100 UMR_BAR_SEC_1_10_0_S6_S3 -100 0
 /begin AXIS_DESCR STD_AXIS zff_atsys._.iSignale._.obj.sig_m_t UMR_NM__1_1_0_S6_S3 6 -400 1640 DEPOSIT ABSOLUTE MONOTONY MON_INCREASE /end AXIS_DESCR
/end CHARACTERISTIC
/begin CHARACTERISTIC KF_PKABFOLSP71 "Schaltdruck ab.Kupplung fuer MRS Folgeschaltung" MAP 0x24B704 kf_si16_S6_S3 12.75 UMR_BAR__1_1000_0_S6_S3 0 12.75
 /begin AXIS_DESCR STD_AXIS NO_INPUT_QUANTITY UMR_U_MIN_32_1_0_S6_S3 8 0 8160 DEPOSIT ABSOLUTE MONOTONY MON_INCREASE /end AXIS_DESCR
 /begin AXIS_DESCR STD_AXIS zff_atsys._.iSignale._.obj.sig_m_t UMR_NM__1_1_0_S6_S3 10 -400 1640 DEPOSIT ABSOLUTE MONOTONY MON_INCREASE /end AXIS_DESCR
/end CHARACTERISTIC
/begin CHARACTERISTIC TO_TSYNHINSYNSSP71 "Zeitoffset nach Synchron für Dauer Haltephase in Syn. KAB" VALUE 0x26E805 kw_ui8_S6_S3 2540 UMR_MSEC__10_1_0_S6_S3 0 2540 /end CHARACTERISTIC
/begin CHARACTERISTIC KL_POKABNGABSP71 "Druckoffset in Abhaengigkeit von ng_ab" CURVE 0x24B7D0 kl_si16_S6_S3 12 UMR_BAR__1_1000_0_S6_S3 -6 6
 /begin AXIS_DESCR STD_AXIS iItfInput.ng_ab UMR_U_MINSEC_1_1_0_S6_S3 4 -5000 1000 DEPOSIT ABSOLUTE MONOTONY MON_INCREASE /end AXIS_DESCR
/end CHARACTERISTIC
/begin CHARACTERISTIC T_SYNKABWSSP71 "Zeit vor sync. Ende Schaltdruck KAB bei Weiterschaltung" VALUE 0x26E806 kw_ui8_S6_S3 1280 UMR_MSEC__10_1_M128_S6_S3 -1280 0 /end CHARACTERISTIC
/begin CHARACTERISTIC KL_FPOCGHINSYNKABSP71 "Temperaturabhängige Gewichtung des Haltedruckoffsets" CURVE 0x24B7E4 kl_ui8_S6_S3 1 UMR___1_100_0_S6_S3 0 1
 /begin AXIS_DESCR STD_AXIS zff_atsys._.iSignale._.obj.sig_c_getr UMR_GRADC__1_1_M40_S6_S3 4 -40 150 DEPOSIT ABSOLUTE MONOTONY MON_INCREASE /end AXIS_DESCR
/end CHARACTERISTIC
/begin CHARACTERISTIC KL_TOHKABCGSP71 "Zeit Offset Haltephase" CURVE 0x24B7F0 kl_ui8_S6_S3 1270 UMR_MSEC__10_1_0_S6_S3 0 1270
 /begin AXIS_DESCR STD_AXIS zff_atsys._.iSignale._.obj.sig_c_getr UMR_GRADC__1_1_M40_S6_S3 4 -40 190 DEPOSIT ABSOLUTE MONOTONY MON_INCREASE /end AXIS_DESCR
/end CHARACTERISTIC
/begin CHARACTERISTIC KL_PGRASYNKABSP71 "Druckgradient Wegschalten abschaltende Kupplung" CURVE 0x24B7FC kl_si16_S6_S3 100 UMR_BAR_SEC_1_10_0_S6_S3 -100 0
 /begin AXIS_DESCR STD_AXIS zff_atsys._.iSignale._.obj.sig_m_t UMR_NM__1_1_0_S6_S3 6 -400 1640 DEPOSIT ABSOLUTE MONOTONY MON_INCREASE /end AXIS_DESCR
/end CHARACTERISTIC
/begin CHARACTERISTIC KL_PGRASYNKABWSSP71 "Druckgradient Wegschalten abschaltende Kupplung bei Weiterschaltung" CURVE 0x24B818 kl_si16_S6_S3 100 UMR_BAR_SEC_1_10_0_S6_S3 -100 0
 /begin AXIS_DESCR STD_AXIS zff_atsys._.iSignale._.obj.sig_m_t UMR_NM__1_1_0_S6_S3 6 -400 1640 DEPOSIT ABSOLUTE MONOTONY MON_INCREASE /end AXIS_DESCR
/end CHARACTERISTIC
/begin CHARACTERISTIC KF_POKABMTCGSP71 "Schaltdruckoffset" MAP 0x24B834 kf_si16_S6_S3 12.75 UMR_BAR__1_1000_0_S6_S3 -6.4 6.35
 /begin AXIS_DESCR STD_AXIS zff_atsys._.iSignale._.obj.sig_m_t UMR_NM__1_1_0_S6_S3 5 -400 1640 DEPOSIT ABSOLUTE MONOTONY MON_INCREASE /end AXIS_DESCR
 /begin AXIS_DESCR STD_AXIS zff_atsys._.iSignale._.obj.sig_c_getr UMR_GRADC__1_1_M40_S6_S3 10 -40 150 DEPOSIT ABSOLUTE MONOTONY MON_INCREASE /end AXIS_DESCR
/end CHARACTERISTIC
/begin CHARACTERISTIC KL_POKABMDMOTSOLLSP71 "Schaltdruckoffset in Abhaengigkeit von md_motsoll_sas" CURVE 0x24B8C0 kl_si16_S6_S3 12.75 UMR_BAR__1_1000_0_S6_S3 -6.4 6.35
 /begin AXIS_DESCR STD_AXIS NO_INPUT_QUANTITY UMR_NM__1_1_0_S6_S3 6 -2000 2000 DEPOSIT ABSOLUTE MONOTONY MON_INCREASE /end AXIS_DESCR
/end CHARACTERISTIC
/begin CHARACTERISTIC KF_TVKABMTNMOTRSSP71 "Verzögerungszeit abschaltende Kupplung bei RS" MAP 0x24B8DC kf_ui8_S6_S3 2000 UMR_MSEC__10_1_0_S6_S3 0 2000
 /begin AXIS_DESCR STD_AXIS zff_atsys._.iSignale._.obj.sig_m_t8 UMR_NM__8_1_M50_S6_S3 4 -400 1640 DEPOSIT ABSOLUTE MONOTONY MON_INCREASE /end AXIS_DESCR
 /begin AXIS_DESCR STD_AXIS zff_atsys._.iSignale._.obj.sig_n_mot8 UMR_U_MIN_32_1_0_S6_S3 4 0 8160 DEPOSIT ABSOLUTE MONOTONY MON_INCREASE /end AXIS_DESCR
/end CHARACTERISTIC
/begin CHARACTERISTIC T_RAABVSP75 "Zeit Rampe auf Schaltdruck" VALUE 0x26E807 kw_ui8_S6_S3 2540 UMR_MSEC__10_1_0_S6_S3 0 2540 /end CHARACTERISTIC
/begin CHARACTERISTIC T_RAABVFOLNACHMRSSP75 "Zeit Rampe auf Schaltdruck" VALUE 0x26E808 kw_ui8_S6_S3 2540 UMR_MSEC__10_1_0_S6_S3 0 2540 /end CHARACTERISTIC
/begin CHARACTERISTIC KL_POKABVSP75 "Druckoffset Folgeschaltung in Abhaengigkeit von m_t" CURVE 0x24B8FC kl_si16_S6_S3 12 UMR_BAR__1_1000_0_S6_S3 -6 6
 /begin AXIS_DESCR STD_AXIS zff_atsys._.iSignale._.obj.sig_m_t UMR_NM__1_1_0_S6_S3 4 -400 1640 DEPOSIT ABSOLUTE MONOTONY MON_INCREASE /end AXIS_DESCR
/end CHARACTERISTIC
/begin CHARACTERISTIC KL_POKABVFOLNACHMRSSP75 "Druckoffset Folgeschaltung nach MRS in Abhaengigkeit von m_t" CURVE 0x24B910 kl_si16_S6_S3 12 UMR_BAR__1_1000_0_S6_S3 -6 6
 /begin AXIS_DESCR STD_AXIS zff_atsys._.iSignale._.obj.sig_m_t UMR_NM__1_1_0_S6_S3 4 -400 1640 DEPOSIT ABSOLUTE MONOTONY MON_INCREASE /end AXIS_DESCR
/end CHARACTERISTIC
/begin CHARACTERISTIC KF_TSYNMTNTKABVFOLNACHMRSSP75 "Zeit vor sync. Ende Haltephase vorb. KAB" MAP 0x24B924 kf_si16_S6_S3 5000 UMR_MSEC__10_1_0_S6_S3 -5000 0
 /begin AXIS_DESCR STD_AXIS zff_atsys._.iSignale._.obj.sig_m_t UMR_NM__1_1_0_S6_S3 4 -400 1640 DEPOSIT ABSOLUTE MONOTONY MON_INCREASE /end AXIS_DESCR
 /begin AXIS_DESCR STD_AXIS zff_atsys._.iSignale._.obj.sig_n_t UMR_U_MIN_1_1_0_S6_S3 6 0 8160 DEPOSIT ABSOLUTE MONOTONY MON_INCREASE /end AXIS_DESCR
/end CHARACTERISTIC
/begin CHARACTERISTIC KL_PGOKABFOLNACHRSSP75 "Druckgradient in Abhaengigkeit von m_t fuer Folgeschaltung" CURVE 0x24B970 kl_si16_S6_S3 200 UMR_BAR_SEC_1_10_0_S6_S3 -100 100
 /begin AXIS_DESCR STD_AXIS zff_atsys._.iSignale._.obj.sig_m_t UMR_NM__1_1_0_S6_S3 6 -400 1640 DEPOSIT ABSOLUTE MONOTONY MON_INCREASE /end AXIS_DESCR
/end CHARACTERISTIC
/begin CHARACTERISTIC KL_PGRASYNKABFOLNACHRSSP75 "Druckgradient Wegschalten KAB fuer Folgeschaltung" CURVE 0x24B98C kl_si16_S6_S3 100 UMR_BAR_SEC_1_10_0_S6_S3 -100 0
 /begin AXIS_DESCR STD_AXIS zff_atsys._.iSignale._.obj.sig_m_t UMR_NM__1_1_0_S6_S3 6 -400 1640 DEPOSIT ABSOLUTE MONOTONY MON_INCREASE /end AXIS_DESCR
/end CHARACTERISTIC
/begin CHARACTERISTIC KF_PKABFOLSP75 "Schaltdruck ab.Kupplung fuer MRS Folgeschaltung" MAP 0x24B9A8 kf_si16_S6_S3 12.75 UMR_BAR__1_1000_0_S6_S3 0 12.75
 /begin AXIS_DESCR STD_AXIS NO_INPUT_QUANTITY UMR_U_MIN_32_1_0_S6_S3 8 0 8160 DEPOSIT ABSOLUTE MONOTONY MON_INCREASE /end AXIS_DESCR
 /begin AXIS_DESCR STD_AXIS zff_atsys._.iSignale._.obj.sig_m_t UMR_NM__1_1_0_S6_S3 10 -400 1640 DEPOSIT ABSOLUTE MONOTONY MON_INCREASE /end AXIS_DESCR
/end CHARACTERISTIC
/begin CHARACTERISTIC TO_TSYNHINSYNSSP75 "Zeitoffset nach Synchron für Dauer Haltephase in Syn. KAB" VALUE 0x26E809 kw_ui8_S6_S3 2540 UMR_MSEC__10_1_0_S6_S3 0 2540 /end CHARACTERISTIC
/begin CHARACTERISTIC KL_POKABNGABSP75 "Druckoffset in Abhaengigkeit von ng_ab" CURVE 0x24BA74 kl_si16_S6_S3 12 UMR_BAR__1_1000_0_S6_S3 -6 6
 /begin AXIS_DESCR STD_AXIS iItfInput.ng_ab UMR_U_MINSEC_1_1_0_S6_S3 4 -5000 1000 DEPOSIT ABSOLUTE MONOTONY MON_INCREASE /end AXIS_DESCR
/end CHARACTERISTIC
/begin CHARACTERISTIC T_SYNKABWSSP75 "Zeit vor sync. Ende Schaltdruck KAB bei Weiterschaltung" VALUE 0x26E80A kw_ui8_S6_S3 1280 UMR_MSEC__10_1_M128_S6_S3 -1280 0 /end CHARACTERISTIC
/begin CHARACTERISTIC KL_FPOCGHINSYNKABSP75 "Temperaturabhängige Gewichtung des Haltedruckoffsets" CURVE 0x24BA88 kl_ui8_S6_S3 1 UMR___1_100_0_S6_S3 0 1
 /begin AXIS_DESCR STD_AXIS zff_atsys._.iSignale._.obj.sig_c_getr UMR_GRADC__1_1_M40_S6_S3 4 -40 150 DEPOSIT ABSOLUTE MONOTONY MON_INCREASE /end AXIS_DESCR
/end CHARACTERISTIC
/begin CHARACTERISTIC KL_TOHKABCGSP75 "Zeit Offset Haltephase" CURVE 0x24BA94 kl_ui8_S6_S3 1270 UMR_MSEC__10_1_0_S6_S3 0 1270
 /begin AXIS_DESCR STD_AXIS zff_atsys._.iSignale._.obj.sig_c_getr UMR_GRADC__1_1_M40_S6_S3 4 -40 190 DEPOSIT ABSOLUTE MONOTONY MON_INCREASE /end AXIS_DESCR
/end CHARACTERISTIC
/begin CHARACTERISTIC KL_PGRASYNKABSP75 "Druckgradient Wegschalten abschaltende Kupplung" CURVE 0x24BAA0 kl_si16_S6_S3 100 UMR_BAR_SEC_1_10_0_S6_S3 -100 0
 /begin AXIS_DESCR STD_AXIS zff_atsys._.iSignale._.obj.sig_m_t UMR_NM__1_1_0_S6_S3 6 -400 1640 DEPOSIT ABSOLUTE MONOTONY MON_INCREASE /end AXIS_DESCR
/end CHARACTERISTIC
/begin CHARACTERISTIC KL_PGRASYNKABWSSP75 "Druckgradient Wegschalten abschaltende Kupplung bei Weiterschaltung" CURVE 0x24BABC kl_si16_S6_S3 100 UMR_BAR_SEC_1_10_0_S6_S3 -100 0
 /begin AXIS_DESCR STD_AXIS zff_atsys._.iSignale._.obj.sig_m_t UMR_NM__1_1_0_S6_S3 6 -400 1640 DEPOSIT ABSOLUTE MONOTONY MON_INCREASE /end AXIS_DESCR
/end CHARACTERISTIC
/begin CHARACTERISTIC KF_POKABMTCGSP75 "Schaltdruckoffset" MAP 0x24BAD8 kf_si16_S6_S3 12.75 UMR_BAR__1_1000_0_S6_S3 -6.4 6.35
 /begin AXIS_DESCR STD_AXIS zff_atsys._.iSignale._.obj.sig_m_t UMR_NM__1_1_0_S6_S3 5 -400 1640 DEPOSIT ABSOLUTE MONOTONY MON_INCREASE /end AXIS_DESCR
 /begin AXIS_DESCR STD_AXIS zff_atsys._.iSignale._.obj.sig_c_getr UMR_GRADC__1_1_M40_S6_S3 10 -40 150 DEPOSIT ABSOLUTE MONOTONY MON_INCREASE /end AXIS_DESCR
/end CHARACTERISTIC
/begin CHARACTERISTIC KL_POKABMDMOTSOLLSP75 "Schaltdruckoffset in Abhaengigkeit von md_motsoll_sas" CURVE 0x24BB64 kl_si16_S6_S3 12.75 UMR_BAR__1_1000_0_S6_S3 -6.4 6.35
 /begin AXIS_DESCR STD_AXIS NO_INPUT_QUANTITY UMR_NM__1_1_0_S6_S3 6 -2000 2000 DEPOSIT ABSOLUTE MONOTONY MON_INCREASE /end AXIS_DESCR
/end CHARACTERISTIC
/begin CHARACTERISTIC KF_TVKABMTNMOTRSSP75 "Verzögerungszeit abschaltende Kupplung bei RS" MAP 0x24BB80 kf_ui8_S6_S3 2000 UMR_MSEC__10_1_0_S6_S3 0 2000
 /begin AXIS_DESCR STD_AXIS zff_atsys._.iSignale._.obj.sig_m_t8 UMR_NM__8_1_M50_S6_S3 4 -400 1640 DEPOSIT ABSOLUTE MONOTONY MON_INCREASE /end AXIS_DESCR
 /begin AXIS_DESCR STD_AXIS zff_atsys._.iSignale._.obj.sig_n_mot8 UMR_U_MIN_32_1_0_S6_S3 4 0 8160 DEPOSIT ABSOLUTE MONOTONY MON_INCREASE /end AXIS_DESCR
/end CHARACTERISTIC
/begin CHARACTERISTIC T_RAABVSP82 "Zeit Rampe auf Schaltdruck" VALUE 0x26E80B kw_ui8_S6_S3 2540 UMR_MSEC__10_1_0_S6_S3 0 2540 /end CHARACTERISTIC
/begin CHARACTERISTIC T_RAABVFOLNACHMRSSP82 "Zeit Rampe auf Schaltdruck" VALUE 0x26E80C kw_ui8_S6_S3 2540 UMR_MSEC__10_1_0_S6_S3 0 2540 /end CHARACTERISTIC
/begin CHARACTERISTIC KL_POKABVSP82 "Druckoffset Folgeschaltung in Abhaengigkeit von m_t" CURVE 0x24BBA0 kl_si16_S6_S3 12 UMR_BAR__1_1000_0_S6_S3 -6 6
 /begin AXIS_DESCR STD_AXIS zff_atsys._.iSignale._.obj.sig_m_t UMR_NM__1_1_0_S6_S3 4 -400 1640 DEPOSIT ABSOLUTE MONOTONY MON_INCREASE /end AXIS_DESCR
/end CHARACTERISTIC
/begin CHARACTERISTIC KL_POKABVFOLNACHMRSSP82 "Druckoffset Folgeschaltung nach MRS in Abhaengigkeit von m_t" CURVE 0x24BBB4 kl_si16_S6_S3 12 UMR_BAR__1_1000_0_S6_S3 -6 6
 /begin AXIS_DESCR STD_AXIS zff_atsys._.iSignale._.obj.sig_m_t UMR_NM__1_1_0_S6_S3 4 -400 1640 DEPOSIT ABSOLUTE MONOTONY MON_INCREASE /end AXIS_DESCR
/end CHARACTERISTIC
/begin CHARACTERISTIC KF_TSYNMTNTKABVFOLNACHMRSSP82 "Zeit vor sync. Ende Haltephase vorb. KAB" MAP 0x24BBC8 kf_si16_S6_S3 5000 UMR_MSEC__10_1_0_S6_S3 -5000 0
 /begin AXIS_DESCR STD_AXIS zff_atsys._.iSignale._.obj.sig_m_t UMR_NM__1_1_0_S6_S3 4 -400 1640 DEPOSIT ABSOLUTE MONOTONY MON_INCREASE /end AXIS_DESCR
 /begin AXIS_DESCR STD_AXIS zff_atsys._.iSignale._.obj.sig_n_t UMR_U_MIN_1_1_0_S6_S3 6 0 8160 DEPOSIT ABSOLUTE MONOTONY MON_INCREASE /end AXIS_DESCR
/end CHARACTERISTIC
/begin CHARACTERISTIC KL_PGOKABFOLNACHRSSP82 "Druckgradient in Abhaengigkeit von m_t fuer Folgeschaltung" CURVE 0x24BC14 kl_si16_S6_S3 200 UMR_BAR_SEC_1_10_0_S6_S3 -100 100
 /begin AXIS_DESCR STD_AXIS zff_atsys._.iSignale._.obj.sig_m_t UMR_NM__1_1_0_S6_S3 6 -400 1640 DEPOSIT ABSOLUTE MONOTONY MON_INCREASE /end AXIS_DESCR
/end CHARACTERISTIC
/begin CHARACTERISTIC KL_PGRASYNKABFOLNACHRSSP82 "Druckgradient Wegschalten KAB fuer Folgeschaltung" CURVE 0x24BC30 kl_si16_S6_S3 100 UMR_BAR_SEC_1_10_0_S6_S3 -100 0
 /begin AXIS_DESCR STD_AXIS zff_atsys._.iSignale._.obj.sig_m_t UMR_NM__1_1_0_S6_S3 6 -400 1640 DEPOSIT ABSOLUTE MONOTONY MON_INCREASE /end AXIS_DESCR
/end CHARACTERISTIC
/begin CHARACTERISTIC KF_PKABFOLSP82 "Schaltdruck ab.Kupplung fuer MRS Folgeschaltung" MAP 0x24BC4C kf_si16_S6_S3 12.75 UMR_BAR__1_1000_0_S6_S3 0 12.75
 /begin AXIS_DESCR STD_AXIS NO_INPUT_QUANTITY UMR_U_MIN_32_1_0_S6_S3 8 0 8160 DEPOSIT ABSOLUTE MONOTONY MON_INCREASE /end AXIS_DESCR
 /begin AXIS_DESCR STD_AXIS zff_atsys._.iSignale._.obj.sig_m_t UMR_NM__1_1_0_S6_S3 10 -400 1640 DEPOSIT ABSOLUTE MONOTONY MON_INCREASE /end AXIS_DESCR
/end CHARACTERISTIC
/begin CHARACTERISTIC TO_TSYNHINSYNSSP82 "Zeitoffset nach Synchron für Dauer Haltephase in Syn. KAB" VALUE 0x26E80D kw_ui8_S6_S3 2540 UMR_MSEC__10_1_0_S6_S3 0 2540 /end CHARACTERISTIC
/begin CHARACTERISTIC KL_POKABNGABSP82 "Druckoffset in Abhaengigkeit von ng_ab" CURVE 0x24BD18 kl_si16_S6_S3 12 UMR_BAR__1_1000_0_S6_S3 -6 6
 /begin AXIS_DESCR STD_AXIS iItfInput.ng_ab UMR_U_MINSEC_1_1_0_S6_S3 4 -5000 1000 DEPOSIT ABSOLUTE MONOTONY MON_INCREASE /end AXIS_DESCR
/end CHARACTERISTIC
/begin CHARACTERISTIC T_SYNKABWSSP82 "Zeit vor sync. Ende Schaltdruck KAB bei Weiterschaltung" VALUE 0x26E80E kw_ui8_S6_S3 1280 UMR_MSEC__10_1_M128_S6_S3 -1280 0 /end CHARACTERISTIC
/begin CHARACTERISTIC KL_FPOCGHINSYNKABSP82 "Temperaturabhängige Gewichtung des Haltedruckoffsets" CURVE 0x24BD2C kl_ui8_S6_S3 1 UMR___1_100_0_S6_S3 0 1
 /begin AXIS_DESCR STD_AXIS zff_atsys._.iSignale._.obj.sig_c_getr UMR_GRADC__1_1_M40_S6_S3 4 -40 150 DEPOSIT ABSOLUTE MONOTONY MON_INCREASE /end AXIS_DESCR
/end CHARACTERISTIC
/begin CHARACTERISTIC KL_TOHKABCGSP82 "Zeit Offset Haltephase" CURVE 0x24BD38 kl_ui8_S6_S3 1270 UMR_MSEC__10_1_0_S6_S3 0 1270
 /begin AXIS_DESCR STD_AXIS zff_atsys._.iSignale._.obj.sig_c_getr UMR_GRADC__1_1_M40_S6_S3 4 -40 190 DEPOSIT ABSOLUTE MONOTONY MON_INCREASE /end AXIS_DESCR
/end CHARACTERISTIC
/begin CHARACTERISTIC KL_PGRASYNKABSP82 "Druckgradient Wegschalten abschaltende Kupplung" CURVE 0x24BD44 kl_si16_S6_S3 100 UMR_BAR_SEC_1_10_0_S6_S3 -100 0
 /begin AXIS_DESCR STD_AXIS zff_atsys._.iSignale._.obj.sig_m_t UMR_NM__1_1_0_S6_S3 6 -400 1640 DEPOSIT ABSOLUTE MONOTONY MON_INCREASE /end AXIS_DESCR
/end CHARACTERISTIC
/begin CHARACTERISTIC KL_PGRASYNKABWSSP82 "Druckgradient Wegschalten abschaltende Kupplung bei Weiterschaltung" CURVE 0x24BD60 kl_si16_S6_S3 100 UMR_BAR_SEC_1_10_0_S6_S3 -100 0
 /begin AXIS_DESCR STD_AXIS zff_atsys._.iSignale._.obj.sig_m_t UMR_NM__1_1_0_S6_S3 6 -400 1640 DEPOSIT ABSOLUTE MONOTONY MON_INCREASE /end AXIS_DESCR
/end CHARACTERISTIC
/begin CHARACTERISTIC KF_POKABMTCGSP82 "Schaltdruckoffset" MAP 0x24BD7C kf_si16_S6_S3 12.75 UMR_BAR__1_1000_0_S6_S3 -6.4 6.35
 /begin AXIS_DESCR STD_AXIS zff_atsys._.iSignale._.obj.sig_m_t UMR_NM__1_1_0_S6_S3 5 -400 1640 DEPOSIT ABSOLUTE MONOTONY MON_INCREASE /end AXIS_DESCR
 /begin AXIS_DESCR STD_AXIS zff_atsys._.iSignale._.obj.sig_c_getr UMR_GRADC__1_1_M40_S6_S3 10 -40 150 DEPOSIT ABSOLUTE MONOTONY MON_INCREASE /end AXIS_DESCR
/end CHARACTERISTIC
/begin CHARACTERISTIC KL_POKABMDMOTSOLLSP82 "Schaltdruckoffset in Abhaengigkeit von md_motsoll_sas" CURVE 0x24BE08 kl_si16_S6_S3 12.75 UMR_BAR__1_1000_0_S6_S3 -6.4 6.35
 /begin AXIS_DESCR STD_AXIS NO_INPUT_QUANTITY UMR_NM__1_1_0_S6_S3 6 -2000 2000 DEPOSIT ABSOLUTE MONOTONY MON_INCREASE /end AXIS_DESCR
/end CHARACTERISTIC
/begin CHARACTERISTIC KF_TVKABMTNMOTRSSP82 "Verzögerungszeit abschaltende Kupplung bei RS" MAP 0x24BE24 kf_ui8_S6_S3 2000 UMR_MSEC__10_1_0_S6_S3 0 2000
 /begin AXIS_DESCR STD_AXIS zff_atsys._.iSignale._.obj.sig_m_t8 UMR_NM__8_1_M50_S6_S3 4 -400 1640 DEPOSIT ABSOLUTE MONOTONY MON_INCREASE /end AXIS_DESCR
 /begin AXIS_DESCR STD_AXIS zff_atsys._.iSignale._.obj.sig_n_mot8 UMR_U_MIN_32_1_0_S6_S3 4 0 8160 DEPOSIT ABSOLUTE MONOTONY MON_INCREASE /end AXIS_DESCR
/end CHARACTERISTIC
/begin CHARACTERISTIC T_RAABVSP86 "Zeit Rampe auf Schaltdruck" VALUE 0x26E80F kw_ui8_S6_S3 2540 UMR_MSEC__10_1_0_S6_S3 0 2540 /end CHARACTERISTIC
/begin CHARACTERISTIC T_RAABVFOLNACHMRSSP86 "Zeit Rampe auf Schaltdruck" VALUE 0x26E810 kw_ui8_S6_S3 2540 UMR_MSEC__10_1_0_S6_S3 0 2540 /end CHARACTERISTIC
/begin CHARACTERISTIC KL_POKABVSP86 "Druckoffset Folgeschaltung in Abhaengigkeit von m_t" CURVE 0x24BE44 kl_si16_S6_S3 12 UMR_BAR__1_1000_0_S6_S3 -6 6
 /begin AXIS_DESCR STD_AXIS zff_atsys._.iSignale._.obj.sig_m_t UMR_NM__1_1_0_S6_S3 4 -400 1640 DEPOSIT ABSOLUTE MONOTONY MON_INCREASE /end AXIS_DESCR
/end CHARACTERISTIC
/begin CHARACTERISTIC KL_POKABVFOLNACHMRSSP86 "Druckoffset Folgeschaltung nach MRS in Abhaengigkeit von m_t" CURVE 0x24BE58 kl_si16_S6_S3 12 UMR_BAR__1_1000_0_S6_S3 -6 6
 /begin AXIS_DESCR STD_AXIS zff_atsys._.iSignale._.obj.sig_m_t UMR_NM__1_1_0_S6_S3 4 -400 1640 DEPOSIT ABSOLUTE MONOTONY MON_INCREASE /end AXIS_DESCR
/end CHARACTERISTIC
/begin CHARACTERISTIC KF_TSYNMTNTKABVFOLNACHMRSSP86 "Zeit vor sync. Ende Haltephase vorb. KAB" MAP 0x24BE6C kf_si16_S6_S3 5000 UMR_MSEC__10_1_0_S6_S3 -5000 0
 /begin AXIS_DESCR STD_AXIS zff_atsys._.iSignale._.obj.sig_m_t UMR_NM__1_1_0_S6_S3 4 -400 1640 DEPOSIT ABSOLUTE MONOTONY MON_INCREASE /end AXIS_DESCR
 /begin AXIS_DESCR STD_AXIS zff_atsys._.iSignale._.obj.sig_n_t UMR_U_MIN_1_1_0_S6_S3 6 0 8160 DEPOSIT ABSOLUTE MONOTONY MON_INCREASE /end AXIS_DESCR
/end CHARACTERISTIC
/begin CHARACTERISTIC KL_PGOKABFOLNACHRSSP86 "Druckgradient in Abhaengigkeit von m_t fuer Folgeschaltung" CURVE 0x24BEB8 kl_si16_S6_S3 200 UMR_BAR_SEC_1_10_0_S6_S3 -100 100
 /begin AXIS_DESCR STD_AXIS zff_atsys._.iSignale._.obj.sig_m_t UMR_NM__1_1_0_S6_S3 6 -400 1640 DEPOSIT ABSOLUTE MONOTONY MON_INCREASE /end AXIS_DESCR
/end CHARACTERISTIC
/begin CHARACTERISTIC KL_PGRASYNKABFOLNACHRSSP86 "Druckgradient Wegschalten KAB fuer Folgeschaltung" CURVE 0x24BED4 kl_si16_S6_S3 100 UMR_BAR_SEC_1_10_0_S6_S3 -100 0
 /begin AXIS_DESCR STD_AXIS zff_atsys._.iSignale._.obj.sig_m_t UMR_NM__1_1_0_S6_S3 6 -400 1640 DEPOSIT ABSOLUTE MONOTONY MON_INCREASE /end AXIS_DESCR
/end CHARACTERISTIC
/begin CHARACTERISTIC KF_PKABFOLSP86 "Schaltdruck ab.Kupplung fuer MRS Folgeschaltung" MAP 0x24BEF0 kf_si16_S6_S3 12.75 UMR_BAR__1_1000_0_S6_S3 0 12.75
 /begin AXIS_DESCR STD_AXIS NO_INPUT_QUANTITY UMR_U_MIN_32_1_0_S6_S3 8 0 8160 DEPOSIT ABSOLUTE MONOTONY MON_INCREASE /end AXIS_DESCR
 /begin AXIS_DESCR STD_AXIS zff_atsys._.iSignale._.obj.sig_m_t UMR_NM__1_1_0_S6_S3 10 -400 1640 DEPOSIT ABSOLUTE MONOTONY MON_INCREASE /end AXIS_DESCR
/end CHARACTERISTIC
/begin CHARACTERISTIC TO_TSYNHINSYNSSP86 "Zeitoffset nach Synchron für Dauer Haltephase in Syn. KAB" VALUE 0x26E811 kw_ui8_S6_S3 2540 UMR_MSEC__10_1_0_S6_S3 0 2540 /end CHARACTERISTIC
/begin CHARACTERISTIC KL_POKABNGABSP86 "Druckoffset in Abhaengigkeit von ng_ab" CURVE 0x24BFBC kl_si16_S6_S3 12 UMR_BAR__1_1000_0_S6_S3 -6 6
 /begin AXIS_DESCR STD_AXIS iItfInput.ng_ab UMR_U_MINSEC_1_1_0_S6_S3 4 -5000 1000 DEPOSIT ABSOLUTE MONOTONY MON_INCREASE /end AXIS_DESCR
/end CHARACTERISTIC
/begin CHARACTERISTIC T_SYNKABWSSP86 "Zeit vor sync. Ende Schaltdruck KAB bei Weiterschaltung" VALUE 0x26E812 kw_ui8_S6_S3 1280 UMR_MSEC__10_1_M128_S6_S3 -1280 0 /end CHARACTERISTIC
/begin CHARACTERISTIC KL_FPOCGHINSYNKABSP86 "Temperaturabhängige Gewichtung des Haltedruckoffsets" CURVE 0x24BFD0 kl_ui8_S6_S3 1 UMR___1_100_0_S6_S3 0 1
 /begin AXIS_DESCR STD_AXIS zff_atsys._.iSignale._.obj.sig_c_getr UMR_GRADC__1_1_M40_S6_S3 4 -40 150 DEPOSIT ABSOLUTE MONOTONY MON_INCREASE /end AXIS_DESCR
/end CHARACTERISTIC
/begin CHARACTERISTIC KL_TOHKABCGSP86 "Zeit Offset Haltephase" CURVE 0x24BFDC kl_ui8_S6_S3 1270 UMR_MSEC__10_1_0_S6_S3 0 1270
 /begin AXIS_DESCR STD_AXIS zff_atsys._.iSignale._.obj.sig_c_getr UMR_GRADC__1_1_M40_S6_S3 4 -40 190 DEPOSIT ABSOLUTE MONOTONY MON_INCREASE /end AXIS_DESCR
/end CHARACTERISTIC
/begin CHARACTERISTIC KL_PGRASYNKABSP86 "Druckgradient Wegschalten abschaltende Kupplung" CURVE 0x24BFE8 kl_si16_S6_S3 100 UMR_BAR_SEC_1_10_0_S6_S3 -100 0
 /begin AXIS_DESCR STD_AXIS zff_atsys._.iSignale._.obj.sig_m_t UMR_NM__1_1_0_S6_S3 6 -400 1640 DEPOSIT ABSOLUTE MONOTONY MON_INCREASE /end AXIS_DESCR
/end CHARACTERISTIC
/begin CHARACTERISTIC KL_PGRASYNKABWSSP86 "Druckgradient Wegschalten abschaltende Kupplung bei Weiterschaltung" CURVE 0x24C004 kl_si16_S6_S3 100 UMR_BAR_SEC_1_10_0_S6_S3 -100 0
 /begin AXIS_DESCR STD_AXIS zff_atsys._.iSignale._.obj.sig_m_t UMR_NM__1_1_0_S6_S3 6 -400 1640 DEPOSIT ABSOLUTE MONOTONY MON_INCREASE /end AXIS_DESCR
/end CHARACTERISTIC
/begin CHARACTERISTIC KF_POKABMTCGSP86 "Schaltdruckoffset" MAP 0x24C020 kf_si16_S6_S3 12.75 UMR_BAR__1_1000_0_S6_S3 -6.4 6.35
 /begin AXIS_DESCR STD_AXIS zff_atsys._.iSignale._.obj.sig_m_t UMR_NM__1_1_0_S6_S3 5 -400 1640 DEPOSIT ABSOLUTE MONOTONY MON_INCREASE /end AXIS_DESCR
 /begin AXIS_DESCR STD_AXIS zff_atsys._.iSignale._.obj.sig_c_getr UMR_GRADC__1_1_M40_S6_S3 10 -40 150 DEPOSIT ABSOLUTE MONOTONY MON_INCREASE /end AXIS_DESCR
/end CHARACTERISTIC
/begin CHARACTERISTIC KL_POKABMDMOTSOLLSP86 "Schaltdruckoffset in Abhaengigkeit von md_motsoll_sas" CURVE 0x24C0AC kl_si16_S6_S3 12.75 UMR_BAR__1_1000_0_S6_S3 -6.4 6.35
 /begin AXIS_DESCR STD_AXIS NO_INPUT_QUANTITY UMR_NM__1_1_0_S6_S3 6 -2000 2000 DEPOSIT ABSOLUTE MONOTONY MON_INCREASE /end AXIS_DESCR
/end CHARACTERISTIC
/begin CHARACTERISTIC KF_TVKABMTNMOTRSSP86 "Verzögerungszeit abschaltende Kupplung bei RS" MAP 0x24C0C8 kf_ui8_S6_S3 2000 UMR_MSEC__10_1_0_S6_S3 0 2000
 /begin AXIS_DESCR STD_AXIS zff_atsys._.iSignale._.obj.sig_m_t8 UMR_NM__8_1_M50_S6_S3 4 -400 1640 DEPOSIT ABSOLUTE MONOTONY MON_INCREASE /end AXIS_DESCR
 /begin AXIS_DESCR STD_AXIS zff_atsys._.iSignale._.obj.sig_n_mot8 UMR_U_MIN_32_1_0_S6_S3 4 0 8160 DEPOSIT ABSOLUTE MONOTONY MON_INCREASE /end AXIS_DESCR
/end CHARACTERISTIC
/begin CHARACTERISTIC T_RAABVSP84 "Zeit Rampe auf Schaltdruck" VALUE 0x26E813 kw_ui8_S6_S3 2540 UMR_MSEC__10_1_0_S6_S3 0 2540 /end CHARACTERISTIC
/begin CHARACTERISTIC T_RAABVFOLNACHMRSSP84 "Zeit Rampe auf Schaltdruck" VALUE 0x26E814 kw_ui8_S6_S3 2540 UMR_MSEC__10_1_0_S6_S3 0 2540 /end CHARACTERISTIC
/begin CHARACTERISTIC KL_POKABVSP84 "Druckoffset Folgeschaltung in Abhaengigkeit von m_t" CURVE 0x24C0E8 kl_si16_S6_S3 12 UMR_BAR__1_1000_0_S6_S3 -6 6
 /begin AXIS_DESCR STD_AXIS zff_atsys._.iSignale._.obj.sig_m_t UMR_NM__1_1_0_S6_S3 4 -400 1640 DEPOSIT ABSOLUTE MONOTONY MON_INCREASE /end AXIS_DESCR
/end CHARACTERISTIC
/begin CHARACTERISTIC KL_POKABVFOLNACHMRSSP84 "Druckoffset Folgeschaltung nach MRS in Abhaengigkeit von m_t" CURVE 0x24C0FC kl_si16_S6_S3 12 UMR_BAR__1_1000_0_S6_S3 -6 6
 /begin AXIS_DESCR STD_AXIS zff_atsys._.iSignale._.obj.sig_m_t UMR_NM__1_1_0_S6_S3 4 -400 1640 DEPOSIT ABSOLUTE MONOTONY MON_INCREASE /end AXIS_DESCR
/end CHARACTERISTIC
/begin CHARACTERISTIC KF_TSYNMTNTKABVFOLNACHMRSSP84 "Zeit vor sync. Ende Haltephase vorb. KAB" MAP 0x24C110 kf_si16_S6_S3 5000 UMR_MSEC__10_1_0_S6_S3 -5000 0
 /begin AXIS_DESCR STD_AXIS zff_atsys._.iSignale._.obj.sig_m_t UMR_NM__1_1_0_S6_S3 4 -400 1640 DEPOSIT ABSOLUTE MONOTONY MON_INCREASE /end AXIS_DESCR
 /begin AXIS_DESCR STD_AXIS zff_atsys._.iSignale._.obj.sig_n_t UMR_U_MIN_1_1_0_S6_S3 6 0 8160 DEPOSIT ABSOLUTE MONOTONY MON_INCREASE /end AXIS_DESCR
/end CHARACTERISTIC
/begin CHARACTERISTIC KL_PGOKABFOLNACHRSSP84 "Druckgradient in Abhaengigkeit von m_t fuer Folgeschaltung" CURVE 0x24C15C kl_si16_S6_S3 200 UMR_BAR_SEC_1_10_0_S6_S3 -100 100
 /begin AXIS_DESCR STD_AXIS zff_atsys._.iSignale._.obj.sig_m_t UMR_NM__1_1_0_S6_S3 6 -400 1640 DEPOSIT ABSOLUTE MONOTONY MON_INCREASE /end AXIS_DESCR
/end CHARACTERISTIC
/begin CHARACTERISTIC KL_PGRASYNKABFOLNACHRSSP84 "Druckgradient Wegschalten KAB fuer Folgeschaltung" CURVE 0x24C178 kl_si16_S6_S3 100 UMR_BAR_SEC_1_10_0_S6_S3 -100 0
 /begin AXIS_DESCR STD_AXIS zff_atsys._.iSignale._.obj.sig_m_t UMR_NM__1_1_0_S6_S3 6 -400 1640 DEPOSIT ABSOLUTE MONOTONY MON_INCREASE /end AXIS_DESCR
/end CHARACTERISTIC
/begin CHARACTERISTIC KF_PKABFOLSP84 "Schaltdruck ab.Kupplung fuer MRS Folgeschaltung" MAP 0x24C194 kf_si16_S6_S3 12.75 UMR_BAR__1_1000_0_S6_S3 0 12.75
 /begin AXIS_DESCR STD_AXIS NO_INPUT_QUANTITY UMR_U_MIN_32_1_0_S6_S3 8 0 8160 DEPOSIT ABSOLUTE MONOTONY MON_INCREASE /end AXIS_DESCR
 /begin AXIS_DESCR STD_AXIS zff_atsys._.iSignale._.obj.sig_m_t UMR_NM__1_1_0_S6_S3 10 -400 1640 DEPOSIT ABSOLUTE MONOTONY MON_INCREASE /end AXIS_DESCR
/end CHARACTERISTIC
/begin CHARACTERISTIC TO_TSYNHINSYNSSP84 "Zeitoffset nach Synchron für Dauer Haltephase in Syn. KAB" VALUE 0x26E815 kw_ui8_S6_S3 2540 UMR_MSEC__10_1_0_S6_S3 0 2540 /end CHARACTERISTIC
/begin CHARACTERISTIC KL_POKABNGABSP84 "Druckoffset in Abhaengigkeit von ng_ab" CURVE 0x24C260 kl_si16_S6_S3 12 UMR_BAR__1_1000_0_S6_S3 -6 6
 /begin AXIS_DESCR STD_AXIS iItfInput.ng_ab UMR_U_MINSEC_1_1_0_S6_S3 4 -5000 1000 DEPOSIT ABSOLUTE MONOTONY MON_INCREASE /end AXIS_DESCR
/end CHARACTERISTIC
/begin CHARACTERISTIC T_SYNKABWSSP84 "Zeit vor sync. Ende Schaltdruck KAB bei Weiterschaltung" VALUE 0x26E816 kw_ui8_S6_S3 1280 UMR_MSEC__10_1_M128_S6_S3 -1280 0 /end CHARACTERISTIC
/begin CHARACTERISTIC KL_FPOCGHINSYNKABSP84 "Temperaturabhängige Gewichtung des Haltedruckoffsets" CURVE 0x24C274 kl_ui8_S6_S3 1 UMR___1_100_0_S6_S3 0 1
 /begin AXIS_DESCR STD_AXIS zff_atsys._.iSignale._.obj.sig_c_getr UMR_GRADC__1_1_M40_S6_S3 4 -40 150 DEPOSIT ABSOLUTE MONOTONY MON_INCREASE /end AXIS_DESCR
/end CHARACTERISTIC
/begin CHARACTERISTIC KL_TOHKABCGSP84 "Zeit Offset Haltephase" CURVE 0x24C280 kl_ui8_S6_S3 1270 UMR_MSEC__10_1_0_S6_S3 0 1270
 /begin AXIS_DESCR STD_AXIS zff_atsys._.iSignale._.obj.sig_c_getr UMR_GRADC__1_1_M40_S6_S3 4 -40 190 DEPOSIT ABSOLUTE MONOTONY MON_INCREASE /end AXIS_DESCR
/end CHARACTERISTIC
/begin CHARACTERISTIC KL_PGRASYNKABSP84 "Druckgradient Wegschalten abschaltende Kupplung" CURVE 0x24C28C kl_si16_S6_S3 100 UMR_BAR_SEC_1_10_0_S6_S3 -100 0
 /begin AXIS_DESCR STD_AXIS zff_atsys._.iSignale._.obj.sig_m_t UMR_NM__1_1_0_S6_S3 6 -400 1640 DEPOSIT ABSOLUTE MONOTONY MON_INCREASE /end AXIS_DESCR
/end CHARACTERISTIC
/begin CHARACTERISTIC KL_PGRASYNKABWSSP84 "Druckgradient Wegschalten abschaltende Kupplung bei Weiterschaltung" CURVE 0x24C2A8 kl_si16_S6_S3 100 UMR_BAR_SEC_1_10_0_S6_S3 -100 0
 /begin AXIS_DESCR STD_AXIS zff_atsys._.iSignale._.obj.sig_m_t UMR_NM__1_1_0_S6_S3 6 -400 1640 DEPOSIT ABSOLUTE MONOTONY MON_INCREASE /end AXIS_DESCR
/end CHARACTERISTIC
/begin CHARACTERISTIC KF_POKABMTCGSP84 "Schaltdruckoffset" MAP 0x24C2C4 kf_si16_S6_S3 12.75 UMR_BAR__1_1000_0_S6_S3 -6.4 6.35
 /begin AXIS_DESCR STD_AXIS zff_atsys._.iSignale._.obj.sig_m_t UMR_NM__1_1_0_S6_S3 5 -400 1640 DEPOSIT ABSOLUTE MONOTONY MON_INCREASE /end AXIS_DESCR
 /begin AXIS_DESCR STD_AXIS zff_atsys._.iSignale._.obj.sig_c_getr UMR_GRADC__1_1_M40_S6_S3 10 -40 150 DEPOSIT ABSOLUTE MONOTONY MON_INCREASE /end AXIS_DESCR
/end CHARACTERISTIC
/begin CHARACTERISTIC KL_POKABMDMOTSOLLSP84 "Schaltdruckoffset in Abhaengigkeit von md_motsoll_sas" CURVE 0x24C350 kl_si16_S6_S3 12.75 UMR_BAR__1_1000_0_S6_S3 -6.4 6.35
 /begin AXIS_DESCR STD_AXIS NO_INPUT_QUANTITY UMR_NM__1_1_0_S6_S3 6 -2000 2000 DEPOSIT ABSOLUTE MONOTONY MON_INCREASE /end AXIS_DESCR
/end CHARACTERISTIC
/begin CHARACTERISTIC KF_TVKABMTNMOTRSSP84 "Verzögerungszeit abschaltende Kupplung bei RS" MAP 0x24C36C kf_ui8_S6_S3 2000 UMR_MSEC__10_1_0_S6_S3 0 2000
 /begin AXIS_DESCR STD_AXIS zff_atsys._.iSignale._.obj.sig_m_t8 UMR_NM__8_1_M50_S6_S3 4 -400 1640 DEPOSIT ABSOLUTE MONOTONY MON_INCREASE /end AXIS_DESCR
 /begin AXIS_DESCR STD_AXIS zff_atsys._.iSignale._.obj.sig_n_mot8 UMR_U_MIN_32_1_0_S6_S3 4 0 8160 DEPOSIT ABSOLUTE MONOTONY MON_INCREASE /end AXIS_DESCR
/end CHARACTERISTIC
/begin CHARACTERISTIC KL_TMAXCG12 "Maximaldauer Schaltung" CURVE 0x236570 kl_ui16_S6_S3 10000 UMR_MSEC__10_1_0_S6_S3 0 10000
 /begin AXIS_DESCR STD_AXIS NO_INPUT_QUANTITY UMR_GRADC__1_1_M40_S6_S3 2 -40 150 DEPOSIT ABSOLUTE MONOTONY MON_INCREASE /end AXIS_DESCR
/end CHARACTERISTIC
/begin CHARACTERISTIC T_RAMAX12 "Rampe bei Timeout" VALUE 0x26E64B kw_ui8_S6_S3 2540 UMR_MSEC__10_1_0_S6_S3 0 2540 /end CHARACTERISTIC
/begin CHARACTERISTIC NS_SYNISTE12 "Turbinendifferenzdrehzahlschwelle zur Erkennung Synchron istgang verlassen" VALUE 0x26D8A0 kw_si16_S6_S3 1000 UMR_U_MIN_1_1_0_S6_S3 0 1000 /end CHARACTERISTIC
/begin CHARACTERISTIC M_MOTMAXVERHSS12 "Max. Motormoment während aktiver Fkt." VALUE 0x26D8A2 kw_si16_S6_S3 2040 UMR_NM__1_1_0_S6_S3 -400 1640 /end CHARACTERISTIC
/begin CHARACTERISTIC MG_MMOTMAXVERHSSAUF12 "Gradient über den die Momentenbegrenzung aufgehoben wird" VALUE 0x26D8A4 kw_si16_S6_S3 2750 UMR_NM_SEC_10_1_0_S6_S3 -200 2550 /end CHARACTERISTIC
/begin CHARACTERISTIC NS_VERSIAE12 "Drehzahlschwelle auf Leerlaufdrehzahl zur Verhinderung der Verschachtelung bei IAE" VALUE 0x26D8A6 kw_si16_S6_S3 8200 UMR_U_MIN_1_1_0_S6_S3 0 8200 /end CHARACTERISTIC
/begin CHARACTERISTIC NGS_VERIAE12 "Abtriebsdrehzahlgradientenschwelle für ausführen der verschachtelten Schaltung mit IAE" VALUE 0x26D8A8 kw_si16_S6_S3 20000 UMR_U_MINSEC_1_1_0_S6_S3 -10000 10000 /end CHARACTERISTIC
/begin CHARACTERISTIC HYS_NGS_VERIAE12 "Hysterese für Gradientenschwelle bei IAE" VALUE 0x26D8AA kw_si16_S6_S3 20000 UMR_U_MINSEC_1_1_0_S6_S3 -10000 10000 /end CHARACTERISTIC
/begin CHARACTERISTIC KL_TMAXCG23 "Maximaldauer Schaltung" CURVE 0x23657C kl_ui16_S6_S3 10000 UMR_MSEC__10_1_0_S6_S3 0 10000
 /begin AXIS_DESCR STD_AXIS NO_INPUT_QUANTITY UMR_GRADC__1_1_M40_S6_S3 2 -40 150 DEPOSIT ABSOLUTE MONOTONY MON_INCREASE /end AXIS_DESCR
/end CHARACTERISTIC
/begin CHARACTERISTIC T_RAMAX23 "Rampe bei Timeout" VALUE 0x26E64C kw_ui8_S6_S3 2540 UMR_MSEC__10_1_0_S6_S3 0 2540 /end CHARACTERISTIC
/begin CHARACTERISTIC NS_SYNISTE23 "Turbinendifferenzdrehzahlschwelle zur Erkennung Synchron istgang verlassen" VALUE 0x26D8AC kw_si16_S6_S3 1000 UMR_U_MIN_1_1_0_S6_S3 0 1000 /end CHARACTERISTIC
/begin CHARACTERISTIC M_MOTMAXVERHSS23 "Max. Motormoment während aktiver Fkt." VALUE 0x26D8AE kw_si16_S6_S3 2040 UMR_NM__1_1_0_S6_S3 -400 1640 /end CHARACTERISTIC
/begin CHARACTERISTIC MG_MMOTMAXVERHSSAUF23 "Gradient über den die Momentenbegrenzung aufgehoben wird" VALUE 0x26D8B0 kw_si16_S6_S3 2750 UMR_NM_SEC_10_1_0_S6_S3 -200 2550 /end CHARACTERISTIC
/begin CHARACTERISTIC NS_VERSIAE23 "Drehzahlschwelle auf Leerlaufdrehzahl zur Verhinderung der Verschachtelung bei IAE" VALUE 0x26D8B2 kw_si16_S6_S3 8200 UMR_U_MIN_1_1_0_S6_S3 0 8200 /end CHARACTERISTIC
/begin CHARACTERISTIC NGS_VERIAE23 "Abtriebsdrehzahlgradientenschwelle für ausführen der verschachtelten Schaltung mit IAE" VALUE 0x26D8B4 kw_si16_S6_S3 20000 UMR_U_MINSEC_1_1_0_S6_S3 -10000 10000 /end CHARACTERISTIC
/begin CHARACTERISTIC HYS_NGS_VERIAE23 "Hysterese für Gradientenschwelle bei IAE" VALUE 0x26D8B6 kw_si16_S6_S3 20000 UMR_U_MINSEC_1_1_0_S6_S3 -10000 10000 /end CHARACTERISTIC
/begin CHARACTERISTIC KL_TMAXCG34 "Maximaldauer Schaltung" CURVE 0x236588 kl_ui16_S6_S3 10000 UMR_MSEC__10_1_0_S6_S3 0 10000
 /begin AXIS_DESCR STD_AXIS NO_INPUT_QUANTITY UMR_GRADC__1_1_M40_S6_S3 2 -40 150 DEPOSIT ABSOLUTE MONOTONY MON_INCREASE /end AXIS_DESCR
/end CHARACTERISTIC
/begin CHARACTERISTIC T_RAMAX34 "Rampe bei Timeout" VALUE 0x26E64D kw_ui8_S6_S3 2540 UMR_MSEC__10_1_0_S6_S3 0 2540 /end CHARACTERISTIC
/begin CHARACTERISTIC NS_SYNISTE34 "Turbinendifferenzdrehzahlschwelle zur Erkennung Synchron istgang verlassen" VALUE 0x26D8B8 kw_si16_S6_S3 1000 UMR_U_MIN_1_1_0_S6_S3 0 1000 /end CHARACTERISTIC
/begin CHARACTERISTIC M_MOTMAXVERHSS34 "Max. Motormoment während aktiver Fkt." VALUE 0x26D8BA kw_si16_S6_S3 2040 UMR_NM__1_1_0_S6_S3 -400 1640 /end CHARACTERISTIC
/begin CHARACTERISTIC MG_MMOTMAXVERHSSAUF34 "Gradient über den die Momentenbegrenzung aufgehoben wird" VALUE 0x26D8BC kw_si16_S6_S3 2750 UMR_NM_SEC_10_1_0_S6_S3 -200 2550 /end CHARACTERISTIC
/begin CHARACTERISTIC NS_VERSIAE34 "Drehzahlschwelle auf Leerlaufdrehzahl zur Verhinderung der Verschachtelung bei IAE" VALUE 0x26D8BE kw_si16_S6_S3 8200 UMR_U_MIN_1_1_0_S6_S3 0 8200 /end CHARACTERISTIC
/begin CHARACTERISTIC NGS_VERIAE34 "Abtriebsdrehzahlgradientenschwelle für ausführen der verschachtelten Schaltung mit IAE" VALUE 0x26D8C0 kw_si16_S6_S3 20000 UMR_U_MINSEC_1_1_0_S6_S3 -10000 10000 /end CHARACTERISTIC
/begin CHARACTERISTIC HYS_NGS_VERIAE34 "Hysterese für Gradientenschwelle bei IAE" VALUE 0x26D8C2 kw_si16_S6_S3 20000 UMR_U_MINSEC_1_1_0_S6_S3 -10000 10000 /end CHARACTERISTIC
/begin CHARACTERISTIC KL_TMAXCG45 "Maximaldauer Schaltung" CURVE 0x236594 kl_ui16_S6_S3 10000 UMR_MSEC__10_1_0_S6_S3 0 10000
 /begin AXIS_DESCR STD_AXIS NO_INPUT_QUANTITY UMR_GRADC__1_1_M40_S6_S3 2 -40 150 DEPOSIT ABSOLUTE MONOTONY MON_INCREASE /end AXIS_DESCR
/end CHARACTERISTIC
/begin CHARACTERISTIC T_RAMAX45 "Rampe bei Timeout" VALUE 0x26E64E kw_ui8_S6_S3 2540 UMR_MSEC__10_1_0_S6_S3 0 2540 /end CHARACTERISTIC
/begin CHARACTERISTIC NS_SYNISTE45 "Turbinendifferenzdrehzahlschwelle zur Erkennung Synchron istgang verlassen" VALUE 0x26D8C4 kw_si16_S6_S3 1000 UMR_U_MIN_1_1_0_S6_S3 0 1000 /end CHARACTERISTIC
/begin CHARACTERISTIC M_MOTMAXVERHSS45 "Max. Motormoment während aktiver Fkt." VALUE 0x26D8C6 kw_si16_S6_S3 2040 UMR_NM__1_1_0_S6_S3 -400 1640 /end CHARACTERISTIC
/begin CHARACTERISTIC MG_MMOTMAXVERHSSAUF45 "Gradient über den die Momentenbegrenzung aufgehoben wird" VALUE 0x26D8C8 kw_si16_S6_S3 2750 UMR_NM_SEC_10_1_0_S6_S3 -200 2550 /end CHARACTERISTIC
/begin CHARACTERISTIC NS_VERSIAE45 "Drehzahlschwelle auf Leerlaufdrehzahl zur Verhinderung der Verschachtelung bei IAE" VALUE 0x26D8CA kw_si16_S6_S3 8200 UMR_U_MIN_1_1_0_S6_S3 0 8200 /end CHARACTERISTIC
/begin CHARACTERISTIC NGS_VERIAE45 "Abtriebsdrehzahlgradientenschwelle für ausführen der verschachtelten Schaltung mit IAE" VALUE 0x26D8CC kw_si16_S6_S3 20000 UMR_U_MINSEC_1_1_0_S6_S3 -10000 10000 /end CHARACTERISTIC
/begin CHARACTERISTIC HYS_NGS_VERIAE45 "Hysterese für Gradientenschwelle bei IAE" VALUE 0x26D8CE kw_si16_S6_S3 20000 UMR_U_MINSEC_1_1_0_S6_S3 -10000 10000 /end CHARACTERISTIC
/begin CHARACTERISTIC KL_TMAXCG56 "Maximaldauer Schaltung" CURVE 0x2365A0 kl_ui16_S6_S3 10000 UMR_MSEC__10_1_0_S6_S3 0 10000
 /begin AXIS_DESCR STD_AXIS NO_INPUT_QUANTITY UMR_GRADC__1_1_M40_S6_S3 2 -40 150 DEPOSIT ABSOLUTE MONOTONY MON_INCREASE /end AXIS_DESCR
/end CHARACTERISTIC
/begin CHARACTERISTIC T_RAMAX56 "Rampe bei Timeout" VALUE 0x26E64F kw_ui8_S6_S3 2540 UMR_MSEC__10_1_0_S6_S3 0 2540 /end CHARACTERISTIC
/begin CHARACTERISTIC NS_SYNISTE56 "Turbinendifferenzdrehzahlschwelle zur Erkennung Synchron istgang verlassen" VALUE 0x26D8D0 kw_si16_S6_S3 1000 UMR_U_MIN_1_1_0_S6_S3 0 1000 /end CHARACTERISTIC
/begin CHARACTERISTIC M_MOTMAXVERHSS56 "Max. Motormoment während aktiver Fkt." VALUE 0x26D8D2 kw_si16_S6_S3 2040 UMR_NM__1_1_0_S6_S3 -400 1640 /end CHARACTERISTIC
/begin CHARACTERISTIC MG_MMOTMAXVERHSSAUF56 "Gradient über den die Momentenbegrenzung aufgehoben wird" VALUE 0x26D8D4 kw_si16_S6_S3 2750 UMR_NM_SEC_10_1_0_S6_S3 -200 2550 /end CHARACTERISTIC
/begin CHARACTERISTIC NS_VERSIAE56 "Drehzahlschwelle auf Leerlaufdrehzahl zur Verhinderung der Verschachtelung bei IAE" VALUE 0x26D8D6 kw_si16_S6_S3 8200 UMR_U_MIN_1_1_0_S6_S3 0 8200 /end CHARACTERISTIC
/begin CHARACTERISTIC NGS_VERIAE56 "Abtriebsdrehzahlgradientenschwelle für ausführen der verschachtelten Schaltung mit IAE" VALUE 0x26D8D8 kw_si16_S6_S3 20000 UMR_U_MINSEC_1_1_0_S6_S3 -10000 10000 /end CHARACTERISTIC
/begin CHARACTERISTIC HYS_NGS_VERIAE56 "Hysterese für Gradientenschwelle bei IAE" VALUE 0x26D8DA kw_si16_S6_S3 20000 UMR_U_MINSEC_1_1_0_S6_S3 -10000 10000 /end CHARACTERISTIC
/begin CHARACTERISTIC KL_TMAXCG67 "Maximaldauer Schaltung" CURVE 0x2365AC kl_ui16_S6_S3 10000 UMR_MSEC__10_1_0_S6_S3 0 10000
 /begin AXIS_DESCR STD_AXIS NO_INPUT_QUANTITY UMR_GRADC__1_1_M40_S6_S3 2 -40 150 DEPOSIT ABSOLUTE MONOTONY MON_INCREASE /end AXIS_DESCR
/end CHARACTERISTIC
/begin CHARACTERISTIC T_RAMAX67 "Rampe bei Timeout" VALUE 0x26E650 kw_ui8_S6_S3 2540 UMR_MSEC__10_1_0_S6_S3 0 2540 /end CHARACTERISTIC
/begin CHARACTERISTIC NS_SYNISTE67 "Turbinendifferenzdrehzahlschwelle zur Erkennung Synchron istgang verlassen" VALUE 0x26D8DC kw_si16_S6_S3 1000 UMR_U_MIN_1_1_0_S6_S3 0 1000 /end CHARACTERISTIC
/begin CHARACTERISTIC M_MOTMAXVERHSS67 "Max. Motormoment während aktiver Fkt." VALUE 0x26D8DE kw_si16_S6_S3 2040 UMR_NM__1_1_0_S6_S3 -400 1640 /end CHARACTERISTIC
/begin CHARACTERISTIC MG_MMOTMAXVERHSSAUF67 "Gradient über den die Momentenbegrenzung aufgehoben wird" VALUE 0x26D8E0 kw_si16_S6_S3 2750 UMR_NM_SEC_10_1_0_S6_S3 -200 2550 /end CHARACTERISTIC
/begin CHARACTERISTIC NS_VERSIAE67 "Drehzahlschwelle auf Leerlaufdrehzahl zur Verhinderung der Verschachtelung bei IAE" VALUE 0x26D8E2 kw_si16_S6_S3 8200 UMR_U_MIN_1_1_0_S6_S3 0 8200 /end CHARACTERISTIC
/begin CHARACTERISTIC NGS_VERIAE67 "Abtriebsdrehzahlgradientenschwelle für ausführen der verschachtelten Schaltung mit IAE" VALUE 0x26D8E4 kw_si16_S6_S3 20000 UMR_U_MINSEC_1_1_0_S6_S3 -10000 10000 /end CHARACTERISTIC
/begin CHARACTERISTIC HYS_NGS_VERIAE67 "Hysterese für Gradientenschwelle bei IAE" VALUE 0x26D8E6 kw_si16_S6_S3 20000 UMR_U_MINSEC_1_1_0_S6_S3 -10000 10000 /end CHARACTERISTIC
/begin CHARACTERISTIC KL_TMAXCG78 "Maximaldauer Schaltung" CURVE 0x2365B8 kl_ui16_S6_S3 10000 UMR_MSEC__10_1_0_S6_S3 0 10000
 /begin AXIS_DESCR STD_AXIS NO_INPUT_QUANTITY UMR_GRADC__1_1_M40_S6_S3 2 -40 150 DEPOSIT ABSOLUTE MONOTONY MON_INCREASE /end AXIS_DESCR
/end CHARACTERISTIC
/begin CHARACTERISTIC T_RAMAX78 "Rampe bei Timeout" VALUE 0x26E651 kw_ui8_S6_S3 2540 UMR_MSEC__10_1_0_S6_S3 0 2540 /end CHARACTERISTIC
/begin CHARACTERISTIC NS_SYNISTE78 "Turbinendifferenzdrehzahlschwelle zur Erkennung Synchron istgang verlassen" VALUE 0x26D8E8 kw_si16_S6_S3 1000 UMR_U_MIN_1_1_0_S6_S3 0 1000 /end CHARACTERISTIC
/begin CHARACTERISTIC M_MOTMAXVERHSS78 "Max. Motormoment während aktiver Fkt." VALUE 0x26D8EA kw_si16_S6_S3 2040 UMR_NM__1_1_0_S6_S3 -400 1640 /end CHARACTERISTIC
/begin CHARACTERISTIC MG_MMOTMAXVERHSSAUF78 "Gradient über den die Momentenbegrenzung aufgehoben wird" VALUE 0x26D8EC kw_si16_S6_S3 2750 UMR_NM_SEC_10_1_0_S6_S3 -200 2550 /end CHARACTERISTIC
/begin CHARACTERISTIC NS_VERSIAE78 "Drehzahlschwelle auf Leerlaufdrehzahl zur Verhinderung der Verschachtelung bei IAE" VALUE 0x26D8EE kw_si16_S6_S3 8200 UMR_U_MIN_1_1_0_S6_S3 0 8200 /end CHARACTERISTIC
/begin CHARACTERISTIC NGS_VERIAE78 "Abtriebsdrehzahlgradientenschwelle für ausführen der verschachtelten Schaltung mit IAE" VALUE 0x26D8F0 kw_si16_S6_S3 20000 UMR_U_MINSEC_1_1_0_S6_S3 -10000 10000 /end CHARACTERISTIC
/begin CHARACTERISTIC HYS_NGS_VERIAE78 "Hysterese für Gradientenschwelle bei IAE" VALUE 0x26D8F2 kw_si16_S6_S3 20000 UMR_U_MINSEC_1_1_0_S6_S3 -10000 10000 /end CHARACTERISTIC
/begin CHARACTERISTIC KL_TMAXCG13 "Maximaldauer Schaltung" CURVE 0x2365C4 kl_ui16_S6_S3 10000 UMR_MSEC__10_1_0_S6_S3 0 10000
 /begin AXIS_DESCR STD_AXIS NO_INPUT_QUANTITY UMR_GRADC__1_1_M40_S6_S3 2 -40 150 DEPOSIT ABSOLUTE MONOTONY MON_INCREASE /end AXIS_DESCR
/end CHARACTERISTIC
/begin CHARACTERISTIC T_RAMAX13 "Rampe bei Timeout" VALUE 0x26E652 kw_ui8_S6_S3 2540 UMR_MSEC__10_1_0_S6_S3 0 2540 /end CHARACTERISTIC
/begin CHARACTERISTIC NS_SYNISTE13 "Turbinendifferenzdrehzahlschwelle zur Erkennung Synchron istgang verlassen" VALUE 0x26D8F4 kw_si16_S6_S3 1000 UMR_U_MIN_1_1_0_S6_S3 0 1000 /end CHARACTERISTIC
/begin CHARACTERISTIC M_MOTMAXVERHSS13 "Max. Motormoment während aktiver Fkt." VALUE 0x26D8F6 kw_si16_S6_S3 2040 UMR_NM__1_1_0_S6_S3 -400 1640 /end CHARACTERISTIC
/begin CHARACTERISTIC MG_MMOTMAXVERHSSAUF13 "Gradient über den die Momentenbegrenzung aufgehoben wird" VALUE 0x26D8F8 kw_si16_S6_S3 2750 UMR_NM_SEC_10_1_0_S6_S3 -200 2550 /end CHARACTERISTIC
/begin CHARACTERISTIC NS_VERSIAE13 "Drehzahlschwelle auf Leerlaufdrehzahl zur Verhinderung der Verschachtelung bei IAE" VALUE 0x26D8FA kw_si16_S6_S3 8200 UMR_U_MIN_1_1_0_S6_S3 0 8200 /end CHARACTERISTIC
/begin CHARACTERISTIC NGS_VERIAE13 "Abtriebsdrehzahlgradientenschwelle für ausführen der verschachtelten Schaltung mit IAE" VALUE 0x26D8FC kw_si16_S6_S3 20000 UMR_U_MINSEC_1_1_0_S6_S3 -10000 10000 /end CHARACTERISTIC
/begin CHARACTERISTIC HYS_NGS_VERIAE13 "Hysterese für Gradientenschwelle bei IAE" VALUE 0x26D8FE kw_si16_S6_S3 20000 UMR_U_MINSEC_1_1_0_S6_S3 -10000 10000 /end CHARACTERISTIC
/begin CHARACTERISTIC KL_TMAXCG24 "Maximaldauer Schaltung" CURVE 0x2365D0 kl_ui16_S6_S3 10000 UMR_MSEC__10_1_0_S6_S3 0 10000
 /begin AXIS_DESCR STD_AXIS NO_INPUT_QUANTITY UMR_GRADC__1_1_M40_S6_S3 2 -40 150 DEPOSIT ABSOLUTE MONOTONY MON_INCREASE /end AXIS_DESCR
/end CHARACTERISTIC
/begin CHARACTERISTIC T_RAMAX24 "Rampe bei Timeout" VALUE 0x26E653 kw_ui8_S6_S3 2540 UMR_MSEC__10_1_0_S6_S3 0 2540 /end CHARACTERISTIC
/begin CHARACTERISTIC NS_SYNISTE24 "Turbinendifferenzdrehzahlschwelle zur Erkennung Synchron istgang verlassen" VALUE 0x26D900 kw_si16_S6_S3 1000 UMR_U_MIN_1_1_0_S6_S3 0 1000 /end CHARACTERISTIC
/begin CHARACTERISTIC M_MOTMAXVERHSS24 "Max. Motormoment während aktiver Fkt." VALUE 0x26D902 kw_si16_S6_S3 2040 UMR_NM__1_1_0_S6_S3 -400 1640 /end CHARACTERISTIC
/begin CHARACTERISTIC MG_MMOTMAXVERHSSAUF24 "Gradient über den die Momentenbegrenzung aufgehoben wird" VALUE 0x26D904 kw_si16_S6_S3 2750 UMR_NM_SEC_10_1_0_S6_S3 -200 2550 /end CHARACTERISTIC
/begin CHARACTERISTIC NS_VERSIAE24 "Drehzahlschwelle auf Leerlaufdrehzahl zur Verhinderung der Verschachtelung bei IAE" VALUE 0x26D906 kw_si16_S6_S3 8200 UMR_U_MIN_1_1_0_S6_S3 0 8200 /end CHARACTERISTIC
/begin CHARACTERISTIC NGS_VERIAE24 "Abtriebsdrehzahlgradientenschwelle für ausführen der verschachtelten Schaltung mit IAE" VALUE 0x26D908 kw_si16_S6_S3 20000 UMR_U_MINSEC_1_1_0_S6_S3 -10000 10000 /end CHARACTERISTIC
/begin CHARACTERISTIC HYS_NGS_VERIAE24 "Hysterese für Gradientenschwelle bei IAE" VALUE 0x26D90A kw_si16_S6_S3 20000 UMR_U_MINSEC_1_1_0_S6_S3 -10000 10000 /end CHARACTERISTIC
/begin CHARACTERISTIC KL_TMAXCG35 "Maximaldauer Schaltung" CURVE 0x2365DC kl_ui16_S6_S3 10000 UMR_MSEC__10_1_0_S6_S3 0 10000
 /begin AXIS_DESCR STD_AXIS NO_INPUT_QUANTITY UMR_GRADC__1_1_M40_S6_S3 2 -40 150 DEPOSIT ABSOLUTE MONOTONY MON_INCREASE /end AXIS_DESCR
/end CHARACTERISTIC
/begin CHARACTERISTIC T_RAMAX35 "Rampe bei Timeout" VALUE 0x26E654 kw_ui8_S6_S3 2540 UMR_MSEC__10_1_0_S6_S3 0 2540 /end CHARACTERISTIC
/begin CHARACTERISTIC NS_SYNISTE35 "Turbinendifferenzdrehzahlschwelle zur Erkennung Synchron istgang verlassen" VALUE 0x26D90C kw_si16_S6_S3 1000 UMR_U_MIN_1_1_0_S6_S3 0 1000 /end CHARACTERISTIC
/begin CHARACTERISTIC M_MOTMAXVERHSS35 "Max. Motormoment während aktiver Fkt." VALUE 0x26D90E kw_si16_S6_S3 2040 UMR_NM__1_1_0_S6_S3 -400 1640 /end CHARACTERISTIC
/begin CHARACTERISTIC MG_MMOTMAXVERHSSAUF35 "Gradient über den die Momentenbegrenzung aufgehoben wird" VALUE 0x26D910 kw_si16_S6_S3 2750 UMR_NM_SEC_10_1_0_S6_S3 -200 2550 /end CHARACTERISTIC
/begin CHARACTERISTIC NS_VERSIAE35 "Drehzahlschwelle auf Leerlaufdrehzahl zur Verhinderung der Verschachtelung bei IAE" VALUE 0x26D912 kw_si16_S6_S3 8200 UMR_U_MIN_1_1_0_S6_S3 0 8200 /end CHARACTERISTIC
/begin CHARACTERISTIC NGS_VERIAE35 "Abtriebsdrehzahlgradientenschwelle für ausführen der verschachtelten Schaltung mit IAE" VALUE 0x26D914 kw_si16_S6_S3 20000 UMR_U_MINSEC_1_1_0_S6_S3 -10000 10000 /end CHARACTERISTIC
/begin CHARACTERISTIC HYS_NGS_VERIAE35 "Hysterese für Gradientenschwelle bei IAE" VALUE 0x26D916 kw_si16_S6_S3 20000 UMR_U_MINSEC_1_1_0_S6_S3 -10000 10000 /end CHARACTERISTIC
/begin CHARACTERISTIC KL_TMAXCG46 "Maximaldauer Schaltung" CURVE 0x2365E8 kl_ui16_S6_S3 10000 UMR_MSEC__10_1_0_S6_S3 0 10000
 /begin AXIS_DESCR STD_AXIS NO_INPUT_QUANTITY UMR_GRADC__1_1_M40_S6_S3 2 -40 150 DEPOSIT ABSOLUTE MONOTONY MON_INCREASE /end AXIS_DESCR
/end CHARACTERISTIC
/begin CHARACTERISTIC T_RAMAX46 "Rampe bei Timeout" VALUE 0x26E655 kw_ui8_S6_S3 2540 UMR_MSEC__10_1_0_S6_S3 0 2540 /end CHARACTERISTIC
/begin CHARACTERISTIC NS_SYNISTE46 "Turbinendifferenzdrehzahlschwelle zur Erkennung Synchron istgang verlassen" VALUE 0x26D918 kw_si16_S6_S3 1000 UMR_U_MIN_1_1_0_S6_S3 0 1000 /end CHARACTERISTIC
/begin CHARACTERISTIC M_MOTMAXVERHSS46 "Max. Motormoment während aktiver Fkt." VALUE 0x26D91A kw_si16_S6_S3 2040 UMR_NM__1_1_0_S6_S3 -400 1640 /end CHARACTERISTIC
/begin CHARACTERISTIC MG_MMOTMAXVERHSSAUF46 "Gradient über den die Momentenbegrenzung aufgehoben wird" VALUE 0x26D91C kw_si16_S6_S3 2750 UMR_NM_SEC_10_1_0_S6_S3 -200 2550 /end CHARACTERISTIC
/begin CHARACTERISTIC NS_VERSIAE46 "Drehzahlschwelle auf Leerlaufdrehzahl zur Verhinderung der Verschachtelung bei IAE" VALUE 0x26D91E kw_si16_S6_S3 8200 UMR_U_MIN_1_1_0_S6_S3 0 8200 /end CHARACTERISTIC
/begin CHARACTERISTIC NGS_VERIAE46 "Abtriebsdrehzahlgradientenschwelle für ausführen der verschachtelten Schaltung mit IAE" VALUE 0x26D920 kw_si16_S6_S3 20000 UMR_U_MINSEC_1_1_0_S6_S3 -10000 10000 /end CHARACTERISTIC
/begin CHARACTERISTIC HYS_NGS_VERIAE46 "Hysterese für Gradientenschwelle bei IAE" VALUE 0x26D922 kw_si16_S6_S3 20000 UMR_U_MINSEC_1_1_0_S6_S3 -10000 10000 /end CHARACTERISTIC
/begin CHARACTERISTIC KL_TMAXCG57 "Maximaldauer Schaltung" CURVE 0x2365F4 kl_ui16_S6_S3 10000 UMR_MSEC__10_1_0_S6_S3 0 10000
 /begin AXIS_DESCR STD_AXIS NO_INPUT_QUANTITY UMR_GRADC__1_1_M40_S6_S3 2 -40 150 DEPOSIT ABSOLUTE MONOTONY MON_INCREASE /end AXIS_DESCR
/end CHARACTERISTIC
/begin CHARACTERISTIC T_RAMAX57 "Rampe bei Timeout" VALUE 0x26E656 kw_ui8_S6_S3 2540 UMR_MSEC__10_1_0_S6_S3 0 2540 /end CHARACTERISTIC
/begin CHARACTERISTIC NS_SYNISTE57 "Turbinendifferenzdrehzahlschwelle zur Erkennung Synchron istgang verlassen" VALUE 0x26D924 kw_si16_S6_S3 1000 UMR_U_MIN_1_1_0_S6_S3 0 1000 /end CHARACTERISTIC
/begin CHARACTERISTIC M_MOTMAXVERHSS57 "Max. Motormoment während aktiver Fkt." VALUE 0x26D926 kw_si16_S6_S3 2040 UMR_NM__1_1_0_S6_S3 -400 1640 /end CHARACTERISTIC
/begin CHARACTERISTIC MG_MMOTMAXVERHSSAUF57 "Gradient über den die Momentenbegrenzung aufgehoben wird" VALUE 0x26D928 kw_si16_S6_S3 2750 UMR_NM_SEC_10_1_0_S6_S3 -200 2550 /end CHARACTERISTIC
/begin CHARACTERISTIC NS_VERSIAE57 "Drehzahlschwelle auf Leerlaufdrehzahl zur Verhinderung der Verschachtelung bei IAE" VALUE 0x26D92A kw_si16_S6_S3 8200 UMR_U_MIN_1_1_0_S6_S3 0 8200 /end CHARACTERISTIC
/begin CHARACTERISTIC NGS_VERIAE57 "Abtriebsdrehzahlgradientenschwelle für ausführen der verschachtelten Schaltung mit IAE" VALUE 0x26D92C kw_si16_S6_S3 20000 UMR_U_MINSEC_1_1_0_S6_S3 -10000 10000 /end CHARACTERISTIC
/begin CHARACTERISTIC HYS_NGS_VERIAE57 "Hysterese für Gradientenschwelle bei IAE" VALUE 0x26D92E kw_si16_S6_S3 20000 UMR_U_MINSEC_1_1_0_S6_S3 -10000 10000 /end CHARACTERISTIC
/begin CHARACTERISTIC KL_TMAXCG68 "Maximaldauer Schaltung" CURVE 0x236600 kl_ui16_S6_S3 10000 UMR_MSEC__10_1_0_S6_S3 0 10000
 /begin AXIS_DESCR STD_AXIS NO_INPUT_QUANTITY UMR_GRADC__1_1_M40_S6_S3 2 -40 150 DEPOSIT ABSOLUTE MONOTONY MON_INCREASE /end AXIS_DESCR
/end CHARACTERISTIC
/begin CHARACTERISTIC T_RAMAX68 "Rampe bei Timeout" VALUE 0x26E657 kw_ui8_S6_S3 2540 UMR_MSEC__10_1_0_S6_S3 0 2540 /end CHARACTERISTIC
/begin CHARACTERISTIC NS_SYNISTE68 "Turbinendifferenzdrehzahlschwelle zur Erkennung Synchron istgang verlassen" VALUE 0x26D930 kw_si16_S6_S3 1000 UMR_U_MIN_1_1_0_S6_S3 0 1000 /end CHARACTERISTIC
/begin CHARACTERISTIC M_MOTMAXVERHSS68 "Max. Motormoment während aktiver Fkt." VALUE 0x26D932 kw_si16_S6_S3 2040 UMR_NM__1_1_0_S6_S3 -400 1640 /end CHARACTERISTIC
/begin CHARACTERISTIC MG_MMOTMAXVERHSSAUF68 "Gradient über den die Momentenbegrenzung aufgehoben wird" VALUE 0x26D934 kw_si16_S6_S3 2750 UMR_NM_SEC_10_1_0_S6_S3 -200 2550 /end CHARACTERISTIC
/begin CHARACTERISTIC NS_VERSIAE68 "Drehzahlschwelle auf Leerlaufdrehzahl zur Verhinderung der Verschachtelung bei IAE" VALUE 0x26D936 kw_si16_S6_S3 8200 UMR_U_MIN_1_1_0_S6_S3 0 8200 /end CHARACTERISTIC
/begin CHARACTERISTIC NGS_VERIAE68 "Abtriebsdrehzahlgradientenschwelle für ausführen der verschachtelten Schaltung mit IAE" VALUE 0x26D938 kw_si16_S6_S3 20000 UMR_U_MINSEC_1_1_0_S6_S3 -10000 10000 /end CHARACTERISTIC
/begin CHARACTERISTIC HYS_NGS_VERIAE68 "Hysterese für Gradientenschwelle bei IAE" VALUE 0x26D93A kw_si16_S6_S3 20000 UMR_U_MINSEC_1_1_0_S6_S3 -10000 10000 /end CHARACTERISTIC
/begin CHARACTERISTIC TAB_IKABENTLEER "Schalttyp abhängige Aktivierung der Stromrampe" MAP 0x234C78 tab2d_ui8_S6_S3 1 UMR___1_1_0_S6_S3 0 1
 /begin AXIS_DESCR FIX_AXIS iSasZentr.zug_schub_sas UMR___1_1_0_S6_S3 2 0 1 FIX_AXIS_PAR_DIST 0 1 2 /end AXIS_DESCR
 /begin AXIS_DESCR FIX_AXIS iSasZentr.schaltart_sas_sps UMR___1_1_0_S6_S3 4 0 3 FIX_AXIS_PAR_DIST 0 1 4 /end AXIS_DESCR
/end CHARACTERISTIC
/begin CHARACTERISTIC CS_IKABENTLEER "Getriebetemp.schwelle ab welcher die Stromrampe aktiviert werden kann" VALUE 0x26E621 kw_ui8_S6_S3 190 UMR_GRADC__1_1_M40_S6_S3 -40 150 /end CHARACTERISTIC
/begin CHARACTERISTIC SWI_VERSZYKL "Schalter fuer einmalige Abfrage der Einstiegsbed bei Start der Versch" VALUE 0x26E622 kw_bool8_S6_S3 1 UMR___1_1_0_S6_S3 0 1 /end CHARACTERISTIC
/begin CHARACTERISTIC SWI_SCHLEPPVERS "Schalter zur aktivierung der Bedingung für Verschachtelung bei Schleppstart" VALUE 0x26E623 kw_bool8_S6_S3 1 UMR___1_1_0_S6_S3 0 1 /end CHARACTERISTIC
/begin CHARACTERISTIC T_MAXABBRSINHS "Max Zeit für Digitalen Abbruch RS in HS" VALUE 0x26E624 kw_ui8_S6_S3 1000 UMR_MSEC__10_1_0_S6_S3 0 1000 /end CHARACTERISTIC
/begin CHARACTERISTIC T_MAXABBRSINRS "Max Zeit für Digitalen Abbruch RS mit direkter RS" VALUE 0x26E625 kw_ui8_S6_S3 1000 UMR_MSEC__10_1_0_S6_S3 0 1000 /end CHARACTERISTIC
/begin CHARACTERISTIC SWI_HINSYN "Schalter Funktion Hinsyn aktivieren" VALUE 0x26E626 kw_bool8_S6_S3 1 UMR___1_1_0_S6_S3 0 1 /end CHARACTERISTIC
/begin CHARACTERISTIC TAB_NSTABB "Turbinendrehzahlschwelle für Schaltungsabbruch in GLS" MAP 0x234C88 tab2d_ui16_S6_S3 8200 UMR___1_1_0_S6_S3 0 8200
 /begin AXIS_DESCR FIX_AXIS zff_atsys._.iSignale._.obj.sig_zielgang UMR___1_1_0_S6_S3 10 -1 8 FIX_AXIS_PAR_DIST -1 1 10 /end AXIS_DESCR
 /begin AXIS_DESCR FIX_AXIS iAzsZielgangSoll.zielgang_soll UMR___1_1_0_S6_S3 10 -1 8 FIX_AXIS_PAR_DIST -1 1 10 /end AXIS_DESCR
/end CHARACTERISTIC
/begin CHARACTERISTIC TAB_NSTABBSP "Turbinendrehzahlschwelle für Schaltungsabbruch in GLS" MAP 0x234D58 tab2d_ui16_S6_S3 8200 UMR___1_1_0_S6_S3 0 8200
 /begin AXIS_DESCR FIX_AXIS zff_atsys._.iSignale._.obj.sig_zielgang UMR___1_1_0_S6_S3 10 -1 8 FIX_AXIS_PAR_DIST -1 1 10 /end AXIS_DESCR
 /begin AXIS_DESCR FIX_AXIS iAzsZielgangSoll.zielgang_soll UMR___1_1_0_S6_S3 10 -1 8 FIX_AXIS_PAR_DIST -1 1 10 /end AXIS_DESCR
/end CHARACTERISTIC
/begin CHARACTERISTIC TAB_NSTABBSPORT "Turbinendrehzahlschwelle für Schaltungsabbruch in GLS" MAP 0x234E28 tab2d_ui16_S6_S3 8200 UMR___1_1_0_S6_S3 0 8200
 /begin AXIS_DESCR FIX_AXIS zff_atsys._.iSignale._.obj.sig_zielgang UMR___1_1_0_S6_S3 10 -1 8 FIX_AXIS_PAR_DIST -1 1 10 /end AXIS_DESCR
 /begin AXIS_DESCR FIX_AXIS iAzsZielgangSoll.zielgang_soll UMR___1_1_0_S6_S3 10 -1 8 FIX_AXIS_PAR_DIST -1 1 10 /end AXIS_DESCR
/end CHARACTERISTIC
/begin CHARACTERISTIC TAB_MTHINSYN "Momentenschwelle fuer HINSYN" MAP 0x234EF8 tab2d_si16_S6_S3 1000 UMR_NM__1_1_0_S6_S3 -400 600
 /begin AXIS_DESCR FIX_AXIS zff_atsys._.iSignale._.obj.sig_zielgang UMR___1_1_0_S6_S3 10 -1 8 FIX_AXIS_PAR_DIST -1 1 10 /end AXIS_DESCR
 /begin AXIS_DESCR FIX_AXIS zff_atsys._.iSignale._.obj.sig_istgang UMR___1_1_0_S6_S3 10 -1 8 FIX_AXIS_PAR_DIST -1 1 10 /end AXIS_DESCR
/end CHARACTERISTIC
/begin CHARACTERISTIC T_FNGABSAS "Filterzeit fuer Abtriebsdrehzahlgradient Motoreingriff" VALUE 0x26D886 kw_ui16_S6_S3 999 UMR_MSEC__1_1_0_S6_S3 1 1000 /end CHARACTERISTIC
/begin CHARACTERISTIC T_MINGANGFLAG_SYN "Mindestzeit fuer Setzen des Gangwechsel Flags" VALUE 0x26E627 kw_ui8_S6_S3 2540 UMR_MSEC__10_1_0_S6_S3 0 2540 /end CHARACTERISTIC
/begin CHARACTERISTIC T_MINGANGFLAG "Mindestzeit Flag sync_ziel_erreicht" VALUE 0x26E628 kw_ui8_S6_S3 50 UMR_MSEC__10_1_0_S6_S3 0 50 /end CHARACTERISTIC
/begin CHARACTERISTIC SWI_START_GANGWECHSEL "Schalter fuer Art der Berechnung fuer die Ausgabe vom Gangwechsel" VALUE 0x26E629 kw_bool8_S6_S3 1 UMR___1_1_0_S6_S3 0 1 /end CHARACTERISTIC
/begin CHARACTERISTIC TAB_TV_GANGWECHSEL "Verzoegerung Ausgabe Gangwechsel" CURVE 0x234FC8 tab_si16_S6_S3 5080 UMR_MSEC__10_1_0_S6_S3 -2540 2540
 /begin AXIS_DESCR FIX_AXIS iSasZentr.schalttyp UMR___1_1_0_S6_S3 5 0 4 FIX_AXIS_PAR_DIST 0 1 5 /end AXIS_DESCR
/end CHARACTERISTIC
/begin CHARACTERISTIC KL_NDSGANGWECHSEL "Drehzahlschwelle zur Ausgabe Gangwechsel Flag" CURVE 0x234FD8 kl_si16_S6_S3 8000 UMR_U_MIN_1_1_0_S6_S3 0 8000
 /begin AXIS_DESCR STD_AXIS zff_atsys._.iSignale._.obj.sig_c_getr UMR_GRADC__1_1_M40_S6_S3 4 -40 150 DEPOSIT ABSOLUTE MONOTONY MON_INCREASE /end AXIS_DESCR
/end CHARACTERISTIC
/begin CHARACTERISTIC KL_TFNGDSYNZIELGANG "Filterzeit fuer Berechnung Differenzdrehzahlgradient ng_dsynzielgang" CURVE 0x234FEC kl_ui16_S6_S3 999 UMR_MSEC__1_1_0_S6_S3 1 1000
 /begin AXIS_DESCR STD_AXIS zff_atsys._.iSignale._.obj.sig_n_ab UMR_U_MIN_1_1_0_S6_S3 3 0 8160 DEPOSIT ABSOLUTE MONOTONY MON_INCREASE /end AXIS_DESCR
/end CHARACTERISTIC
/begin CHARACTERISTIC TAB_SWISPONTRS "Aktivierung spontane RS (SP und SPORT) aus Index" CURVE 0x234FFC tab_ui8_S6_S3 2 UMR___1_1_0_S6_S3 0 2
 /begin AXIS_DESCR FIX_AXIS zff_atsys._.iSignale._.obj.sig_index_sp_sps UMR___1_1_0_S6_S3 100 0 99 FIX_AXIS_PAR_DIST 0 1 100 /end AXIS_DESCR
/end CHARACTERISTIC
/begin CHARACTERISTIC TAB_SWISPONTHS "Aktivierung spontane HS aus Index" CURVE 0x235064 tab_ui8_S6_S3 2 UMR___1_1_0_S6_S3 0 2
 /begin AXIS_DESCR FIX_AXIS zff_atsys._.iSignale._.obj.sig_index_sp_sps UMR___1_1_0_S6_S3 100 0 99 FIX_AXIS_PAR_DIST 0 1 100 /end AXIS_DESCR
/end CHARACTERISTIC
/begin CHARACTERISTIC TAB_SWIECOMODE "Tabelle zu Aktivierung ECO Mode aus Index" CURVE 0x2350CC tab_ui8_S6_S3 1 UMR___1_1_0_S6_S3 0 1
 /begin AXIS_DESCR FIX_AXIS zff_atsys._.iSignale._.obj.sig_index_sp_sps UMR___1_1_0_S6_S3 100 0 99 FIX_AXIS_PAR_DIST 0 1 100 /end AXIS_DESCR
/end CHARACTERISTIC
/begin CHARACTERISTIC SWI_EFSPONTSAS "Beeinflussung Spontindex bei E-Fahr Betrieb" VALUE 0x26E62A kw_ui8_S6_S3 3 UMR___1_1_0_S6_S3 0 3 /end CHARACTERISTIC
/begin CHARACTERISTIC TAB_SWIVERSFOLGE "Schaltungen bei denen eine Folgeschaltung verschachtelt wird" MAP 0x235134 tab2d_ui8_S6_S3 5 UMR___1_1_0_S6_S3 0 5
 /begin AXIS_DESCR FIX_AXIS zff_atsys._.iSignale._.obj.sig_istgang UMR___1_1_0_S6_S3 10 -1 8 FIX_AXIS_PAR_DIST -1 1 10 /end AXIS_DESCR
 /begin AXIS_DESCR FIX_AXIS zff_atsys._.iSignale._.obj.sig_zielgang UMR___1_1_0_S6_S3 10 -1 8 FIX_AXIS_PAR_DIST -1 1 10 /end AXIS_DESCR
/end CHARACTERISTIC
/begin CHARACTERISTIC TAB_SWIVERSFOLGE_EFAHREN "Auswahltabelle fuer verschachtelte Folgeschaltungen waehrend E-Fahren" MAP 0x2351A0 tab2d_ui8_S6_S3 1 UMR___1_1_0_S6_S3 0 1
 /begin AXIS_DESCR FIX_AXIS zff_atsys._.iSignale._.obj.sig_istgang UMR___1_1_0_S6_S3 10 -1 8 FIX_AXIS_PAR_DIST -1 1 10 /end AXIS_DESCR
 /begin AXIS_DESCR FIX_AXIS zff_atsys._.iSignale._.obj.sig_zielgang UMR___1_1_0_S6_S3 10 -1 8 FIX_AXIS_PAR_DIST -1 1 10 /end AXIS_DESCR
/end CHARACTERISTIC
/begin CHARACTERISTIC DKIS_VERS_EFAHREN "DKI Schwelle Ausfuehrung einer verschachtelten Schaltung waehrend E Fahren" VALUE 0x26E62B kw_ui8_S6_S3 100 UMR_PROZENT__20_51_0_S6_S3 0 100 /end CHARACTERISTIC
/begin CHARACTERISTIC CS_GVERSHS "Untere Getriebetemp.schwelle fuer Verschacht. schaltungen HS" VALUE 0x26E62C kw_ui8_S6_S3 190 UMR_GRADC__1_1_M40_S6_S3 -40 150 /end CHARACTERISTIC
/begin CHARACTERISTIC CS_GVERSRS "Untere Getriebetemp.schwelle fuer Verschacht. schaltungen RS" VALUE 0x26E62D kw_ui8_S6_S3 190 UMR_GRADC__1_1_M40_S6_S3 -40 150 /end CHARACTERISTIC
/begin CHARACTERISTIC NS_MOTVERS "Motordrehzahlschwelle Verschachtelung" VALUE 0x26D888 kw_ui16_S6_S3 8160 UMR_U_MIN_1_1_0_S6_S3 0 8160 /end CHARACTERISTIC
/begin CHARACTERISTIC TAB_NGSABVERSUN "untere Schwelle Abtriebsgradient fuer Ausfuehrung verschachtelte Schaltung" MAP 0x23520C tab2d_si16_S6_S3 10000 UMR_U_MINSEC_1_1_0_S6_S3 -5000 5000
 /begin AXIS_DESCR FIX_AXIS zff_atsys._.iSignale._.obj.sig_istgang UMR___1_1_0_S6_S3 10 -1 8 FIX_AXIS_PAR_DIST -1 1 10 /end AXIS_DESCR
 /begin AXIS_DESCR FIX_AXIS zff_atsys._.iSignale._.obj.sig_zielgang UMR___1_1_0_S6_S3 10 -1 8 FIX_AXIS_PAR_DIST -1 1 10 /end AXIS_DESCR
/end CHARACTERISTIC
/begin CHARACTERISTIC NGS_ABVERSOB "obere Schwelle Abtriebsdrehzahlgradient Verschachtelung" VALUE 0x26D88A kw_si16_S6_S3 13200 UMR_U_MINSEC_1_1_0_S6_S3 -5000 8200 /end CHARACTERISTIC
/begin CHARACTERISTIC DKIS_VERS "DKI Schwelle Ausführung einer verschachtelten Schaltung" VALUE 0x26E62E kw_ui8_S6_S3 100 UMR_PROZENT__20_51_0_S6_S3 0 100 /end CHARACTERISTIC
/begin CHARACTERISTIC DKIS_VERSSP "DKI Schwelle Ausführung einer verschachtelten Schaltung fuer SP" VALUE 0x26E62F kw_ui8_S6_S3 100 UMR_PROZENT__20_51_0_S6_S3 0 100 /end CHARACTERISTIC
/begin CHARACTERISTIC DKIS_VERSSPORT "DKI Schwelle Ausführung einer verschachtelten Schaltung fuer SPORT" VALUE 0x26E630 kw_ui8_S6_S3 100 UMR_PROZENT__20_51_0_S6_S3 0 100 /end CHARACTERISTIC
/begin CHARACTERISTIC NS_NTVERSHS "Drehzahlschwelle für Ausführung verschachtelter Schaltung HS" VALUE 0x26D88C kw_ui16_S6_S3 8200 UMR_U_MIN_1_1_0_S6_S3 0 8200 /end CHARACTERISTIC
/begin CHARACTERISTIC NS_NTVERSRS "Drehzahlschwelle für Ausführung verschachtelter Schaltung RS" VALUE 0x26D88E kw_ui16_S6_S3 8200 UMR_U_MIN_1_1_0_S6_S3 0 8200 /end CHARACTERISTIC
/begin CHARACTERISTIC SWI_ABBRS "Schalter Abbruch einer RS" VALUE 0x26E631 kw_ui8_S6_S3 3 UMR___1_1_0_S6_S3 0 3 /end CHARACTERISTIC
/begin CHARACTERISTIC SWI_ABBSYNISTHS "Schalter Abbruch einer HS bevor sync istgang verlassen" VALUE 0x26E632 kw_bool8_S6_S3 1 UMR___1_1_0_S6_S3 0 1 /end CHARACTERISTIC
/begin CHARACTERISTIC CS_GABBHS "Getriebetemp.schwelle fuer Abbruch von Hochschaltungen" VALUE 0x26E633 kw_ui8_S6_S3 220 UMR_GRADC__1_1_M40_S6_S3 -40 180 /end CHARACTERISTIC
/begin CHARACTERISTIC F_VSYNABBHS "Faktor Drehzahlfenster GLS-Abbruch" VALUE 0x26E634 kw_ui8_S6_S3 100 UMR_PROZENT__20_51_0_S6_S3 0 100 /end CHARACTERISTIC
/begin CHARACTERISTIC SWI_ERRSP "Schalter schnelle Rueckschaltungen auch bei Fehlereintrag" VALUE 0x26E635 kw_bool8_S6_S3 1 UMR___1_1_0_S6_S3 0 1 /end CHARACTERISTIC
/begin CHARACTERISTIC CS_OBSP "Obere Getriebetemperaturschwelle fuer verkuerzte RS" VALUE 0x26E636 kw_ui8_S6_S3 190 UMR_GRADC__1_1_M40_S6_S3 -40 150 /end CHARACTERISTIC
/begin CHARACTERISTIC CS_UNSPHS "Untere Getriebetemperaturschwelle fuer verkuerzte HS" VALUE 0x26E637 kw_ui8_S6_S3 190 UMR_GRADC__1_1_M40_S6_S3 -40 150 /end CHARACTERISTIC
/begin CHARACTERISTIC CS_UNSPRS "Untere Getriebetemperaturschwelle fuer verkuerzte RS" VALUE 0x26E638 kw_ui8_S6_S3 190 UMR_GRADC__1_1_M40_S6_S3 -40 150 /end CHARACTERISTIC
/begin CHARACTERISTIC CS_OBSPORT "Obere Getriebetemperaturschwelle fuer sportl. RS" VALUE 0x26E639 kw_ui8_S6_S3 190 UMR_GRADC__1_1_M40_S6_S3 -40 150 /end CHARACTERISTIC
/begin CHARACTERISTIC CS_UNSPORTHS "Untere Getriebetemperaturschwelle fuer sportl. HS" VALUE 0x26E63A kw_ui8_S6_S3 190 UMR_GRADC__1_1_M40_S6_S3 -40 150 /end CHARACTERISTIC
/begin CHARACTERISTIC CS_UNSPORTRS "Untere Getriebetemperaturschwelle fuer sportl. RS" VALUE 0x26E63B kw_ui8_S6_S3 190 UMR_GRADC__1_1_M40_S6_S3 -40 150 /end CHARACTERISTIC
/begin CHARACTERISTIC SWI_UMSPLABRS "Switch Umschaltung aller Label fuer spontane RS auch nach Start Schaltung" VALUE 0x26E63C kw_bool8_S6_S3 1 UMR___1_1_0_S6_S3 0 1 /end CHARACTERISTIC
/begin CHARACTERISTIC SCHWELLE_NDSYN "Drehzahlschwelle fuer Verlassen/Erreichen synchron" VALUE 0x26D890 kw_ui16_S6_S3 8160 UMR_U_MIN_1_1_0_S6_S3 0 8160 /end CHARACTERISTIC
/begin CHARACTERISTIC NS_ABSSCHRHS "Abtriebsdrehzahlschwelle Schrittschaltung HS" VALUE 0x26D892 kw_ui16_S6_S3 8160 UMR_U_MIN_1_1_0_S6_S3 0 8160 /end CHARACTERISTIC
/begin CHARACTERISTIC NS_ABSSCHRRS "Abtriebsdrehzahlschwelle Schrittschaltung RS" VALUE 0x26D894 kw_ui16_S6_S3 8160 UMR_U_MIN_1_1_0_S6_S3 0 8160 /end CHARACTERISTIC
/begin CHARACTERISTIC NS_ABSSCHRHS1 "Schwelle Schrittschaltung bei HS mit 1.Gang" VALUE 0x26D896 kw_ui16_S6_S3 8160 UMR_U_MIN_1_1_0_S6_S3 0 8160 /end CHARACTERISTIC
/begin CHARACTERISTIC NS_ABSSCHRRS1 "Schwelle Schrittschaltung bei RS mit 1.Gang" VALUE 0x26D898 kw_ui16_S6_S3 8160 UMR_U_MIN_1_1_0_S6_S3 0 8160 /end CHARACTERISTIC
/begin CHARACTERISTIC NS_TSSCHR "Turbinendrehzahlschwelle Schrittschaltung" VALUE 0x26D89A kw_ui16_S6_S3 8160 UMR_U_MIN_1_1_0_S6_S3 0 8160 /end CHARACTERISTIC
/begin CHARACTERISTIC TAB_MSTVERS "Momentenschwelle fuer verschachtelte Schaltungen" MAP 0x2352DC tab2d_si16_S6_S3 2040 UMR_NM__1_1_0_S6_S3 -400 1640
 /begin AXIS_DESCR FIX_AXIS zff_atsys._.iSignale._.obj.sig_istgang UMR___1_1_0_S6_S3 10 -1 8 FIX_AXIS_PAR_DIST -1 1 10 /end AXIS_DESCR
 /begin AXIS_DESCR FIX_AXIS zff_atsys._.iSignale._.obj.sig_zielgang UMR___1_1_0_S6_S3 10 -1 8 FIX_AXIS_PAR_DIST -1 1 10 /end AXIS_DESCR
/end CHARACTERISTIC
/begin CHARACTERISTIC TAB_MSTOBSP "untere Momentenschwelle fuer verkuerzte Schaltungen" MAP 0x2353AC tab2d_si16_S6_S3 2040 UMR_NM__1_1_0_S6_S3 -400 1640
 /begin AXIS_DESCR FIX_AXIS zff_atsys._.iSignale._.obj.sig_istgang UMR___1_1_0_S6_S3 10 -1 8 FIX_AXIS_PAR_DIST -1 1 10 /end AXIS_DESCR
 /begin AXIS_DESCR FIX_AXIS zff_atsys._.iSignale._.obj.sig_zielgang UMR___1_1_0_S6_S3 10 -1 8 FIX_AXIS_PAR_DIST -1 1 10 /end AXIS_DESCR
/end CHARACTERISTIC
/begin CHARACTERISTIC TAB_MSTOBSPORT "Obere Momentenschwelle für sport Schaltungen" MAP 0x23547C tab2d_si16_S6_S3 2040 UMR_NM__1_1_0_S6_S3 -400 1640
 /begin AXIS_DESCR FIX_AXIS zff_atsys._.iSignale._.obj.sig_istgang UMR___1_1_0_S6_S3 10 -1 8 FIX_AXIS_PAR_DIST -1 1 10 /end AXIS_DESCR
 /begin AXIS_DESCR FIX_AXIS zff_atsys._.iSignale._.obj.sig_zielgang UMR___1_1_0_S6_S3 10 -1 8 FIX_AXIS_PAR_DIST -1 1 10 /end AXIS_DESCR
/end CHARACTERISTIC
/begin CHARACTERISTIC TAB_MSTUNSP "untere Momentenschwelle fuer verkuerzte Schaltungen" MAP 0x23554C tab2d_si16_S6_S3 2040 UMR_NM__1_1_0_S6_S3 -400 1640
 /begin AXIS_DESCR FIX_AXIS zff_atsys._.iSignale._.obj.sig_istgang UMR___1_1_0_S6_S3 10 -1 8 FIX_AXIS_PAR_DIST -1 1 10 /end AXIS_DESCR
 /begin AXIS_DESCR FIX_AXIS zff_atsys._.iSignale._.obj.sig_zielgang UMR___1_1_0_S6_S3 10 -1 8 FIX_AXIS_PAR_DIST -1 1 10 /end AXIS_DESCR
/end CHARACTERISTIC
/begin CHARACTERISTIC TAB_MSTUNSPORT "Untere Momentenschwelle für sport Schaltungen" MAP 0x23561C tab2d_si16_S6_S3 2040 UMR_NM__1_1_0_S6_S3 -400 1640
 /begin AXIS_DESCR FIX_AXIS zff_atsys._.iSignale._.obj.sig_istgang UMR___1_1_0_S6_S3 10 -1 8 FIX_AXIS_PAR_DIST -1 1 10 /end AXIS_DESCR
 /begin AXIS_DESCR FIX_AXIS zff_atsys._.iSignale._.obj.sig_zielgang UMR___1_1_0_S6_S3 10 -1 8 FIX_AXIS_PAR_DIST -1 1 10 /end AXIS_DESCR
/end CHARACTERISTIC
/begin CHARACTERISTIC TAB_NSABSP "Abtriebsdrehzahlschwelle fuer verkuerzte Schaltungen" MAP 0x2356EC tab2d_ui16_S6_S3 8160 UMR_U_MIN_1_1_0_S6_S3 0 8160
 /begin AXIS_DESCR FIX_AXIS zff_atsys._.iSignale._.obj.sig_istgang UMR___1_1_0_S6_S3 10 -1 8 FIX_AXIS_PAR_DIST -1 1 10 /end AXIS_DESCR
 /begin AXIS_DESCR FIX_AXIS zff_atsys._.iSignale._.obj.sig_zielgang UMR___1_1_0_S6_S3 10 -1 8 FIX_AXIS_PAR_DIST -1 1 10 /end AXIS_DESCR
/end CHARACTERISTIC
/begin CHARACTERISTIC TAB_NSABSPORT "Abtriebsdrehzahlschwelle für sport Schaltungen" MAP 0x2357BC tab2d_ui16_S6_S3 8160 UMR_U_MIN_1_1_0_S6_S3 0 8160
 /begin AXIS_DESCR FIX_AXIS zff_atsys._.iSignale._.obj.sig_istgang UMR___1_1_0_S6_S3 10 -1 8 FIX_AXIS_PAR_DIST -1 1 10 /end AXIS_DESCR
 /begin AXIS_DESCR FIX_AXIS zff_atsys._.iSignale._.obj.sig_zielgang UMR___1_1_0_S6_S3 10 -1 8 FIX_AXIS_PAR_DIST -1 1 10 /end AXIS_DESCR
/end CHARACTERISTIC
/begin CHARACTERISTIC TAB_NTFAKTORKAB "Turbinendrehzahlfaktor für Berechnung Kupplungsdrehzahl bei Schaltungen für abschaltende Kupplung" MAP 0x23588C tab2d_si16_S6_S3 20 UMR___1_1000_0_S6_S3 -10 10
 /begin AXIS_DESCR FIX_AXIS zff_atsys._.iSignale._.obj.sig_istgang UMR___1_1_0_S6_S3 10 -1 8 FIX_AXIS_PAR_DIST -1 1 10 /end AXIS_DESCR
 /begin AXIS_DESCR FIX_AXIS zff_atsys._.iSignale._.obj.sig_zielgang_sas UMR___1_1_0_S6_S3 10 -1 8 FIX_AXIS_PAR_DIST -1 1 10 /end AXIS_DESCR
/end CHARACTERISTIC
/begin CHARACTERISTIC TAB_NTFAKTORKZU "Turbinendrehzahlfaktor für Berechnung Kupplungsdrehzahl bei Schaltungen für zuschaltende Kupplung" MAP 0x23595C tab2d_si16_S6_S3 20 UMR___1_1000_0_S6_S3 -10 10
 /begin AXIS_DESCR FIX_AXIS zff_atsys._.iSignale._.obj.sig_istgang UMR___1_1_0_S6_S3 10 -1 8 FIX_AXIS_PAR_DIST -1 1 10 /end AXIS_DESCR
 /begin AXIS_DESCR FIX_AXIS zff_atsys._.iSignale._.obj.sig_zielgang_sas UMR___1_1_0_S6_S3 10 -1 8 FIX_AXIS_PAR_DIST -1 1 10 /end AXIS_DESCR
/end CHARACTERISTIC
/begin CHARACTERISTIC TAB_NABFAKTORKAB "Abtriebsdrehzahlfaktor für Berechnung Kupplungsdrehzahl bei Schaltungen für abschaltende Kupplung" MAP 0x235A2C tab2d_si16_S6_S3 20 UMR___1_1000_0_S6_S3 -10 10
 /begin AXIS_DESCR FIX_AXIS zff_atsys._.iSignale._.obj.sig_istgang UMR___1_1_0_S6_S3 10 -1 8 FIX_AXIS_PAR_DIST -1 1 10 /end AXIS_DESCR
 /begin AXIS_DESCR FIX_AXIS zff_atsys._.iSignale._.obj.sig_zielgang_sas UMR___1_1_0_S6_S3 10 -1 8 FIX_AXIS_PAR_DIST -1 1 10 /end AXIS_DESCR
/end CHARACTERISTIC
/begin CHARACTERISTIC TAB_NABFAKTORKZU "Abtriebsdrehzahlfaktor für Berechnung Kupplungsdrehzahl bei Schaltungen für zuschaltende Kupplung" MAP 0x235AFC tab2d_si16_S6_S3 20 UMR___1_1000_0_S6_S3 -10 10
 /begin AXIS_DESCR FIX_AXIS zff_atsys._.iSignale._.obj.sig_istgang UMR___1_1_0_S6_S3 10 -1 8 FIX_AXIS_PAR_DIST -1 1 10 /end AXIS_DESCR
 /begin AXIS_DESCR FIX_AXIS zff_atsys._.iSignale._.obj.sig_zielgang_sas UMR___1_1_0_S6_S3 10 -1 8 FIX_AXIS_PAR_DIST -1 1 10 /end AXIS_DESCR
/end CHARACTERISTIC
/begin CHARACTERISTIC TAB_REIBFAKTORKAB_1 "Reibfaktor der abschaltenden Kupplung schaltungsabhängig" MAP 0x235BCC tab2d_si16_S6_S3 300 UMR_NM_BAR_1_100_0_S6_S3 0 300
 /begin AXIS_DESCR FIX_AXIS zff_atsys._.iSignale._.obj.sig_istgang UMR___1_1_0_S6_S3 10 -1 8 FIX_AXIS_PAR_DIST -1 1 10 /end AXIS_DESCR
 /begin AXIS_DESCR FIX_AXIS zff_atsys._.iSignale._.obj.sig_zielgang_sas UMR___1_1_0_S6_S3 10 -1 8 FIX_AXIS_PAR_DIST -1 1 10 /end AXIS_DESCR
/end CHARACTERISTIC
/begin CHARACTERISTIC TAB_REIBFAKTORKAB_2 "Reibfaktor der abschaltenden Kupplung schaltungsabhängig" MAP 0x235C9C tab2d_si16_S6_S3 10 UMR_NM_BAR2_1_100_0_S6_S3 -10 0
 /begin AXIS_DESCR FIX_AXIS zff_atsys._.iSignale._.obj.sig_istgang UMR___1_1_0_S6_S3 10 -1 8 FIX_AXIS_PAR_DIST -1 1 10 /end AXIS_DESCR
 /begin AXIS_DESCR FIX_AXIS zff_atsys._.iSignale._.obj.sig_zielgang_sas UMR___1_1_0_S6_S3 10 -1 8 FIX_AXIS_PAR_DIST -1 1 10 /end AXIS_DESCR
/end CHARACTERISTIC
/begin CHARACTERISTIC TAB_REIBFAKTORKZU_1 "Reibfaktor der zuschaltenden Kupplung schaltungsabhängig" MAP 0x235D6C tab2d_si16_S6_S3 300 UMR_NM_BAR_1_100_0_S6_S3 0 300
 /begin AXIS_DESCR FIX_AXIS zff_atsys._.iSignale._.obj.sig_istgang UMR___1_1_0_S6_S3 10 -1 8 FIX_AXIS_PAR_DIST -1 1 10 /end AXIS_DESCR
 /begin AXIS_DESCR FIX_AXIS zff_atsys._.iSignale._.obj.sig_zielgang_sas UMR___1_1_0_S6_S3 10 -1 8 FIX_AXIS_PAR_DIST -1 1 10 /end AXIS_DESCR
/end CHARACTERISTIC
/begin CHARACTERISTIC TAB_REIBFAKTORKZU_2 "Reibfaktor der zuschaltenden Kupplung schaltungsabhängig" MAP 0x235E3C tab2d_si16_S6_S3 10 UMR_NM_BAR2_1_100_0_S6_S3 -10 0
 /begin AXIS_DESCR FIX_AXIS zff_atsys._.iSignale._.obj.sig_istgang UMR___1_1_0_S6_S3 10 -1 8 FIX_AXIS_PAR_DIST -1 1 10 /end AXIS_DESCR
 /begin AXIS_DESCR FIX_AXIS zff_atsys._.iSignale._.obj.sig_zielgang_sas UMR___1_1_0_S6_S3 10 -1 8 FIX_AXIS_PAR_DIST -1 1 10 /end AXIS_DESCR
/end CHARACTERISTIC
/begin CHARACTERISTIC TAB_GESAMTREIBFLAECHE "Reibfläche der Kupplung" CURVE 0x235F0C tab_si16_S6_S3 299990 UMR_MM2__10_1_0_S6_S3 10 300000
 /begin AXIS_DESCR FIX_AXIS iTciCompu.k_zu UMR___1_1_0_S6_S3 5 1 5 FIX_AXIS_PAR_DIST 1 1 5 /end AXIS_DESCR
/end CHARACTERISTIC
/begin CHARACTERISTIC TAB_GESAMTMASSE "Gesamtmasse der Stahllamellen der Kupplung" CURVE 0x235F1C tab_si16_S6_S3 9999 UMR_G__1_1_0_S6_S3 1 10000
 /begin AXIS_DESCR FIX_AXIS iTciCompu.k_zu UMR___1_1_0_S6_S3 5 1 5 FIX_AXIS_PAR_DIST 1 1 5 /end AXIS_DESCR
/end CHARACTERISTIC
/begin CHARACTERISTIC TAB_LMAXZULKAB "Max. zulässige Reibleistung der abschaltenden Kupplung" MAP 0x235F2C tab2d_si16_S6_S3 4.99 UMR_W_MM2_1_100_0_S6_S3 0.01 5
 /begin AXIS_DESCR FIX_AXIS zff_atsys._.iSignale._.obj.sig_istgang UMR___1_1_0_S6_S3 10 -1 8 FIX_AXIS_PAR_DIST -1 1 10 /end AXIS_DESCR
 /begin AXIS_DESCR FIX_AXIS zff_atsys._.iSignale._.obj.sig_zielgang_sas UMR___1_1_0_S6_S3 10 -1 8 FIX_AXIS_PAR_DIST -1 1 10 /end AXIS_DESCR
/end CHARACTERISTIC
/begin CHARACTERISTIC TAB_LMAXZULKZU "Max. zulässige Reibleistung der zuschaltenden Kupplung" MAP 0x235FFC tab2d_si16_S6_S3 4.99 UMR_W_MM2_1_100_0_S6_S3 0.01 5
 /begin AXIS_DESCR FIX_AXIS zff_atsys._.iSignale._.obj.sig_istgang UMR___1_1_0_S6_S3 10 -1 8 FIX_AXIS_PAR_DIST -1 1 10 /end AXIS_DESCR
 /begin AXIS_DESCR FIX_AXIS zff_atsys._.iSignale._.obj.sig_zielgang_sas UMR___1_1_0_S6_S3 10 -1 8 FIX_AXIS_PAR_DIST -1 1 10 /end AXIS_DESCR
/end CHARACTERISTIC
/begin CHARACTERISTIC TAB_WMAXZULKAB "Max. zulässige Reibarbeit der abschaltenden Kupplung" MAP 0x2360CC tab2d_fl32_S6_S3 199.9 UMR_J_G_1_1_0_S6_S3 0.1 200 FORMAT "%5.3"
 /begin AXIS_DESCR FIX_AXIS zff_atsys._.iSignale._.obj.sig_istgang UMR___1_1_0_S6_S3 10 -1 8 FIX_AXIS_PAR_DIST -1 1 10 /end AXIS_DESCR
 /begin AXIS_DESCR FIX_AXIS zff_atsys._.iSignale._.obj.sig_zielgang_sas UMR___1_1_0_S6_S3 10 -1 8 FIX_AXIS_PAR_DIST -1 1 10 /end AXIS_DESCR
/end CHARACTERISTIC
/begin CHARACTERISTIC TAB_WMAXZULKZU "Max. zulässige Reibarbeit der zuschaltenden Kupplung" MAP 0x236264 tab2d_fl32_S6_S3 199.9 UMR_J_G_1_1_0_S6_S3 0.1 200 FORMAT "%5.3"
 /begin AXIS_DESCR FIX_AXIS zff_atsys._.iSignale._.obj.sig_istgang UMR___1_1_0_S6_S3 10 -1 8 FIX_AXIS_PAR_DIST -1 1 10 /end AXIS_DESCR
 /begin AXIS_DESCR FIX_AXIS zff_atsys._.iSignale._.obj.sig_zielgang_sas UMR___1_1_0_S6_S3 10 -1 8 FIX_AXIS_PAR_DIST -1 1 10 /end AXIS_DESCR
/end CHARACTERISTIC
/begin CHARACTERISTIC KL_TFPKZUCG_KUPBEL "Filterzeit für Kupplungswirkdruck kzu" CURVE 0x2363FC kl_ui8_S6_S3 2530 UMR_MSEC__10_1_0_S6_S3 10 2540
 /begin AXIS_DESCR STD_AXIS zff_atsys._.iSignale._.obj.sig_c_getr UMR_GRADC__1_1_M40_S6_S3 4 -40 150 DEPOSIT ABSOLUTE MONOTONY MON_INCREASE /end AXIS_DESCR
/end CHARACTERISTIC
/begin CHARACTERISTIC KL_TFPKABCG_KUPBEL "Filterzeit für Kupplungswirkdruck kab" CURVE 0x236408 kl_ui8_S6_S3 2530 UMR_MSEC__10_1_0_S6_S3 10 2540
 /begin AXIS_DESCR STD_AXIS zff_atsys._.iSignale._.obj.sig_c_getr UMR_GRADC__1_1_M40_S6_S3 4 -40 150 DEPOSIT ABSOLUTE MONOTONY MON_INCREASE /end AXIS_DESCR
/end CHARACTERISTIC
/begin CHARACTERISTIC WAERMEKAP_LAM "Wärmekapazität einer Stahllamelle der Kupplung" VALUE 0x26D89C kw_ui16_S6_S3 0.999 UMR_J_GK_1_1000_0_S6_S3 0.001 1 /end CHARACTERISTIC
/begin CHARACTERISTIC TAB_MASSE_LAM "Masse einer Stahllamelle der Kupplung" CURVE 0x236414 tab_ui16_S6_S3 999.9 UMR_G__1_10_0_S6_S3 0.1 1000
 /begin AXIS_DESCR FIX_AXIS iTciCompu.k_zu UMR___1_1_0_S6_S3 5 1 5 FIX_AXIS_PAR_DIST 1 1 5 /end AXIS_DESCR
/end CHARACTERISTIC
/begin CHARACTERISTIC TAB_N_LAM "Anzahl der Stahllamellen der Kupplung" CURVE 0x236424 tab_ui8_S6_S3 9 UMR___1_1_0_S6_S3 1 10
 /begin AXIS_DESCR FIX_AXIS iTciCompu.k_zu UMR___1_1_0_S6_S3 5 1 5 FIX_AXIS_PAR_DIST 1 1 5 /end AXIS_DESCR
/end CHARACTERISTIC
/begin CHARACTERISTIC TAB_F_KORCKUPPL "Korrekturfaktor für Schaltelementerwärmung" MAP 0x236430 tab2d_ui8_S6_S3 2.55 UMR___1_100_0_S6_S3 0 2.55
 /begin AXIS_DESCR FIX_AXIS iTciCompu.k_zu UMR___1_1_0_S6_S3 5 1 5 FIX_AXIS_PAR_DIST 1 1 5 /end AXIS_DESCR
 /begin AXIS_DESCR FIX_AXIS iTciCompu.schaltart_sas_red_tci UMR___1_1_0_S6_S3 3 1 3 FIX_AXIS_PAR_DIST 1 1 3 /end AXIS_DESCR
/end CHARACTERISTIC
/begin CHARACTERISTIC T_PT2_C_KUPBEL "Filterzeitkonstante PT2-Filter fuer c_kupplung" VALUE 0x26D89E kw_ui16_S6_S3 3990 UMR_MSEC__10_1_0_S6_S3 10 4000 /end CHARACTERISTIC
/begin CHARACTERISTIC DKI_SCKSAS "DKI Schwelle zur QS Umstellung" VALUE 0x26E63D kw_ui8_S6_S3 100 UMR_PROZENT__20_51_0_S6_S3 0 100 /end CHARACTERISTIC
/begin CHARACTERISTIC KL_MTCKSPSAS "Momentenschwelle zur QS Umstellung" CURVE 0x236448 kl_si16_S6_S3 1500 UMR_NM__1_1_0_S6_S3 -200 1300
 /begin AXIS_DESCR STD_AXIS zff_atsys._.iSignale._.obj.sig_n_t UMR_U_MIN_1_1_0_S6_S3 4 0 8000 DEPOSIT ABSOLUTE MONOTONY MON_INCREASE /end AXIS_DESCR
/end CHARACTERISTIC
/begin CHARACTERISTIC KL_CK_MMOTMAX "Kupplungstemperaturabhängige Motormomentenbegrenzung." CURVE 0x23645C kl_si16_S6_S3 1500 UMR_NM__1_1_0_S6_S3 -200 1300
 /begin AXIS_DESCR STD_AXIS NO_INPUT_QUANTITY UMR_GRADC__1_1_0_S6_S3 4 -40 500 DEPOSIT ABSOLUTE MONOTONY MON_INCREASE /end AXIS_DESCR
/end CHARACTERISTIC
/begin CHARACTERISTIC T_MMOTMAXCKAB "Rampenzeit auf Kupplungstemperaturabhängige Motormomentenbegrenzung" VALUE 0x26E63E kw_ui8_S6_S3 2540 UMR_MSEC__10_1_0_S6_S3 0 2540 /end CHARACTERISTIC
/begin CHARACTERISTIC MG_MOTMAXCKAUF "Momentengradient bei Rücknahme Kupplungstemperaturabhängige Motormomentenbegrenzung" VALUE 0x26E63F kw_ui8_S6_S3 2550 UMR_NM_SEC_10_1_0_S6_S3 0 2550 /end CHARACTERISTIC
/begin CHARACTERISTIC SWI_VERHVERSMMOTMAX "Schalter zur Verhinderung der Verschachtelung wenn Kupplungstemperaturabhängige Motormomentenbegrenzung aktiv" VALUE 0x26E640 kw_bool8_S6_S3 1 UMR___1_1_0_S6_S3 0 1 /end CHARACTERISTIC
/begin CHARACTERISTIC TAB_SWISTARTSCHALT "Schalter, ob Schaltung mit Start ME-Haupt beginnt" MAP 0x236470 tab2d_ui8_S6_S3 1 UMR___1_1_0_S6_S3 0 1
 /begin AXIS_DESCR FIX_AXIS NO_INPUT_QUANTITY UMR___1_1_0_S6_S3 2 0 1 FIX_AXIS_PAR_DIST 0 1 2 /end AXIS_DESCR
 /begin AXIS_DESCR FIX_AXIS iSasZentr.schaltung_anfahren_idx UMR___1_1_0_S6_S3 5 0 4 FIX_AXIS_PAR_DIST 0 1 5 /end AXIS_DESCR
/end CHARACTERISTIC
/begin CHARACTERISTIC TAB_VZINITSCHALT "Verzoegerungszeit [ms] Schaltungsende nach Ende Hauptmotoreingriff" MAP 0x236484 tab2d_ui8_S6_S3 1990 UMR_MSEC__10_1_0_S6_S3 10 2000
 /begin AXIS_DESCR FIX_AXIS NO_INPUT_QUANTITY UMR___1_1_0_S6_S3 2 0 1 FIX_AXIS_PAR_DIST 0 1 2 /end AXIS_DESCR
 /begin AXIS_DESCR FIX_AXIS iSasZentr.schaltung_anfahren_idx UMR___1_1_0_S6_S3 5 0 4 FIX_AXIS_PAR_DIST 0 1 5 /end AXIS_DESCR
/end CHARACTERISTIC
/begin CHARACTERISTIC SWI_DKIRSS "Schalter zur Abfrage DKI Schwelle" VALUE 0x26E641 kw_ui8_S6_S3 2 UMR___1_1_0_S6_S3 0 2 /end CHARACTERISTIC
/begin CHARACTERISTIC KF_P_KUP_BEDARF_A "Kupplungsdruck zur Sicherstellung der Übertragungsfähigkeit" MAP 0x23660C kf_si16_S6_S3 22 UMR_BAR__1_1000_0_S6_S3 0 22
 /begin AXIS_DESCR STD_AXIS NO_INPUT_QUANTITY UMR_NM__1_1_0_S6_S3 6 -32768 32767 DEPOSIT ABSOLUTE MONOTONY MON_INCREASE /end AXIS_DESCR
 /begin AXIS_DESCR STD_AXIS NO_INPUT_QUANTITY UMR___1_1_0_S6_S3 9 0 8 DEPOSIT ABSOLUTE MONOTONY MON_INCREASE /end AXIS_DESCR
/end CHARACTERISTIC
/begin CHARACTERISTIC KF_POKZUFOL_A "Kupplungsabhängiger Offset vorbereitende KZU" MAP 0x2366A0 kf_si16_S6_S3 12.8 UMR_BAR__1_1000_0_S6_S3 -6.4 6.4
 /begin AXIS_DESCR STD_AXIS zff_atsys._.iSignale._.obj.sig_m_t UMR_NM__1_1_0_S6_S3 4 -400 1640 DEPOSIT ABSOLUTE MONOTONY MON_INCREASE /end AXIS_DESCR
 /begin AXIS_DESCR STD_AXIS zff_atsys._.iSignale._.obj.sig_c_getr UMR_GRADC__1_1_M40_S6_S3 4 -40 215 DEPOSIT ABSOLUTE MONOTONY MON_INCREASE /end AXIS_DESCR
/end CHARACTERISTIC
/begin CHARACTERISTIC KF_POKZUFOLSP_A "Kupplungsabhängiger Offset vorbereitende KZU" MAP 0x2366D8 kf_si16_S6_S3 12.8 UMR_BAR__1_1000_0_S6_S3 -6.4 6.4
 /begin AXIS_DESCR STD_AXIS zff_atsys._.iSignale._.obj.sig_m_t UMR_NM__1_1_0_S6_S3 4 -400 1640 DEPOSIT ABSOLUTE MONOTONY MON_INCREASE /end AXIS_DESCR
 /begin AXIS_DESCR STD_AXIS zff_atsys._.iSignale._.obj.sig_c_getr UMR_GRADC__1_1_M40_S6_S3 4 -40 215 DEPOSIT ABSOLUTE MONOTONY MON_INCREASE /end AXIS_DESCR
/end CHARACTERISTIC
/begin CHARACTERISTIC KF_POKZUFOLSPORT_A "Kupplungsabhängiger Offset vorbereitende KZU" MAP 0x236710 kf_si16_S6_S3 12.8 UMR_BAR__1_1000_0_S6_S3 -6.4 6.4
 /begin AXIS_DESCR STD_AXIS zff_atsys._.iSignale._.obj.sig_m_t UMR_NM__1_1_0_S6_S3 4 -400 1640 DEPOSIT ABSOLUTE MONOTONY MON_INCREASE /end AXIS_DESCR
 /begin AXIS_DESCR STD_AXIS zff_atsys._.iSignale._.obj.sig_c_getr UMR_GRADC__1_1_M40_S6_S3 4 -40 215 DEPOSIT ABSOLUTE MONOTONY MON_INCREASE /end AXIS_DESCR
/end CHARACTERISTIC
/begin CHARACTERISTIC PO_WIRKKORRKZU_A "Druckoffset zur Korrektur des Wirkdrucks" VALUE 0x26E658 kw_si8_S6_S3 2 UMR_BAR__1_100_0_S6_S3 -1 1 /end CHARACTERISTIC
/begin CHARACTERISTIC PO_WIRKKORRKAB_A "Druckoffset zur Korrektur des Wirkdrucks" VALUE 0x26E659 kw_si8_S6_S3 2 UMR_BAR__1_100_0_S6_S3 -1 1 /end CHARACTERISTIC
/begin CHARACTERISTIC KL_PO1FCG_A "Kennlinie Fuelldruckoffset 1. Befuellung" CURVE 0x236748 kl_si16_S6_S3 12.75 UMR_BAR__1_1000_0_S6_S3 -6.4 6.35
 /begin AXIS_DESCR STD_AXIS zff_atsys._.iSignale._.obj.sig_c_getr UMR_GRADC__1_1_M40_S6_S3 3 -40 150 DEPOSIT ABSOLUTE MONOTONY MON_INCREASE /end AXIS_DESCR
/end CHARACTERISTIC
/begin CHARACTERISTIC KL_PO1KZUCG_A "Schaltdruckoffset fuer erste Zuschaltung nach Neustart (kuppl.-bezogen)" CURVE 0x236758 kl_si16_S6_S3 12.75 UMR_BAR__1_1000_0_S6_S3 -6.4 6.35
 /begin AXIS_DESCR STD_AXIS zff_atsys._.iSignale._.obj.sig_c_getr UMR_GRADC__1_1_M40_S6_S3 3 -40 150 DEPOSIT ABSOLUTE MONOTONY MON_INCREASE /end AXIS_DESCR
/end CHARACTERISTIC
/begin CHARACTERISTIC TAB_MVG_CKUP_A "Grenzen der Teilintervalle für die Kupplungstemperatur beim Getriebemonitoring" CURVE 0x236768 tab_si16_S6_S3 540 UMR_GRADC__1_1_0_S6_S3 -40 500
 /begin AXIS_DESCR FIX_AXIS NO_INPUT_QUANTITY UMR___1_1_0_S6_S3 7 1 7 FIX_AXIS_PAR_DIST 1 1 7 /end AXIS_DESCR
/end CHARACTERISTIC
/begin CHARACTERISTIC KL_ABKOEFPSYS_AUF_A "Abkühlkoeffizient bei offenem Schaltelement" CURVE 0x23677C kl_ui16_S6_S3 1 UMR_K_SECK_1_1000_0_S6_S3 0 1
 /begin AXIS_DESCR STD_AXIS iSasPsyst.p_sys UMR_BAR__1_1000_0_S6_S3 4 0 20 DEPOSIT ABSOLUTE MONOTONY MON_INCREASE /end AXIS_DESCR
/end CHARACTERISTIC
/begin CHARACTERISTIC KL_ABKOEFPSYS_ZU_A "Abkühlkoeffizient bei geschlossenem Schaltelement" CURVE 0x236790 kl_ui16_S6_S3 1 UMR_K_SECK_1_1000_0_S6_S3 0 1
 /begin AXIS_DESCR STD_AXIS iSasPsyst.p_sys UMR_BAR__1_1000_0_S6_S3 4 0 20 DEPOSIT ABSOLUTE MONOTONY MON_INCREASE /end AXIS_DESCR
/end CHARACTERISTIC
/begin CHARACTERISTIC KF_P_KUP_BEDARF_B "Kupplungsdruck zur Sicherstellung der Übertragungsfähigkeit" MAP 0x2367A4 kf_si16_S6_S3 22 UMR_BAR__1_1000_0_S6_S3 0 22
 /begin AXIS_DESCR STD_AXIS NO_INPUT_QUANTITY UMR_NM__1_1_0_S6_S3 6 -32768 32767 DEPOSIT ABSOLUTE MONOTONY MON_INCREASE /end AXIS_DESCR
 /begin AXIS_DESCR STD_AXIS NO_INPUT_QUANTITY UMR___1_1_0_S6_S3 9 0 8 DEPOSIT ABSOLUTE MONOTONY MON_INCREASE /end AXIS_DESCR
/end CHARACTERISTIC
/begin CHARACTERISTIC KF_POKZUFOL_B "Kupplungsabhängiger Offset vorbereitende KZU" MAP 0x236838 kf_si16_S6_S3 12.8 UMR_BAR__1_1000_0_S6_S3 -6.4 6.4
 /begin AXIS_DESCR STD_AXIS zff_atsys._.iSignale._.obj.sig_m_t UMR_NM__1_1_0_S6_S3 4 -400 1640 DEPOSIT ABSOLUTE MONOTONY MON_INCREASE /end AXIS_DESCR
 /begin AXIS_DESCR STD_AXIS zff_atsys._.iSignale._.obj.sig_c_getr UMR_GRADC__1_1_M40_S6_S3 4 -40 215 DEPOSIT ABSOLUTE MONOTONY MON_INCREASE /end AXIS_DESCR
/end CHARACTERISTIC
/begin CHARACTERISTIC KF_POKZUFOLSP_B "Kupplungsabhängiger Offset vorbereitende KZU" MAP 0x236870 kf_si16_S6_S3 12.8 UMR_BAR__1_1000_0_S6_S3 -6.4 6.4
 /begin AXIS_DESCR STD_AXIS zff_atsys._.iSignale._.obj.sig_m_t UMR_NM__1_1_0_S6_S3 4 -400 1640 DEPOSIT ABSOLUTE MONOTONY MON_INCREASE /end AXIS_DESCR
 /begin AXIS_DESCR STD_AXIS zff_atsys._.iSignale._.obj.sig_c_getr UMR_GRADC__1_1_M40_S6_S3 4 -40 215 DEPOSIT ABSOLUTE MONOTONY MON_INCREASE /end AXIS_DESCR
/end CHARACTERISTIC
/begin CHARACTERISTIC KF_POKZUFOLSPORT_B "Kupplungsabhängiger Offset vorbereitende KZU" MAP 0x2368A8 kf_si16_S6_S3 12.8 UMR_BAR__1_1000_0_S6_S3 -6.4 6.4
 /begin AXIS_DESCR STD_AXIS zff_atsys._.iSignale._.obj.sig_m_t UMR_NM__1_1_0_S6_S3 4 -400 1640 DEPOSIT ABSOLUTE MONOTONY MON_INCREASE /end AXIS_DESCR
 /begin AXIS_DESCR STD_AXIS zff_atsys._.iSignale._.obj.sig_c_getr UMR_GRADC__1_1_M40_S6_S3 4 -40 215 DEPOSIT ABSOLUTE MONOTONY MON_INCREASE /end AXIS_DESCR
/end CHARACTERISTIC
/begin CHARACTERISTIC PO_WIRKKORRKZU_B "Druckoffset zur Korrektur des Wirkdrucks" VALUE 0x26E65A kw_si8_S6_S3 2 UMR_BAR__1_100_0_S6_S3 -1 1 /end CHARACTERISTIC
/begin CHARACTERISTIC PO_WIRKKORRKAB_B "Druckoffset zur Korrektur des Wirkdrucks" VALUE 0x26E65B kw_si8_S6_S3 2 UMR_BAR__1_100_0_S6_S3 -1 1 /end CHARACTERISTIC
/begin CHARACTERISTIC KL_PO1FCG_B "Kennlinie Fuelldruckoffset 1. Befuellung" CURVE 0x2368E0 kl_si16_S6_S3 12.75 UMR_BAR__1_1000_0_S6_S3 -6.4 6.35
 /begin AXIS_DESCR STD_AXIS zff_atsys._.iSignale._.obj.sig_c_getr UMR_GRADC__1_1_M40_S6_S3 3 -40 150 DEPOSIT ABSOLUTE MONOTONY MON_INCREASE /end AXIS_DESCR
/end CHARACTERISTIC
/begin CHARACTERISTIC KL_PO1KZUCG_B "Schaltdruckoffset fuer erste Zuschaltung nach Neustart (kuppl.-bezogen)" CURVE 0x2368F0 kl_si16_S6_S3 12.75 UMR_BAR__1_1000_0_S6_S3 -6.4 6.35
 /begin AXIS_DESCR STD_AXIS zff_atsys._.iSignale._.obj.sig_c_getr UMR_GRADC__1_1_M40_S6_S3 3 -40 150 DEPOSIT ABSOLUTE MONOTONY MON_INCREASE /end AXIS_DESCR
/end CHARACTERISTIC
/begin CHARACTERISTIC TAB_MVG_CKUP_B "Grenzen der Teilintervalle für die Kupplungstemperatur beim Getriebemonitoring" CURVE 0x236900 tab_si16_S6_S3 540 UMR_GRADC__1_1_0_S6_S3 -40 500
 /begin AXIS_DESCR FIX_AXIS NO_INPUT_QUANTITY UMR___1_1_0_S6_S3 7 1 7 FIX_AXIS_PAR_DIST 1 1 7 /end AXIS_DESCR
/end CHARACTERISTIC
/begin CHARACTERISTIC KL_ABKOEFPSYS_AUF_B "Abkühlkoeffizient bei offenem Schaltelement" CURVE 0x236914 kl_ui16_S6_S3 1 UMR_K_SECK_1_1000_0_S6_S3 0 1
 /begin AXIS_DESCR STD_AXIS iSasPsyst.p_sys UMR_BAR__1_1000_0_S6_S3 4 0 20 DEPOSIT ABSOLUTE MONOTONY MON_INCREASE /end AXIS_DESCR
/end CHARACTERISTIC
/begin CHARACTERISTIC KL_ABKOEFPSYS_ZU_B "Abkühlkoeffizient bei geschlossenem Schaltelement" CURVE 0x236928 kl_ui16_S6_S3 1 UMR_K_SECK_1_1000_0_S6_S3 0 1
 /begin AXIS_DESCR STD_AXIS iSasPsyst.p_sys UMR_BAR__1_1000_0_S6_S3 4 0 20 DEPOSIT ABSOLUTE MONOTONY MON_INCREASE /end AXIS_DESCR
/end CHARACTERISTIC
/begin CHARACTERISTIC KF_P_KUP_BEDARF_C "Kupplungsdruck zur Sicherstellung der Übertragungsfähigkeit" MAP 0x23693C kf_si16_S6_S3 22 UMR_BAR__1_1000_0_S6_S3 0 22
 /begin AXIS_DESCR STD_AXIS NO_INPUT_QUANTITY UMR_NM__1_1_0_S6_S3 6 -32768 32767 DEPOSIT ABSOLUTE MONOTONY MON_INCREASE /end AXIS_DESCR
 /begin AXIS_DESCR STD_AXIS NO_INPUT_QUANTITY UMR___1_1_0_S6_S3 9 0 8 DEPOSIT ABSOLUTE MONOTONY MON_INCREASE /end AXIS_DESCR
/end CHARACTERISTIC
/begin CHARACTERISTIC KF_POKZUFOL_C "Kupplungsabhängiger Offset vorbereitende KZU" MAP 0x2369D0 kf_si16_S6_S3 12.8 UMR_BAR__1_1000_0_S6_S3 -6.4 6.4
 /begin AXIS_DESCR STD_AXIS zff_atsys._.iSignale._.obj.sig_m_t UMR_NM__1_1_0_S6_S3 4 -400 1640 DEPOSIT ABSOLUTE MONOTONY MON_INCREASE /end AXIS_DESCR
 /begin AXIS_DESCR STD_AXIS zff_atsys._.iSignale._.obj.sig_c_getr UMR_GRADC__1_1_M40_S6_S3 4 -40 215 DEPOSIT ABSOLUTE MONOTONY MON_INCREASE /end AXIS_DESCR
/end CHARACTERISTIC
/begin CHARACTERISTIC KF_POKZUFOLSP_C "Kupplungsabhängiger Offset vorbereitende KZU" MAP 0x236A08 kf_si16_S6_S3 12.8 UMR_BAR__1_1000_0_S6_S3 -6.4 6.4
 /begin AXIS_DESCR STD_AXIS zff_atsys._.iSignale._.obj.sig_m_t UMR_NM__1_1_0_S6_S3 4 -400 1640 DEPOSIT ABSOLUTE MONOTONY MON_INCREASE /end AXIS_DESCR
 /begin AXIS_DESCR STD_AXIS zff_atsys._.iSignale._.obj.sig_c_getr UMR_GRADC__1_1_M40_S6_S3 4 -40 215 DEPOSIT ABSOLUTE MONOTONY MON_INCREASE /end AXIS_DESCR
/end CHARACTERISTIC
/begin CHARACTERISTIC KF_POKZUFOLSPORT_C "Kupplungsabhängiger Offset vorbereitende KZU" MAP 0x236A40 kf_si16_S6_S3 12.8 UMR_BAR__1_1000_0_S6_S3 -6.4 6.4
 /begin AXIS_DESCR STD_AXIS zff_atsys._.iSignale._.obj.sig_m_t UMR_NM__1_1_0_S6_S3 4 -400 1640 DEPOSIT ABSOLUTE MONOTONY MON_INCREASE /end AXIS_DESCR
 /begin AXIS_DESCR STD_AXIS zff_atsys._.iSignale._.obj.sig_c_getr UMR_GRADC__1_1_M40_S6_S3 4 -40 215 DEPOSIT ABSOLUTE MONOTONY MON_INCREASE /end AXIS_DESCR
/end CHARACTERISTIC
/begin CHARACTERISTIC PO_WIRKKORRKZU_C "Druckoffset zur Korrektur des Wirkdrucks" VALUE 0x26E65C kw_si8_S6_S3 2 UMR_BAR__1_100_0_S6_S3 -1 1 /end CHARACTERISTIC
/begin CHARACTERISTIC PO_WIRKKORRKAB_C "Druckoffset zur Korrektur des Wirkdrucks" VALUE 0x26E65D kw_si8_S6_S3 2 UMR_BAR__1_100_0_S6_S3 -1 1 /end CHARACTERISTIC
/begin CHARACTERISTIC KL_PO1FCG_C "Kennlinie Fuelldruckoffset 1. Befuellung" CURVE 0x236A78 kl_si16_S6_S3 12.75 UMR_BAR__1_1000_0_S6_S3 -6.4 6.35
 /begin AXIS_DESCR STD_AXIS zff_atsys._.iSignale._.obj.sig_c_getr UMR_GRADC__1_1_M40_S6_S3 3 -40 150 DEPOSIT ABSOLUTE MONOTONY MON_INCREASE /end AXIS_DESCR
/end CHARACTERISTIC
/begin CHARACTERISTIC KL_PO1KZUCG_C "Schaltdruckoffset fuer erste Zuschaltung nach Neustart (kuppl.-bezogen)" CURVE 0x236A88 kl_si16_S6_S3 12.75 UMR_BAR__1_1000_0_S6_S3 -6.4 6.35
 /begin AXIS_DESCR STD_AXIS zff_atsys._.iSignale._.obj.sig_c_getr UMR_GRADC__1_1_M40_S6_S3 3 -40 150 DEPOSIT ABSOLUTE MONOTONY MON_INCREASE /end AXIS_DESCR
/end CHARACTERISTIC
/begin CHARACTERISTIC TAB_MVG_CKUP_C "Grenzen der Teilintervalle für die Kupplungstemperatur beim Getriebemonitoring" CURVE 0x236A98 tab_si16_S6_S3 540 UMR_GRADC__1_1_0_S6_S3 -40 500
 /begin AXIS_DESCR FIX_AXIS NO_INPUT_QUANTITY UMR___1_1_0_S6_S3 7 1 7 FIX_AXIS_PAR_DIST 1 1 7 /end AXIS_DESCR
/end CHARACTERISTIC
/begin CHARACTERISTIC KL_ABKOEFPSYS_AUF_C "Abkühlkoeffizient bei offenem Schaltelement" CURVE 0x236AAC kl_ui16_S6_S3 1 UMR_K_SECK_1_1000_0_S6_S3 0 1
 /begin AXIS_DESCR STD_AXIS iSasPsyst.p_sys UMR_BAR__1_1000_0_S6_S3 4 0 20 DEPOSIT ABSOLUTE MONOTONY MON_INCREASE /end AXIS_DESCR
/end CHARACTERISTIC
/begin CHARACTERISTIC KL_ABKOEFPSYS_ZU_C "Abkühlkoeffizient bei geschlossenem Schaltelement" CURVE 0x236AC0 kl_ui16_S6_S3 1 UMR_K_SECK_1_1000_0_S6_S3 0 1
 /begin AXIS_DESCR STD_AXIS iSasPsyst.p_sys UMR_BAR__1_1000_0_S6_S3 4 0 20 DEPOSIT ABSOLUTE MONOTONY MON_INCREASE /end AXIS_DESCR
/end CHARACTERISTIC
/begin CHARACTERISTIC KF_P_KUP_BEDARF_D "Kupplungsdruck zur Sicherstellung der Übertragungsfähigkeit" MAP 0x236AD4 kf_si16_S6_S3 22 UMR_BAR__1_1000_0_S6_S3 0 22
 /begin AXIS_DESCR STD_AXIS NO_INPUT_QUANTITY UMR_NM__1_1_0_S6_S3 6 -32768 32767 DEPOSIT ABSOLUTE MONOTONY MON_INCREASE /end AXIS_DESCR
 /begin AXIS_DESCR STD_AXIS NO_INPUT_QUANTITY UMR___1_1_0_S6_S3 9 0 8 DEPOSIT ABSOLUTE MONOTONY MON_INCREASE /end AXIS_DESCR
/end CHARACTERISTIC
/begin CHARACTERISTIC KF_POKZUFOL_D "Kupplungsabhängiger Offset vorbereitende KZU" MAP 0x236B68 kf_si16_S6_S3 12.8 UMR_BAR__1_1000_0_S6_S3 -6.4 6.4
 /begin AXIS_DESCR STD_AXIS zff_atsys._.iSignale._.obj.sig_m_t UMR_NM__1_1_0_S6_S3 4 -400 1640 DEPOSIT ABSOLUTE MONOTONY MON_INCREASE /end AXIS_DESCR
 /begin AXIS_DESCR STD_AXIS zff_atsys._.iSignale._.obj.sig_c_getr UMR_GRADC__1_1_M40_S6_S3 4 -40 215 DEPOSIT ABSOLUTE MONOTONY MON_INCREASE /end AXIS_DESCR
/end CHARACTERISTIC
/begin CHARACTERISTIC KF_POKZUFOLSP_D "Kupplungsabhängiger Offset vorbereitende KZU" MAP 0x236BA0 kf_si16_S6_S3 12.8 UMR_BAR__1_1000_0_S6_S3 -6.4 6.4
 /begin AXIS_DESCR STD_AXIS zff_atsys._.iSignale._.obj.sig_m_t UMR_NM__1_1_0_S6_S3 4 -400 1640 DEPOSIT ABSOLUTE MONOTONY MON_INCREASE /end AXIS_DESCR
 /begin AXIS_DESCR STD_AXIS zff_atsys._.iSignale._.obj.sig_c_getr UMR_GRADC__1_1_M40_S6_S3 4 -40 215 DEPOSIT ABSOLUTE MONOTONY MON_INCREASE /end AXIS_DESCR
/end CHARACTERISTIC
/begin CHARACTERISTIC KF_POKZUFOLSPORT_D "Kupplungsabhängiger Offset vorbereitende KZU" MAP 0x236BD8 kf_si16_S6_S3 12.8 UMR_BAR__1_1000_0_S6_S3 -6.4 6.4
 /begin AXIS_DESCR STD_AXIS zff_atsys._.iSignale._.obj.sig_m_t UMR_NM__1_1_0_S6_S3 4 -400 1640 DEPOSIT ABSOLUTE MONOTONY MON_INCREASE /end AXIS_DESCR
 /begin AXIS_DESCR STD_AXIS zff_atsys._.iSignale._.obj.sig_c_getr UMR_GRADC__1_1_M40_S6_S3 4 -40 215 DEPOSIT ABSOLUTE MONOTONY MON_INCREASE /end AXIS_DESCR
/end CHARACTERISTIC
/begin CHARACTERISTIC PO_WIRKKORRKZU_D "Druckoffset zur Korrektur des Wirkdrucks" VALUE 0x26E65E kw_si8_S6_S3 2 UMR_BAR__1_100_0_S6_S3 -1 1 /end CHARACTERISTIC
/begin CHARACTERISTIC PO_WIRKKORRKAB_D "Druckoffset zur Korrektur des Wirkdrucks" VALUE 0x26E65F kw_si8_S6_S3 2 UMR_BAR__1_100_0_S6_S3 -1 1 /end CHARACTERISTIC
/begin CHARACTERISTIC KL_PO1FCG_D "Kennlinie Fuelldruckoffset 1. Befuellung" CURVE 0x236C10 kl_si16_S6_S3 12.75 UMR_BAR__1_1000_0_S6_S3 -6.4 6.35
 /begin AXIS_DESCR STD_AXIS zff_atsys._.iSignale._.obj.sig_c_getr UMR_GRADC__1_1_M40_S6_S3 3 -40 150 DEPOSIT ABSOLUTE MONOTONY MON_INCREASE /end AXIS_DESCR
/end CHARACTERISTIC
/begin CHARACTERISTIC KL_PO1KZUCG_D "Schaltdruckoffset fuer erste Zuschaltung nach Neustart (kuppl.-bezogen)" CURVE 0x236C20 kl_si16_S6_S3 12.75 UMR_BAR__1_1000_0_S6_S3 -6.4 6.35
 /begin AXIS_DESCR STD_AXIS zff_atsys._.iSignale._.obj.sig_c_getr UMR_GRADC__1_1_M40_S6_S3 3 -40 150 DEPOSIT ABSOLUTE MONOTONY MON_INCREASE /end AXIS_DESCR
/end CHARACTERISTIC
/begin CHARACTERISTIC TAB_MVG_CKUP_D "Grenzen der Teilintervalle für die Kupplungstemperatur beim Getriebemonitoring" CURVE 0x236C30 tab_si16_S6_S3 540 UMR_GRADC__1_1_0_S6_S3 -40 500
 /begin AXIS_DESCR FIX_AXIS NO_INPUT_QUANTITY UMR___1_1_0_S6_S3 7 1 7 FIX_AXIS_PAR_DIST 1 1 7 /end AXIS_DESCR
/end CHARACTERISTIC
/begin CHARACTERISTIC KL_ABKOEFPSYS_AUF_D "Abkühlkoeffizient bei offenem Schaltelement" CURVE 0x236C44 kl_ui16_S6_S3 1 UMR_K_SECK_1_1000_0_S6_S3 0 1
 /begin AXIS_DESCR STD_AXIS iSasPsyst.p_sys UMR_BAR__1_1000_0_S6_S3 4 0 20 DEPOSIT ABSOLUTE MONOTONY MON_INCREASE /end AXIS_DESCR
/end CHARACTERISTIC
/begin CHARACTERISTIC KL_ABKOEFPSYS_ZU_D "Abkühlkoeffizient bei geschlossenem Schaltelement" CURVE 0x236C58 kl_ui16_S6_S3 1 UMR_K_SECK_1_1000_0_S6_S3 0 1
 /begin AXIS_DESCR STD_AXIS iSasPsyst.p_sys UMR_BAR__1_1000_0_S6_S3 4 0 20 DEPOSIT ABSOLUTE MONOTONY MON_INCREASE /end AXIS_DESCR
/end CHARACTERISTIC
/begin CHARACTERISTIC KF_P_KUP_BEDARF_E "Kupplungsdruck zur Sicherstellung der Übertragungsfähigkeit" MAP 0x236C6C kf_si16_S6_S3 22 UMR_BAR__1_1000_0_S6_S3 0 22
 /begin AXIS_DESCR STD_AXIS NO_INPUT_QUANTITY UMR_NM__1_1_0_S6_S3 6 -32768 32767 DEPOSIT ABSOLUTE MONOTONY MON_INCREASE /end AXIS_DESCR
 /begin AXIS_DESCR STD_AXIS NO_INPUT_QUANTITY UMR___1_1_0_S6_S3 9 0 8 DEPOSIT ABSOLUTE MONOTONY MON_INCREASE /end AXIS_DESCR
/end CHARACTERISTIC
/begin CHARACTERISTIC KF_POKZUFOL_E "Kupplungsabhängiger Offset vorbereitende KZU" MAP 0x236D00 kf_si16_S6_S3 12.8 UMR_BAR__1_1000_0_S6_S3 -6.4 6.4
 /begin AXIS_DESCR STD_AXIS zff_atsys._.iSignale._.obj.sig_m_t UMR_NM__1_1_0_S6_S3 4 -400 1640 DEPOSIT ABSOLUTE MONOTONY MON_INCREASE /end AXIS_DESCR
 /begin AXIS_DESCR STD_AXIS zff_atsys._.iSignale._.obj.sig_c_getr UMR_GRADC__1_1_M40_S6_S3 4 -40 215 DEPOSIT ABSOLUTE MONOTONY MON_INCREASE /end AXIS_DESCR
/end CHARACTERISTIC
/begin CHARACTERISTIC KF_POKZUFOLSP_E "Kupplungsabhängiger Offset vorbereitende KZU" MAP 0x236D38 kf_si16_S6_S3 12.8 UMR_BAR__1_1000_0_S6_S3 -6.4 6.4
 /begin AXIS_DESCR STD_AXIS zff_atsys._.iSignale._.obj.sig_m_t UMR_NM__1_1_0_S6_S3 4 -400 1640 DEPOSIT ABSOLUTE MONOTONY MON_INCREASE /end AXIS_DESCR
 /begin AXIS_DESCR STD_AXIS zff_atsys._.iSignale._.obj.sig_c_getr UMR_GRADC__1_1_M40_S6_S3 4 -40 215 DEPOSIT ABSOLUTE MONOTONY MON_INCREASE /end AXIS_DESCR
/end CHARACTERISTIC
/begin CHARACTERISTIC KF_POKZUFOLSPORT_E "Kupplungsabhängiger Offset vorbereitende KZU" MAP 0x236D70 kf_si16_S6_S3 12.8 UMR_BAR__1_1000_0_S6_S3 -6.4 6.4
 /begin AXIS_DESCR STD_AXIS zff_atsys._.iSignale._.obj.sig_m_t UMR_NM__1_1_0_S6_S3 4 -400 1640 DEPOSIT ABSOLUTE MONOTONY MON_INCREASE /end AXIS_DESCR
 /begin AXIS_DESCR STD_AXIS zff_atsys._.iSignale._.obj.sig_c_getr UMR_GRADC__1_1_M40_S6_S3 4 -40 215 DEPOSIT ABSOLUTE MONOTONY MON_INCREASE /end AXIS_DESCR
/end CHARACTERISTIC
/begin CHARACTERISTIC PO_WIRKKORRKZU_E "Druckoffset zur Korrektur des Wirkdrucks" VALUE 0x26E660 kw_si8_S6_S3 2 UMR_BAR__1_100_0_S6_S3 -1 1 /end CHARACTERISTIC
/begin CHARACTERISTIC PO_WIRKKORRKAB_E "Druckoffset zur Korrektur des Wirkdrucks" VALUE 0x26E661 kw_si8_S6_S3 2 UMR_BAR__1_100_0_S6_S3 -1 1 /end CHARACTERISTIC
/begin CHARACTERISTIC KL_PO1FCG_E "Kennlinie Fuelldruckoffset 1. Befuellung" CURVE 0x236DA8 kl_si16_S6_S3 12.75 UMR_BAR__1_1000_0_S6_S3 -6.4 6.35
 /begin AXIS_DESCR STD_AXIS zff_atsys._.iSignale._.obj.sig_c_getr UMR_GRADC__1_1_M40_S6_S3 3 -40 150 DEPOSIT ABSOLUTE MONOTONY MON_INCREASE /end AXIS_DESCR
/end CHARACTERISTIC
/begin CHARACTERISTIC KL_PO1FCG_E_EL "Kennlinie Fuelldruckoffset 1. Befuellung" CURVE 0x236DB8 kl_si16_S6_S3 12.75 UMR_BAR__1_1000_0_S6_S3 -6.4 6.35
 /begin AXIS_DESCR STD_AXIS zff_atsys._.iSignale._.obj.sig_c_getr UMR_GRADC__1_1_M40_S6_S3 3 -40 150 DEPOSIT ABSOLUTE MONOTONY MON_INCREASE /end AXIS_DESCR
/end CHARACTERISTIC
/begin CHARACTERISTIC KL_PO1KZUCG_E "Schaltdruckoffset fuer erste Zuschaltung nach Neustart (kuppl.-bezogen)" CURVE 0x236DC8 kl_si16_S6_S3 12.75 UMR_BAR__1_1000_0_S6_S3 -6.4 6.35
 /begin AXIS_DESCR STD_AXIS zff_atsys._.iSignale._.obj.sig_c_getr UMR_GRADC__1_1_M40_S6_S3 3 -40 150 DEPOSIT ABSOLUTE MONOTONY MON_INCREASE /end AXIS_DESCR
/end CHARACTERISTIC
/begin CHARACTERISTIC KL_PO1KZUCG_E_EL "Schaltdruckoffset fuer erste Zuschaltung nach Neustart (kuppl.-bezogen)" CURVE 0x236DD8 kl_si16_S6_S3 12.75 UMR_BAR__1_1000_0_S6_S3 -6.4 6.35
 /begin AXIS_DESCR STD_AXIS zff_atsys._.iSignale._.obj.sig_c_getr UMR_GRADC__1_1_M40_S6_S3 3 -40 150 DEPOSIT ABSOLUTE MONOTONY MON_INCREASE /end AXIS_DESCR
/end CHARACTERISTIC
/begin CHARACTERISTIC TAB_MVG_CKUP_E "Grenzen der Teilintervalle für die Kupplungstemperatur beim Getriebemonitoring" CURVE 0x236DE8 tab_si16_S6_S3 540 UMR_GRADC__1_1_0_S6_S3 -40 500
 /begin AXIS_DESCR FIX_AXIS NO_INPUT_QUANTITY UMR___1_1_0_S6_S3 7 1 7 FIX_AXIS_PAR_DIST 1 1 7 /end AXIS_DESCR
/end CHARACTERISTIC
/begin CHARACTERISTIC KL_ABKOEFPSYS_AUF_E "Abkühlkoeffizient bei offenem Schaltelement" CURVE 0x236DFC kl_ui16_S6_S3 1 UMR_K_SECK_1_1000_0_S6_S3 0 1
 /begin AXIS_DESCR STD_AXIS iSasPsyst.p_sys UMR_BAR__1_1000_0_S6_S3 4 0 20 DEPOSIT ABSOLUTE MONOTONY MON_INCREASE /end AXIS_DESCR
/end CHARACTERISTIC
/begin CHARACTERISTIC KL_ABKOEFPSYS_ZU_E "Abkühlkoeffizient bei geschlossenem Schaltelement" CURVE 0x236E10 kl_ui16_S6_S3 1 UMR_K_SECK_1_1000_0_S6_S3 0 1
 /begin AXIS_DESCR STD_AXIS iSasPsyst.p_sys UMR_BAR__1_1000_0_S6_S3 4 0 20 DEPOSIT ABSOLUTE MONOTONY MON_INCREASE /end AXIS_DESCR
/end CHARACTERISTIC
/begin CHARACTERISTIC T_RAABVFOLNACH84MRS43 "Zeit Rampe auf Schaltdruck" VALUE 0x26E6FD kw_ui8_S6_S3 2540 UMR_MSEC__10_1_0_S6_S3 0 2540 /end CHARACTERISTIC
/begin CHARACTERISTIC T_RAABVFOLNACH64MRS43 "Zeit Rampe auf Schaltdruck" VALUE 0x26E6FE kw_ui8_S6_S3 2540 UMR_MSEC__10_1_0_S6_S3 0 2540 /end CHARACTERISTIC
/begin CHARACTERISTIC KF_TSYNMTNTKABVFOLNACH84MRS43 "Zeit vor sync. Ende Haltephase vorb. KAB" MAP 0x23B584 kf_si16_S6_S3 5000 UMR_MSEC__10_1_0_S6_S3 -5000 0
 /begin AXIS_DESCR STD_AXIS zff_atsys._.iSignale._.obj.sig_m_t UMR_NM__1_1_0_S6_S3 4 -400 1640 DEPOSIT ABSOLUTE MONOTONY MON_INCREASE /end AXIS_DESCR
 /begin AXIS_DESCR STD_AXIS zff_atsys._.iSignale._.obj.sig_n_t UMR_U_MIN_1_1_0_S6_S3 6 0 8160 DEPOSIT ABSOLUTE MONOTONY MON_INCREASE /end AXIS_DESCR
/end CHARACTERISTIC
/begin CHARACTERISTIC KF_TSYNMTNTKABVFOLNACH64MRS43 "Zeit vor sync. Ende Haltephase vorb. KAB" MAP 0x23B5D0 kf_si16_S6_S3 5000 UMR_MSEC__10_1_0_S6_S3 -5000 0
 /begin AXIS_DESCR STD_AXIS zff_atsys._.iSignale._.obj.sig_m_t UMR_NM__1_1_0_S6_S3 4 -400 1640 DEPOSIT ABSOLUTE MONOTONY MON_INCREASE /end AXIS_DESCR
 /begin AXIS_DESCR STD_AXIS zff_atsys._.iSignale._.obj.sig_n_t UMR_U_MIN_1_1_0_S6_S3 6 0 8160 DEPOSIT ABSOLUTE MONOTONY MON_INCREASE /end AXIS_DESCR
/end CHARACTERISTIC
/begin CHARACTERISTIC KF_PKABFOLNACH84MRS43 "Schaltdruck ab.Kupplung fuer Folgeschaltung nach DRS" MAP 0x23B61C kf_si16_S6_S3 12.75 UMR_BAR__1_1000_0_S6_S3 0 12.75
 /begin AXIS_DESCR STD_AXIS NO_INPUT_QUANTITY UMR_U_MIN_32_1_0_S6_S3 8 0 8160 DEPOSIT ABSOLUTE MONOTONY MON_INCREASE /end AXIS_DESCR
 /begin AXIS_DESCR STD_AXIS zff_atsys._.iSignale._.obj.sig_m_t UMR_NM__1_1_0_S6_S3 10 -400 1640 DEPOSIT ABSOLUTE MONOTONY MON_INCREASE /end AXIS_DESCR
/end CHARACTERISTIC
/begin CHARACTERISTIC KF_PKABFOLNACH84MRS43_EL "Schaltdruck ab.Kupplung fuer Folgeschaltung nach DRS" MAP 0x23B6E8 kf_si16_S6_S3 12.75 UMR_BAR__1_1000_0_S6_S3 0 12.75
 /begin AXIS_DESCR STD_AXIS NO_INPUT_QUANTITY UMR_U_MIN_32_1_0_S6_S3 8 0 8160 DEPOSIT ABSOLUTE MONOTONY MON_INCREASE /end AXIS_DESCR
 /begin AXIS_DESCR STD_AXIS zff_atsys._.iSignale._.obj.sig_m_t UMR_NM__1_1_0_S6_S3 10 -400 1640 DEPOSIT ABSOLUTE MONOTONY MON_INCREASE /end AXIS_DESCR
/end CHARACTERISTIC
/begin CHARACTERISTIC KF_PKABFOLNACH84MRS43SP "Schaltdruck ab.Kupplung fuer verkuerzte Folgeschaltung nach DRS" MAP 0x23B7B4 kf_si16_S6_S3 12.75 UMR_BAR__1_1000_0_S6_S3 0 12.75
 /begin AXIS_DESCR STD_AXIS NO_INPUT_QUANTITY UMR_U_MIN_32_1_0_S6_S3 8 0 8160 DEPOSIT ABSOLUTE MONOTONY MON_INCREASE /end AXIS_DESCR
 /begin AXIS_DESCR STD_AXIS zff_atsys._.iSignale._.obj.sig_m_t UMR_NM__1_1_0_S6_S3 10 -400 1640 DEPOSIT ABSOLUTE MONOTONY MON_INCREASE /end AXIS_DESCR
/end CHARACTERISTIC
/begin CHARACTERISTIC KF_PKABFOLNACH84MRS43SPORT "Schaltdruck ab.Kupplung fuer verkuerzte Folgeschaltung nach DRS" MAP 0x23B880 kf_si16_S6_S3 12.75 UMR_BAR__1_1000_0_S6_S3 0 12.75
 /begin AXIS_DESCR STD_AXIS NO_INPUT_QUANTITY UMR_U_MIN_32_1_0_S6_S3 8 0 8160 DEPOSIT ABSOLUTE MONOTONY MON_INCREASE /end AXIS_DESCR
 /begin AXIS_DESCR STD_AXIS zff_atsys._.iSignale._.obj.sig_m_t UMR_NM__1_1_0_S6_S3 10 -400 1640 DEPOSIT ABSOLUTE MONOTONY MON_INCREASE /end AXIS_DESCR
/end CHARACTERISTIC
/begin CHARACTERISTIC KF_PKABFOLNACH64MRS43 "Schaltdruck ab.Kupplung fuer Folgeschaltung nach MRS" MAP 0x23B94C kf_si16_S6_S3 12.75 UMR_BAR__1_1000_0_S6_S3 0 12.75
 /begin AXIS_DESCR STD_AXIS NO_INPUT_QUANTITY UMR_U_MIN_32_1_0_S6_S3 8 0 8160 DEPOSIT ABSOLUTE MONOTONY MON_INCREASE /end AXIS_DESCR
 /begin AXIS_DESCR STD_AXIS zff_atsys._.iSignale._.obj.sig_m_t UMR_NM__1_1_0_S6_S3 10 -400 1640 DEPOSIT ABSOLUTE MONOTONY MON_INCREASE /end AXIS_DESCR
/end CHARACTERISTIC
/begin CHARACTERISTIC KF_PKABFOLNACH64MRS43_EL "Schaltdruck ab.Kupplung fuer Folgeschaltung nach MRS" MAP 0x23BA18 kf_si16_S6_S3 12.75 UMR_BAR__1_1000_0_S6_S3 0 12.75
 /begin AXIS_DESCR STD_AXIS NO_INPUT_QUANTITY UMR_U_MIN_32_1_0_S6_S3 8 0 8160 DEPOSIT ABSOLUTE MONOTONY MON_INCREASE /end AXIS_DESCR
 /begin AXIS_DESCR STD_AXIS zff_atsys._.iSignale._.obj.sig_m_t UMR_NM__1_1_0_S6_S3 10 -400 1640 DEPOSIT ABSOLUTE MONOTONY MON_INCREASE /end AXIS_DESCR
/end CHARACTERISTIC
/begin CHARACTERISTIC KF_PKABFOLNACH64MRS43SP "Schaltdruck ab.Kupplung fuer verkuerzte Folgeschaltung nach MRS" MAP 0x23BAE4 kf_si16_S6_S3 12.75 UMR_BAR__1_1000_0_S6_S3 0 12.75
 /begin AXIS_DESCR STD_AXIS NO_INPUT_QUANTITY UMR_U_MIN_32_1_0_S6_S3 8 0 8160 DEPOSIT ABSOLUTE MONOTONY MON_INCREASE /end AXIS_DESCR
 /begin AXIS_DESCR STD_AXIS zff_atsys._.iSignale._.obj.sig_m_t UMR_NM__1_1_0_S6_S3 10 -400 1640 DEPOSIT ABSOLUTE MONOTONY MON_INCREASE /end AXIS_DESCR
/end CHARACTERISTIC
/begin CHARACTERISTIC KF_PKABFOLNACH64MRS43SPORT "Schaltdruck ab.Kupplung fuer verkuerzte Folgeschaltung nach DRS" MAP 0x23BBB0 kf_si16_S6_S3 12.75 UMR_BAR__1_1000_0_S6_S3 0 12.75
 /begin AXIS_DESCR STD_AXIS NO_INPUT_QUANTITY UMR_U_MIN_32_1_0_S6_S3 8 0 8160 DEPOSIT ABSOLUTE MONOTONY MON_INCREASE /end AXIS_DESCR
 /begin AXIS_DESCR STD_AXIS zff_atsys._.iSignale._.obj.sig_m_t UMR_NM__1_1_0_S6_S3 10 -400 1640 DEPOSIT ABSOLUTE MONOTONY MON_INCREASE /end AXIS_DESCR
/end CHARACTERISTIC
/begin CHARACTERISTIC KF_THKABMTCGESTART12 "Zeitoffset Ende Haltephase KAB fuer HS" MAP 0x23BC7C kf_ui8_S6_S3 2000 UMR_MSEC__10_1_M128_S6_S3 -1000 1000
 /begin AXIS_DESCR STD_AXIS zff_atsys._.iSignale._.obj.sig_m_t8 UMR_NM__8_1_M50_S6_S3 8 -400 1640 DEPOSIT ABSOLUTE MONOTONY MON_INCREASE /end AXIS_DESCR
 /begin AXIS_DESCR STD_AXIS zff_atsys._.iSignale._.obj.sig_c_getr UMR_GRADC__1_1_M40_S6_S3 8 -40 150 DEPOSIT ABSOLUTE MONOTONY MON_INCREASE /end AXIS_DESCR
/end CHARACTERISTIC
/begin CHARACTERISTIC KF_TPKABMTCGESTART12 "Zeitoffset Ende Rampe auf Schaltdruck KAB fuer HS" MAP 0x23BCD4 kf_ui8_S6_S3 2000 UMR_MSEC__10_1_M128_S6_S3 -1000 1000
 /begin AXIS_DESCR STD_AXIS zff_atsys._.iSignale._.obj.sig_m_t8 UMR_NM__8_1_M50_S6_S3 8 -400 1640 DEPOSIT ABSOLUTE MONOTONY MON_INCREASE /end AXIS_DESCR
 /begin AXIS_DESCR STD_AXIS zff_atsys._.iSignale._.obj.sig_c_getr UMR_GRADC__1_1_M40_S6_S3 8 -40 150 DEPOSIT ABSOLUTE MONOTONY MON_INCREASE /end AXIS_DESCR
/end CHARACTERISTIC
/begin CHARACTERISTIC KF_TPKABMTCGESTART12_EL "Zeitoffset Ende Rampe auf Schaltdruck KAB fuer HS" MAP 0x23BD2C kf_ui8_S6_S3 2000 UMR_MSEC__10_1_M128_S6_S3 -1000 1000
 /begin AXIS_DESCR STD_AXIS zff_atsys._.iSignale._.obj.sig_m_t8 UMR_NM__8_1_M50_S6_S3 8 -400 1640 DEPOSIT ABSOLUTE MONOTONY MON_INCREASE /end AXIS_DESCR
 /begin AXIS_DESCR STD_AXIS zff_atsys._.iSignale._.obj.sig_c_getr UMR_GRADC__1_1_M40_S6_S3 8 -40 150 DEPOSIT ABSOLUTE MONOTONY MON_INCREASE /end AXIS_DESCR
/end CHARACTERISTIC
/begin CHARACTERISTIC TAB_CSPGOMTKAB "Temperaturschwelle fuer Schaltdruckphase bei HS" CURVE 0x23BD84 tab_ui8_S6_S3 255 UMR_GRADC__1_1_M40_S6_S3 -40 215
 /begin AXIS_DESCR FIX_AXIS iSasZentr.iSchaltend.index_spsas UMR___1_1_0_S6_S3 3 0 2 FIX_AXIS_PAR_DIST 0 1 3 /end AXIS_DESCR
/end CHARACTERISTIC
/begin CHARACTERISTIC KL_PGOKABFOLNACHMRS21 "Druckgradient in Abhaengigkeit von m_t fuer Folgeschaltung" CURVE 0x23C0B8 kl_si16_S6_S3 200 UMR_BAR_SEC_1_10_0_S6_S3 -100 100
 /begin AXIS_DESCR STD_AXIS zff_atsys._.iSignale._.obj.sig_m_t UMR_NM__1_1_0_S6_S3 6 -400 1640 DEPOSIT ABSOLUTE MONOTONY MON_INCREASE /end AXIS_DESCR
/end CHARACTERISTIC
/begin CHARACTERISTIC KL_PGRASYNKABFOLNACHMRS21 "Druckgradient Wegschalten KAB fuer Folgeschaltung" CURVE 0x23C0D4 kl_si16_S6_S3 100 UMR_BAR_SEC_1_10_0_S6_S3 -100 0
 /begin AXIS_DESCR STD_AXIS zff_atsys._.iSignale._.obj.sig_m_t UMR_NM__1_1_0_S6_S3 6 -400 1640 DEPOSIT ABSOLUTE MONOTONY MON_INCREASE /end AXIS_DESCR
/end CHARACTERISTIC
/begin CHARACTERISTIC KF_PKABFOLNACHRS21 "Schaltdruck ab.Kupplung fuer Folgeschaltung" MAP 0x23C0F0 kf_si16_S6_S3 12.75 UMR_BAR__1_1000_0_S6_S3 0 12.75
 /begin AXIS_DESCR STD_AXIS NO_INPUT_QUANTITY UMR_U_MIN_32_1_0_S6_S3 8 0 8160 DEPOSIT ABSOLUTE MONOTONY MON_INCREASE /end AXIS_DESCR
 /begin AXIS_DESCR STD_AXIS zff_atsys._.iSignale._.obj.sig_m_t UMR_NM__1_1_0_S6_S3 10 -400 1640 DEPOSIT ABSOLUTE MONOTONY MON_INCREASE /end AXIS_DESCR
/end CHARACTERISTIC
/begin CHARACTERISTIC KF_PKABFOLNACHRS21_EL "Schaltdruck ab.Kupplung fuer Folgeschaltung" MAP 0x23C1BC kf_si16_S6_S3 12.75 UMR_BAR__1_1000_0_S6_S3 0 12.75
 /begin AXIS_DESCR STD_AXIS NO_INPUT_QUANTITY UMR_U_MIN_32_1_0_S6_S3 8 0 8160 DEPOSIT ABSOLUTE MONOTONY MON_INCREASE /end AXIS_DESCR
 /begin AXIS_DESCR STD_AXIS zff_atsys._.iSignale._.obj.sig_m_t UMR_NM__1_1_0_S6_S3 10 -400 1640 DEPOSIT ABSOLUTE MONOTONY MON_INCREASE /end AXIS_DESCR
/end CHARACTERISTIC
/begin CHARACTERISTIC KF_PKABFOLNACHMRS21 "Schaltdruck ab.Kupplung fuer Folgeschaltung nach MRS" MAP 0x23C288 kf_si16_S6_S3 12.75 UMR_BAR__1_1000_0_S6_S3 0 12.75
 /begin AXIS_DESCR STD_AXIS NO_INPUT_QUANTITY UMR_U_MIN_32_1_0_S6_S3 8 0 8160 DEPOSIT ABSOLUTE MONOTONY MON_INCREASE /end AXIS_DESCR
 /begin AXIS_DESCR STD_AXIS zff_atsys._.iSignale._.obj.sig_m_t UMR_NM__1_1_0_S6_S3 10 -400 1640 DEPOSIT ABSOLUTE MONOTONY MON_INCREASE /end AXIS_DESCR
/end CHARACTERISTIC
/begin CHARACTERISTIC KF_PKABFOLNACHMRS21_EL "Schaltdruck ab.Kupplung fuer Folgeschaltung nach MRS" MAP 0x23C354 kf_si16_S6_S3 12.75 UMR_BAR__1_1000_0_S6_S3 0 12.75
 /begin AXIS_DESCR STD_AXIS NO_INPUT_QUANTITY UMR_U_MIN_32_1_0_S6_S3 8 0 8160 DEPOSIT ABSOLUTE MONOTONY MON_INCREASE /end AXIS_DESCR
 /begin AXIS_DESCR STD_AXIS zff_atsys._.iSignale._.obj.sig_m_t UMR_NM__1_1_0_S6_S3 10 -400 1640 DEPOSIT ABSOLUTE MONOTONY MON_INCREASE /end AXIS_DESCR
/end CHARACTERISTIC
/begin CHARACTERISTIC KF_PKABFOLNACHRSSP21 "Schaltdruck KAB fuer verkuerzte Folgeschaltung" MAP 0x23C420 kf_si16_S6_S3 12.75 UMR_BAR__1_1000_0_S6_S3 0 12.75
 /begin AXIS_DESCR STD_AXIS NO_INPUT_QUANTITY UMR_U_MIN_32_1_0_S6_S3 8 0 8160 DEPOSIT ABSOLUTE MONOTONY MON_INCREASE /end AXIS_DESCR
 /begin AXIS_DESCR STD_AXIS zff_atsys._.iSignale._.obj.sig_m_t UMR_NM__1_1_0_S6_S3 10 -400 1640 DEPOSIT ABSOLUTE MONOTONY MON_INCREASE /end AXIS_DESCR
/end CHARACTERISTIC
/begin CHARACTERISTIC KF_PKABFOLNACHRSSPORT21 "Schaltdruck KAB fuer verkuerzte Folgeschaltung" MAP 0x23C4EC kf_si16_S6_S3 12.75 UMR_BAR__1_1000_0_S6_S3 0 12.75
 /begin AXIS_DESCR STD_AXIS NO_INPUT_QUANTITY UMR_U_MIN_32_1_0_S6_S3 8 0 8160 DEPOSIT ABSOLUTE MONOTONY MON_INCREASE /end AXIS_DESCR
 /begin AXIS_DESCR STD_AXIS zff_atsys._.iSignale._.obj.sig_m_t UMR_NM__1_1_0_S6_S3 10 -400 1640 DEPOSIT ABSOLUTE MONOTONY MON_INCREASE /end AXIS_DESCR
/end CHARACTERISTIC
/begin CHARACTERISTIC KF_PKABFOLNACHMRSSP21 "Schaltdruck ab.Kupplung fuer verkuerzte Folgeschaltung nach MRS" MAP 0x23C5B8 kf_si16_S6_S3 12.75 UMR_BAR__1_1000_0_S6_S3 0 12.75
 /begin AXIS_DESCR STD_AXIS NO_INPUT_QUANTITY UMR_U_MIN_32_1_0_S6_S3 8 0 8160 DEPOSIT ABSOLUTE MONOTONY MON_INCREASE /end AXIS_DESCR
 /begin AXIS_DESCR STD_AXIS zff_atsys._.iSignale._.obj.sig_m_t UMR_NM__1_1_0_S6_S3 10 -400 1640 DEPOSIT ABSOLUTE MONOTONY MON_INCREASE /end AXIS_DESCR
/end CHARACTERISTIC
/begin CHARACTERISTIC KF_PKABFOLNACHMRSSPORT21 "Schaltdruck ab.Kupplung fuer verkuerzte Folgeschaltung nach MRS" MAP 0x23C684 kf_si16_S6_S3 12.75 UMR_BAR__1_1000_0_S6_S3 0 12.75
 /begin AXIS_DESCR STD_AXIS NO_INPUT_QUANTITY UMR_U_MIN_32_1_0_S6_S3 8 0 8160 DEPOSIT ABSOLUTE MONOTONY MON_INCREASE /end AXIS_DESCR
 /begin AXIS_DESCR STD_AXIS zff_atsys._.iSignale._.obj.sig_m_t UMR_NM__1_1_0_S6_S3 10 -400 1640 DEPOSIT ABSOLUTE MONOTONY MON_INCREASE /end AXIS_DESCR
/end CHARACTERISTIC
/begin CHARACTERISTIC KL_PGOKABFOLNACHMRS32 "Druckgradient in Abhaengigkeit von m_t fuer Folgeschaltung" CURVE 0x23C750 kl_si16_S6_S3 200 UMR_BAR_SEC_1_10_0_S6_S3 -100 100
 /begin AXIS_DESCR STD_AXIS zff_atsys._.iSignale._.obj.sig_m_t UMR_NM__1_1_0_S6_S3 6 -400 1640 DEPOSIT ABSOLUTE MONOTONY MON_INCREASE /end AXIS_DESCR
/end CHARACTERISTIC
/begin CHARACTERISTIC KL_PGRASYNKABFOLNACHMRS32 "Druckgradient Wegschalten KAB fuer Folgeschaltung" CURVE 0x23C76C kl_si16_S6_S3 100 UMR_BAR_SEC_1_10_0_S6_S3 -100 0
 /begin AXIS_DESCR STD_AXIS zff_atsys._.iSignale._.obj.sig_m_t UMR_NM__1_1_0_S6_S3 6 -400 1640 DEPOSIT ABSOLUTE MONOTONY MON_INCREASE /end AXIS_DESCR
/end CHARACTERISTIC
/begin CHARACTERISTIC KF_PKABFOLNACHRS32 "Schaltdruck ab.Kupplung fuer Folgeschaltung" MAP 0x23C788 kf_si16_S6_S3 12.75 UMR_BAR__1_1000_0_S6_S3 0 12.75
 /begin AXIS_DESCR STD_AXIS NO_INPUT_QUANTITY UMR_U_MIN_32_1_0_S6_S3 8 0 8160 DEPOSIT ABSOLUTE MONOTONY MON_INCREASE /end AXIS_DESCR
 /begin AXIS_DESCR STD_AXIS zff_atsys._.iSignale._.obj.sig_m_t UMR_NM__1_1_0_S6_S3 10 -400 1640 DEPOSIT ABSOLUTE MONOTONY MON_INCREASE /end AXIS_DESCR
/end CHARACTERISTIC
/begin CHARACTERISTIC KF_PKABFOLNACHRS32_EL "Schaltdruck ab.Kupplung fuer Folgeschaltung" MAP 0x23C854 kf_si16_S6_S3 12.75 UMR_BAR__1_1000_0_S6_S3 0 12.75
 /begin AXIS_DESCR STD_AXIS NO_INPUT_QUANTITY UMR_U_MIN_32_1_0_S6_S3 8 0 8160 DEPOSIT ABSOLUTE MONOTONY MON_INCREASE /end AXIS_DESCR
 /begin AXIS_DESCR STD_AXIS zff_atsys._.iSignale._.obj.sig_m_t UMR_NM__1_1_0_S6_S3 10 -400 1640 DEPOSIT ABSOLUTE MONOTONY MON_INCREASE /end AXIS_DESCR
/end CHARACTERISTIC
/begin CHARACTERISTIC KF_PKABFOLNACHMRS32 "Schaltdruck ab.Kupplung fuer Folgeschaltung nach MRS" MAP 0x23C920 kf_si16_S6_S3 12.75 UMR_BAR__1_1000_0_S6_S3 0 12.75
 /begin AXIS_DESCR STD_AXIS NO_INPUT_QUANTITY UMR_U_MIN_32_1_0_S6_S3 8 0 8160 DEPOSIT ABSOLUTE MONOTONY MON_INCREASE /end AXIS_DESCR
 /begin AXIS_DESCR STD_AXIS zff_atsys._.iSignale._.obj.sig_m_t UMR_NM__1_1_0_S6_S3 10 -400 1640 DEPOSIT ABSOLUTE MONOTONY MON_INCREASE /end AXIS_DESCR
/end CHARACTERISTIC
/begin CHARACTERISTIC KF_PKABFOLNACHMRS32_EL "Schaltdruck ab.Kupplung fuer Folgeschaltung nach MRS" MAP 0x23C9EC kf_si16_S6_S3 12.75 UMR_BAR__1_1000_0_S6_S3 0 12.75
 /begin AXIS_DESCR STD_AXIS NO_INPUT_QUANTITY UMR_U_MIN_32_1_0_S6_S3 8 0 8160 DEPOSIT ABSOLUTE MONOTONY MON_INCREASE /end AXIS_DESCR
 /begin AXIS_DESCR STD_AXIS zff_atsys._.iSignale._.obj.sig_m_t UMR_NM__1_1_0_S6_S3 10 -400 1640 DEPOSIT ABSOLUTE MONOTONY MON_INCREASE /end AXIS_DESCR
/end CHARACTERISTIC
/begin CHARACTERISTIC KF_PKABFOLNACHRSSP32 "Schaltdruck KAB fuer verkuerzte Folgeschaltung" MAP 0x23CAB8 kf_si16_S6_S3 12.75 UMR_BAR__1_1000_0_S6_S3 0 12.75
 /begin AXIS_DESCR STD_AXIS NO_INPUT_QUANTITY UMR_U_MIN_32_1_0_S6_S3 8 0 8160 DEPOSIT ABSOLUTE MONOTONY MON_INCREASE /end AXIS_DESCR
 /begin AXIS_DESCR STD_AXIS zff_atsys._.iSignale._.obj.sig_m_t UMR_NM__1_1_0_S6_S3 10 -400 1640 DEPOSIT ABSOLUTE MONOTONY MON_INCREASE /end AXIS_DESCR
/end CHARACTERISTIC
/begin CHARACTERISTIC KF_PKABFOLNACHRSSPORT32 "Schaltdruck KAB fuer verkuerzte Folgeschaltung" MAP 0x23CB84 kf_si16_S6_S3 12.75 UMR_BAR__1_1000_0_S6_S3 0 12.75
 /begin AXIS_DESCR STD_AXIS NO_INPUT_QUANTITY UMR_U_MIN_32_1_0_S6_S3 8 0 8160 DEPOSIT ABSOLUTE MONOTONY MON_INCREASE /end AXIS_DESCR
 /begin AXIS_DESCR STD_AXIS zff_atsys._.iSignale._.obj.sig_m_t UMR_NM__1_1_0_S6_S3 10 -400 1640 DEPOSIT ABSOLUTE MONOTONY MON_INCREASE /end AXIS_DESCR
/end CHARACTERISTIC
/begin CHARACTERISTIC KF_PKABFOLNACHMRSSP32 "Schaltdruck ab.Kupplung fuer verkuerzte Folgeschaltung nach MRS" MAP 0x23CC50 kf_si16_S6_S3 12.75 UMR_BAR__1_1000_0_S6_S3 0 12.75
 /begin AXIS_DESCR STD_AXIS NO_INPUT_QUANTITY UMR_U_MIN_32_1_0_S6_S3 8 0 8160 DEPOSIT ABSOLUTE MONOTONY MON_INCREASE /end AXIS_DESCR
 /begin AXIS_DESCR STD_AXIS zff_atsys._.iSignale._.obj.sig_m_t UMR_NM__1_1_0_S6_S3 10 -400 1640 DEPOSIT ABSOLUTE MONOTONY MON_INCREASE /end AXIS_DESCR
/end CHARACTERISTIC
/begin CHARACTERISTIC KF_PKABFOLNACHMRSSPORT32 "Schaltdruck ab.Kupplung fuer verkuerzte Folgeschaltung nach MRS" MAP 0x23CD1C kf_si16_S6_S3 12.75 UMR_BAR__1_1000_0_S6_S3 0 12.75
 /begin AXIS_DESCR STD_AXIS NO_INPUT_QUANTITY UMR_U_MIN_32_1_0_S6_S3 8 0 8160 DEPOSIT ABSOLUTE MONOTONY MON_INCREASE /end AXIS_DESCR
 /begin AXIS_DESCR STD_AXIS zff_atsys._.iSignale._.obj.sig_m_t UMR_NM__1_1_0_S6_S3 10 -400 1640 DEPOSIT ABSOLUTE MONOTONY MON_INCREASE /end AXIS_DESCR
/end CHARACTERISTIC
/begin CHARACTERISTIC KL_PGOKABFOLNACHMRS43 "Druckgradient in Abhaengigkeit von m_t fuer Folgeschaltung" CURVE 0x23CDE8 kl_si16_S6_S3 200 UMR_BAR_SEC_1_10_0_S6_S3 -100 100
 /begin AXIS_DESCR STD_AXIS zff_atsys._.iSignale._.obj.sig_m_t UMR_NM__1_1_0_S6_S3 6 -400 1640 DEPOSIT ABSOLUTE MONOTONY MON_INCREASE /end AXIS_DESCR
/end CHARACTERISTIC
/begin CHARACTERISTIC KL_PGRASYNKABFOLNACHMRS43 "Druckgradient Wegschalten KAB fuer Folgeschaltung" CURVE 0x23CE04 kl_si16_S6_S3 100 UMR_BAR_SEC_1_10_0_S6_S3 -100 0
 /begin AXIS_DESCR STD_AXIS zff_atsys._.iSignale._.obj.sig_m_t UMR_NM__1_1_0_S6_S3 6 -400 1640 DEPOSIT ABSOLUTE MONOTONY MON_INCREASE /end AXIS_DESCR
/end CHARACTERISTIC
/begin CHARACTERISTIC KF_PKABFOLNACHRS43 "Schaltdruck ab.Kupplung fuer Folgeschaltung" MAP 0x23CE20 kf_si16_S6_S3 12.75 UMR_BAR__1_1000_0_S6_S3 0 12.75
 /begin AXIS_DESCR STD_AXIS NO_INPUT_QUANTITY UMR_U_MIN_32_1_0_S6_S3 8 0 8160 DEPOSIT ABSOLUTE MONOTONY MON_INCREASE /end AXIS_DESCR
 /begin AXIS_DESCR STD_AXIS zff_atsys._.iSignale._.obj.sig_m_t UMR_NM__1_1_0_S6_S3 10 -400 1640 DEPOSIT ABSOLUTE MONOTONY MON_INCREASE /end AXIS_DESCR
/end CHARACTERISTIC
/begin CHARACTERISTIC KF_PKABFOLNACHRS43_EL "Schaltdruck ab.Kupplung fuer Folgeschaltung" MAP 0x23CEEC kf_si16_S6_S3 12.75 UMR_BAR__1_1000_0_S6_S3 0 12.75
 /begin AXIS_DESCR STD_AXIS NO_INPUT_QUANTITY UMR_U_MIN_32_1_0_S6_S3 8 0 8160 DEPOSIT ABSOLUTE MONOTONY MON_INCREASE /end AXIS_DESCR
 /begin AXIS_DESCR STD_AXIS zff_atsys._.iSignale._.obj.sig_m_t UMR_NM__1_1_0_S6_S3 10 -400 1640 DEPOSIT ABSOLUTE MONOTONY MON_INCREASE /end AXIS_DESCR
/end CHARACTERISTIC
/begin CHARACTERISTIC KF_PKABFOLNACHRSSP43 "Schaltdruck KAB fuer verkuerzte Folgeschaltung" MAP 0x23CFB8 kf_si16_S6_S3 12.75 UMR_BAR__1_1000_0_S6_S3 0 12.75
 /begin AXIS_DESCR STD_AXIS NO_INPUT_QUANTITY UMR_U_MIN_32_1_0_S6_S3 8 0 8160 DEPOSIT ABSOLUTE MONOTONY MON_INCREASE /end AXIS_DESCR
 /begin AXIS_DESCR STD_AXIS zff_atsys._.iSignale._.obj.sig_m_t UMR_NM__1_1_0_S6_S3 10 -400 1640 DEPOSIT ABSOLUTE MONOTONY MON_INCREASE /end AXIS_DESCR
/end CHARACTERISTIC
/begin CHARACTERISTIC KF_PKABFOLNACHRSSPORT43 "Schaltdruck KAB fuer verkuerzte Folgeschaltung" MAP 0x23D084 kf_si16_S6_S3 12.75 UMR_BAR__1_1000_0_S6_S3 0 12.75
 /begin AXIS_DESCR STD_AXIS NO_INPUT_QUANTITY UMR_U_MIN_32_1_0_S6_S3 8 0 8160 DEPOSIT ABSOLUTE MONOTONY MON_INCREASE /end AXIS_DESCR
 /begin AXIS_DESCR STD_AXIS zff_atsys._.iSignale._.obj.sig_m_t UMR_NM__1_1_0_S6_S3 10 -400 1640 DEPOSIT ABSOLUTE MONOTONY MON_INCREASE /end AXIS_DESCR
/end CHARACTERISTIC
/begin CHARACTERISTIC KL_PGOKABFOLNACHMRS54 "Druckgradient in Abhaengigkeit von m_t fuer Folgeschaltung" CURVE 0x23D150 kl_si16_S6_S3 200 UMR_BAR_SEC_1_10_0_S6_S3 -100 100
 /begin AXIS_DESCR STD_AXIS zff_atsys._.iSignale._.obj.sig_m_t UMR_NM__1_1_0_S6_S3 6 -400 1640 DEPOSIT ABSOLUTE MONOTONY MON_INCREASE /end AXIS_DESCR
/end CHARACTERISTIC
/begin CHARACTERISTIC KL_PGRASYNKABFOLNACHMRS54 "Druckgradient Wegschalten KAB fuer Folgeschaltung" CURVE 0x23D16C kl_si16_S6_S3 100 UMR_BAR_SEC_1_10_0_S6_S3 -100 0
 /begin AXIS_DESCR STD_AXIS zff_atsys._.iSignale._.obj.sig_m_t UMR_NM__1_1_0_S6_S3 6 -400 1640 DEPOSIT ABSOLUTE MONOTONY MON_INCREASE /end AXIS_DESCR
/end CHARACTERISTIC
/begin CHARACTERISTIC KF_PKABFOLNACHRS54 "Schaltdruck ab.Kupplung fuer Folgeschaltung" MAP 0x23D188 kf_si16_S6_S3 12.75 UMR_BAR__1_1000_0_S6_S3 0 12.75
 /begin AXIS_DESCR STD_AXIS NO_INPUT_QUANTITY UMR_U_MIN_32_1_0_S6_S3 8 0 8160 DEPOSIT ABSOLUTE MONOTONY MON_INCREASE /end AXIS_DESCR
 /begin AXIS_DESCR STD_AXIS zff_atsys._.iSignale._.obj.sig_m_t UMR_NM__1_1_0_S6_S3 10 -400 1640 DEPOSIT ABSOLUTE MONOTONY MON_INCREASE /end AXIS_DESCR
/end CHARACTERISTIC
/begin CHARACTERISTIC KF_PKABFOLNACHRS54_EL "Schaltdruck ab.Kupplung fuer Folgeschaltung" MAP 0x23D254 kf_si16_S6_S3 12.75 UMR_BAR__1_1000_0_S6_S3 0 12.75
 /begin AXIS_DESCR STD_AXIS NO_INPUT_QUANTITY UMR_U_MIN_32_1_0_S6_S3 8 0 8160 DEPOSIT ABSOLUTE MONOTONY MON_INCREASE /end AXIS_DESCR
 /begin AXIS_DESCR STD_AXIS zff_atsys._.iSignale._.obj.sig_m_t UMR_NM__1_1_0_S6_S3 10 -400 1640 DEPOSIT ABSOLUTE MONOTONY MON_INCREASE /end AXIS_DESCR
/end CHARACTERISTIC
/begin CHARACTERISTIC KF_PKABFOLNACHMRS54 "Schaltdruck ab.Kupplung fuer Folgeschaltung nach MRS" MAP 0x23D320 kf_si16_S6_S3 12.75 UMR_BAR__1_1000_0_S6_S3 0 12.75
 /begin AXIS_DESCR STD_AXIS NO_INPUT_QUANTITY UMR_U_MIN_32_1_0_S6_S3 8 0 8160 DEPOSIT ABSOLUTE MONOTONY MON_INCREASE /end AXIS_DESCR
 /begin AXIS_DESCR STD_AXIS zff_atsys._.iSignale._.obj.sig_m_t UMR_NM__1_1_0_S6_S3 10 -400 1640 DEPOSIT ABSOLUTE MONOTONY MON_INCREASE /end AXIS_DESCR
/end CHARACTERISTIC
/begin CHARACTERISTIC KF_PKABFOLNACHMRS54_EL "Schaltdruck ab.Kupplung fuer Folgeschaltung nach MRS" MAP 0x23D3EC kf_si16_S6_S3 12.75 UMR_BAR__1_1000_0_S6_S3 0 12.75
 /begin AXIS_DESCR STD_AXIS NO_INPUT_QUANTITY UMR_U_MIN_32_1_0_S6_S3 8 0 8160 DEPOSIT ABSOLUTE MONOTONY MON_INCREASE /end AXIS_DESCR
 /begin AXIS_DESCR STD_AXIS zff_atsys._.iSignale._.obj.sig_m_t UMR_NM__1_1_0_S6_S3 10 -400 1640 DEPOSIT ABSOLUTE MONOTONY MON_INCREASE /end AXIS_DESCR
/end CHARACTERISTIC
/begin CHARACTERISTIC KF_PKABFOLNACHRSSP54 "Schaltdruck KAB fuer verkuerzte Folgeschaltung" MAP 0x23D4B8 kf_si16_S6_S3 12.75 UMR_BAR__1_1000_0_S6_S3 0 12.75
 /begin AXIS_DESCR STD_AXIS NO_INPUT_QUANTITY UMR_U_MIN_32_1_0_S6_S3 8 0 8160 DEPOSIT ABSOLUTE MONOTONY MON_INCREASE /end AXIS_DESCR
 /begin AXIS_DESCR STD_AXIS zff_atsys._.iSignale._.obj.sig_m_t UMR_NM__1_1_0_S6_S3 10 -400 1640 DEPOSIT ABSOLUTE MONOTONY MON_INCREASE /end AXIS_DESCR
/end CHARACTERISTIC
/begin CHARACTERISTIC KF_PKABFOLNACHRSSPORT54 "Schaltdruck KAB fuer verkuerzte Folgeschaltung" MAP 0x23D584 kf_si16_S6_S3 12.75 UMR_BAR__1_1000_0_S6_S3 0 12.75
 /begin AXIS_DESCR STD_AXIS NO_INPUT_QUANTITY UMR_U_MIN_32_1_0_S6_S3 8 0 8160 DEPOSIT ABSOLUTE MONOTONY MON_INCREASE /end AXIS_DESCR
 /begin AXIS_DESCR STD_AXIS zff_atsys._.iSignale._.obj.sig_m_t UMR_NM__1_1_0_S6_S3 10 -400 1640 DEPOSIT ABSOLUTE MONOTONY MON_INCREASE /end AXIS_DESCR
/end CHARACTERISTIC
/begin CHARACTERISTIC KF_PKABFOLNACHMRSSP54 "Schaltdruck ab.Kupplung fuer verkuerzte Folgeschaltung nach MRS" MAP 0x23D650 kf_si16_S6_S3 12.75 UMR_BAR__1_1000_0_S6_S3 0 12.75
 /begin AXIS_DESCR STD_AXIS NO_INPUT_QUANTITY UMR_U_MIN_32_1_0_S6_S3 8 0 8160 DEPOSIT ABSOLUTE MONOTONY MON_INCREASE /end AXIS_DESCR
 /begin AXIS_DESCR STD_AXIS zff_atsys._.iSignale._.obj.sig_m_t UMR_NM__1_1_0_S6_S3 10 -400 1640 DEPOSIT ABSOLUTE MONOTONY MON_INCREASE /end AXIS_DESCR
/end CHARACTERISTIC
/begin CHARACTERISTIC KF_PKABFOLNACHMRSSPORT54 "Schaltdruck ab.Kupplung fuer verkuerzte Folgeschaltung nach MRS" MAP 0x23D71C kf_si16_S6_S3 12.75 UMR_BAR__1_1000_0_S6_S3 0 12.75
 /begin AXIS_DESCR STD_AXIS NO_INPUT_QUANTITY UMR_U_MIN_32_1_0_S6_S3 8 0 8160 DEPOSIT ABSOLUTE MONOTONY MON_INCREASE /end AXIS_DESCR
 /begin AXIS_DESCR STD_AXIS zff_atsys._.iSignale._.obj.sig_m_t UMR_NM__1_1_0_S6_S3 10 -400 1640 DEPOSIT ABSOLUTE MONOTONY MON_INCREASE /end AXIS_DESCR
/end CHARACTERISTIC
/begin CHARACTERISTIC KL_PGOKABFOLNACHMRS65 "Druckgradient in Abhaengigkeit von m_t fuer Folgeschaltung" CURVE 0x23D7E8 kl_si16_S6_S3 200 UMR_BAR_SEC_1_10_0_S6_S3 -100 100
 /begin AXIS_DESCR STD_AXIS zff_atsys._.iSignale._.obj.sig_m_t UMR_NM__1_1_0_S6_S3 6 -400 1640 DEPOSIT ABSOLUTE MONOTONY MON_INCREASE /end AXIS_DESCR
/end CHARACTERISTIC
/begin CHARACTERISTIC KL_PGRASYNKABFOLNACHMRS65 "Druckgradient Wegschalten KAB fuer Folgeschaltung" CURVE 0x23D804 kl_si16_S6_S3 100 UMR_BAR_SEC_1_10_0_S6_S3 -100 0
 /begin AXIS_DESCR STD_AXIS zff_atsys._.iSignale._.obj.sig_m_t UMR_NM__1_1_0_S6_S3 6 -400 1640 DEPOSIT ABSOLUTE MONOTONY MON_INCREASE /end AXIS_DESCR
/end CHARACTERISTIC
/begin CHARACTERISTIC KF_PKABFOLNACHRS65 "Schaltdruck ab.Kupplung fuer Folgeschaltung" MAP 0x23D820 kf_si16_S6_S3 12.75 UMR_BAR__1_1000_0_S6_S3 0 12.75
 /begin AXIS_DESCR STD_AXIS NO_INPUT_QUANTITY UMR_U_MIN_32_1_0_S6_S3 8 0 8160 DEPOSIT ABSOLUTE MONOTONY MON_INCREASE /end AXIS_DESCR
 /begin AXIS_DESCR STD_AXIS zff_atsys._.iSignale._.obj.sig_m_t UMR_NM__1_1_0_S6_S3 10 -400 1640 DEPOSIT ABSOLUTE MONOTONY MON_INCREASE /end AXIS_DESCR
/end CHARACTERISTIC
/begin CHARACTERISTIC KF_PKABFOLNACHRS65_EL "Schaltdruck ab.Kupplung fuer Folgeschaltung" MAP 0x23D8EC kf_si16_S6_S3 12.75 UMR_BAR__1_1000_0_S6_S3 0 12.75
 /begin AXIS_DESCR STD_AXIS NO_INPUT_QUANTITY UMR_U_MIN_32_1_0_S6_S3 8 0 8160 DEPOSIT ABSOLUTE MONOTONY MON_INCREASE /end AXIS_DESCR
 /begin AXIS_DESCR STD_AXIS zff_atsys._.iSignale._.obj.sig_m_t UMR_NM__1_1_0_S6_S3 10 -400 1640 DEPOSIT ABSOLUTE MONOTONY MON_INCREASE /end AXIS_DESCR
/end CHARACTERISTIC
/begin CHARACTERISTIC KF_PKABFOLNACHMRS65 "Schaltdruck ab.Kupplung fuer Folgeschaltung nach MRS" MAP 0x23D9B8 kf_si16_S6_S3 12.75 UMR_BAR__1_1000_0_S6_S3 0 12.75
 /begin AXIS_DESCR STD_AXIS NO_INPUT_QUANTITY UMR_U_MIN_32_1_0_S6_S3 8 0 8160 DEPOSIT ABSOLUTE MONOTONY MON_INCREASE /end AXIS_DESCR
 /begin AXIS_DESCR STD_AXIS zff_atsys._.iSignale._.obj.sig_m_t UMR_NM__1_1_0_S6_S3 10 -400 1640 DEPOSIT ABSOLUTE MONOTONY MON_INCREASE /end AXIS_DESCR
/end CHARACTERISTIC
/begin CHARACTERISTIC KF_PKABFOLNACHMRS65_EL "Schaltdruck ab.Kupplung fuer Folgeschaltung nach MRS" MAP 0x23DA84 kf_si16_S6_S3 12.75 UMR_BAR__1_1000_0_S6_S3 0 12.75
 /begin AXIS_DESCR STD_AXIS NO_INPUT_QUANTITY UMR_U_MIN_32_1_0_S6_S3 8 0 8160 DEPOSIT ABSOLUTE MONOTONY MON_INCREASE /end AXIS_DESCR
 /begin AXIS_DESCR STD_AXIS zff_atsys._.iSignale._.obj.sig_m_t UMR_NM__1_1_0_S6_S3 10 -400 1640 DEPOSIT ABSOLUTE MONOTONY MON_INCREASE /end AXIS_DESCR
/end CHARACTERISTIC
/begin CHARACTERISTIC KF_PKABFOLNACHRSSP65 "Schaltdruck KAB fuer verkuerzte Folgeschaltung" MAP 0x23DB50 kf_si16_S6_S3 12.75 UMR_BAR__1_1000_0_S6_S3 0 12.75
 /begin AXIS_DESCR STD_AXIS NO_INPUT_QUANTITY UMR_U_MIN_32_1_0_S6_S3 8 0 8160 DEPOSIT ABSOLUTE MONOTONY MON_INCREASE /end AXIS_DESCR
 /begin AXIS_DESCR STD_AXIS zff_atsys._.iSignale._.obj.sig_m_t UMR_NM__1_1_0_S6_S3 10 -400 1640 DEPOSIT ABSOLUTE MONOTONY MON_INCREASE /end AXIS_DESCR
/end CHARACTERISTIC
/begin CHARACTERISTIC KF_PKABFOLNACHRSSPORT65 "Schaltdruck KAB fuer verkuerzte Folgeschaltung" MAP 0x23DC1C kf_si16_S6_S3 12.75 UMR_BAR__1_1000_0_S6_S3 0 12.75
 /begin AXIS_DESCR STD_AXIS NO_INPUT_QUANTITY UMR_U_MIN_32_1_0_S6_S3 8 0 8160 DEPOSIT ABSOLUTE MONOTONY MON_INCREASE /end AXIS_DESCR
 /begin AXIS_DESCR STD_AXIS zff_atsys._.iSignale._.obj.sig_m_t UMR_NM__1_1_0_S6_S3 10 -400 1640 DEPOSIT ABSOLUTE MONOTONY MON_INCREASE /end AXIS_DESCR
/end CHARACTERISTIC
/begin CHARACTERISTIC KF_PKABFOLNACHMRSSP65 "Schaltdruck ab.Kupplung fuer verkuerzte Folgeschaltung nach MRS" MAP 0x23DCE8 kf_si16_S6_S3 12.75 UMR_BAR__1_1000_0_S6_S3 0 12.75
 /begin AXIS_DESCR STD_AXIS NO_INPUT_QUANTITY UMR_U_MIN_32_1_0_S6_S3 8 0 8160 DEPOSIT ABSOLUTE MONOTONY MON_INCREASE /end AXIS_DESCR
 /begin AXIS_DESCR STD_AXIS zff_atsys._.iSignale._.obj.sig_m_t UMR_NM__1_1_0_S6_S3 10 -400 1640 DEPOSIT ABSOLUTE MONOTONY MON_INCREASE /end AXIS_DESCR
/end CHARACTERISTIC
/begin CHARACTERISTIC KF_PKABFOLNACHMRSSPORT65 "Schaltdruck ab.Kupplung fuer verkuerzte Folgeschaltung nach MRS" MAP 0x23DDB4 kf_si16_S6_S3 12.75 UMR_BAR__1_1000_0_S6_S3 0 12.75
 /begin AXIS_DESCR STD_AXIS NO_INPUT_QUANTITY UMR_U_MIN_32_1_0_S6_S3 8 0 8160 DEPOSIT ABSOLUTE MONOTONY MON_INCREASE /end AXIS_DESCR
 /begin AXIS_DESCR STD_AXIS zff_atsys._.iSignale._.obj.sig_m_t UMR_NM__1_1_0_S6_S3 10 -400 1640 DEPOSIT ABSOLUTE MONOTONY MON_INCREASE /end AXIS_DESCR
/end CHARACTERISTIC
/begin CHARACTERISTIC KL_PGOKABFOLNACHMRS76 "Druckgradient in Abhaengigkeit von m_t fuer Folgeschaltung" CURVE 0x23DE80 kl_si16_S6_S3 200 UMR_BAR_SEC_1_10_0_S6_S3 -100 100
 /begin AXIS_DESCR STD_AXIS zff_atsys._.iSignale._.obj.sig_m_t UMR_NM__1_1_0_S6_S3 6 -400 1640 DEPOSIT ABSOLUTE MONOTONY MON_INCREASE /end AXIS_DESCR
/end CHARACTERISTIC
/begin CHARACTERISTIC KL_PGRASYNKABFOLNACHMRS76 "Druckgradient Wegschalten KAB fuer Folgeschaltung" CURVE 0x23DE9C kl_si16_S6_S3 100 UMR_BAR_SEC_1_10_0_S6_S3 -100 0
 /begin AXIS_DESCR STD_AXIS zff_atsys._.iSignale._.obj.sig_m_t UMR_NM__1_1_0_S6_S3 6 -400 1640 DEPOSIT ABSOLUTE MONOTONY MON_INCREASE /end AXIS_DESCR
/end CHARACTERISTIC
/begin CHARACTERISTIC KF_PKABFOLNACHRS76 "Schaltdruck ab.Kupplung fuer Folgeschaltung" MAP 0x23DEB8 kf_si16_S6_S3 12.75 UMR_BAR__1_1000_0_S6_S3 0 12.75
 /begin AXIS_DESCR STD_AXIS NO_INPUT_QUANTITY UMR_U_MIN_32_1_0_S6_S3 8 0 8160 DEPOSIT ABSOLUTE MONOTONY MON_INCREASE /end AXIS_DESCR
 /begin AXIS_DESCR STD_AXIS zff_atsys._.iSignale._.obj.sig_m_t UMR_NM__1_1_0_S6_S3 10 -400 1640 DEPOSIT ABSOLUTE MONOTONY MON_INCREASE /end AXIS_DESCR
/end CHARACTERISTIC
/begin CHARACTERISTIC KF_PKABFOLNACHRS76_EL "Schaltdruck ab.Kupplung fuer Folgeschaltung" MAP 0x23DF84 kf_si16_S6_S3 12.75 UMR_BAR__1_1000_0_S6_S3 0 12.75
 /begin AXIS_DESCR STD_AXIS NO_INPUT_QUANTITY UMR_U_MIN_32_1_0_S6_S3 8 0 8160 DEPOSIT ABSOLUTE MONOTONY MON_INCREASE /end AXIS_DESCR
 /begin AXIS_DESCR STD_AXIS zff_atsys._.iSignale._.obj.sig_m_t UMR_NM__1_1_0_S6_S3 10 -400 1640 DEPOSIT ABSOLUTE MONOTONY MON_INCREASE /end AXIS_DESCR
/end CHARACTERISTIC
/begin CHARACTERISTIC KF_PKABFOLNACHMRS76 "Schaltdruck ab.Kupplung fuer Folgeschaltung nach MRS" MAP 0x23E050 kf_si16_S6_S3 12.75 UMR_BAR__1_1000_0_S6_S3 0 12.75
 /begin AXIS_DESCR STD_AXIS NO_INPUT_QUANTITY UMR_U_MIN_32_1_0_S6_S3 8 0 8160 DEPOSIT ABSOLUTE MONOTONY MON_INCREASE /end AXIS_DESCR
 /begin AXIS_DESCR STD_AXIS zff_atsys._.iSignale._.obj.sig_m_t UMR_NM__1_1_0_S6_S3 10 -400 1640 DEPOSIT ABSOLUTE MONOTONY MON_INCREASE /end AXIS_DESCR
/end CHARACTERISTIC
/begin CHARACTERISTIC KF_PKABFOLNACHMRS76_EL "Schaltdruck ab.Kupplung fuer Folgeschaltung nach MRS" MAP 0x23E11C kf_si16_S6_S3 12.75 UMR_BAR__1_1000_0_S6_S3 0 12.75
 /begin AXIS_DESCR STD_AXIS NO_INPUT_QUANTITY UMR_U_MIN_32_1_0_S6_S3 8 0 8160 DEPOSIT ABSOLUTE MONOTONY MON_INCREASE /end AXIS_DESCR
 /begin AXIS_DESCR STD_AXIS zff_atsys._.iSignale._.obj.sig_m_t UMR_NM__1_1_0_S6_S3 10 -400 1640 DEPOSIT ABSOLUTE MONOTONY MON_INCREASE /end AXIS_DESCR
/end CHARACTERISTIC
/begin CHARACTERISTIC KF_PKABFOLNACHRSSP76 "Schaltdruck KAB fuer verkuerzte Folgeschaltung" MAP 0x23E1E8 kf_si16_S6_S3 12.75 UMR_BAR__1_1000_0_S6_S3 0 12.75
 /begin AXIS_DESCR STD_AXIS NO_INPUT_QUANTITY UMR_U_MIN_32_1_0_S6_S3 8 0 8160 DEPOSIT ABSOLUTE MONOTONY MON_INCREASE /end AXIS_DESCR
 /begin AXIS_DESCR STD_AXIS zff_atsys._.iSignale._.obj.sig_m_t UMR_NM__1_1_0_S6_S3 10 -400 1640 DEPOSIT ABSOLUTE MONOTONY MON_INCREASE /end AXIS_DESCR
/end CHARACTERISTIC
/begin CHARACTERISTIC KF_PKABFOLNACHRSSPORT76 "Schaltdruck KAB fuer verkuerzte Folgeschaltung" MAP 0x23E2B4 kf_si16_S6_S3 12.75 UMR_BAR__1_1000_0_S6_S3 0 12.75
 /begin AXIS_DESCR STD_AXIS NO_INPUT_QUANTITY UMR_U_MIN_32_1_0_S6_S3 8 0 8160 DEPOSIT ABSOLUTE MONOTONY MON_INCREASE /end AXIS_DESCR
 /begin AXIS_DESCR STD_AXIS zff_atsys._.iSignale._.obj.sig_m_t UMR_NM__1_1_0_S6_S3 10 -400 1640 DEPOSIT ABSOLUTE MONOTONY MON_INCREASE /end AXIS_DESCR
/end CHARACTERISTIC
/begin CHARACTERISTIC KF_PKABFOLNACHMRSSP76 "Schaltdruck ab.Kupplung fuer verkuerzte Folgeschaltung nach MRS" MAP 0x23E380 kf_si16_S6_S3 12.75 UMR_BAR__1_1000_0_S6_S3 0 12.75
 /begin AXIS_DESCR STD_AXIS NO_INPUT_QUANTITY UMR_U_MIN_32_1_0_S6_S3 8 0 8160 DEPOSIT ABSOLUTE MONOTONY MON_INCREASE /end AXIS_DESCR
 /begin AXIS_DESCR STD_AXIS zff_atsys._.iSignale._.obj.sig_m_t UMR_NM__1_1_0_S6_S3 10 -400 1640 DEPOSIT ABSOLUTE MONOTONY MON_INCREASE /end AXIS_DESCR
/end CHARACTERISTIC
/begin CHARACTERISTIC KF_PKABFOLNACHMRSSPORT76 "Schaltdruck ab.Kupplung fuer verkuerzte Folgeschaltung nach MRS" MAP 0x23E44C kf_si16_S6_S3 12.75 UMR_BAR__1_1000_0_S6_S3 0 12.75
 /begin AXIS_DESCR STD_AXIS NO_INPUT_QUANTITY UMR_U_MIN_32_1_0_S6_S3 8 0 8160 DEPOSIT ABSOLUTE MONOTONY MON_INCREASE /end AXIS_DESCR
 /begin AXIS_DESCR STD_AXIS zff_atsys._.iSignale._.obj.sig_m_t UMR_NM__1_1_0_S6_S3 10 -400 1640 DEPOSIT ABSOLUTE MONOTONY MON_INCREASE /end AXIS_DESCR
/end CHARACTERISTIC
/begin CHARACTERISTIC KL_PGOKABFOLNACHMRS87 "Druckgradient in Abhaengigkeit von m_t fuer Folgeschaltung" CURVE 0x23E518 kl_si16_S6_S3 200 UMR_BAR_SEC_1_10_0_S6_S3 -100 100
 /begin AXIS_DESCR STD_AXIS zff_atsys._.iSignale._.obj.sig_m_t UMR_NM__1_1_0_S6_S3 6 -400 1640 DEPOSIT ABSOLUTE MONOTONY MON_INCREASE /end AXIS_DESCR
/end CHARACTERISTIC
/begin CHARACTERISTIC KL_PGRASYNKABFOLNACHMRS87 "Druckgradient Wegschalten KAB fuer Folgeschaltung" CURVE 0x23E534 kl_si16_S6_S3 100 UMR_BAR_SEC_1_10_0_S6_S3 -100 0
 /begin AXIS_DESCR STD_AXIS zff_atsys._.iSignale._.obj.sig_m_t UMR_NM__1_1_0_S6_S3 6 -400 1640 DEPOSIT ABSOLUTE MONOTONY MON_INCREASE /end AXIS_DESCR
/end CHARACTERISTIC
/begin CHARACTERISTIC KF_PKABFOLNACHRS87 "Schaltdruck ab.Kupplung fuer Folgeschaltung" MAP 0x23E550 kf_si16_S6_S3 12.75 UMR_BAR__1_1000_0_S6_S3 0 12.75
 /begin AXIS_DESCR STD_AXIS NO_INPUT_QUANTITY UMR_U_MIN_32_1_0_S6_S3 8 0 8160 DEPOSIT ABSOLUTE MONOTONY MON_INCREASE /end AXIS_DESCR
 /begin AXIS_DESCR STD_AXIS zff_atsys._.iSignale._.obj.sig_m_t UMR_NM__1_1_0_S6_S3 10 -400 1640 DEPOSIT ABSOLUTE MONOTONY MON_INCREASE /end AXIS_DESCR
/end CHARACTERISTIC
/begin CHARACTERISTIC KF_PKABFOLNACHRS87_EL "Schaltdruck ab.Kupplung fuer Folgeschaltung" MAP 0x23E61C kf_si16_S6_S3 12.75 UMR_BAR__1_1000_0_S6_S3 0 12.75
 /begin AXIS_DESCR STD_AXIS NO_INPUT_QUANTITY UMR_U_MIN_32_1_0_S6_S3 8 0 8160 DEPOSIT ABSOLUTE MONOTONY MON_INCREASE /end AXIS_DESCR
 /begin AXIS_DESCR STD_AXIS zff_atsys._.iSignale._.obj.sig_m_t UMR_NM__1_1_0_S6_S3 10 -400 1640 DEPOSIT ABSOLUTE MONOTONY MON_INCREASE /end AXIS_DESCR
/end CHARACTERISTIC
/begin CHARACTERISTIC KF_PKABFOLNACHMRS87 "Schaltdruck ab.Kupplung fuer Folgeschaltung nach MRS" MAP 0x23E6E8 kf_si16_S6_S3 12.75 UMR_BAR__1_1000_0_S6_S3 0 12.75
 /begin AXIS_DESCR STD_AXIS NO_INPUT_QUANTITY UMR_U_MIN_32_1_0_S6_S3 8 0 8160 DEPOSIT ABSOLUTE MONOTONY MON_INCREASE /end AXIS_DESCR
 /begin AXIS_DESCR STD_AXIS zff_atsys._.iSignale._.obj.sig_m_t UMR_NM__1_1_0_S6_S3 10 -400 1640 DEPOSIT ABSOLUTE MONOTONY MON_INCREASE /end AXIS_DESCR
/end CHARACTERISTIC
/begin CHARACTERISTIC KF_PKABFOLNACHMRS87_EL "Schaltdruck ab.Kupplung fuer Folgeschaltung nach MRS" MAP 0x23E7B4 kf_si16_S6_S3 12.75 UMR_BAR__1_1000_0_S6_S3 0 12.75
 /begin AXIS_DESCR STD_AXIS NO_INPUT_QUANTITY UMR_U_MIN_32_1_0_S6_S3 8 0 8160 DEPOSIT ABSOLUTE MONOTONY MON_INCREASE /end AXIS_DESCR
 /begin AXIS_DESCR STD_AXIS zff_atsys._.iSignale._.obj.sig_m_t UMR_NM__1_1_0_S6_S3 10 -400 1640 DEPOSIT ABSOLUTE MONOTONY MON_INCREASE /end AXIS_DESCR
/end CHARACTERISTIC
/begin CHARACTERISTIC KF_PKABFOLNACHRSSP87 "Schaltdruck KAB fuer verkuerzte Folgeschaltung" MAP 0x23E880 kf_si16_S6_S3 12.75 UMR_BAR__1_1000_0_S6_S3 0 12.75
 /begin AXIS_DESCR STD_AXIS NO_INPUT_QUANTITY UMR_U_MIN_32_1_0_S6_S3 8 0 8160 DEPOSIT ABSOLUTE MONOTONY MON_INCREASE /end AXIS_DESCR
 /begin AXIS_DESCR STD_AXIS zff_atsys._.iSignale._.obj.sig_m_t UMR_NM__1_1_0_S6_S3 10 -400 1640 DEPOSIT ABSOLUTE MONOTONY MON_INCREASE /end AXIS_DESCR
/end CHARACTERISTIC
/begin CHARACTERISTIC KF_PKABFOLNACHRSSPORT87 "Schaltdruck KAB fuer verkuerzte Folgeschaltung" MAP 0x23E94C kf_si16_S6_S3 12.75 UMR_BAR__1_1000_0_S6_S3 0 12.75
 /begin AXIS_DESCR STD_AXIS NO_INPUT_QUANTITY UMR_U_MIN_32_1_0_S6_S3 8 0 8160 DEPOSIT ABSOLUTE MONOTONY MON_INCREASE /end AXIS_DESCR
 /begin AXIS_DESCR STD_AXIS zff_atsys._.iSignale._.obj.sig_m_t UMR_NM__1_1_0_S6_S3 10 -400 1640 DEPOSIT ABSOLUTE MONOTONY MON_INCREASE /end AXIS_DESCR
/end CHARACTERISTIC
/begin CHARACTERISTIC KF_PKABFOLNACHMRSSP87 "Schaltdruck ab.Kupplung fuer verkuerzte Folgeschaltung nach MRS" MAP 0x23EA18 kf_si16_S6_S3 12.75 UMR_BAR__1_1000_0_S6_S3 0 12.75
 /begin AXIS_DESCR STD_AXIS NO_INPUT_QUANTITY UMR_U_MIN_32_1_0_S6_S3 8 0 8160 DEPOSIT ABSOLUTE MONOTONY MON_INCREASE /end AXIS_DESCR
 /begin AXIS_DESCR STD_AXIS zff_atsys._.iSignale._.obj.sig_m_t UMR_NM__1_1_0_S6_S3 10 -400 1640 DEPOSIT ABSOLUTE MONOTONY MON_INCREASE /end AXIS_DESCR
/end CHARACTERISTIC
/begin CHARACTERISTIC KF_PKABFOLNACHMRSSPORT87 "Schaltdruck ab.Kupplung fuer verkuerzte Folgeschaltung nach MRS" MAP 0x23EAE4 kf_si16_S6_S3 12.75 UMR_BAR__1_1000_0_S6_S3 0 12.75
 /begin AXIS_DESCR STD_AXIS NO_INPUT_QUANTITY UMR_U_MIN_32_1_0_S6_S3 8 0 8160 DEPOSIT ABSOLUTE MONOTONY MON_INCREASE /end AXIS_DESCR
 /begin AXIS_DESCR STD_AXIS zff_atsys._.iSignale._.obj.sig_m_t UMR_NM__1_1_0_S6_S3 10 -400 1640 DEPOSIT ABSOLUTE MONOTONY MON_INCREASE /end AXIS_DESCR
/end CHARACTERISTIC
/begin CHARACTERISTIC KL_TSYNMTKZUSFV21 "Zeit vor sync. Start Schnellfuellung vorb. KZU" CURVE 0x25D4E8 kl_si16_S6_S3 5000 UMR_MSEC__10_1_0_S6_S3 -5000 0
 /begin AXIS_DESCR STD_AXIS zff_atsys._.iSignale._.obj.sig_m_t UMR_NM__1_1_0_S6_S3 4 -400 1640 DEPOSIT ABSOLUTE MONOTONY MON_INCREASE /end AXIS_DESCR
/end CHARACTERISTIC
/begin CHARACTERISTIC KL_TSYNMTTRAKZUV21 "Zeit vor sync. Ende Fuellausgleich vorb. KZU" CURVE 0x25D4FC kl_ui8_S6_S3 1280 UMR_MSEC__10_1_M128_S6_S3 -1280 0
 /begin AXIS_DESCR STD_AXIS zff_atsys._.iSignale._.obj.sig_m_t8 UMR_NM__8_1_M50_S6_S3 4 -400 1640 DEPOSIT ABSOLUTE MONOTONY MON_INCREASE /end AXIS_DESCR
/end CHARACTERISTIC
/begin CHARACTERISTIC T_SYN21 "Zeit n_t innerhalb Synchronschwelle bis Start Rampe 4" VALUE 0x26E9A3 kw_ui8_S6_S3 2540 UMR_MSEC__10_1_0_S6_S3 0 2540 /end CHARACTERISTIC
/begin CHARACTERISTIC T_VKZU21 "Verzoegerungszeit Start SF zuschaltende Kupplung" VALUE 0x26E9A4 kw_ui8_S6_S3 2540 UMR_MSEC__10_1_0_S6_S3 0 2540 /end CHARACTERISTIC
/begin CHARACTERISTIC TO_VKZUSLST21 "Zeitoffset auf Verzögerung Schnellfüllung bei Schleppstart" VALUE 0x26E9A5 kw_ui8_S6_S3 90 UMR_MSEC__10_1_0_S6_S3 10 100 /end CHARACTERISTIC
/begin CHARACTERISTIC T_MIN_IG_CHANGE21 "Mindestzeit fuer Ausgabe von Momentenuebergang" VALUE 0x26E9A6 kw_ui8_S6_S3 2540 UMR_MSEC__10_1_0_S6_S3 0 2540 /end CHARACTERISTIC
/begin CHARACTERISTIC KF_T_DT_IG_CHANGE21 "Kennfeld Zeitvorhalt für Übergabe Rampenzeit auf Schaltdruck" MAP 0x25D508 kf_si16_S6_S3 5080 UMR_MSEC__10_1_0_S6_S3 -2540 2540
 /begin AXIS_DESCR STD_AXIS zff_atsys._.iSignale._.obj.sig_n_t UMR_U_MIN_1_1_0_S6_S3 4 0 8160 DEPOSIT ABSOLUTE MONOTONY MON_INCREASE /end AXIS_DESCR
 /begin AXIS_DESCR STD_AXIS zff_atsys._.iSignale._.obj.sig_m_t UMR_NM__1_1_0_S6_S3 4 -400 1640 DEPOSIT ABSOLUTE MONOTONY MON_INCREASE /end AXIS_DESCR
/end CHARACTERISTIC
/begin CHARACTERISTIC KF_T2_DT_IG_CHANGE21 "Kennfeld Zeitvorhalt für Übergabe Rampenzeit auf Schaltdruck" MAP 0x25D540 kf_si16_S6_S3 5080 UMR_MSEC__10_1_0_S6_S3 -2540 2540
 /begin AXIS_DESCR STD_AXIS zff_atsys._.iSignale._.obj.sig_n_t UMR_U_MIN_1_1_0_S6_S3 4 0 8160 DEPOSIT ABSOLUTE MONOTONY MON_INCREASE /end AXIS_DESCR
 /begin AXIS_DESCR STD_AXIS zff_atsys._.iSignale._.obj.sig_m_t UMR_NM__1_1_0_S6_S3 4 -400 1640 DEPOSIT ABSOLUTE MONOTONY MON_INCREASE /end AXIS_DESCR
/end CHARACTERISTIC
/begin CHARACTERISTIC KL_POKZUCG21 "Schaltdruckoffset" CURVE 0x25D578 kl_si16_S6_S3 12.75 UMR_BAR__1_1000_0_S6_S3 -6.4 6.35
 /begin AXIS_DESCR STD_AXIS zff_atsys._.iSignale._.obj.sig_c_getr UMR_GRADC__1_1_M40_S6_S3 10 -40 150 DEPOSIT ABSOLUTE MONOTONY MON_INCREASE /end AXIS_DESCR
/end CHARACTERISTIC
/begin CHARACTERISTIC KL_POFCG21 "Kennlinie Fuelldruckoffset" CURVE 0x25D5A4 kl_si16_S6_S3 12.75 UMR_BAR__1_1000_0_S6_S3 -6.4 6.35
 /begin AXIS_DESCR STD_AXIS zff_atsys._.iSignale._.obj.sig_c_getr UMR_GRADC__1_1_M40_S6_S3 10 -40 150 DEPOSIT ABSOLUTE MONOTONY MON_INCREASE /end AXIS_DESCR
/end CHARACTERISTIC
/begin CHARACTERISTIC KL_PORASYN21 "Rampe n.Syn.->l.Stuetzst. y PMAX" CURVE 0x25D5D0 kl_si16_S6_S3 12.75 UMR_BAR__1_1000_0_S6_S3 0 12.75
 /begin AXIS_DESCR STD_AXIS iSasZentr.iSchaltend.iKzu.timer_zkzu UMR_MSEC__10_1_0_S6_S3 3 0 2540 DEPOSIT ABSOLUTE MONOTONY MON_INCREASE /end AXIS_DESCR
/end CHARACTERISTIC
/begin CHARACTERISTIC T_RA2SSCHR21 "Zeit 2.Rampe bei Schrittschaltung" VALUE 0x26E9A7 kw_ui8_S6_S3 2540 UMR_MSEC__10_1_0_S6_S3 0 2540 /end CHARACTERISTIC
/begin CHARACTERISTIC KL_POKZUNGAB21 "Druckoffset in Abhaengigkeit von ng_ab" CURVE 0x25D5E0 kl_si16_S6_S3 12.75 UMR_BAR__1_1000_0_S6_S3 -6.4 6.35
 /begin AXIS_DESCR STD_AXIS iItfInput.ng_ab UMR_U_MINSEC_1_1_0_S6_S3 4 -5000 1000 DEPOSIT ABSOLUTE MONOTONY MON_INCREASE /end AXIS_DESCR
/end CHARACTERISTIC
/begin CHARACTERISTIC KL_PORAKZU21 "Schaltdruckoffset" CURVE 0x25D5F4 kl_si16_S6_S3 12.75 UMR_BAR__1_1000_0_S6_S3 -6.4 6.35
 /begin AXIS_DESCR STD_AXIS iSasZentr.iSchaltend.iKzu.timer_zkzu UMR_MSEC__10_1_0_S6_S3 3 0 2540 DEPOSIT ABSOLUTE MONOTONY MON_INCREASE /end AXIS_DESCR
/end CHARACTERISTIC
/begin CHARACTERISTIC KL_PGOKZU21 "Druckgradient in Abhaengigkeit von m_t" CURVE 0x25D604 kl_si16_S6_S3 200 UMR_BAR_SEC_1_10_0_S6_S3 -100 100
 /begin AXIS_DESCR STD_AXIS zff_atsys._.iSignale._.obj.sig_m_t UMR_NM__1_1_0_S6_S3 6 -400 1640 DEPOSIT ABSOLUTE MONOTONY MON_INCREASE /end AXIS_DESCR
/end CHARACTERISTIC
/begin CHARACTERISTIC KL_PGOKZUWS21 "Druckgradient in Abhaengigkeit von m_t" CURVE 0x25D620 kl_si16_S6_S3 200 UMR_BAR_SEC_1_10_0_S6_S3 -100 100
 /begin AXIS_DESCR STD_AXIS zff_atsys._.iSignale._.obj.sig_m_t UMR_NM__1_1_0_S6_S3 6 -400 1640 DEPOSIT ABSOLUTE MONOTONY MON_INCREASE /end AXIS_DESCR
/end CHARACTERISTIC
/begin CHARACTERISTIC KL_POMDTSYN21 "Druckoffset Schliessphase f(delta_m_t seit synchron)" CURVE 0x25D63C kl_si16_S6_S3 12 UMR_BAR__1_1000_0_S6_S3 -6 6
 /begin AXIS_DESCR STD_AXIS iSasZentr.md_tpgrasyn UMR_NM__1_1_0_S6_S3 4 -2000 2000 DEPOSIT ABSOLUTE MONOTONY MON_INCREASE /end AXIS_DESCR
/end CHARACTERISTIC
/begin CHARACTERISTIC KL_FPGRASYN21 "Faktor Schließrampengradient" CURVE 0x25D650 kl_si16_S6_S3 50 UMR___1_10_0_S6_S3 0 50
 /begin AXIS_DESCR STD_AXIS iItfInput.ng_ab UMR_U_MINSEC_1_1_0_S6_S3 4 -5000 1000 DEPOSIT ABSOLUTE MONOTONY MON_INCREASE /end AXIS_DESCR
/end CHARACTERISTIC
/begin CHARACTERISTIC KF_PKZUWS21 "Schaltdruckkennfeld (n_tkf, m_t)" MAP 0x25D664 kf_si16_S6_S3 12.75 UMR_BAR__1_1000_0_S6_S3 0 12.75
 /begin AXIS_DESCR STD_AXIS iSasZentr.iSchaltend.n_tkf UMR_U_MIN_32_1_0_S6_S3 8 0 8160 DEPOSIT ABSOLUTE MONOTONY MON_INCREASE /end AXIS_DESCR
 /begin AXIS_DESCR STD_AXIS zff_atsys._.iSignale._.obj.sig_m_t UMR_NM__1_1_0_S6_S3 8 -400 1640 DEPOSIT ABSOLUTE MONOTONY MON_INCREASE /end AXIS_DESCR
/end CHARACTERISTIC
/begin CHARACTERISTIC KL_TSYNCGRAKZU21 "Zeit vor sync. Ende Schaltdruck/Start 3. Rampe KZU" CURVE 0x25D70C kl_ui8_S6_S3 1280 UMR_MSEC__10_1_M128_S6_S3 -1280 0
 /begin AXIS_DESCR STD_AXIS zff_atsys._.iSignale._.obj.sig_c_getr UMR_GRADC__1_1_M40_S6_S3 4 -40 215 DEPOSIT ABSOLUTE MONOTONY MON_INCREASE /end AXIS_DESCR
/end CHARACTERISTIC
/begin CHARACTERISTIC KF_TSYNMTNTRAKZUWS21 "Zeit vor sync. Ende Schaltdruck/Start 3. Rampe KZU bei Weiterschaltung (n_tkf, m_t8)" MAP 0x25D718 kf_ui8_S6_S3 1280 UMR_MSEC__10_1_M128_S6_S3 -1280 0
 /begin AXIS_DESCR STD_AXIS zff_atsys._.iSignale._.obj.sig_m_t8 UMR_NM__8_1_M50_S6_S3 4 -400 1640 DEPOSIT ABSOLUTE MONOTONY MON_INCREASE /end AXIS_DESCR
 /begin AXIS_DESCR STD_AXIS iSasZentr.iSchaltend.n_tkf UMR_U_MIN_32_1_0_S6_S3 4 0 8160 DEPOSIT ABSOLUTE MONOTONY MON_INCREASE /end AXIS_DESCR
/end CHARACTERISTIC
/begin CHARACTERISTIC KL_POFMDMOTSOLL21 "Fuelldruckoffset f(Erhoehung Motorsollmoment)" CURVE 0x25D738 kl_si16_S6_S3 12.75 UMR_BAR__1_1000_0_S6_S3 -6.4 6.35
 /begin AXIS_DESCR STD_AXIS NO_INPUT_QUANTITY UMR_NM__1_1_0_S6_S3 6 -2000 2000 DEPOSIT ABSOLUTE MONOTONY MON_INCREASE /end AXIS_DESCR
/end CHARACTERISTIC
/begin CHARACTERISTIC KL_POKZUMDMOTSOLL21 "Schaltdruckoffset in Abhaengigkeit von md_motsoll_sas" CURVE 0x25D754 kl_si16_S6_S3 12.75 UMR_BAR__1_1000_0_S6_S3 -6.4 6.35
 /begin AXIS_DESCR STD_AXIS NO_INPUT_QUANTITY UMR_NM__1_1_0_S6_S3 6 -2000 2000 DEPOSIT ABSOLUTE MONOTONY MON_INCREASE /end AXIS_DESCR
/end CHARACTERISTIC
/begin CHARACTERISTIC KL_TSYNMTKZUSFV32 "Zeit vor sync. Start Schnellfuellung vorb. KZU" CURVE 0x25D770 kl_si16_S6_S3 5000 UMR_MSEC__10_1_0_S6_S3 -5000 0
 /begin AXIS_DESCR STD_AXIS zff_atsys._.iSignale._.obj.sig_m_t UMR_NM__1_1_0_S6_S3 4 -400 1640 DEPOSIT ABSOLUTE MONOTONY MON_INCREASE /end AXIS_DESCR
/end CHARACTERISTIC
/begin CHARACTERISTIC KL_TSYNMTTRAKZUV32 "Zeit vor sync. Ende Fuellausgleich vorb. KZU" CURVE 0x25D784 kl_ui8_S6_S3 1280 UMR_MSEC__10_1_M128_S6_S3 -1280 0
 /begin AXIS_DESCR STD_AXIS zff_atsys._.iSignale._.obj.sig_m_t8 UMR_NM__8_1_M50_S6_S3 4 -400 1640 DEPOSIT ABSOLUTE MONOTONY MON_INCREASE /end AXIS_DESCR
/end CHARACTERISTIC
/begin CHARACTERISTIC T_SYN32 "Zeit n_t innerhalb Synchronschwelle bis Start Rampe 4" VALUE 0x26E9A8 kw_ui8_S6_S3 2540 UMR_MSEC__10_1_0_S6_S3 0 2540 /end CHARACTERISTIC
/begin CHARACTERISTIC T_VKZU32 "Verzoegerungszeit Start SF zuschaltende Kupplung" VALUE 0x26E9A9 kw_ui8_S6_S3 2540 UMR_MSEC__10_1_0_S6_S3 0 2540 /end CHARACTERISTIC
/begin CHARACTERISTIC TO_VKZUSLST32 "Zeitoffset auf Verzögerung Schnellfüllung bei Schleppstart" VALUE 0x26E9AA kw_ui8_S6_S3 90 UMR_MSEC__10_1_0_S6_S3 10 100 /end CHARACTERISTIC
/begin CHARACTERISTIC T_MIN_IG_CHANGE32 "Mindestzeit fuer Ausgabe von Momentenuebergang" VALUE 0x26E9AB kw_ui8_S6_S3 2540 UMR_MSEC__10_1_0_S6_S3 0 2540 /end CHARACTERISTIC
/begin CHARACTERISTIC KF_T_DT_IG_CHANGE32 "Kennfeld Zeitvorhalt für Übergabe Rampenzeit auf Schaltdruck" MAP 0x25D790 kf_si16_S6_S3 5080 UMR_MSEC__10_1_0_S6_S3 -2540 2540
 /begin AXIS_DESCR STD_AXIS zff_atsys._.iSignale._.obj.sig_n_t UMR_U_MIN_1_1_0_S6_S3 4 0 8160 DEPOSIT ABSOLUTE MONOTONY MON_INCREASE /end AXIS_DESCR
 /begin AXIS_DESCR STD_AXIS zff_atsys._.iSignale._.obj.sig_m_t UMR_NM__1_1_0_S6_S3 4 -400 1640 DEPOSIT ABSOLUTE MONOTONY MON_INCREASE /end AXIS_DESCR
/end CHARACTERISTIC
/begin CHARACTERISTIC KF_T2_DT_IG_CHANGE32 "Kennfeld Zeitvorhalt für Übergabe Rampenzeit auf Schaltdruck" MAP 0x25D7C8 kf_si16_S6_S3 5080 UMR_MSEC__10_1_0_S6_S3 -2540 2540
 /begin AXIS_DESCR STD_AXIS zff_atsys._.iSignale._.obj.sig_n_t UMR_U_MIN_1_1_0_S6_S3 4 0 8160 DEPOSIT ABSOLUTE MONOTONY MON_INCREASE /end AXIS_DESCR
 /begin AXIS_DESCR STD_AXIS zff_atsys._.iSignale._.obj.sig_m_t UMR_NM__1_1_0_S6_S3 4 -400 1640 DEPOSIT ABSOLUTE MONOTONY MON_INCREASE /end AXIS_DESCR
/end CHARACTERISTIC
/begin CHARACTERISTIC KL_POKZUCG32 "Schaltdruckoffset" CURVE 0x25D800 kl_si16_S6_S3 12.75 UMR_BAR__1_1000_0_S6_S3 -6.4 6.35
 /begin AXIS_DESCR STD_AXIS zff_atsys._.iSignale._.obj.sig_c_getr UMR_GRADC__1_1_M40_S6_S3 10 -40 150 DEPOSIT ABSOLUTE MONOTONY MON_INCREASE /end AXIS_DESCR
/end CHARACTERISTIC
/begin CHARACTERISTIC KL_POFCG32 "Kennlinie Fuelldruckoffset" CURVE 0x25D82C kl_si16_S6_S3 12.75 UMR_BAR__1_1000_0_S6_S3 -6.4 6.35
 /begin AXIS_DESCR STD_AXIS zff_atsys._.iSignale._.obj.sig_c_getr UMR_GRADC__1_1_M40_S6_S3 10 -40 150 DEPOSIT ABSOLUTE MONOTONY MON_INCREASE /end AXIS_DESCR
/end CHARACTERISTIC
/begin CHARACTERISTIC KL_PORASYN32 "Rampe n.Syn.->l.Stuetzst. y PMAX" CURVE 0x25D858 kl_si16_S6_S3 12.75 UMR_BAR__1_1000_0_S6_S3 0 12.75
 /begin AXIS_DESCR STD_AXIS iSasZentr.iSchaltend.iKzu.timer_zkzu UMR_MSEC__10_1_0_S6_S3 3 0 2540 DEPOSIT ABSOLUTE MONOTONY MON_INCREASE /end AXIS_DESCR
/end CHARACTERISTIC
/begin CHARACTERISTIC T_RA2SSCHR32 "Zeit 2.Rampe bei Schrittschaltung" VALUE 0x26E9AC kw_ui8_S6_S3 2540 UMR_MSEC__10_1_0_S6_S3 0 2540 /end CHARACTERISTIC
/begin CHARACTERISTIC KL_POKZUNGAB32 "Druckoffset in Abhaengigkeit von ng_ab" CURVE 0x25D868 kl_si16_S6_S3 12.75 UMR_BAR__1_1000_0_S6_S3 -6.4 6.35
 /begin AXIS_DESCR STD_AXIS iItfInput.ng_ab UMR_U_MINSEC_1_1_0_S6_S3 4 -5000 1000 DEPOSIT ABSOLUTE MONOTONY MON_INCREASE /end AXIS_DESCR
/end CHARACTERISTIC
/begin CHARACTERISTIC KL_PORAKZU32 "Schaltdruckoffset" CURVE 0x25D87C kl_si16_S6_S3 12.75 UMR_BAR__1_1000_0_S6_S3 -6.4 6.35
 /begin AXIS_DESCR STD_AXIS iSasZentr.iSchaltend.iKzu.timer_zkzu UMR_MSEC__10_1_0_S6_S3 3 0 2540 DEPOSIT ABSOLUTE MONOTONY MON_INCREASE /end AXIS_DESCR
/end CHARACTERISTIC
/begin CHARACTERISTIC KL_PGOKZU32 "Druckgradient in Abhaengigkeit von m_t" CURVE 0x25D88C kl_si16_S6_S3 200 UMR_BAR_SEC_1_10_0_S6_S3 -100 100
 /begin AXIS_DESCR STD_AXIS zff_atsys._.iSignale._.obj.sig_m_t UMR_NM__1_1_0_S6_S3 6 -400 1640 DEPOSIT ABSOLUTE MONOTONY MON_INCREASE /end AXIS_DESCR
/end CHARACTERISTIC
/begin CHARACTERISTIC KL_PGOKZUWS32 "Druckgradient in Abhaengigkeit von m_t" CURVE 0x25D8A8 kl_si16_S6_S3 200 UMR_BAR_SEC_1_10_0_S6_S3 -100 100
 /begin AXIS_DESCR STD_AXIS zff_atsys._.iSignale._.obj.sig_m_t UMR_NM__1_1_0_S6_S3 6 -400 1640 DEPOSIT ABSOLUTE MONOTONY MON_INCREASE /end AXIS_DESCR
/end CHARACTERISTIC
/begin CHARACTERISTIC KL_POMDTSYN32 "Druckoffset Schliessphase f(delta_m_t seit synchron)" CURVE 0x25D8C4 kl_si16_S6_S3 12 UMR_BAR__1_1000_0_S6_S3 -6 6
 /begin AXIS_DESCR STD_AXIS iSasZentr.md_tpgrasyn UMR_NM__1_1_0_S6_S3 4 -2000 2000 DEPOSIT ABSOLUTE MONOTONY MON_INCREASE /end AXIS_DESCR
/end CHARACTERISTIC
/begin CHARACTERISTIC KL_FPGRASYN32 "Faktor Schließrampengradient" CURVE 0x25D8D8 kl_si16_S6_S3 50 UMR___1_10_0_S6_S3 0 50
 /begin AXIS_DESCR STD_AXIS iItfInput.ng_ab UMR_U_MINSEC_1_1_0_S6_S3 4 -5000 1000 DEPOSIT ABSOLUTE MONOTONY MON_INCREASE /end AXIS_DESCR
/end CHARACTERISTIC
/begin CHARACTERISTIC KF_PKZUWS32 "Schaltdruckkennfeld (n_tkf, m_t)" MAP 0x25D8EC kf_si16_S6_S3 12.75 UMR_BAR__1_1000_0_S6_S3 0 12.75
 /begin AXIS_DESCR STD_AXIS iSasZentr.iSchaltend.n_tkf UMR_U_MIN_32_1_0_S6_S3 8 0 8160 DEPOSIT ABSOLUTE MONOTONY MON_INCREASE /end AXIS_DESCR
 /begin AXIS_DESCR STD_AXIS zff_atsys._.iSignale._.obj.sig_m_t UMR_NM__1_1_0_S6_S3 8 -400 1640 DEPOSIT ABSOLUTE MONOTONY MON_INCREASE /end AXIS_DESCR
/end CHARACTERISTIC
/begin CHARACTERISTIC KL_TSYNCGRAKZU32 "Zeit vor sync. Ende Schaltdruck/Start 3. Rampe KZU" CURVE 0x25D994 kl_ui8_S6_S3 1280 UMR_MSEC__10_1_M128_S6_S3 -1280 0
 /begin AXIS_DESCR STD_AXIS zff_atsys._.iSignale._.obj.sig_c_getr UMR_GRADC__1_1_M40_S6_S3 4 -40 215 DEPOSIT ABSOLUTE MONOTONY MON_INCREASE /end AXIS_DESCR
/end CHARACTERISTIC
/begin CHARACTERISTIC KF_TSYNMTNTRAKZUWS32 "Zeit vor sync. Ende Schaltdruck/Start 3. Rampe KZU bei Weiterschaltung (n_tkf, m_t8)" MAP 0x25D9A0 kf_ui8_S6_S3 1280 UMR_MSEC__10_1_M128_S6_S3 -1280 0
 /begin AXIS_DESCR STD_AXIS zff_atsys._.iSignale._.obj.sig_m_t8 UMR_NM__8_1_M50_S6_S3 4 -400 1640 DEPOSIT ABSOLUTE MONOTONY MON_INCREASE /end AXIS_DESCR
 /begin AXIS_DESCR STD_AXIS iSasZentr.iSchaltend.n_tkf UMR_U_MIN_32_1_0_S6_S3 4 0 8160 DEPOSIT ABSOLUTE MONOTONY MON_INCREASE /end AXIS_DESCR
/end CHARACTERISTIC
/begin CHARACTERISTIC KL_POFMDMOTSOLL32 "Fuelldruckoffset f(Erhoehung Motorsollmoment)" CURVE 0x25D9C0 kl_si16_S6_S3 12.75 UMR_BAR__1_1000_0_S6_S3 -6.4 6.35
 /begin AXIS_DESCR STD_AXIS NO_INPUT_QUANTITY UMR_NM__1_1_0_S6_S3 6 -2000 2000 DEPOSIT ABSOLUTE MONOTONY MON_INCREASE /end AXIS_DESCR
/end CHARACTERISTIC
/begin CHARACTERISTIC KL_POKZUMDMOTSOLL32 "Schaltdruckoffset in Abhaengigkeit von md_motsoll_sas" CURVE 0x25D9DC kl_si16_S6_S3 12.75 UMR_BAR__1_1000_0_S6_S3 -6.4 6.35
 /begin AXIS_DESCR STD_AXIS NO_INPUT_QUANTITY UMR_NM__1_1_0_S6_S3 6 -2000 2000 DEPOSIT ABSOLUTE MONOTONY MON_INCREASE /end AXIS_DESCR
/end CHARACTERISTIC
/begin CHARACTERISTIC KL_TSYNMTKZUSFV43 "Zeit vor sync. Start Schnellfuellung vorb. KZU" CURVE 0x25D9F8 kl_si16_S6_S3 5000 UMR_MSEC__10_1_0_S6_S3 -5000 0
 /begin AXIS_DESCR STD_AXIS zff_atsys._.iSignale._.obj.sig_m_t UMR_NM__1_1_0_S6_S3 4 -400 1640 DEPOSIT ABSOLUTE MONOTONY MON_INCREASE /end AXIS_DESCR
/end CHARACTERISTIC
/begin CHARACTERISTIC KL_TSYNMTTRAKZUV43 "Zeit vor sync. Ende Fuellausgleich vorb. KZU" CURVE 0x25DA0C kl_ui8_S6_S3 1280 UMR_MSEC__10_1_M128_S6_S3 -1280 0
 /begin AXIS_DESCR STD_AXIS zff_atsys._.iSignale._.obj.sig_m_t8 UMR_NM__8_1_M50_S6_S3 4 -400 1640 DEPOSIT ABSOLUTE MONOTONY MON_INCREASE /end AXIS_DESCR
/end CHARACTERISTIC
/begin CHARACTERISTIC T_SYN43 "Zeit n_t innerhalb Synchronschwelle bis Start Rampe 4" VALUE 0x26E9AD kw_ui8_S6_S3 2540 UMR_MSEC__10_1_0_S6_S3 0 2540 /end CHARACTERISTIC
/begin CHARACTERISTIC T_VKZU43 "Verzoegerungszeit Start SF zuschaltende Kupplung" VALUE 0x26E9AE kw_ui8_S6_S3 2540 UMR_MSEC__10_1_0_S6_S3 0 2540 /end CHARACTERISTIC
/begin CHARACTERISTIC TO_VKZUSLST43 "Zeitoffset auf Verzögerung Schnellfüllung bei Schleppstart" VALUE 0x26E9AF kw_ui8_S6_S3 90 UMR_MSEC__10_1_0_S6_S3 10 100 /end CHARACTERISTIC
/begin CHARACTERISTIC T_MIN_IG_CHANGE43 "Mindestzeit fuer Ausgabe von Momentenuebergang" VALUE 0x26E9B0 kw_ui8_S6_S3 2540 UMR_MSEC__10_1_0_S6_S3 0 2540 /end CHARACTERISTIC
/begin CHARACTERISTIC KF_T_DT_IG_CHANGE43 "Kennfeld Zeitvorhalt für Übergabe Rampenzeit auf Schaltdruck" MAP 0x25DA18 kf_si16_S6_S3 5080 UMR_MSEC__10_1_0_S6_S3 -2540 2540
 /begin AXIS_DESCR STD_AXIS zff_atsys._.iSignale._.obj.sig_n_t UMR_U_MIN_1_1_0_S6_S3 4 0 8160 DEPOSIT ABSOLUTE MONOTONY MON_INCREASE /end AXIS_DESCR
 /begin AXIS_DESCR STD_AXIS zff_atsys._.iSignale._.obj.sig_m_t UMR_NM__1_1_0_S6_S3 4 -400 1640 DEPOSIT ABSOLUTE MONOTONY MON_INCREASE /end AXIS_DESCR
/end CHARACTERISTIC
/begin CHARACTERISTIC KF_T2_DT_IG_CHANGE43 "Kennfeld Zeitvorhalt für Übergabe Rampenzeit auf Schaltdruck" MAP 0x25DA50 kf_si16_S6_S3 5080 UMR_MSEC__10_1_0_S6_S3 -2540 2540
 /begin AXIS_DESCR STD_AXIS zff_atsys._.iSignale._.obj.sig_n_t UMR_U_MIN_1_1_0_S6_S3 4 0 8160 DEPOSIT ABSOLUTE MONOTONY MON_INCREASE /end AXIS_DESCR
 /begin AXIS_DESCR STD_AXIS zff_atsys._.iSignale._.obj.sig_m_t UMR_NM__1_1_0_S6_S3 4 -400 1640 DEPOSIT ABSOLUTE MONOTONY MON_INCREASE /end AXIS_DESCR
/end CHARACTERISTIC
/begin CHARACTERISTIC KL_POKZUCG43 "Schaltdruckoffset" CURVE 0x25DA88 kl_si16_S6_S3 12.75 UMR_BAR__1_1000_0_S6_S3 -6.4 6.35
 /begin AXIS_DESCR STD_AXIS zff_atsys._.iSignale._.obj.sig_c_getr UMR_GRADC__1_1_M40_S6_S3 10 -40 150 DEPOSIT ABSOLUTE MONOTONY MON_INCREASE /end AXIS_DESCR
/end CHARACTERISTIC
/begin CHARACTERISTIC KL_POFCG43 "Kennlinie Fuelldruckoffset" CURVE 0x25DAB4 kl_si16_S6_S3 12.75 UMR_BAR__1_1000_0_S6_S3 -6.4 6.35
 /begin AXIS_DESCR STD_AXIS zff_atsys._.iSignale._.obj.sig_c_getr UMR_GRADC__1_1_M40_S6_S3 10 -40 150 DEPOSIT ABSOLUTE MONOTONY MON_INCREASE /end AXIS_DESCR
/end CHARACTERISTIC
/begin CHARACTERISTIC KL_PORASYN43 "Rampe n.Syn.->l.Stuetzst. y PMAX" CURVE 0x25DAE0 kl_si16_S6_S3 12.75 UMR_BAR__1_1000_0_S6_S3 0 12.75
 /begin AXIS_DESCR STD_AXIS iSasZentr.iSchaltend.iKzu.timer_zkzu UMR_MSEC__10_1_0_S6_S3 3 0 2540 DEPOSIT ABSOLUTE MONOTONY MON_INCREASE /end AXIS_DESCR
/end CHARACTERISTIC
/begin CHARACTERISTIC T_RA2SSCHR43 "Zeit 2.Rampe bei Schrittschaltung" VALUE 0x26E9B1 kw_ui8_S6_S3 2540 UMR_MSEC__10_1_0_S6_S3 0 2540 /end CHARACTERISTIC
/begin CHARACTERISTIC KL_POKZUNGAB43 "Druckoffset in Abhaengigkeit von ng_ab" CURVE 0x25DAF0 kl_si16_S6_S3 12.75 UMR_BAR__1_1000_0_S6_S3 -6.4 6.35
 /begin AXIS_DESCR STD_AXIS iItfInput.ng_ab UMR_U_MINSEC_1_1_0_S6_S3 4 -5000 1000 DEPOSIT ABSOLUTE MONOTONY MON_INCREASE /end AXIS_DESCR
/end CHARACTERISTIC
/begin CHARACTERISTIC KL_PORAKZU43 "Schaltdruckoffset" CURVE 0x25DB04 kl_si16_S6_S3 12.75 UMR_BAR__1_1000_0_S6_S3 -6.4 6.35
 /begin AXIS_DESCR STD_AXIS iSasZentr.iSchaltend.iKzu.timer_zkzu UMR_MSEC__10_1_0_S6_S3 3 0 2540 DEPOSIT ABSOLUTE MONOTONY MON_INCREASE /end AXIS_DESCR
/end CHARACTERISTIC
/begin CHARACTERISTIC KL_PGOKZU43 "Druckgradient in Abhaengigkeit von m_t" CURVE 0x25DB14 kl_si16_S6_S3 200 UMR_BAR_SEC_1_10_0_S6_S3 -100 100
 /begin AXIS_DESCR STD_AXIS zff_atsys._.iSignale._.obj.sig_m_t UMR_NM__1_1_0_S6_S3 6 -400 1640 DEPOSIT ABSOLUTE MONOTONY MON_INCREASE /end AXIS_DESCR
/end CHARACTERISTIC
/begin CHARACTERISTIC KL_PGOKZUWS43 "Druckgradient in Abhaengigkeit von m_t" CURVE 0x25DB30 kl_si16_S6_S3 200 UMR_BAR_SEC_1_10_0_S6_S3 -100 100
 /begin AXIS_DESCR STD_AXIS zff_atsys._.iSignale._.obj.sig_m_t UMR_NM__1_1_0_S6_S3 6 -400 1640 DEPOSIT ABSOLUTE MONOTONY MON_INCREASE /end AXIS_DESCR
/end CHARACTERISTIC
/begin CHARACTERISTIC KL_POMDTSYN43 "Druckoffset Schliessphase f(delta_m_t seit synchron)" CURVE 0x25DB4C kl_si16_S6_S3 12 UMR_BAR__1_1000_0_S6_S3 -6 6
 /begin AXIS_DESCR STD_AXIS iSasZentr.md_tpgrasyn UMR_NM__1_1_0_S6_S3 4 -2000 2000 DEPOSIT ABSOLUTE MONOTONY MON_INCREASE /end AXIS_DESCR
/end CHARACTERISTIC
/begin CHARACTERISTIC KL_FPGRASYN43 "Faktor Schließrampengradient" CURVE 0x25DB60 kl_si16_S6_S3 50 UMR___1_10_0_S6_S3 0 50
 /begin AXIS_DESCR STD_AXIS iItfInput.ng_ab UMR_U_MINSEC_1_1_0_S6_S3 4 -5000 1000 DEPOSIT ABSOLUTE MONOTONY MON_INCREASE /end AXIS_DESCR
/end CHARACTERISTIC
/begin CHARACTERISTIC KF_PKZUWS43 "Schaltdruckkennfeld (n_tkf, m_t)" MAP 0x25DB74 kf_si16_S6_S3 12.75 UMR_BAR__1_1000_0_S6_S3 0 12.75
 /begin AXIS_DESCR STD_AXIS iSasZentr.iSchaltend.n_tkf UMR_U_MIN_32_1_0_S6_S3 8 0 8160 DEPOSIT ABSOLUTE MONOTONY MON_INCREASE /end AXIS_DESCR
 /begin AXIS_DESCR STD_AXIS zff_atsys._.iSignale._.obj.sig_m_t UMR_NM__1_1_0_S6_S3 8 -400 1640 DEPOSIT ABSOLUTE MONOTONY MON_INCREASE /end AXIS_DESCR
/end CHARACTERISTIC
/begin CHARACTERISTIC KL_TSYNCGRAKZU43 "Zeit vor sync. Ende Schaltdruck/Start 3. Rampe KZU" CURVE 0x25DC1C kl_ui8_S6_S3 1280 UMR_MSEC__10_1_M128_S6_S3 -1280 0
 /begin AXIS_DESCR STD_AXIS zff_atsys._.iSignale._.obj.sig_c_getr UMR_GRADC__1_1_M40_S6_S3 4 -40 215 DEPOSIT ABSOLUTE MONOTONY MON_INCREASE /end AXIS_DESCR
/end CHARACTERISTIC
/begin CHARACTERISTIC KF_TSYNMTNTRAKZUWS43 "Zeit vor sync. Ende Schaltdruck/Start 3. Rampe KZU bei Weiterschaltung (n_tkf, m_t8)" MAP 0x25DC28 kf_ui8_S6_S3 1280 UMR_MSEC__10_1_M128_S6_S3 -1280 0
 /begin AXIS_DESCR STD_AXIS zff_atsys._.iSignale._.obj.sig_m_t8 UMR_NM__8_1_M50_S6_S3 4 -400 1640 DEPOSIT ABSOLUTE MONOTONY MON_INCREASE /end AXIS_DESCR
 /begin AXIS_DESCR STD_AXIS iSasZentr.iSchaltend.n_tkf UMR_U_MIN_32_1_0_S6_S3 4 0 8160 DEPOSIT ABSOLUTE MONOTONY MON_INCREASE /end AXIS_DESCR
/end CHARACTERISTIC
/begin CHARACTERISTIC KL_POFMDMOTSOLL43 "Fuelldruckoffset f(Erhoehung Motorsollmoment)" CURVE 0x25DC48 kl_si16_S6_S3 12.75 UMR_BAR__1_1000_0_S6_S3 -6.4 6.35
 /begin AXIS_DESCR STD_AXIS NO_INPUT_QUANTITY UMR_NM__1_1_0_S6_S3 6 -2000 2000 DEPOSIT ABSOLUTE MONOTONY MON_INCREASE /end AXIS_DESCR
/end CHARACTERISTIC
/begin CHARACTERISTIC KL_POKZUMDMOTSOLL43 "Schaltdruckoffset in Abhaengigkeit von md_motsoll_sas" CURVE 0x25DC64 kl_si16_S6_S3 12.75 UMR_BAR__1_1000_0_S6_S3 -6.4 6.35
 /begin AXIS_DESCR STD_AXIS NO_INPUT_QUANTITY UMR_NM__1_1_0_S6_S3 6 -2000 2000 DEPOSIT ABSOLUTE MONOTONY MON_INCREASE /end AXIS_DESCR
/end CHARACTERISTIC
/begin COMPU_METHOD SAB_PHI_100000GRAD_S2_S3 "int = ((phys * 1) / 100000) - (0) grad" RAT_FUNC "%7.5" "grad" COEFFS 0 1 -0 0 0 100000 /end COMPU_METHOD
/begin COMPU_METHOD SAB_PHI_GRAD100000_S2_S3 "int = ((phys * 100000) / 1) - (0) grad" RAT_FUNC "%7.5" "grad" COEFFS 0 100000 -0 0 0 1 /end COMPU_METHOD
/begin COMPU_METHOD SAB_PHI_2844444GRAD1000000_S2_S3 "int = ((phys * 1.0E6) / 2.844444E6) - (0) grad" RAT_FUNC "%8.6" "grad" COEFFS 0 1000000 -0 0 0 2844444 /end COMPU_METHOD
/begin COMPU_METHOD SAB_PHI_1000000GRAD2844444_S2_S3 "int = ((phys * 2.844444E6) / 1.0E6) - (0) grad" RAT_FUNC "%8.6" "grad" COEFFS 0 2844444 -0 0 0 1000000 /end COMPU_METHOD
/begin COMPU_METHOD SAB_PHI_SENS_1GRAD3_S2_S3 "int = ((phys * 3) / 1) - (0) grad" RAT_FUNC "%5.3" "grad" COEFFS 0 3 -0 0 0 1 /end COMPU_METHOD
/begin COMPU_METHOD SAB_PHI_SENS_1GRAD10_M640_S2_S3 "int = ((phys * 10) / 1) - (-640) grad" RAT_FUNC "%5.3" "grad" COEFFS 0 10 640 0 0 1 /end COMPU_METHOD
/begin COMPU_METHOD UMR___1_1000_0_S6_S3 "int = ((phys * 1000) / 1) - (0) [-]" RAT_FUNC "%5.3" "[-]" COEFFS 0 1000 -0 0 0 1 /end COMPU_METHOD
/begin COMPU_METHOD UMR___1_100_0_S6_S3 "int = ((phys * 100) / 1) - (0) [-]" RAT_FUNC "%4.2" "[-]" COEFFS 0 100 -0 0 0 1 /end COMPU_METHOD
/begin COMPU_METHOD UMR___1_10_0_S6_S3 "int = ((phys * 10) / 1) - (0) [-]" RAT_FUNC "%3.1" "[-]" COEFFS 0 10 -0 0 0 1 /end COMPU_METHOD
/begin COMPU_METHOD UMR___1_1_0_S6_S3 "int = ((phys * 1) / 1) - (0) [-]" RAT_FUNC "%2.0" "[-]" COEFFS 0 1 -0 0 0 1 /end COMPU_METHOD
/begin COMPU_METHOD UMR_NM__1_1_0_S6_S3 "int = ((phys * 1) / 1) - (0) [Nm]" RAT_FUNC "%2.0" "[Nm]" COEFFS 0 1 -0 0 0 1 /end COMPU_METHOD
/begin COMPU_METHOD UMR_NM__8_1_M50_S6_S3 "int = ((phys * 1) / 8) - (-50) [Nm]" RAT_FUNC "%2.0" "[Nm]" COEFFS 0 1 400 0 0 8 /end COMPU_METHOD
/begin COMPU_METHOD UMR_NM_SEC_10_1_0_S6_S3 "int = ((phys * 1) / 10) - (0) [Nm/s]" RAT_FUNC "%3.1" "[Nm/s]" COEFFS 0 1 -0 0 0 10 /end COMPU_METHOD
/begin COMPU_METHOD UMR_NM_BAR_1_100_0_S6_S3 "int = ((phys * 100) / 1) - (0) [Nm/bar]" RAT_FUNC "%4.2" "[Nm/bar]" COEFFS 0 100 -0 0 0 1 /end COMPU_METHOD
/begin COMPU_METHOD UMR_NM_BAR2_1_100_0_S6_S3 "int = ((phys * 100) / 1) - (0) [Nm/bar^2]" RAT_FUNC "%4.2" "[Nm/bar^2]" COEFFS 0 100 -0 0 0 1 /end COMPU_METHOD
/begin COMPU_METHOD UMR_BAR__1_1000_0_S6_S3 "int = ((phys * 1000) / 1) - (0) [bar]" RAT_FUNC "%5.3" "[bar]" COEFFS 0 1000 -0 0 0 1 /end COMPU_METHOD
/begin COMPU_METHOD UMR_BAR__1_100_0_S6_S3 "int = ((phys * 100) / 1) - (0) [bar]" RAT_FUNC "%4.2" "[bar]" COEFFS 0 100 -0 0 0 1 /end COMPU_METHOD
/begin COMPU_METHOD UMR_BAR_SEC_1_10_0_S6_S3 "int = ((phys * 10) / 1) - (0) [bar/s]" RAT_FUNC "%3.1" "[bar/s]" COEFFS 0 10 -0 0 0 1 /end COMPU_METHOD
/begin COMPU_METHOD UMR_U_MIN_1_1_0_S6_S3 "int = ((phys * 1) / 1) - (0) [U/min]" RAT_FUNC "%2.0" "[U/min]" COEFFS 0 1 -0 0 0 1 /end COMPU_METHOD
/begin COMPU_METHOD UMR_U_MIN_32_1_0_S6_S3 "int = ((phys * 1) / 32) - (0) [U/min]" RAT_FUNC "%2.0" "[U/min]" COEFFS 0 1 -0 0 0 32 /end COMPU_METHOD
/begin COMPU_METHOD UMR_U_MINSEC_1_1_0_S6_S3 "int = ((phys * 1) / 1) - (0) [U/(min*s)]" RAT_FUNC "%2.0" "[U/(min*s)]" COEFFS 0 1 -0 0 0 1 /end COMPU_METHOD
/begin COMPU_METHOD UMR_MSEC__1_1_0_S6_S3 "int = ((phys * 1) / 1) - (0) [ms]" RAT_FUNC "%2.0" "[ms]" COEFFS 0 1 -0 0 0 1 /end COMPU_METHOD
/begin COMPU_METHOD UMR_MSEC__10_1_0_S6_S3 "int = ((phys * 1) / 10) - (0) [ms]" RAT_FUNC "%2.0" "[ms]" COEFFS 0 1 -0 0 0 10 /end COMPU_METHOD
/begin COMPU_METHOD UMR_MSEC__10_1_M128_S6_S3 "int = ((phys * 1) / 10) - (-128) [ms]" RAT_FUNC "%2.0" "[ms]" COEFFS 0 1 1280 0 0 10 /end COMPU_METHOD
/begin COMPU_METHOD UMR_GRADC__1_1_0_S6_S3 "int = ((phys * 1) / 1) - (0) [°C]" RAT_FUNC "%2.0" "[°C]" COEFFS 0 1 -0 0 0 1 /end COMPU_METHOD
/begin COMPU_METHOD UMR_GRADC__1_1_M40_S6_S3 "int = ((phys * 1) / 1) - (-40) [°C]" RAT_FUNC "%2.0" "[°C]" COEFFS 0 1 40 0 0 1 /end COMPU_METHOD
/begin COMPU_METHOD UMR_K_SECK_1_1000_0_S6_S3 "int = ((phys * 1000) / 1) - (0) [K/(s*K)]" RAT_FUNC "%5.3" "[K/(s*K)]" COEFFS 0 1000 -0 0 0 1 /end COMPU_METHOD
/begin COMPU_METHOD UMR_PROZENT__20_51_0_S6_S3 "int = ((phys * 51) / 20) - (0) [%]" RAT_FUNC "%6.4" "[%]" COEFFS 0 51 -0 0 0 20 /end COMPU_METHOD
/begin COMPU_METHOD UMR_G__1_1_0_S6_S3 "int = ((phys * 1) / 1) - (0) [g]" RAT_FUNC "%2.0" "[g]" COEFFS 0 1 -0 0 0 1 /end COMPU_METHOD
/begin COMPU_METHOD UMR_G__1_10_0_S6_S3 "int = ((phys * 10) / 1) - (0) [g]" RAT_FUNC "%3.1" "[g]" COEFFS 0 10 -0 0 0 1 /end COMPU_METHOD
/begin COMPU_METHOD UMR_W_MM2_1_100_0_S6_S3 "int = ((phys * 100) / 1) - (0) [W/(mm^2)]" RAT_FUNC "%4.2" "[W/(mm^2)]" COEFFS 0 100 -0 0 0 1 /end COMPU_METHOD
/begin COMPU_METHOD UMR_J_G_1_1_0_S6_S3 "int = ((phys * 1) / 1) - (0) [J/(g)]" RAT_FUNC "%2.0" "[J/(g)]" COEFFS 0 1 -0 0 0 1 /end COMPU_METHOD
/begin COMPU_METHOD UMR_J_GK_1_1000_0_S6_S3 "int = ((phys * 1000) / 1) - (0) [J/(g*K)]" RAT_FUNC "%5.3" "[J/(g*K)]" COEFFS 0 1000 -0 0 0 1 /end COMPU_METHOD
/begin COMPU_METHOD UMR_MM2__10_1_0_S6_S3 "int = ((phys * 1) / 10) - (0) [mm^2]" RAT_FUNC "%2.0" "[mm^2]" COEFFS 0 1 -0 0 0 10 /end COMPU_METHOD
/begin FUNCTION jSasKabRSS53_Fktn "Applikationesgroessen Instanz jSasKabRSS53"
 /begin DEF_CHARACTERISTIC KF_PKABFOLSP53 KF_POKABMTCGSP53 KF_TSYNMTNTKABVFOLNACHMRSSP53 KF_TVKABMTNMOTRSSP53 KL_FPOCGHINSYNKABSP53 KL_PGOKABFOLNACHRSSP53 KL_PGRASYNKABFOLNACHRSSP53 KL_PGRASYNKABSP53 KL_PGRASYNKABWSSP53 KL_POKABMDMOTSOLLSP53 KL_POKABNGABSP53 KL_POKABVFOLNACHMRSSP53 KL_POKABVSP53 KL_TOHKABCGSP53 TO_TSYNHINSYNSSP53 T_RAABVFOLNACHMRSSP53 T_RAABVSP53 T_SYNKABWSSP53 /end DEF_CHARACTERISTIC
/end FUNCTION
/begin FUNCTION jSasKabRSS63_Fktn "Applikationesgroessen Instanz jSasKabRSS63"
 /begin DEF_CHARACTERISTIC KF_PKABFOLSP63 KF_POKABMTCGSP63 KF_TSYNMTNTKABVFOLNACHMRSSP63 KF_TVKABMTNMOTRSSP63 KL_FPOCGHINSYNKABSP63 KL_PGOKABFOLNACHRSSP63 KL_PGRASYNKABFOLNACHRSSP63 KL_PGRASYNKABSP63 KL_PGRASYNKABWSSP63 KL_POKABMDMOTSOLLSP63 KL_POKABNGABSP63 KL_POKABVFOLNACHMRSSP63 KL_POKABVSP63 KL_TOHKABCGSP63 TO_TSYNHINSYNSSP63 T_RAABVFOLNACHMRSSP63 T_RAABVSP63 T_SYNKABWSSP63 /end DEF_CHARACTERISTIC
/end FUNCTION
/begin FUNCTION jSasKabRSS64_Fktn "Applikationesgroessen Instanz jSasKabRSS64"
 /begin DEF_CHARACTERISTIC KF_PKABFOLSP64 KF_POKABMTCGSP64 KF_TSYNMTNTKABVFOLNACHMRSSP64 KF_TVKABMTNMOTRSSP64 KL_FPOCGHINSYNKABSP64 KL_PGOKABFOLNACHRSSP64 KL_PGRASYNKABFOLNACHRSSP64 KL_PGRASYNKABSP64 KL_PGRASYNKABWSSP64 KL_POKABMDMOTSOLLSP64 KL_POKABNGABSP64 KL_POKABVFOLNACHMRSSP64 KL_POKABVSP64 KL_TOHKABCGSP64 TO_TSYNHINSYNSSP64 T_RAABVFOLNACHMRSSP64 T_RAABVSP64 T_SYNKABWSSP64 /end DEF_CHARACTERISTIC
/end FUNCTION
/begin FUNCTION jSasKabRSS71_Fktn "Applikationesgroessen Instanz jSasKabRSS71"
 /begin DEF_CHARACTERISTIC KF_PKABFOLSP71 KF_POKABMTCGSP71 KF_TSYNMTNTKABVFOLNACHMRSSP71 KF_TVKABMTNMOTRSSP71 KL_FPOCGHINSYNKABSP71 KL_PGOKABFOLNACHRSSP71 KL_PGRASYNKABFOLNACHRSSP71 KL_PGRASYNKABSP71 KL_PGRASYNKABWSSP71 KL_POKABMDMOTSOLLSP71 KL_POKABNGABSP71 KL_POKABVFOLNACHMRSSP71 KL_POKABVSP71 KL_TOHKABCGSP71 TO_TSYNHINSYNSSP71 T_RAABVFOLNACHMRSSP71 T_RAABVSP71 T_SYNKABWSSP71 /end DEF_CHARACTERISTIC
/end FUNCTION
/begin FUNCTION jSasKabRSS75_Fktn "Applikationesgroessen Instanz jSasKabRSS75"
 /begin DEF_CHARACTERISTIC KF_PKABFOLSP75 KF_POKABMTCGSP75 KF_TSYNMTNTKABVFOLNACHMRSSP75 KF_TVKABMTNMOTRSSP75 KL_FPOCGHINSYNKABSP75 KL_PGOKABFOLNACHRSSP75 KL_PGRASYNKABFOLNACHRSSP75 KL_PGRASYNKABSP75 KL_PGRASYNKABWSSP75 KL_POKABMDMOTSOLLSP75 KL_POKABNGABSP75 KL_POKABVFOLNACHMRSSP75 KL_POKABVSP75 KL_TOHKABCGSP75 TO_TSYNHINSYNSSP75 T_RAABVFOLNACHMRSSP75 T_RAABVSP75 T_SYNKABWSSP75 /end DEF_CHARACTERISTIC
/end FUNCTION
/begin FUNCTION jSasKabRSS82_Fktn "Applikationesgroessen Instanz jSasKabRSS82"
 /begin DEF_CHARACTERISTIC KF_PKABFOLSP82 KF_POKABMTCGSP82 KF_TSYNMTNTKABVFOLNACHMRSSP82 KF_TVKABMTNMOTRSSP82 KL_FPOCGHINSYNKABSP82 KL_PGOKABFOLNACHRSSP82 KL_PGRASYNKABFOLNACHRSSP82 KL_PGRASYNKABSP82 KL_PGRASYNKABWSSP82 KL_POKABMDMOTSOLLSP82 KL_POKABNGABSP82 KL_POKABVFOLNACHMRSSP82 KL_POKABVSP82 KL_TOHKABCGSP82 TO_TSYNHINSYNSSP82 T_RAABVFOLNACHMRSSP82 T_RAABVSP82 T_SYNKABWSSP82 /end DEF_CHARACTERISTIC
/end FUNCTION
/begin FUNCTION jSasKabRSS86_Fktn "Applikationesgroessen Instanz jSasKabRSS86"
 /begin DEF_CHARACTERISTIC KF_PKABFOLSP86 KF_POKABMTCGSP86 KF_TSYNMTNTKABVFOLNACHMRSSP86 KF_TVKABMTNMOTRSSP86 KL_FPOCGHINSYNKABSP86 KL_PGOKABFOLNACHRSSP86 KL_PGRASYNKABFOLNACHRSSP86 KL_PGRASYNKABSP86 KL_PGRASYNKABWSSP86 KL_POKABMDMOTSOLLSP86 KL_POKABNGABSP86 KL_POKABVFOLNACHMRSSP86 KL_POKABVSP86 KL_TOHKABCGSP86 TO_TSYNHINSYNSSP86 T_RAABVFOLNACHMRSSP86 T_RAABVSP86 T_SYNKABWSSP86 /end DEF_CHARACTERISTIC
/end FUNCTION
/begin FUNCTION jSasKabRSS84_Fktn "Applikationesgroessen Instanz jSasKabRSS84"
 /begin DEF_CHARACTERISTIC KF_PKABFOLSP84 KF_POKABMTCGSP84 KF_TSYNMTNTKABVFOLNACHMRSSP84 KF_TVKABMTNMOTRSSP84 KL_FPOCGHINSYNKABSP84 KL_PGOKABFOLNACHRSSP84 KL_PGRASYNKABFOLNACHRSSP84 KL_PGRASYNKABSP84 KL_PGRASYNKABWSSP84 KL_POKABMDMOTSOLLSP84 KL_POKABNGABSP84 KL_POKABVFOLNACHMRSSP84 KL_POKABVSP84 KL_TOHKABCGSP84 TO_TSYNHINSYNSSP84 T_RAABVFOLNACHMRSSP84 T_RAABVSP84 T_SYNKABWSSP84 /end DEF_CHARACTERISTIC
/end FUNCTION
/begin FUNCTION dSasGloHSS_Fktn "Applikationesgroessen der Komponente dSasGloHSS"
 /begin SUB_FUNCTION jSasGloHSS12_Fktn jSasGloHSS23_Fktn jSasGloHSS34_Fktn jSasGloHSS45_Fktn jSasGloHSS56_Fktn jSasGloHSS67_Fktn jSasGloHSS78_Fktn jSasGloHSS13_Fktn jSasGloHSS24_Fktn jSasGloHSS35_Fktn jSasGloHSS46_Fktn jSasGloHSS57_Fktn jSasGloHSS68_Fktn /end SUB_FUNCTION
/end FUNCTION
/begin FUNCTION jSasGloHSS12_Fktn "Applikationesgroessen Instanz jSasGloHSS12"
 /begin DEF_CHARACTERISTIC HYS_NGS_VERIAE12 KL_TMAXCG12 MG_MMOTMAXVERHSSAUF12 M_MOTMAXVERHSS12 NGS_VERIAE12 NS_SYNISTE12 NS_VERSIAE12 T_RAMAX12 /end DEF_CHARACTERISTIC
/end FUNCTION
/begin FUNCTION jSasGloHSS23_Fktn "Applikationesgroessen Instanz jSasGloHSS23"
 /begin DEF_CHARACTERISTIC HYS_NGS_VERIAE23 KL_TMAXCG23 MG_MMOTMAXVERHSSAUF23 M_MOTMAXVERHSS23 NGS_VERIAE23 NS_SYNISTE23 NS_VERSIAE23 T_RAMAX23 /end DEF_CHARACTERISTIC
/end FUNCTION
/begin FUNCTION jSasGloHSS34_Fktn "Applikationesgroessen Instanz jSasGloHSS34"
 /begin DEF_CHARACTERISTIC HYS_NGS_VERIAE34 KL_TMAXCG34 MG_MMOTMAXVERHSSAUF34 M_MOTMAXVERHSS34 NGS_VERIAE34 NS_SYNISTE34 NS_VERSIAE34 T_RAMAX34 /end DEF_CHARACTERISTIC
/end FUNCTION
/begin FUNCTION jSasGloHSS45_Fktn "Applikationesgroessen Instanz jSasGloHSS45"
 /begin DEF_CHARACTERISTIC HYS_NGS_VERIAE45 KL_TMAXCG45 MG_MMOTMAXVERHSSAUF45 M_MOTMAXVERHSS45 NGS_VERIAE45 NS_SYNISTE45 NS_VERSIAE45 T_RAMAX45 /end DEF_CHARACTERISTIC
/end FUNCTION
/begin FUNCTION jSasGloHSS56_Fktn "Applikationesgroessen Instanz jSasGloHSS56"
 /begin DEF_CHARACTERISTIC HYS_NGS_VERIAE56 KL_TMAXCG56 MG_MMOTMAXVERHSSAUF56 M_MOTMAXVERHSS56 NGS_VERIAE56 NS_SYNISTE56 NS_VERSIAE56 T_RAMAX56 /end DEF_CHARACTERISTIC
/end FUNCTION
/begin FUNCTION jSasGloHSS67_Fktn "Applikationesgroessen Instanz jSasGloHSS67"
 /begin DEF_CHARACTERISTIC HYS_NGS_VERIAE67 KL_TMAXCG67 MG_MMOTMAXVERHSSAUF67 M_MOTMAXVERHSS67 NGS_VERIAE67 NS_SYNISTE67 NS_VERSIAE67 T_RAMAX67 /end DEF_CHARACTERISTIC
/end FUNCTION
/begin FUNCTION jSasGloHSS78_Fktn "Applikationesgroessen Instanz jSasGloHSS78"
 /begin DEF_CHARACTERISTIC HYS_NGS_VERIAE78 KL_TMAXCG78 MG_MMOTMAXVERHSSAUF78 M_MOTMAXVERHSS78 NGS_VERIAE78 NS_SYNISTE78 NS_VERSIAE78 T_RAMAX78 /end DEF_CHARACTERISTIC
/end FUNCTION
/begin FUNCTION jSasGloHSS13_Fktn "Applikationesgroessen Instanz jSasGloHSS13"
 /begin DEF_CHARACTERISTIC HYS_NGS_VERIAE13 KL_TMAXCG13 MG_MMOTMAXVERHSSAUF13 M_MOTMAXVERHSS13 NGS_VERIAE13 NS_SYNISTE13 NS_VERSIAE13 T_RAMAX13 /end DEF_CHARACTERISTIC
/end FUNCTION
/begin FUNCTION jSasGloHSS24_Fktn "Applikationesgroessen Instanz jSasGloHSS24"
 /begin DEF_CHARACTERISTIC HYS_NGS_VERIAE24 KL_TMAXCG24 MG_MMOTMAXVERHSSAUF24 M_MOTMAXVERHSS24 NGS_VERIAE24 NS_SYNISTE24 NS_VERSIAE24 T_RAMAX24 /end DEF_CHARACTERISTIC
/end FUNCTION
/begin FUNCTION jSasGloHSS35_Fktn "Applikationesgroessen Instanz jSasGloHSS35"
 /begin DEF_CHARACTERISTIC HYS_NGS_VERIAE35 KL_TMAXCG35 MG_MMOTMAXVERHSSAUF35 M_MOTMAXVERHSS35 NGS_VERIAE35 NS_SYNISTE35 NS_VERSIAE35 T_RAMAX35 /end DEF_CHARACTERISTIC
/end FUNCTION
/begin FUNCTION jSasGloHSS46_Fktn "Applikationesgroessen Instanz jSasGloHSS46"
 /begin DEF_CHARACTERISTIC HYS_NGS_VERIAE46 KL_TMAXCG46 MG_MMOTMAXVERHSSAUF46 M_MOTMAXVERHSS46 NGS_VERIAE46 NS_SYNISTE46 NS_VERSIAE46 T_RAMAX46 /end DEF_CHARACTERISTIC
/end FUNCTION
/begin FUNCTION jSasGloHSS57_Fktn "Applikationesgroessen Instanz jSasGloHSS57"
 /begin DEF_CHARACTERISTIC HYS_NGS_VERIAE57 KL_TMAXCG57 MG_MMOTMAXVERHSSAUF57 M_MOTMAXVERHSS57 NGS_VERIAE57 NS_SYNISTE57 NS_VERSIAE57 T_RAMAX57 /end DEF_CHARACTERISTIC
/end FUNCTION
/begin FUNCTION jSasGloHSS68_Fktn "Applikationesgroessen Instanz jSasGloHSS68"
 /begin DEF_CHARACTERISTIC HYS_NGS_VERIAE68 KL_TMAXCG68 MG_MMOTMAXVERHSSAUF68 M_MOTMAXVERHSS68 NGS_VERIAE68 NS_SYNISTE68 NS_VERSIAE68 T_RAMAX68 /end DEF_CHARACTERISTIC
/end FUNCTION
/begin FUNCTION dSasGloAl_Fktn "Applikationesgroessen der Komponente dSasGloAl" /begin SUB_FUNCTION jSasGloAl_Fktn /end SUB_FUNCTION /end FUNCTION
/begin FUNCTION jSasGloAl_Fktn "Applikationesgroessen Instanz jSasGloAl"
 /begin DEF_CHARACTERISTIC CS_GABBHS CS_GVERSHS CS_GVERSRS CS_IKABENTLEER CS_OBSP CS_OBSPORT CS_UNSPHS CS_UNSPORTHS CS_UNSPORTRS CS_UNSPRS DKIS_VERS DKIS_VERSSP DKIS_VERSSPORT DKIS_VERS_EFAHREN DKI_SCKSAS F_VSYNABBHS KL_CK_MMOTMAX KL_MTCKSPSAS KL_NDSGANGWECHSEL KL_TFNGDSYNZIELGANG KL_TFPKABCG_KUPBEL KL_TFPKZUCG_KUPBEL MG_MOTMAXCKAUF NGS_ABVERSOB NS_ABSSCHRHS NS_ABSSCHRHS1 NS_ABSSCHRRS NS_ABSSCHRRS1 NS_MOTVERS NS_NTVERSHS NS_NTVERSRS NS_TSSCHR SCHWELLE_NDSYN SWI_ABBRS SWI_ABBSYNISTHS SWI_DKIRSS SWI_EFSPONTSAS SWI_ERRSP SWI_HINSYN SWI_SCHLEPPVERS SWI_START_GANGWECHSEL SWI_UMSPLABRS SWI_VERHVERSMMOTMAX SWI_VERSZYKL TAB_F_KORCKUPPL TAB_GESAMTMASSE TAB_GESAMTREIBFLAECHE TAB_IKABENTLEER TAB_LMAXZULKAB TAB_LMAXZULKZU TAB_MASSE_LAM TAB_MSTOBSP TAB_MSTOBSPORT TAB_MSTUNSP TAB_MSTUNSPORT TAB_MSTVERS TAB_MTHINSYN TAB_NABFAKTORKAB TAB_NABFAKTORKZU TAB_NGSABVERSUN TAB_NSABSP TAB_NSABSPORT TAB_NSTABB TAB_NSTABBSP TAB_NSTABBSPORT TAB_NTFAKTORKAB TAB_NTFAKTORKZU TAB_N_LAM TAB_REIBFAKTORKAB_1 TAB_REIBFAKTORKAB_2 TAB_REIBFAKTORKZU_1 TAB_REIBFAKTORKZU_2 TAB_SWIECOMODE TAB_SWISPONTHS TAB_SWISPONTRS TAB_SWISTARTSCHALT TAB_SWIVERSFOLGE TAB_SWIVERSFOLGE_EFAHREN TAB_TV_GANGWECHSEL TAB_VZINITSCHALT TAB_WMAXZULKAB TAB_WMAXZULKZU T_FNGABSAS T_MAXABBRSINHS T_MAXABBRSINRS T_MINGANGFLAG T_MINGANGFLAG_SYN T_MMOTMAXCKAB T_PT2_C_KUPBEL WAERMEKAP_LAM /end DEF_CHARACTERISTIC
/end FUNCTION
/begin FUNCTION dSasGloKuK_Fktn "Applikationesgroessen der Komponente dSasGloKuK"
 /begin SUB_FUNCTION jSasGloKuKA_Fktn jSasGloKuKB_Fktn jSasGloKuKC_Fktn jSasGloKuKD_Fktn jSasGloKuKE_Fktn /end SUB_FUNCTION
/end FUNCTION
/begin FUNCTION jSasGloKuKA_Fktn "Applikationesgroessen Instanz jSasGloKuKA"
 /begin DEF_CHARACTERISTIC KF_POKZUFOLSPORT_A KF_POKZUFOLSP_A KF_POKZUFOL_A KF_P_KUP_BEDARF_A KL_ABKOEFPSYS_AUF_A KL_ABKOEFPSYS_ZU_A KL_PO1FCG_A KL_PO1KZUCG_A PO_WIRKKORRKAB_A PO_WIRKKORRKZU_A TAB_MVG_CKUP_A /end DEF_CHARACTERISTIC
/end FUNCTION
/begin FUNCTION jSasGloKuKB_Fktn "Applikationesgroessen Instanz jSasGloKuKB"
 /begin DEF_CHARACTERISTIC KF_POKZUFOLSPORT_B KF_POKZUFOLSP_B KF_POKZUFOL_B KF_P_KUP_BEDARF_B KL_ABKOEFPSYS_AUF_B KL_ABKOEFPSYS_ZU_B KL_PO1FCG_B KL_PO1KZUCG_B PO_WIRKKORRKAB_B PO_WIRKKORRKZU_B TAB_MVG_CKUP_B /end DEF_CHARACTERISTIC
/end FUNCTION
/begin FUNCTION jSasGloKuKC_Fktn "Applikationesgroessen Instanz jSasGloKuKC"
 /begin DEF_CHARACTERISTIC KF_POKZUFOLSPORT_C KF_POKZUFOLSP_C KF_POKZUFOL_C KF_P_KUP_BEDARF_C KL_ABKOEFPSYS_AUF_C KL_ABKOEFPSYS_ZU_C KL_PO1FCG_C KL_PO1KZUCG_C PO_WIRKKORRKAB_C PO_WIRKKORRKZU_C TAB_MVG_CKUP_C /end DEF_CHARACTERISTIC
/end FUNCTION
/begin FUNCTION jSasGloKuKD_Fktn "Applikationesgroessen Instanz jSasGloKuKD"
 /begin DEF_CHARACTERISTIC KF_POKZUFOLSPORT_D KF_POKZUFOLSP_D KF_POKZUFOL_D KF_P_KUP_BEDARF_D KL_ABKOEFPSYS_AUF_D KL_ABKOEFPSYS_ZU_D KL_PO1FCG_D KL_PO1KZUCG_D PO_WIRKKORRKAB_D PO_WIRKKORRKZU_D TAB_MVG_CKUP_D /end DEF_CHARACTERISTIC
/end FUNCTION
/begin FUNCTION jSasGloKuKE_Fktn "Applikationesgroessen Instanz jSasGloKuKE"
 /begin DEF_CHARACTERISTIC KF_POKZUFOLSPORT_E KF_POKZUFOLSP_E KF_POKZUFOL_E KF_P_KUP_BEDARF_E KL_ABKOEFPSYS_AUF_E KL_ABKOEFPSYS_ZU_E KL_PO1FCG_E KL_PO1FCG_E_EL KL_PO1KZUCG_E KL_PO1KZUCG_E_EL PO_WIRKKORRKAB_E PO_WIRKKORRKZU_E TAB_MVG_CKUP_E /end DEF_CHARACTERISTIC
/end FUNCTION
/begin FUNCTION dSasKabAl_Fktn "Applikationesgroessen der Komponente dSasKabAl" /begin SUB_FUNCTION jSasKabAl_Fktn /end SUB_FUNCTION /end FUNCTION
/begin FUNCTION jSasKabAl_Fktn "Applikationesgroessen Instanz jSasKabAl"
 /begin DEF_CHARACTERISTIC KF_PKABFOLNACH64MRS43 KF_PKABFOLNACH64MRS43SP KF_PKABFOLNACH64MRS43SPORT KF_PKABFOLNACH64MRS43_EL KF_PKABFOLNACH84MRS43 KF_PKABFOLNACH84MRS43SP KF_PKABFOLNACH84MRS43SPORT KF_PKABFOLNACH84MRS43_EL KF_THKABMTCGESTART12 KF_TPKABMTCGESTART12 KF_TPKABMTCGESTART12_EL KF_TSYNMTNTKABVFOLNACH64MRS43 KF_TSYNMTNTKABVFOLNACH84MRS43 TAB_CSPGOMTKAB T_RAABVFOLNACH64MRS43 T_RAABVFOLNACH84MRS43 /end DEF_CHARACTERISTIC
/end FUNCTION
/begin FUNCTION dSasKabERS_Fktn "Applikationesgroessen der Komponente dSasKabERS"
 /begin SUB_FUNCTION jSasKabERS21_Fktn jSasKabERS32_Fktn jSasKabERS43_Fktn jSasKabERS54_Fktn jSasKabERS65_Fktn jSasKabERS76_Fktn jSasKabERS87_Fktn /end SUB_FUNCTION
/end FUNCTION
/begin FUNCTION jSasKabERS21_Fktn "Applikationesgroessen Instanz jSasKabERS21"
 /begin DEF_CHARACTERISTIC KF_PKABFOLNACHMRS21 KF_PKABFOLNACHMRS21_EL KF_PKABFOLNACHMRSSP21 KF_PKABFOLNACHMRSSPORT21 KF_PKABFOLNACHRS21 KF_PKABFOLNACHRS21_EL KF_PKABFOLNACHRSSP21 KF_PKABFOLNACHRSSPORT21 KL_PGOKABFOLNACHMRS21 KL_PGRASYNKABFOLNACHMRS21 /end DEF_CHARACTERISTIC
/end FUNCTION
/begin FUNCTION jSasKabERS32_Fktn "Applikationesgroessen Instanz jSasKabERS32"
 /begin DEF_CHARACTERISTIC KF_PKABFOLNACHMRS32 KF_PKABFOLNACHMRS32_EL KF_PKABFOLNACHMRSSP32 KF_PKABFOLNACHMRSSPORT32 KF_PKABFOLNACHRS32 KF_PKABFOLNACHRS32_EL KF_PKABFOLNACHRSSP32 KF_PKABFOLNACHRSSPORT32 KL_PGOKABFOLNACHMRS32 KL_PGRASYNKABFOLNACHMRS32 /end DEF_CHARACTERISTIC
/end FUNCTION
/begin FUNCTION jSasKabERS43_Fktn "Applikationesgroessen Instanz jSasKabERS43"
 /begin DEF_CHARACTERISTIC KF_PKABFOLNACHRS43 KF_PKABFOLNACHRS43_EL KF_PKABFOLNACHRSSP43 KF_PKABFOLNACHRSSPORT43 KL_PGOKABFOLNACHMRS43 KL_PGRASYNKABFOLNACHMRS43 /end DEF_CHARACTERISTIC
/end FUNCTION
/begin FUNCTION jSasKabERS54_Fktn "Applikationesgroessen Instanz jSasKabERS54"
 /begin DEF_CHARACTERISTIC KF_PKABFOLNACHMRS54 KF_PKABFOLNACHMRS54_EL KF_PKABFOLNACHMRSSP54 KF_PKABFOLNACHMRSSPORT54 KF_PKABFOLNACHRS54 KF_PKABFOLNACHRS54_EL KF_PKABFOLNACHRSSP54 KF_PKABFOLNACHRSSPORT54 KL_PGOKABFOLNACHMRS54 KL_PGRASYNKABFOLNACHMRS54 /end DEF_CHARACTERISTIC
/end FUNCTION
/begin FUNCTION jSasKabERS65_Fktn "Applikationesgroessen Instanz jSasKabERS65"
 /begin DEF_CHARACTERISTIC KF_PKABFOLNACHMRS65 KF_PKABFOLNACHMRS65_EL KF_PKABFOLNACHMRSSP65 KF_PKABFOLNACHMRSSPORT65 KF_PKABFOLNACHRS65 KF_PKABFOLNACHRS65_EL KF_PKABFOLNACHRSSP65 KF_PKABFOLNACHRSSPORT65 KL_PGOKABFOLNACHMRS65 KL_PGRASYNKABFOLNACHMRS65 /end DEF_CHARACTERISTIC
/end FUNCTION
/begin FUNCTION jSasKabERS76_Fktn "Applikationesgroessen Instanz jSasKabERS76"
 /begin DEF_CHARACTERISTIC KF_PKABFOLNACHMRS76 KF_PKABFOLNACHMRS76_EL KF_PKABFOLNACHMRSSP76 KF_PKABFOLNACHMRSSPORT76 KF_PKABFOLNACHRS76 KF_PKABFOLNACHRS76_EL KF_PKABFOLNACHRSSP76 KF_PKABFOLNACHRSSPORT76 KL_PGOKABFOLNACHMRS76 KL_PGRASYNKABFOLNACHMRS76 /end DEF_CHARACTERISTIC
/end FUNCTION
/begin FUNCTION jSasKabERS87_Fktn "Applikationesgroessen Instanz jSasKabERS87"
 /begin DEF_CHARACTERISTIC KF_PKABFOLNACHMRS87 KF_PKABFOLNACHMRS87_EL KF_PKABFOLNACHMRSSP87 KF_PKABFOLNACHMRSSPORT87 KF_PKABFOLNACHRS87 KF_PKABFOLNACHRS87_EL KF_PKABFOLNACHRSSP87 KF_PKABFOLNACHRSSPORT87 KL_PGOKABFOLNACHMRS87 KL_PGRASYNKABFOLNACHMRS87 /end DEF_CHARACTERISTIC
/end FUNCTION
/begin FUNCTION dSasKzuRSS_Fktn "Applikationesgroessen der Komponente dSasKzuRSS"
 /begin SUB_FUNCTION jSasKzuRSS21_Fktn jSasKzuRSS32_Fktn jSasKzuRSS43_Fktn jSasKzuRSS54_Fktn jSasKzuRSS65_Fktn jSasKzuRSS76_Fktn jSasKzuRSS87_Fktn jSasKzuRSS31_Fktn jSasKzuRSS42_Fktn jSasKzuRSS51_Fktn jSasKzuRSS53_Fktn jSasKzuRSS63_Fktn jSasKzuRSS64_Fktn jSasKzuRSS71_Fktn jSasKzuRSS75_Fktn jSasKzuRSS82_Fktn jSasKzuRSS84_Fktn jSasKzuRSS86_Fktn /end SUB_FUNCTION
/end FUNCTION
/begin FUNCTION jSasKzuRSS21_Fktn "Applikationesgroessen Instanz jSasKzuRSS21"
 /begin DEF_CHARACTERISTIC KF_PKZUWS21 KF_T2_DT_IG_CHANGE21 KF_TSYNMTNTRAKZUWS21 KF_T_DT_IG_CHANGE21 KL_FPGRASYN21 KL_PGOKZU21 KL_PGOKZUWS21 KL_POFCG21 KL_POFMDMOTSOLL21 KL_POKZUCG21 KL_POKZUMDMOTSOLL21 KL_POKZUNGAB21 KL_POMDTSYN21 KL_PORAKZU21 KL_PORASYN21 KL_TSYNCGRAKZU21 KL_TSYNMTKZUSFV21 KL_TSYNMTTRAKZUV21 TO_VKZUSLST21 T_MIN_IG_CHANGE21 T_RA2SSCHR21 T_SYN21 T_VKZU21 /end DEF_CHARACTERISTIC
/end FUNCTION
/begin FUNCTION jSasKzuRSS32_Fktn "Applikationesgroessen Instanz jSasKzuRSS32"
 /begin DEF_CHARACTERISTIC KF_PKZUWS32 KF_T2_DT_IG_CHANGE32 KF_TSYNMTNTRAKZUWS32 KF_T_DT_IG_CHANGE32 KL_FPGRASYN32 KL_PGOKZU32 KL_PGOKZUWS32 KL_POFCG32 KL_POFMDMOTSOLL32 KL_POKZUCG32 KL_POKZUMDMOTSOLL32 KL_POKZUNGAB32 KL_POMDTSYN32 KL_PORAKZU32 KL_PORASYN32 KL_TSYNCGRAKZU32 KL_TSYNMTKZUSFV32 KL_TSYNMTTRAKZUV32 TO_VKZUSLST32 T_MIN_IG_CHANGE32 T_RA2SSCHR32 T_SYN32 T_VKZU32 /end DEF_CHARACTERISTIC
/end FUNCTION
/begin FUNCTION jSasKzuRSS43_Fktn "Applikationesgroessen Instanz jSasKzuRSS43"
 /begin DEF_CHARACTERISTIC KF_PKZUWS43 KF_T2_DT_IG_CHANGE43 KF_TSYNMTNTRAKZUWS43 KF_T_DT_IG_CHANGE43 KL_FPGRASYN43 KL_PGOKZU43 KL_PGOKZUWS43 KL_POFCG43 KL_POFMDMOTSOLL43 KL_POKZUCG43 KL_POKZUMDMOTSOLL43 KL_POKZUNGAB43 KL_POMDTSYN43 KL_PORAKZU43 KL_PORASYN43 KL_TSYNCGRAKZU43 KL_TSYNMTKZUSFV43 KL_TSYNMTTRAKZUV43 TO_VKZUSLST43 T_MIN_IG_CHANGE43 T_RA2SSCHR43 T_SYN43 T_VKZU43 /end DEF_CHARACTERISTIC
/end FUNCTION
/begin RECORD_LAYOUT kw_bool8_S6_S3 FNC_VALUES 1 UBYTE COLUMN_DIR DIRECT /end RECORD_LAYOUT
/begin RECORD_LAYOUT kw_ui8_S6_S3 FNC_VALUES 1 UBYTE COLUMN_DIR DIRECT /end RECORD_LAYOUT
/begin RECORD_LAYOUT kw_ui16_S6_S3 FNC_VALUES 1 UWORD COLUMN_DIR DIRECT /end RECORD_LAYOUT
/begin RECORD_LAYOUT kw_si8_S6_S3 FNC_VALUES 1 SBYTE COLUMN_DIR DIRECT /end RECORD_LAYOUT
/begin RECORD_LAYOUT kw_si16_S6_S3 FNC_VALUES 1 SWORD COLUMN_DIR DIRECT /end RECORD_LAYOUT
/begin RECORD_LAYOUT tab_ui8_S6_S3 FNC_VALUES 2 UBYTE COLUMN_DIR DIRECT NO_AXIS_PTS_X 1 ULONG /end RECORD_LAYOUT
/begin RECORD_LAYOUT tab_ui16_S6_S3 FNC_VALUES 2 UWORD COLUMN_DIR DIRECT NO_AXIS_PTS_X 1 ULONG /end RECORD_LAYOUT
/begin RECORD_LAYOUT tab_si16_S6_S3 FNC_VALUES 2 SWORD COLUMN_DIR DIRECT NO_AXIS_PTS_X 1 ULONG /end RECORD_LAYOUT
/begin RECORD_LAYOUT tab2d_ui8_S6_S3 FNC_VALUES 3 UBYTE ROW_DIR DIRECT NO_AXIS_PTS_X 1 ULONG NO_AXIS_PTS_Y 2 ULONG /end RECORD_LAYOUT
/begin RECORD_LAYOUT tab2d_ui16_S6_S3 FNC_VALUES 3 UWORD ROW_DIR DIRECT NO_AXIS_PTS_X 1 ULONG NO_AXIS_PTS_Y 2 ULONG /end RECORD_LAYOUT
/begin RECORD_LAYOUT tab2d_si16_S6_S3 FNC_VALUES 3 SWORD ROW_DIR DIRECT NO_AXIS_PTS_X 1 ULONG NO_AXIS_PTS_Y 2 ULONG /end RECORD_LAYOUT
/begin RECORD_LAYOUT tab2d_fl32_S6_S3 FNC_VALUES 3 FLOAT32_IEEE ROW_DIR DIRECT NO_AXIS_PTS_X 1 ULONG NO_AXIS_PTS_Y 2 ULONG /end RECORD_LAYOUT
/begin RECORD_LAYOUT kl_ui8_S6_S3 FNC_VALUES 3 UBYTE COLUMN_DIR DIRECT AXIS_PTS_X 2 UBYTE INDEX_INCR DIRECT NO_AXIS_PTS_X 1 ULONG /end RECORD_LAYOUT
/begin RECORD_LAYOUT kl_ui16_S6_S3 FNC_VALUES 3 UWORD COLUMN_DIR DIRECT AXIS_PTS_X 2 UWORD INDEX_INCR DIRECT NO_AXIS_PTS_X 1 ULONG /end RECORD_LAYOUT
/begin RECORD_LAYOUT kl_si16_S6_S3 FNC_VALUES 3 SWORD COLUMN_DIR DIRECT AXIS_PTS_X 2 SWORD INDEX_INCR DIRECT NO_AXIS_PTS_X 1 ULONG /end RECORD_LAYOUT
/begin RECORD_LAYOUT kf_ui8_S6_S3 FNC_VALUES 5 UBYTE ROW_DIR DIRECT AXIS_PTS_X 3 UBYTE INDEX_INCR DIRECT AXIS_PTS_Y 4 UBYTE INDEX_INCR DIRECT NO_AXIS_PTS_X 1 ULONG NO_AXIS_PTS_Y 2 ULONG /end RECORD_LAYOUT
/begin RECORD_LAYOUT kf_si16_S6_S3 FNC_VALUES 5 SWORD ROW_DIR DIRECT AXIS_PTS_X 3 SWORD INDEX_INCR DIRECT AXIS_PTS_Y 4 SWORD INDEX_INCR DIRECT NO_AXIS_PTS_X 1 ULONG NO_AXIS_PTS_Y 2 ULONG /end RECORD_LAYOUT
/end MODULE
/end PROJECT
