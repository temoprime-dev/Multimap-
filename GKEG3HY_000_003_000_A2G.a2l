ASAP2_VERSION 1 51
/begin PROJECT _929_929 "Gen2_BMW_System_Supplier_Lib"
/begin HEADER "" VERSION "C_03_03" PROJECT_NO _929_929 /end HEADER
/begin MODULE DIM ""
/begin MOD_COMMON "" BYTE_ORDER MSB_FIRST ALIGNMENT_BYTE 1 ALIGNMENT_WORD 2 ALIGNMENT_LONG 4 ALIGNMENT_FLOAT32_IEEE 4 /end MOD_COMMON
/begin AXIS_PTS SSTTAB_MRADOPTS_EFAHREN_GANG1 "" 0x27A85A N_AB _REC_A2AXS_31_u2_S2 65535 _CNV_R_R_Umr_1_zu_1_3_CM_S2 10 0 65535 /end AXIS_PTS
/begin AXIS_PTS SSTTAB_MRADOPTS_EFAHREN_GANG2 "" 0x27A870 N_AB _REC_A2AXS_31_u2_S2 65535 _CNV_R_R_Umr_1_zu_1_3_CM_S2 10 0 65535 /end AXIS_PTS
/begin AXIS_PTS SSTTAB_MRADOPTS_EFAHREN_GANG3 "" 0x27A886 N_AB _REC_A2AXS_31_u2_S2 65535 _CNV_R_R_Umr_1_zu_1_3_CM_S2 10 0 65535 /end AXIS_PTS
/begin AXIS_PTS SSTTAB_MRADOPTS_EFAHREN_GANG4 "" 0x27A89C N_AB _REC_A2AXS_31_u2_S2 65535 _CNV_R_R_Umr_1_zu_1_3_CM_S2 10 0 65535 /end AXIS_PTS
/begin AXIS_PTS SSTTAB_MRADOPTS_EFAHREN_GANG5 "" 0x27A8B2 N_AB _REC_A2AXS_31_u2_S2 65535 _CNV_R_R_Umr_1_zu_1_3_CM_S2 10 0 65535 /end AXIS_PTS
/begin AXIS_PTS SSTTAB_MRADOPTS_EFAHREN_GANG6 "" 0x27A8C8 N_AB _REC_A2AXS_31_u2_S2 65535 _CNV_R_R_Umr_1_zu_1_3_CM_S2 10 0 65535 /end AXIS_PTS
/begin AXIS_PTS SSTTAB_MRADOPTS_EFAHREN_GANG7 "" 0x27A8DE N_AB _REC_A2AXS_31_u2_S2 65535 _CNV_R_R_Umr_1_zu_1_3_CM_S2 10 0 65535 /end AXIS_PTS
/begin AXIS_PTS SSTTAB_MRADOPTS_EFAHREN_GANG8 "" 0x27A8F4 N_AB _REC_A2AXS_31_u2_S2 65535 _CNV_R_R_Umr_1_zu_1_3_CM_S2 10 0 65535 /end AXIS_PTS
/begin AXIS_PTS SSTTAB_MRADOPTS_EFAHREN_GANG9 "" 0x27A90A N_AB _REC_A2AXS_31_u2_S2 65535 _CNV_R_R_Umr_1_zu_1_3_CM_S2 10 0 65535 /end AXIS_PTS
/begin AXIS_PTS SSTTAB_MRADOPTZ_EFAHREN_GANG1 "" 0x27A920 N_AB _REC_A2AXS_31_u2_S2 65535 _CNV_R_R_Umr_1_zu_1_3_CM_S2 10 0 65535 /end AXIS_PTS
/begin AXIS_PTS SSTTAB_MRADOPTZ_EFAHREN_GANG2 "" 0x27A936 N_AB _REC_A2AXS_31_u2_S2 65535 _CNV_R_R_Umr_1_zu_1_3_CM_S2 10 0 65535 /end AXIS_PTS
/begin AXIS_PTS SSTTAB_MRADOPTZ_EFAHREN_GANG3 "" 0x27A94C N_AB _REC_A2AXS_31_u2_S2 65535 _CNV_R_R_Umr_1_zu_1_3_CM_S2 10 0 65535 /end AXIS_PTS
/begin AXIS_PTS SSTTAB_MRADOPTZ_EFAHREN_GANG4 "" 0x27A962 N_AB _REC_A2AXS_31_u2_S2 65535 _CNV_R_R_Umr_1_zu_1_3_CM_S2 10 0 65535 /end AXIS_PTS
/begin AXIS_PTS SSTTAB_MRADOPTZ_EFAHREN_GANG5 "" 0x27A978 N_AB _REC_A2AXS_31_u2_S2 65535 _CNV_R_R_Umr_1_zu_1_3_CM_S2 10 0 65535 /end AXIS_PTS
/begin AXIS_PTS SSTTAB_MRADOPTZ_EFAHREN_GANG6 "" 0x27A98E N_AB _REC_A2AXS_31_u2_S2 65535 _CNV_R_R_Umr_1_zu_1_3_CM_S2 10 0 65535 /end AXIS_PTS
/begin AXIS_PTS SSTTAB_MRADOPTZ_EFAHREN_GANG7 "" 0x27A9A4 N_AB _REC_A2AXS_31_u2_S2 65535 _CNV_R_R_Umr_1_zu_1_3_CM_S2 10 0 65535 /end AXIS_PTS
/begin AXIS_PTS SSTTAB_MRADOPTZ_EFAHREN_GANG8 "" 0x27A9BA N_AB _REC_A2AXS_31_u2_S2 65535 _CNV_R_R_Umr_1_zu_1_3_CM_S2 10 0 65535 /end AXIS_PTS
/begin AXIS_PTS SSTTAB_MRADOPTZ_EFAHREN_GANG9 "" 0x27A9D0 N_AB _REC_A2AXS_31_u2_S2 65535 _CNV_R_R_Umr_1_zu_1_3_CM_S2 10 0 65535 /end AXIS_PTS
/begin MEASUREMENT W_LWVA_EFF "" SWORD _CNV_R_R_Umr_10_zu__10_CM_S2 1 0 -90 90 FORMAT "%3.1" ECU_ADDRESS 0xFFF910A6 /end MEASUREMENT
/begin MEASUREMENT W_STEIGUNG "" SWORD _CNV_R_R_Umr_10_zu__9_CM_S2 1 0 -200 200 FORMAT "%3.1" ECU_ADDRESS 0xFFF90BA2 /end MEASUREMENT
/begin MEASUREMENT W_STEIGUNG_FAST "" SWORD _CNV_R_R_Umr_10_zu__9_CM_S2 1 0 -200 200 FORMAT "%3.1" ECU_ADDRESS 0xFFF90BA4 /end MEASUREMENT
/begin MEASUREMENT W_STEIGUNG_SLOW "" SWORD _CNV_R_R_Umr_10_zu__9_CM_S2 1 0 -200 200 FORMAT "%3.1" ECU_ADDRESS 0xFFF90BA6 /end MEASUREMENT
/begin MEASUREMENT Z_ADAPT_REQ "" UBYTE _CNV_S_3_Enum_EREQA_118_CM_S2 1 0 0 2 ECU_ADDRESS 0xFFF91350 /end MEASUREMENT
/begin MEASUREMENT Z_ANTRIEB "" UBYTE _CNV_S_3_Enum_EANTR_272_CM_S2 1 0 0 2 ECU_ADDRESS 0xFFF915E8 /end MEASUREMENT
/begin MEASUREMENT Z_BLINKEN "" UBYTE _CNV_S_4_Enum_EBLIN_194_CM_S2 1 0 0 3 ECU_ADDRESS 0xFFF91337 /end MEASUREMENT
/begin MEASUREMENT Z_BSA_MSA_NIC "" UBYTE _CNV_S_11_Enum_STATU_14_CM_S2 1 0 0 10 ECU_ADDRESS 0xFFF913F0 /end MEASUREMENT
/begin MEASUREMENT Z_BSMODE "" UBYTE _CNV_S_4_Enum_EBSMO_258_CM_S2 1 0 0 3 ECU_ADDRESS 0xFFF91352 /end MEASUREMENT
/begin MEASUREMENT Z_B_ERR "" UBYTE _CNV_S_3_Enum_EQ_79_CM_S2 1 0 0 2 ECU_ADDRESS 0xFFF91353 /end MEASUREMENT
/begin MEASUREMENT Z_CODIERUNG "" UBYTE _CNV_R_R_Umr_1_zu_1_2_CM_S2 1 0 0 255 FORMAT "%2.0" ECU_ADDRESS 0xFFF91355 /end MEASUREMENT
/begin MEASUREMENT Z_CODIERUNG_OBD "" UBYTE _CNV_R_R_Umr_1_zu_1_2_CM_S2 1 0 0 255 FORMAT "%2.0" ECU_ADDRESS 0xFFF91356 /end MEASUREMENT
/begin MEASUREMENT Z_DL_IDX "" UBYTE _CNV_S_9_Enum_EMAPD_224_CM_S2 1 0 0 8 ECU_ADDRESS 0xFFF915F1 /end MEASUREMENT
/begin MEASUREMENT Z_DL_IDX_ALT "" UBYTE _CNV_S_9_Enum_EMAPD_224_CM_S2 1 0 0 8 ECU_ADDRESS 0xFFF915F2 /end MEASUREMENT
/begin MEASUREMENT Z_DRIVEDYN "" UBYTE _CNV_S_7_Enum_EDRDY_273_CM_S2 1 0 0 13 ECU_ADDRESS 0xFFF91357 /end MEASUREMENT
/begin MEASUREMENT Z_DRIVEDYN_ALT "" UBYTE _CNV_S_7_Enum_EDRDY_273_CM_S2 1 0 0 13 ECU_ADDRESS 0xFFF91358 /end MEASUREMENT
/begin MEASUREMENT Z_DRIVEDYN_DSC "" UBYTE _CNV_S_5_Enum_EDRDY_274_CM_S2 1 0 0 4 ECU_ADDRESS 0xFFF915ED /end MEASUREMENT
/begin MEASUREMENT Z_DRIVEDYN_IDX "" UBYTE _CNV_S_7_Enum_EDRIV_207_CM_S2 1 0 0 6 ECU_ADDRESS 0xFFF915EE /end MEASUREMENT
/begin MEASUREMENT Z_DRIVELOGIC "" UBYTE _CNV_S_6_Enum_EDL_11_CM_S2 1 0 1 6 ECU_ADDRESS 0xFFF915F3 /end MEASUREMENT
/begin MEASUREMENT Z_DSC "" UBYTE _CNV_S_3_Enum_EDSCS_28_CM_S2 1 0 0 2 ECU_ADDRESS 0xFFF915F4 /end MEASUREMENT
/begin MEASUREMENT Z_DSC_FDS "" UBYTE _CNV_S_3_Enum_EDSCS_28_CM_S2 1 0 0 2 ECU_ADDRESS 0xFFF915EF /end MEASUREMENT
/begin MEASUREMENT Z_DSC_IST "" UBYTE _CNV_S_3_Enum_EDSCS_28_CM_S2 1 0 0 2 ECU_ADDRESS 0xFFF91359 /end MEASUREMENT
/begin MEASUREMENT Z_EFAHRKL "" UBYTE _CNV_S_6_Enum_EEFAH_140_CM_S2 1 0 0 5 ECU_ADDRESS 0xFFF9135A /end MEASUREMENT
/begin MEASUREMENT Z_EGS_REAKTION_N_RED "" UBYTE _CNV_S_4_Enum_eEGS__275_CM_S2 1 0 0 3 ECU_ADDRESS 0xFFF9135B /end MEASUREMENT
/begin MEASUREMENT Z_EIN_TRAKTION "" UBYTE _CNV_S_4_Enum_EEIN__276_CM_S2 1 0 0 3 ECU_ADDRESS 0xFFF9135C /end MEASUREMENT
/begin MEASUREMENT Z_FZG_ANH "" UBYTE _CNV_S_3_Enum_EANH_65_CM_S2 1 0 0 2 ECU_ADDRESS 0xFFF9135D /end MEASUREMENT
/begin MEASUREMENT Z_GANG_DEFAULT "" UBYTE _CNV_S_9_Enum_EGANG_30_CM_S2 1 0 0 8 ECU_ADDRESS 0xFFF9135E /end MEASUREMENT
/begin MEASUREMENT Z_GANG_IST "" UBYTE _CNV_S_9_Enum_EGANG_30_CM_S2 1 0 0 8 ECU_ADDRESS 0xFFF91360 /end MEASUREMENT
/begin MEASUREMENT Z_GANG_ZIEL "" UBYTE _CNV_S_9_Enum_EGANG_30_CM_S2 1 0 0 8 ECU_ADDRESS 0xFFF91361 /end MEASUREMENT
/begin MEASUREMENT Z_GANG_ZIEL_AGS "" UBYTE _CNV_S_9_Enum_EGANG_30_CM_S2 1 0 0 8 ECU_ADDRESS 0xFFF91362 /end MEASUREMENT
/begin MEASUREMENT Z_GANG_ZIEL_ANZEIGEGANG "" UBYTE _CNV_S_9_Enum_EGANG_30_CM_S2 1 0 0 8 ECU_ADDRESS 0xFFF91363 /end MEASUREMENT
/begin MEASUREMENT Z_GANG_ZIEL_DBM "" UBYTE _CNV_S_9_Enum_EGANG_30_CM_S2 1 0 0 8 ECU_ADDRESS 0xFFF91364 /end MEASUREMENT
/begin MEASUREMENT Z_GANG_ZIEL_DMRS "" UBYTE _CNV_S_9_Enum_EGANG_30_CM_S2 1 0 0 8 ECU_ADDRESS 0xFFF91365 /end MEASUREMENT
/begin MEASUREMENT Z_GANG_ZIEL_DYNDZM "" UBYTE _CNV_S_9_Enum_EGANG_30_CM_S2 1 0 0 8 ECU_ADDRESS 0xFFF91366 /end MEASUREMENT
/begin MEASUREMENT Z_GANG_ZIEL_EXC "" UBYTE _CNV_S_9_Enum_EGANG_30_CM_S2 1 0 0 8 ECU_ADDRESS 0xFFF91367 /end MEASUREMENT
/begin MEASUREMENT Z_GANG_ZIEL_HSURE "" UBYTE _CNV_S_9_Enum_EGANG_30_CM_S2 1 0 0 8 ECU_ADDRESS 0xFFF91368 /end MEASUREMENT
/begin MEASUREMENT Z_GANG_ZIEL_SAS "" UBYTE _CNV_S_9_Enum_EGANG_30_CM_S2 1 0 0 8 ECU_ADDRESS 0xFFF91369 /end MEASUREMENT
/begin MEASUREMENT Z_GANG_ZIEL_SKL "" UBYTE _CNV_S_9_Enum_EGANG_30_CM_S2 1 0 0 8 ECU_ADDRESS 0xFFF9136A /end MEASUREMENT
/begin MEASUREMENT Z_GANG_ZIEL_SSTEP "" UBYTE _CNV_S_9_Enum_EGANG_30_CM_S2 1 0 0 8 ECU_ADDRESS 0xFFF9136B /end MEASUREMENT
/begin MEASUREMENT Z_GANG_ZIEL_ZKA "" UBYTE _CNV_S_9_Enum_EGANG_30_CM_S2 1 0 0 8 ECU_ADDRESS 0xFFF9136C /end MEASUREMENT
/begin MEASUREMENT Z_GEARREDUCTION "" UBYTE _CNV_S_7_Enum_EGEAR_267_CM_S2 1 0 0 6 ECU_ADDRESS 0xFFF9136D /end MEASUREMENT
/begin MEASUREMENT Z_HAS_IST "" UBYTE _CNV_S_9_Enum_EHASS_141_CM_S2 1 0 0 8 ECU_ADDRESS 0xFFF9136E /end MEASUREMENT
/begin MEASUREMENT Z_HAS_ZIEL "" UBYTE _CNV_S_9_Enum_EHASS_141_CM_S2 1 0 0 8 ECU_ADDRESS 0xFFF9136F /end MEASUREMENT
/begin MEASUREMENT Z_HDC "" UBYTE _CNV_S_8_Enum_EHDC_277_CM_S2 1 0 0 7 ECU_ADDRESS 0xFFF91370 /end MEASUREMENT
/begin MEASUREMENT Z_HDC_SBE "" UBYTE _CNV_S_4_Enum_EHDC__278_CM_S2 1 0 0 3 ECU_ADDRESS 0xFFF91371 /end MEASUREMENT
/begin MEASUREMENT Z_HOTMODE "" UBYTE _CNV_R_R_Umr_1_zu_1_2_CM_S2 1 0 0 2 FORMAT "%2.0" ECU_ADDRESS 0xFFF91372 /end MEASUREMENT
/begin MEASUREMENT Z_INFS "" UBYTE _CNV_S_2_Enum_ESTAT_279_CM_S2 1 0 0 1 ECU_ADDRESS 0xFFF91373 /end MEASUREMENT
/begin MEASUREMENT Z_K0_IST "" UBYTE _CNV_S_6_Enum_EK0_280_CM_S2 1 0 0 5 ECU_ADDRESS 0xFFF91374 /end MEASUREMENT
/begin MEASUREMENT Z_K0_ZIEL "" UBYTE _CNV_S_6_Enum_EK0_280_CM_S2 1 0 0 5 ECU_ADDRESS 0xFFF91375 /end MEASUREMENT
/begin MEASUREMENT Z_LWVA_EFF_STAT "" UBYTE _CNV_S_3_Enum_eLW_V_281_CM_S2 1 0 0 2 ECU_ADDRESS 0xFFF91662 /end MEASUREMENT
/begin MEASUREMENT Z_MOTOR_NOTLAUF "" UBYTE _CNV_S_3_Enum_ENOTL_18_CM_S2 1 0 0 2 ECU_ADDRESS 0xFFF91377 /end MEASUREMENT
/begin MEASUREMENT Z_MOTSTART_TYP "" UBYTE _CNV_S_5_Enum_EMOTS_282_CM_S2 1 0 0 4 ECU_ADDRESS 0xFFF91378 /end MEASUREMENT
/begin MEASUREMENT Z_NABNEGATIV "" UBYTE _CNV_S_3_Enum_EV_RI_283_CM_S2 1 0 0 2 ECU_ADDRESS 0xFFF91379 /end MEASUREMENT
/begin MEASUREMENT Z_POS "" UBYTE _CNV_S_8_Enum_EPOS_33_CM_S2 1 0 0 7 ECU_ADDRESS 0xFFF9137B /end MEASUREMENT
/begin MEASUREMENT Z_POSWECHSEL "" UBYTE _CNV_S_16_Enum_EPOSW_284_CM_S2 1 0 11 44 ECU_ADDRESS 0xFFF9137C /end MEASUREMENT
/begin MEASUREMENT Z_POSWECHSEL_POSALT "" UBYTE _CNV_S_4_Enum_EPOSA_43_CM_S2 1 0 0 3 ECU_ADDRESS 0xFFF9137D /end MEASUREMENT
/begin MEASUREMENT Z_POS_AGS "" UBYTE _CNV_S_4_Enum_EPOSA_43_CM_S2 1 0 0 3 ECU_ADDRESS 0xFFF9137E /end MEASUREMENT
/begin MEASUREMENT Z_POWERSWITCH "" UBYTE _CNV_S_4_Enum_EPOWE_103_CM_S2 1 0 0 3 ECU_ADDRESS 0xFFF9137F /end MEASUREMENT
/begin MEASUREMENT Z_PROG_MODE "" UBYTE _CNV_S_4_Enum_EPROG_35_CM_S2 1 0 0 3 ECU_ADDRESS 0xFFF91380 /end MEASUREMENT
/begin MEASUREMENT Z_REG_ABS "" UBYTE _CNV_S_3_Enum_EABSS_285_CM_S2 1 0 0 2 ECU_ADDRESS 0xFFF91381 /end MEASUREMENT
/begin MEASUREMENT Z_REQUEST_LPA "" UBYTE _CNV_S_8_Enum_E_Z_R_286_CM_S2 1 0 0 7 ECU_ADDRESS 0xFFF91383 /end MEASUREMENT
/begin MEASUREMENT Z_SOC "" UWORD _CNV_R_R_Umr_1_zu_1_53_CM_S2 1 0 0 100 FORMAT "%2.0" ECU_ADDRESS 0xFFF90BAA /end MEASUREMENT
/begin MEASUREMENT Z_SOC_MODE "" UBYTE _CNV_S_4_Enum_ESOCM_142_CM_S2 1 0 0 3 ECU_ADDRESS 0xFFF91384 /end MEASUREMENT
/begin MEASUREMENT Z_SOC_MODE_NL "" UBYTE _CNV_S_4_Enum_ESOCM_142_CM_S2 1 0 0 3 ECU_ADDRESS 0xFFF91385 /end MEASUREMENT
/begin MEASUREMENT Z_SOC_MODE_START "" UBYTE _CNV_S_4_Enum_ESOCM_142_CM_S2 1 0 0 3 ECU_ADDRESS 0xFFF91386 /end MEASUREMENT
/begin MEASUREMENT Z_SPA_REGEN "" UBYTE _CNV_R_R_Umr_1_zu_1_2_CM_S2 1 0 0 2 FORMAT "%2.0" ECU_ADDRESS 0xFFF91387 /end MEASUREMENT
/begin MEASUREMENT Z_STATUS_ANTRIEB_FZG "" UBYTE _CNV_R_R_Umr_1_zu_1_2_CM_S2 1 0 0 255 ECU_ADDRESS 0xFFF91388 /end MEASUREMENT
/begin MEASUREMENT Z_WARMLAUF "" UBYTE _CNV_S_3_Enum_EWARM_287_CM_S2 1 0 0 2 ECU_ADDRESS 0xFFF91389 /end MEASUREMENT
/begin MEASUREMENT Z_WK_IST "" UBYTE _CNV_S_3_Enum_EWK_153_CM_S2 1 0 0 2 ECU_ADDRESS 0xFFF9138A /end MEASUREMENT
/begin MEASUREMENT Z_WK_ZIEL "" UBYTE _CNV_S_3_Enum_EWK_153_CM_S2 1 0 0 2 ECU_ADDRESS 0xFFF9138B /end MEASUREMENT
/begin MEASUREMENT DM_AB_FWS "" SWORD _CNV_R_R_Umr_1_zu_1_42_CM_S2 1 0 -32768 32767 FORMAT "%2.0" ECU_ADDRESS 0xFFF90F22 /end MEASUREMENT
/begin MEASUREMENT DM_AB_FWSALT "" SWORD _CNV_R_R_Umr_1_zu_1_42_CM_S2 1 0 -32768 32767 FORMAT "%2.0" ECU_ADDRESS 0xFFF90F24 /end MEASUREMENT
/begin MEASUREMENT DM_AB_FWSALTREST "" SWORD _CNV_R_R_Umr_1_zu_1_42_CM_S2 1 0 -32768 32767 FORMAT "%2.0" ECU_ADDRESS 0xFFF90F26 /end MEASUREMENT
/begin MEASUREMENT DM_AB_FWSDELTA "" SWORD _CNV_R_R_Umr_1_zu_1_42_CM_S2 1 0 -32768 32767 FORMAT "%2.0" ECU_ADDRESS 0xFFF90F28 /end MEASUREMENT
/begin MEASUREMENT DM_AB_FWSFLANKE "" UBYTE _CNV_R_R_Umr_1_zu_1_2_CM_S2 1 0 0 255 FORMAT "%2.0" ECU_ADDRESS 0xFFF915F6 /end MEASUREMENT
/begin MEASUREMENT DM_AB_FWSFREEZE "" SWORD _CNV_R_R_Umr_1_zu_1_42_CM_S2 1 0 -32768 32767 FORMAT "%2.0" ECU_ADDRESS 0xFFF90F2A /end MEASUREMENT
/begin MEASUREMENT DM_AB_FWSFREEZEALT "" SWORD _CNV_R_R_Umr_1_zu_1_42_CM_S2 1 0 -32768 32767 FORMAT "%2.0" ECU_ADDRESS 0xFFF90F2C /end MEASUREMENT
/begin MEASUREMENT DM_AB_FWSKOR "" SWORD _CNV_R_R_Umr_1_zu_1_42_CM_S2 1 0 -32768 32767 FORMAT "%2.0" ECU_ADDRESS 0xFFF90F2E /end MEASUREMENT
/begin MEASUREMENT DM_AB_FWSKORALT "" SWORD _CNV_R_R_Umr_1_zu_1_42_CM_S2 1 0 -32768 32767 FORMAT "%2.0" ECU_ADDRESS 0xFFF90F30 /end MEASUREMENT
/begin MEASUREMENT DM_AB_FWSKORDELTA "" SWORD _CNV_R_R_Umr_1_zu_1_42_CM_S2 1 0 -32768 32767 FORMAT "%2.0" ECU_ADDRESS 0xFFF90F32 /end MEASUREMENT
/begin MEASUREMENT DM_AB_FWSKOR_FASTREST "" SWORD _CNV_R_R_Umr_1_zu_1_42_CM_S2 1 0 -32768 32767 FORMAT "%2.0" ECU_ADDRESS 0xFFF90F34 /end MEASUREMENT
/begin MEASUREMENT DM_AB_FWSKOR_FILTFAST "" SWORD _CNV_R_R_Umr_1_zu_1_42_CM_S2 1 0 -32768 32767 FORMAT "%2.0" ECU_ADDRESS 0xFFF90F36 /end MEASUREMENT
/begin MEASUREMENT DM_AB_FWSKOR_FILTFASTALT "" SWORD _CNV_R_R_Umr_1_zu_1_42_CM_S2 1 0 -32768 32767 FORMAT "%2.0" ECU_ADDRESS 0xFFF90F38 /end MEASUREMENT
/begin MEASUREMENT DM_AB_FWSKOR_FILTSLOW "" SWORD _CNV_R_R_Umr_1_zu_1_42_CM_S2 1 0 -32768 32767 FORMAT "%2.0" ECU_ADDRESS 0xFFF90F3A /end MEASUREMENT
/begin MEASUREMENT DM_AB_FWSKOR_FILTSLOWALT "" SWORD _CNV_R_R_Umr_1_zu_1_42_CM_S2 1 0 -32768 32767 FORMAT "%2.0" ECU_ADDRESS 0xFFF90F3C /end MEASUREMENT
/begin MEASUREMENT DM_AB_FWSKOR_SLOWREST "" SWORD _CNV_R_R_Umr_1_zu_1_42_CM_S2 1 0 -32768 32767 FORMAT "%2.0" ECU_ADDRESS 0xFFF90F3E /end MEASUREMENT
/begin MEASUREMENT DM_AB_FWSREST "" SWORD _CNV_R_R_Umr_1_zu_1_42_CM_S2 1 0 -32768 32767 FORMAT "%2.0" ECU_ADDRESS 0xFFF90F40 /end MEASUREMENT
/begin MEASUREMENT DM_AB_FWSROH "" SWORD _CNV_R_R_Umr_1_zu_1_42_CM_S2 1 0 -32768 32767 FORMAT "%2.0" ECU_ADDRESS 0xFFF90F42 /end MEASUREMENT
/begin MEASUREMENT DM_AB_FWSROHALT "" SWORD _CNV_R_R_Umr_1_zu_1_42_CM_S2 1 0 -32768 32767 FORMAT "%2.0" ECU_ADDRESS 0xFFF90F44 /end MEASUREMENT
/begin MEASUREMENT DM_AB_FWS_BESCHL "" SWORD _CNV_R_R_Umr_1_zu_1_42_CM_S2 1 0 -32768 32767 FORMAT "%2.0" ECU_ADDRESS 0xFFF90F46 /end MEASUREMENT
/begin MEASUREMENT DM_AB_FWS_FILT "" SWORD _CNV_R_R_Umr_1_zu_1_42_CM_S2 1 0 -32768 32767 FORMAT "%2.0" ECU_ADDRESS 0xFFF90F48 /end MEASUREMENT
/begin MEASUREMENT DM_AB_FWS_FILTALT "" SWORD _CNV_R_R_Umr_1_zu_1_42_CM_S2 1 0 -32768 32767 FORMAT "%2.0" ECU_ADDRESS 0xFFF90F4A /end MEASUREMENT
/begin MEASUREMENT DM_AB_FWS_FILTREST "" SWORD _CNV_R_R_Umr_1_zu_1_42_CM_S2 1 0 -32768 32767 FORMAT "%2.0" ECU_ADDRESS 0xFFF90F4C /end MEASUREMENT
/begin MEASUREMENT DM_AB_FWS_STEIGUNG "" SWORD _CNV_R_R_Umr_1_zu_1_42_CM_S2 1 0 -32768 32767 FORMAT "%2.0" ECU_ADDRESS 0xFFF90F4E /end MEASUREMENT
/begin MEASUREMENT DM_RAD_FWS "" SWORD _CNV_R_R_Umr_1_zu_1_42_CM_S2 1 0 -32768 32767 FORMAT "%2.0" ECU_ADDRESS 0xFFF90F50 /end MEASUREMENT
/begin MEASUREMENT DM_RAD_FWSALT "" SWORD _CNV_R_R_Umr_1_zu_1_42_CM_S2 1 0 -32768 32767 FORMAT "%2.0" ECU_ADDRESS 0xFFF90F52 /end MEASUREMENT
/begin MEASUREMENT DM_RAD_FWSDELTA "" SWORD _CNV_R_R_Umr_1_zu_1_42_CM_S2 1 0 -32768 32767 FORMAT "%2.0" ECU_ADDRESS 0xFFF90F54 /end MEASUREMENT
/begin MEASUREMENT DM_RAD_FWS_FILT "" SWORD _CNV_R_R_Umr_1_zu_1_42_CM_S2 1 0 -32768 32767 FORMAT "%2.0" ECU_ADDRESS 0xFFF90F56 /end MEASUREMENT
/begin MEASUREMENT FUNKINIT_DONE_FAHRWIDERSTAND "" UBYTE _CNV_P_2_A_I_5_CM_S2 1 0 0 255 ECU_ADDRESS 0xFFF915F7 /end MEASUREMENT
/begin MEASUREMENT F_FWS_TEMP "" UWORD _CNV_R_R_Umr_1_zu_1_53_CM_S2 1 0 0 250 FORMAT "%2.0" ECU_ADDRESS 0xFFF90F58 /end MEASUREMENT
/begin MEASUREMENT G2W_AB_FWSFILTALT "" SWORD _CNV_R_R_Umr_10_zu__181_CM_S2 1 0 -3276.8 3276.7 FORMAT "%3.1" ECU_ADDRESS 0xFFF90F5A /end MEASUREMENT
/begin MEASUREMENT G3W_AB_FWSFILT "" SWORD _CNV_R_R_Umr_10_zu__305_CM_S2 1 0 -3276.8 3276.7 ECU_ADDRESS 0xFFF90F5C /end MEASUREMENT
/begin MEASUREMENT GW_FP_ALTFWS "" SWORD _CNV_R_R_Umr_1_zu_1_7_CM_S2 1 0 -32768 32767 FORMAT "%2.0" ECU_ADDRESS 0xFFF90F5E /end MEASUREMENT
/begin MEASUREMENT J_KORFAKT "" SWORD _CNV_R_R_Umr_1_zu_1_2_CM_S2 1 0 1 5000 FORMAT "%2.0" ECU_ADDRESS 0xFFF911B4 /end MEASUREMENT
/begin MEASUREMENT MASSE_FZG "" UWORD _CNV_R_R_Umr_1_zu_1_270_CM_S2 1 0 0 10000 FORMAT "%2.0" ECU_ADDRESS 0xFFF90F60 /end MEASUREMENT
/begin MEASUREMENT MASSE_FZG_REST "" SWORD _CNV_R_R_Umr_1_zu_1_270_CM_S2 1 0 0 10000 FORMAT "%2.0" ECU_ADDRESS 0xFFF911B6 /end MEASUREMENT
/begin MEASUREMENT MUE_DYN "" UWORD _CNV_R_R_Umr_1000_z_57_CM_S2 1 0 0 65.535 FORMAT "%5.3" ECU_ADDRESS 0xFFF90F62 /end MEASUREMENT
/begin MEASUREMENT MUE_DYN_ROH "" UWORD _CNV_R_R_Umr_1000_z_57_CM_S2 1 0 0 65.535 FORMAT "%5.3" ECU_ADDRESS 0xFFF90F64 /end MEASUREMENT
/begin MEASUREMENT MUE_STAT "" UWORD _CNV_R_R_Umr_1000_z_57_CM_S2 1 0 0 65.535 FORMAT "%5.3" ECU_ADDRESS 0xFFF90F66 /end MEASUREMENT
/begin MEASUREMENT MUE_UEBER "" UWORD _CNV_R_R_Umr_1000_z_57_CM_S2 1 0 0 65.535 FORMAT "%5.3" ECU_ADDRESS 0xFFF90F68 /end MEASUREMENT
/begin MEASUREMENT M_AB_BREMS "" SWORD _CNV_R_R_Umr_1_zu_1_42_CM_S2 1 0 -32768 32767 FORMAT "%2.0" ECU_ADDRESS 0xFFF911B8 /end MEASUREMENT
/begin MEASUREMENT M_AB_FWSREF "" SWORD _CNV_R_R_Umr_1_zu_1_42_CM_S2 1 0 -32768 32767 FORMAT "%2.0" ECU_ADDRESS 0xFFF911BA /end MEASUREMENT
/begin MEASUREMENT M_AB_IST_MRAD "" SWORD _CNV_R_R_Umr_1_zu_1_42_CM_S2 1 0 -32768 32767 FORMAT "%2.0" ECU_ADDRESS 0xFFF90F6A /end MEASUREMENT
/begin MEASUREMENT M_AB_IST_MRAD_BUF[0] "" SWORD _CNV_R_R_Umr_1_zu_1_42_CM_S2 1 0 -32768 32767 FORMAT "%2.0" ECU_ADDRESS 0xFFF90F6C /end MEASUREMENT
/begin MEASUREMENT M_AB_IST_MRAD_BUF[1] "" SWORD _CNV_R_R_Umr_1_zu_1_42_CM_S2 1 0 -32768 32767 FORMAT "%2.0" ECU_ADDRESS 0xFFF90F6E /end MEASUREMENT
/begin MEASUREMENT M_AB_IST_MRAD_BUF[2] "" SWORD _CNV_R_R_Umr_1_zu_1_42_CM_S2 1 0 -32768 32767 FORMAT "%2.0" ECU_ADDRESS 0xFFF90F70 /end MEASUREMENT
/begin MEASUREMENT M_AB_IST_MRAD_BUF[3] "" SWORD _CNV_R_R_Umr_1_zu_1_42_CM_S2 1 0 -32768 32767 FORMAT "%2.0" ECU_ADDRESS 0xFFF90F72 /end MEASUREMENT
/begin MEASUREMENT M_AB_IST_MRAD_BUF[4] "" SWORD _CNV_R_R_Umr_1_zu_1_42_CM_S2 1 0 -32768 32767 FORMAT "%2.0" ECU_ADDRESS 0xFFF90F74 /end MEASUREMENT
/begin MEASUREMENT M_AB_IST_MRAD_BUF[5] "" SWORD _CNV_R_R_Umr_1_zu_1_42_CM_S2 1 0 -32768 32767 FORMAT "%2.0" ECU_ADDRESS 0xFFF90F76 /end MEASUREMENT
/begin MEASUREMENT M_AB_IST_MRAD_BUF[6] "" SWORD _CNV_R_R_Umr_1_zu_1_42_CM_S2 1 0 -32768 32767 FORMAT "%2.0" ECU_ADDRESS 0xFFF90F78 /end MEASUREMENT
/begin MEASUREMENT M_AB_IST_MRAD_BUF[7] "" SWORD _CNV_R_R_Umr_1_zu_1_42_CM_S2 1 0 -32768 32767 FORMAT "%2.0" ECU_ADDRESS 0xFFF90F7A /end MEASUREMENT
/begin MEASUREMENT M_AB_IST_MRAD_BUF[8] "" SWORD _CNV_R_R_Umr_1_zu_1_42_CM_S2 1 0 -32768 32767 FORMAT "%2.0" ECU_ADDRESS 0xFFF90F7C /end MEASUREMENT
/begin MEASUREMENT M_AB_IST_MRAD_BUF[9] "" SWORD _CNV_R_R_Umr_1_zu_1_42_CM_S2 1 0 -32768 32767 FORMAT "%2.0" ECU_ADDRESS 0xFFF90F7E /end MEASUREMENT
/begin MEASUREMENT M_AB_IST_MRAD_BUF[10] "" SWORD _CNV_R_R_Umr_1_zu_1_42_CM_S2 1 0 -32768 32767 FORMAT "%2.0" ECU_ADDRESS 0xFFF90F80 /end MEASUREMENT
/begin MEASUREMENT M_AB_IST_MRAD_BUF[11] "" SWORD _CNV_R_R_Umr_1_zu_1_42_CM_S2 1 0 -32768 32767 FORMAT "%2.0" ECU_ADDRESS 0xFFF90F82 /end MEASUREMENT
/begin MEASUREMENT M_AB_IST_MRAD_BUF[12] "" SWORD _CNV_R_R_Umr_1_zu_1_42_CM_S2 1 0 -32768 32767 FORMAT "%2.0" ECU_ADDRESS 0xFFF90F84 /end MEASUREMENT
/begin MEASUREMENT M_AB_IST_MRAD_BUF[13] "" SWORD _CNV_R_R_Umr_1_zu_1_42_CM_S2 1 0 -32768 32767 FORMAT "%2.0" ECU_ADDRESS 0xFFF90F86 /end MEASUREMENT
/begin MEASUREMENT M_AB_IST_MRAD_BUF[14] "" SWORD _CNV_R_R_Umr_1_zu_1_42_CM_S2 1 0 -32768 32767 FORMAT "%2.0" ECU_ADDRESS 0xFFF90F88 /end MEASUREMENT
/begin MEASUREMENT M_AB_IST_MRAD_BUF[15] "" SWORD _CNV_R_R_Umr_1_zu_1_42_CM_S2 1 0 -32768 32767 FORMAT "%2.0" ECU_ADDRESS 0xFFF90F8A /end MEASUREMENT
/begin MEASUREMENT M_AB_IST_MRAD_BUF[16] "" SWORD _CNV_R_R_Umr_1_zu_1_42_CM_S2 1 0 -32768 32767 FORMAT "%2.0" ECU_ADDRESS 0xFFF90F8C /end MEASUREMENT
/begin MEASUREMENT M_AB_IST_MRAD_BUF[17] "" SWORD _CNV_R_R_Umr_1_zu_1_42_CM_S2 1 0 -32768 32767 FORMAT "%2.0" ECU_ADDRESS 0xFFF90F8E /end MEASUREMENT
/begin MEASUREMENT M_AB_IST_MRAD_BUF[18] "" SWORD _CNV_R_R_Umr_1_zu_1_42_CM_S2 1 0 -32768 32767 FORMAT "%2.0" ECU_ADDRESS 0xFFF90F90 /end MEASUREMENT
/begin MEASUREMENT M_AB_IST_MRAD_BUF[19] "" SWORD _CNV_R_R_Umr_1_zu_1_42_CM_S2 1 0 -32768 32767 FORMAT "%2.0" ECU_ADDRESS 0xFFF90F92 /end MEASUREMENT
/begin MEASUREMENT M_AB_IST_MRAD_BUF[20] "" SWORD _CNV_R_R_Umr_1_zu_1_42_CM_S2 1 0 -32768 32767 FORMAT "%2.0" ECU_ADDRESS 0xFFF90F94 /end MEASUREMENT
/begin MEASUREMENT M_AB_IST_MRAD_DELAY "" SWORD _CNV_R_R_Umr_1_zu_1_42_CM_S2 1 0 -32768 32767 FORMAT "%2.0" ECU_ADDRESS 0xFFF90F96 /end MEASUREMENT
/begin MEASUREMENT M_AB_IST_MRAD_REST "" SWORD _CNV_R_R_Umr_1_zu_1_42_CM_S2 1 0 -32768 32767 FORMAT "%2.0" ECU_ADDRESS 0xFFF90F98 /end MEASUREMENT
/begin MEASUREMENT M_AB_IST_MRAD_UNFILT "" SWORD _CNV_R_R_Umr_1_zu_1_42_CM_S2 1 0 -32768 32767 FORMAT "%2.0" ECU_ADDRESS 0xFFF90F9A /end MEASUREMENT
/begin MEASUREMENT M_AB_MUEFILT "" SWORD _CNV_R_R_Umr_1_zu_1_42_CM_S2 1 0 -32000 32000 FORMAT "%2.0" ECU_ADDRESS 0xFFF90F9C /end MEASUREMENT
/begin MEASUREMENT M_AB_MUEFILTREST "" SWORD _CNV_R_R_Umr_1_zu_1_42_CM_S2 1 0 -32768 32767 FORMAT "%2.0" ECU_ADDRESS 0xFFF90F9E /end MEASUREMENT
/begin MEASUREMENT M_AB_ROT "" SWORD _CNV_R_R_Umr_1_zu_1_42_CM_S2 1 0 -32768 32767 FORMAT "%2.0" ECU_ADDRESS 0xFFF911BC /end MEASUREMENT
/begin MEASUREMENT M_AB_ROT_FWSALT "" SWORD _CNV_R_R_Umr_1_zu_1_42_CM_S2 1 0 -32768 32767 FORMAT "%2.0" ECU_ADDRESS 0xFFF911BE /end MEASUREMENT
/begin MEASUREMENT M_RAD_FWSREF "" UWORD _CNV_R_R_Umr_1_zu_1_42_CM_S2 1 0 0 1000 FORMAT "%2.0" ECU_ADDRESS 0xFFF911C0 /end MEASUREMENT
/begin MEASUREMENT ODM_AB_FWSKORLUFT "" SWORD _CNV_R_R_Umr_1_zu_1_42_CM_S2 1 0 0 256 FORMAT "%2.0" ECU_ADDRESS 0xFFF90FA0 /end MEASUREMENT
/begin MEASUREMENT ODM_AB_FWSKORTEMP "" SWORD _CNV_R_R_Umr_1_zu_1_42_CM_S2 1 0 -127 127 FORMAT "%2.0" ECU_ADDRESS 0xFFF90FA2 /end MEASUREMENT
/begin MEASUREMENT SUM_G3WAB_FILT "" SWORD _CNV_R_R_Umr_10_zu__305_CM_S2 1 0 -3276.8 3276.7 ECU_ADDRESS 0xFFF90FA4 /end MEASUREMENT
/begin MEASUREMENT SUM_G3WAB_FWSFILTBUFFER "" SWORD _CNV_R_R_Umr_10_zu__305_CM_S2 1 0 -3276.8 3276.7 ARRAY_SIZE 5 ECU_ADDRESS 0xFFF90FA6 MATRIX_DIM 5 1 1 /end MEASUREMENT
/begin MEASUREMENT S_ABS_ERK "" UBYTE _CNV_P_2_A_I_5_CM_S2 1 0 0 255 ECU_ADDRESS 0xFFF91783 /end MEASUREMENT
/begin MEASUREMENT S_MUE_STATISCH "" UBYTE _CNV_P_2_A_I_5_CM_S2 1 0 0 255 ECU_ADDRESS 0xFFF915F8 /end MEASUREMENT
/begin MEASUREMENT S_MUE_UEBERGANG "" UBYTE _CNV_P_2_A_I_5_CM_S2 1 0 0 255 ECU_ADDRESS 0xFFF915F9 /end MEASUREMENT
/begin MEASUREMENT S_USE_MABBREMS_FWSBER "" UBYTE _CNV_R_R_Umr_1_zu_1_2_CM_S2 1 0 0 1 FORMAT "%2.0" ECU_ADDRESS 0xFFF915FA /end MEASUREMENT
/begin MEASUREMENT S_VALID_DMABFWS "" UBYTE _CNV_P_2_A_I_5_CM_S2 1 0 0 1 ECU_ADDRESS 0xFFF915FB /end MEASUREMENT
/begin MEASUREMENT S_VALID_DMABFWS_ACT_MSASTART "" UBYTE _CNV_R_R_Umr_1_zu_1_2_CM_S2 1 0 0 1 ECU_ADDRESS 0xFFF915FC /end MEASUREMENT
/begin MEASUREMENT S_VALID_DMABFWS_BREMS "" UBYTE _CNV_R_R_Umr_1_zu_1_2_CM_S2 1 0 0 1 ECU_ADDRESS 0xFFF915FE /end MEASUREMENT
/begin MEASUREMENT S_VALID_DMABFWS_BREMSNACHL "" UBYTE _CNV_R_R_Umr_1_zu_1_2_CM_S2 1 0 0 1 ECU_ADDRESS 0xFFF915FF /end MEASUREMENT
/begin MEASUREMENT S_VALID_DMABFWS_GWFP "" UBYTE _CNV_R_R_Umr_1_zu_1_2_CM_S2 1 0 0 1 ECU_ADDRESS 0xFFF91600 /end MEASUREMENT
/begin MEASUREMENT S_VALID_DMABFWS_MSASTART "" UBYTE _CNV_R_R_Umr_1_zu_1_2_CM_S2 1 0 0 1 ECU_ADDRESS 0xFFF915FD /end MEASUREMENT
/begin MEASUREMENT S_VALID_DMABFWS_SCHALT "" UBYTE _CNV_R_R_Umr_1_zu_1_2_CM_S2 1 0 0 1 ECU_ADDRESS 0xFFF91601 /end MEASUREMENT
/begin MEASUREMENT S_VALID_DMABFWS_SCHLUPF "" UBYTE _CNV_R_R_Umr_1_zu_1_2_CM_S2 1 0 0 1 ECU_ADDRESS 0xFFF91602 /end MEASUREMENT
/begin MEASUREMENT T_BUFFER_SPERR_FWSVALID_MSASTART "" ULONG _CNV_R_R_Umr_1_zu_1_6_CM_S2 1 0 0 4294967295 FORMAT "%2.0" ECU_ADDRESS 0xFFF905D0 /end MEASUREMENT
/begin MEASUREMENT T_BUFFER_VALIDFWS_BREMS "" ULONG _CNV_R_R_Umr_1_zu_1_6_CM_S2 1 0 0 4294967295 FORMAT "%2.0" ECU_ADDRESS 0xFFF905D8 /end MEASUREMENT
/begin MEASUREMENT T_BUFFER_VALIDFWS_BREMS_FLANKE "" ULONG _CNV_R_R_Umr_1_zu_1_6_CM_S2 1 0 0 4294967295 FORMAT "%2.0" ECU_ADDRESS 0xFFF905DC /end MEASUREMENT
/begin MEASUREMENT T_BUFFER_VALIDFWS_GWFP "" ULONG _CNV_R_R_Umr_1_zu_1_6_CM_S2 1 0 0 4294967295 FORMAT "%2.0" ECU_ADDRESS 0xFFF905E0 /end MEASUREMENT
/begin MEASUREMENT T_MUE_UEBER "" SLONG _CNV_R_R_Umr_1_zu_1_6_CM_S2 1 0 -2147483647 2147483647 FORMAT "%2.0" ECU_ADDRESS 0xFFF905E4 /end MEASUREMENT
/begin MEASUREMENT T_MUE_UEBERBUF "" ULONG _CNV_R_R_Umr_1_zu_1_6_CM_S2 1 0 0 2147483647 FORMAT "%2.0" ECU_ADDRESS 0xFFF905E8 /end MEASUREMENT
/begin MEASUREMENT T_PRUEF1_VALIDFWS "" UWORD _CNV_R_R_Umr_1_zu_1_6_CM_S2 1 0 0 65535 FORMAT "%2.0" ECU_ADDRESS 0xFFF90FB0 /end MEASUREMENT
/begin MEASUREMENT T_PRUEF2_VALIDFWS "" SWORD _CNV_R_R_Umr_1_zu_1_6_CM_S2 1 0 -32768 32767 FORMAT "%2.0" ECU_ADDRESS 0xFFF90FB2 /end MEASUREMENT
/begin MEASUREMENT T_SPERR_FWSVALID_MSASTART "" ULONG _CNV_R_R_Umr_1_zu_1_6_CM_S2 1 0 0 4294967295 FORMAT "%2.0" ECU_ADDRESS 0xFFF905D4 /end MEASUREMENT
/begin MEASUREMENT T_TIMESTAMP_FWSALT "" ULONG _CNV_R_R_Umr_1_zu_1_6_CM_S2 1 0 0 4294967295 FORMAT "%2.0" ECU_ADDRESS 0xFFF905EC /end MEASUREMENT
/begin MEASUREMENT T_TIMESTAMP_FWSVALIDALT "" ULONG _CNV_R_R_Umr_1_zu_1_6_CM_S2 1 0 0 4294967295 FORMAT "%2.0" ECU_ADDRESS 0xFFF905F0 /end MEASUREMENT
/begin MEASUREMENT T_VALIDFWS_BREMS "" ULONG _CNV_R_R_Umr_1_zu_1_6_CM_S2 1 0 0 4294967295 FORMAT "%2.0" ECU_ADDRESS 0xFFF905F4 /end MEASUREMENT
/begin MEASUREMENT T_VALIDFWS_BREMS_FLANKE "" UWORD _CNV_R_R_Umr_1_zu_1_6_CM_S2 1 0 0 1000 FORMAT "%2.0" ECU_ADDRESS 0xFFF90FB4 /end MEASUREMENT
/begin MEASUREMENT T_VALIDFWS_GWFP "" UWORD _CNV_R_R_Umr_1_zu_1_6_CM_S2 1 0 0 65535 FORMAT "%2.0" ECU_ADDRESS 0xFFF90FB6 /end MEASUREMENT
/begin MEASUREMENT Z_GANG_ZIELALT_FWS "" UBYTE _CNV_S_9_Enum_EGANG_30_CM_S2 1 0 0 8 ECU_ADDRESS 0xFFF91603 /end MEASUREMENT
/begin MEASUREMENT Z_T_PRUEF1_VALIDFWS "" UBYTE _CNV_R_R_Umr_1_zu_1_2_CM_S2 1 0 0 1 ECU_ADDRESS 0xFFF91604 /end MEASUREMENT
/begin MEASUREMENT Z_T_PRUEF2_VALIDFWS "" UBYTE _CNV_R_R_Umr_1_zu_1_2_CM_S2 1 0 0 2 ECU_ADDRESS 0xFFF91605 /end MEASUREMENT
/begin MEASUREMENT DM_RAD_FWSGEW "" SWORD _CNV_R_R_Umr_1_zu_1_42_CM_S2 1 0 -32768 32767 FORMAT "%2.0" ECU_ADDRESS 0xFFF9107A /end MEASUREMENT
/begin MEASUREMENT DM_RAD_FWSGEWFILT "" SWORD _CNV_R_R_Umr_1_zu_1_42_CM_S2 1 0 -32768 32767 FORMAT "%2.0" ECU_ADDRESS 0xFFF9107C /end MEASUREMENT
/begin MEASUREMENT DM_RAD_FWSGEWFILT_ALT "" SWORD _CNV_R_R_Umr_1_zu_1_42_CM_S2 1 0 -32768 32767 FORMAT "%2.0" ECU_ADDRESS 0xFFF9107E /end MEASUREMENT
/begin MEASUREMENT DM_RAD_FWS_FILTREST "" SWORD _CNV_R_R_Umr_1_zu_1_42_CM_S2 1 0 -32768 32767 FORMAT "%2.0" ECU_ADDRESS 0xFFF91080 /end MEASUREMENT
/begin MEASUREMENT DM_RAD_FWS_GRADBEGR "" SWORD _CNV_R_R_Umr_1_zu_1_42_CM_S2 1 0 -32768 32767 FORMAT "%2.0" ECU_ADDRESS 0xFFF91082 /end MEASUREMENT
/begin MEASUREMENT DM_RAD_FWS_STEIGUNG "" SWORD _CNV_R_R_Umr_1_zu_1_42_CM_S2 1 0 -32768 32767 FORMAT "%2.0" ECU_ADDRESS 0xFFF91084 /end MEASUREMENT
/begin MEASUREMENT DM_RAD_KOMP "" SWORD _CNV_R_R_Umr_1_zu_1_42_CM_S2 1 0 -2000 2000 FORMAT "%2.0" ECU_ADDRESS 0xFFF91086 /end MEASUREMENT
/begin MEASUREMENT FAKT_RADKOMP "" SWORD _CNV_R_R_Umr_1_zu_1_53_CM_S2 1 0 -32768 32767 FORMAT "%2.0" ECU_ADDRESS 0xFFF91088 /end MEASUREMENT
/begin MEASUREMENT FUNKINIT_DONE_KOMP "" UBYTE _CNV_P_2_A_I_5_CM_S2 1 0 0 255 ECU_ADDRESS 0xFFF9163D /end MEASUREMENT
/begin MEASUREMENT GDM_RAD_KOMP "" SLONG _CNV_R_R_Umr_1_zu_1_2_CM_S2 1 0 -2147483648 2147483647 FORMAT "%5.3" ECU_ADDRESS 0xFFF90724 /end MEASUREMENT
/begin MEASUREMENT T_DMRADKOMP_ALT "" ULONG _CNV_R_R_Umr_1_zu_1_6_CM_S2 1 0 0 4294967295 FORMAT "%2.0" ECU_ADDRESS 0xFFF90728 /end MEASUREMENT
/begin MEASUREMENT Z_GDM_RAD_KOMP "" UBYTE _CNV_S_3_Enum_EGDM__308_CM_S2 1 0 0 2 ECU_ADDRESS 0xFFF9163E /end MEASUREMENT
/begin MEASUREMENT A_Q_KURVE "" SWORD _CNV_R_R_Umr_10_zu__46_CM_S2 1 0 -3276.8 3276.7 FORMAT "%3.1" ECU_ADDRESS 0xFFF9108A /end MEASUREMENT
/begin MEASUREMENT A_Q_KURVEBUF "" SWORD _CNV_R_R_Umr_10_zu__46_CM_S2 1 0 -3276.8 3276.7 FORMAT "%3.1" ARRAY_SIZE 20 ECU_ADDRESS 0xFFF9072C MATRIX_DIM 20 1 1 /end MEASUREMENT
/begin MEASUREMENT C_INSERT_AQKURVEBUF "" UBYTE _CNV_R_R_Umr_1_zu_1_2_CM_S2 1 0 0 255 FORMAT "%2.0" ECU_ADDRESS 0xFFF9163F /end MEASUREMENT
/begin MEASUREMENT DA_Q_KURVE "" SWORD _CNV_R_R_Umr_10_zu__46_CM_S2 1 0 -20 20 FORMAT "%3.1" ECU_ADDRESS 0xFFF9108E /end MEASUREMENT
/begin MEASUREMENT DN_RAD_HAKURVE "" UWORD _CNV_R_R_Umr_1_zu_1_3_CM_S2 1 0 0 20000 FORMAT "%2.0" ECU_ADDRESS 0xFFF91090 /end MEASUREMENT
/begin MEASUREMENT FUNKINIT_DONE_KURVE "" UBYTE _CNV_R_R_Umr_1_zu_1_2_CM_S2 1 0 0 255 FORMAT "%2.0" ECU_ADDRESS 0xFFF91640 /end MEASUREMENT
/begin MEASUREMENT SCHA_Q_SERP "" UWORD _CNV_R_R_Umr_10_zu__46_CM_S2 1 0 0 6553.5 FORMAT "%3.1" ECU_ADDRESS 0xFFF91092 /end MEASUREMENT
/begin MEASUREMENT SCHW_LWVA_EFF_KURVE "" SWORD _CNV_R_R_Umr_10_zu__10_CM_S2 1 0 -90 90 FORMAT "%3.1" ECU_ADDRESS 0xFFF91094 /end MEASUREMENT
/begin MEASUREMENT SCHW_LWVA_EFF_SERP "" SWORD _CNV_R_R_Umr_10_zu__10_CM_S2 1 0 -90 90 FORMAT "%3.1" ECU_ADDRESS 0xFFF91096 /end MEASUREMENT
/begin MEASUREMENT S_AQ_ERROR "" UBYTE _CNV_S_3_Enum_ERRDS_86_CM_S2 1 0 0 2 ECU_ADDRESS 0xFFF91641 /end MEASUREMENT
/begin MEASUREMENT S_HALT_KURVELDMNACHL "" UBYTE _CNV_P_2_A_I_5_CM_S2 1 0 0 255 ECU_ADDRESS 0xFFF91642 /end MEASUREMENT
/begin MEASUREMENT S_HALT_KURVENACHL "" UBYTE _CNV_P_2_A_I_5_CM_S2 1 0 0 255 ECU_ADDRESS 0xFFF91643 /end MEASUREMENT
/begin MEASUREMENT T_BUFFER_KURVELDMNACHL "" ULONG _CNV_R_R_Umr_1_zu_1_6_CM_S2 1 0 0 4294967295 FORMAT "%2.0" ECU_ADDRESS 0xFFF90754 /end MEASUREMENT
/begin MEASUREMENT T_BUFFER_KURVENACHL "" ULONG _CNV_R_R_Umr_1_zu_1_6_CM_S2 1 0 0 4294967295 FORMAT "%2.0" ECU_ADDRESS 0xFFF90758 /end MEASUREMENT
/begin MEASUREMENT T_BUFFER_NACHLAUF_EINLENK "" ULONG _CNV_R_R_Umr_1_zu_1_6_CM_S2 1 0 0 4294967295 FORMAT "%2.0" ECU_ADDRESS 0xFFF9075C /end MEASUREMENT
/begin MEASUREMENT T_BUFFER_SERP "" ULONG _CNV_R_R_Umr_1_zu_1_6_CM_S2 1 0 0 4294967295 FORMAT "%2.0" ECU_ADDRESS 0xFFF90760 /end MEASUREMENT
/begin MEASUREMENT T_HALT_KURVELDMNACHL "" ULONG _CNV_R_R_Umr_1_zu_1_6_CM_S2 1 0 0 2147483647 FORMAT "%2.0" ECU_ADDRESS 0xFFF90764 /end MEASUREMENT
/begin MEASUREMENT T_HALT_KURVELDMNACHLSUM "" ULONG _CNV_R_R_Umr_1_zu_1_6_CM_S2 1 0 0 2147483647 FORMAT "%2.0" ECU_ADDRESS 0xFFF90768 /end MEASUREMENT
/begin MEASUREMENT T_HALT_KURVENACHL "" ULONG _CNV_R_R_Umr_1_zu_1_6_CM_S2 1 0 0 2147483647 FORMAT "%2.0" ECU_ADDRESS 0xFFF9076C /end MEASUREMENT
/begin MEASUREMENT T_HALT_KURVENACHLSUM "" ULONG _CNV_R_R_Umr_1_zu_1_6_CM_S2 1 0 0 2147483647 FORMAT "%2.0" ECU_ADDRESS 0xFFF90770 /end MEASUREMENT
/begin MEASUREMENT T_HALT_LDMSTART "" ULONG _CNV_R_R_Umr_1_zu_1_6_CM_S2 1 0 0 2147483647 FORMAT "%2.0" ECU_ADDRESS 0xFFF90774 /end MEASUREMENT
/begin MEASUREMENT T_HALT_START "" ULONG _CNV_R_R_Umr_1_zu_1_6_CM_S2 1 0 0 2147483647 FORMAT "%2.0" ECU_ADDRESS 0xFFF90778 /end MEASUREMENT
/begin MEASUREMENT T_KURVE_LDMNACHL "" SLONG _CNV_R_R_Umr_1_zu_1_6_CM_S2 1 0 -2147483647 2147483647 FORMAT "%2.0" ECU_ADDRESS 0xFFF9077C /end MEASUREMENT
/begin MEASUREMENT T_KURVE_NACHL "" SLONG _CNV_R_R_Umr_1_zu_1_6_CM_S2 1 0 -2147483647 2147483647 FORMAT "%2.0" ECU_ADDRESS 0xFFF90780 /end MEASUREMENT
/begin MEASUREMENT T_NACHLAUF_EINLENK "" SLONG _CNV_R_R_Umr_1_zu_1_6_CM_S2 1 0 -2147483648 2147483647 FORMAT "%2.0" ECU_ADDRESS 0xFFF90784 /end MEASUREMENT
/begin MEASUREMENT T_SERP "" SLONG _CNV_R_R_Umr_1_zu_1_6_CM_S2 1 0 -2147483647 2147483647 FORMAT "%2.0" ECU_ADDRESS 0xFFF90788 /end MEASUREMENT
/begin MEASUREMENT W_LWVA_EFF_FILT "" SWORD _CNV_R_R_Umr_10_zu__10_CM_S2 1 0 -90 90 FORMAT "%3.1" ECU_ADDRESS 0xFFF910A8 /end MEASUREMENT
/begin MEASUREMENT W_LWVA_EFF_FILTREST "" SWORD _CNV_R_R_Umr_1_zu_1_2_CM_S2 1 0 -32768 32767 FORMAT "%3.1" ECU_ADDRESS 0xFFF910AA /end MEASUREMENT
/begin MEASUREMENT Z_AGS_TID_MOD "" UBYTE _CNV_S_3_Enum_EAGST_312_CM_S2 1 0 0 2 ECU_ADDRESS 0xFFF91644 /end MEASUREMENT
/begin MEASUREMENT Z_EINLENK "" UBYTE _CNV_S_2_Schalter_A_4_CM_S2 1 0 0 1 ECU_ADDRESS 0xFFF91645 /end MEASUREMENT
/begin MEASUREMENT Z_KURVE "" UBYTE _CNV_S_3_Enum_EKURV_313_CM_S2 1 0 0 2 ECU_ADDRESS 0xFFF91646 /end MEASUREMENT
/begin MEASUREMENT Z_KURVETYP_NORMAL "" UBYTE _CNV_S_5_Enum_EKURV_310_CM_S2 1 0 0 4 ECU_ADDRESS 0xFFF91647 /end MEASUREMENT
/begin MEASUREMENT Z_KURVE_LDM "" UBYTE _CNV_S_3_Enum_EKURV_313_CM_S2 1 0 0 2 ECU_ADDRESS 0xFFF91648 /end MEASUREMENT
/begin MEASUREMENT Z_KURVE_LDMNACHL "" UBYTE _CNV_S_3_Enum_EKURV_313_CM_S2 1 0 0 2 ECU_ADDRESS 0xFFF91649 /end MEASUREMENT
/begin MEASUREMENT Z_KURVE_LDMVORL "" UBYTE _CNV_S_3_Enum_EKURV_313_CM_S2 1 0 0 2 ECU_ADDRESS 0xFFF9164A /end MEASUREMENT
/begin MEASUREMENT Z_KURVE_NACHL "" UBYTE _CNV_S_3_Enum_EKURV_313_CM_S2 1 0 0 2 ECU_ADDRESS 0xFFF9164B /end MEASUREMENT
/begin MEASUREMENT Z_KURVE_VORL "" UBYTE _CNV_S_3_Enum_EKURV_313_CM_S2 1 0 0 2 ECU_ADDRESS 0xFFF9164C /end MEASUREMENT
/begin MEASUREMENT Z_MOD_KURVE "" UBYTE _CNV_S_4_Enum_EKURV_311_CM_S2 1 0 0 3 ECU_ADDRESS 0xFFF9164D /end MEASUREMENT
/begin MEASUREMENT Z_SERP "" UBYTE _CNV_S_3_Enum_EKURV_313_CM_S2 1 0 0 2 ECU_ADDRESS 0xFFF9164E /end MEASUREMENT
/begin MEASUREMENT Z_SERPALT "" UBYTE _CNV_S_3_Enum_EKURV_313_CM_S2 1 0 0 2 ECU_ADDRESS 0xFFF9164F /end MEASUREMENT
/begin MEASUREMENT Z_SERP_SETEINSTIEG "" UBYTE _CNV_P_2_A_I_5_CM_S2 1 0 0 255 ECU_ADDRESS 0xFFF91650 /end MEASUREMENT
/begin MEASUREMENT S_MSA_VERBOT "" UBYTE _CNV_S_2_Schalter_A_4_CM_S2 1 0 0 1 ECU_ADDRESS 0xFFF912E3 /end MEASUREMENT
/begin MEASUREMENT S_MSA_VERBOT_FAS "" UBYTE _CNV_S_2_Schalter_A_4_CM_S2 1 0 0 1 ECU_ADDRESS 0xFFF912E4 /end MEASUREMENT
/begin MEASUREMENT S_MSA_VERBOT_SERP "" UBYTE _CNV_S_2_Schalter_A_4_CM_S2 1 0 0 1 ECU_ADDRESS 0xFFF912E6 /end MEASUREMENT
/begin MEASUREMENT S_MSA_VERBOT_STEIGUNG "" UBYTE _CNV_S_2_Schalter_A_4_CM_S2 1 0 0 1 ECU_ADDRESS 0xFFF912E5 /end MEASUREMENT
/begin MEASUREMENT S_MSA_VERBOT_STEIGUNGNACHL "" UBYTE _CNV_S_2_Schalter_A_4_CM_S2 1 0 0 1 ECU_ADDRESS 0xFFF912E7 /end MEASUREMENT
/begin MEASUREMENT T_MSA_VERBOT_STEIGUNGNACHL "" UWORD _CNV_R_R_Umr_1_zu_1_6_CM_S2 1 0 0 10000 FORMAT "%2.0" ECU_ADDRESS 0xFFF90B04 /end MEASUREMENT
/begin MEASUREMENT DN_K0_SOLL "" UWORD _CNV_R_R_Umr_1_zu_1_3_CM_S2 1 0 0 10000 FORMAT "%2.0" ECU_ADDRESS 0xFFF90AFA /end MEASUREMENT
/begin MEASUREMENT FAKT_GK0_FDYN "" UBYTE _CNV_R_R_Umr_1_zu_1_53_CM_S2 1 0 0 100 FORMAT "%2.0" ECU_ADDRESS 0xFFF912C1 /end MEASUREMENT
/begin MEASUREMENT IDX_M_VMHYST_K0 "" UBYTE _CNV_R_R_Umr_1_zu_1_2_CM_S2 1 0 0 255 FORMAT "%2.0" ECU_ADDRESS 0xFFF915CB /end MEASUREMENT
/begin MEASUREMENT IDX_N_VMHYST_K0 "" UBYTE _CNV_R_R_Umr_1_zu_1_2_CM_S2 1 0 0 255 FORMAT "%2.0" ECU_ADDRESS 0xFFF915CC /end MEASUREMENT
/begin MEASUREMENT S_GK0_FAHRDYNAMIK "" UBYTE _CNV_R_R_Umr_1_zu_1_2_CM_S2 1 0 0 255 FORMAT "%2.0" ECU_ADDRESS 0xFFF912C2 /end MEASUREMENT
/begin MEASUREMENT Z_GANG_ZIEL_K0ALT "" UBYTE _CNV_S_9_Enum_EGANG_30_CM_S2 1 0 0 8 ECU_ADDRESS 0xFFF915CD /end MEASUREMENT
/begin MEASUREMENT Z_K0_SOLL "" UBYTE _CNV_S_12_Enum_EK0_S_91_CM_S2 1 0 0 11 ECU_ADDRESS 0xFFF912C3 /end MEASUREMENT
/begin MEASUREMENT A_MODWHYB_EM "" SWORD _CNV_R_R_Umr_100_zu_329_CM_S2 1 0 -5 5 FORMAT "%4.2" ECU_ADDRESS 0xFFF909F0 /end MEASUREMENT
/begin MEASUREMENT A_MODWHYB_SUMME "" SWORD _CNV_R_R_Umr_100_zu_329_CM_S2 1 0 -5 5 FORMAT "%4.2" ECU_ADDRESS 0xFFF909F2 /end MEASUREMENT
/begin MEASUREMENT DBG_FES1_DBM "" SLONG _CNV_R_R_Umr_1_zu_1_2_CM_S2 1 0 -2147483648 2147483647 FORMAT "%2.0" ECU_ADDRESS 0xFFF90140 /end MEASUREMENT
/begin MEASUREMENT DBG_FES2_DBM "" SLONG _CNV_R_R_Umr_1_zu_1_2_CM_S2 1 0 -2147483648 2147483647 FORMAT "%2.0" ECU_ADDRESS 0xFFF90144 /end MEASUREMENT
/begin MEASUREMENT DBG_FES3_DBM "" SLONG _CNV_R_R_Umr_1_zu_1_2_CM_S2 1 0 -2147483648 2147483647 FORMAT "%2.0" ECU_ADDRESS 0xFFF90148 /end MEASUREMENT
/begin MEASUREMENT DBG_FES4_DBM "" SLONG _CNV_R_R_Umr_1_zu_1_2_CM_S2 1 0 -2147483648 2147483647 FORMAT "%2.0" ECU_ADDRESS 0xFFF9014C /end MEASUREMENT
/begin MEASUREMENT DBG_FES5_DBM "" SLONG _CNV_R_R_Umr_1_zu_1_2_CM_S2 1 0 -2147483648 2147483647 FORMAT "%2.0" ECU_ADDRESS 0xFFF90150 /end MEASUREMENT
/begin MEASUREMENT FAKT_AUSROLLRS_DBM "" SWORD _CNV_R_R_Umr_1_zu_1_2_CM_S2 1 0 0 500 FORMAT "%2.0" ARRAY_SIZE 9 ECU_ADDRESS 0xFFF909F4 MATRIX_DIM 9 1 1 /end MEASUREMENT
/begin MEASUREMENT FAKT_M_RAD_NMOTHS "" SWORD _CNV_R_R_Umr_1_zu_1_53_CM_S2 1 0 -32768 32767 FORMAT "%2.0" ECU_ADDRESS 0xFFF90ADA /end MEASUREMENT
/begin MEASUREMENT INVALID_GEARS_LMPH "" SWORD _CNV_S_2_Enum_EINVA_330_CM_S2 1 0 0 1 ARRAY_SIZE 9 ECU_ADDRESS 0xFFF90A06 MATRIX_DIM 9 1 1 /end MEASUREMENT
/begin MEASUREMENT M_MODWHYB_DBM "" SLONG _CNV_R_R_Umr_1_zu_1_42_CM_S2 1 0 -2147483648 2147483647 FORMAT "%2.0" ARRAY_SIZE 9 ECU_ADDRESS 0xFFF9011C MATRIX_DIM 9 1 1 /end MEASUREMENT
/begin MEASUREMENT M_RAD_IST_ZUSTART "" SWORD _CNV_R_R_Umr_1_zu_1_42_CM_S2 1 0 0 10000 FORMAT "%2.0" ECU_ADDRESS 0xFFF90A18 /end MEASUREMENT
/begin MEASUREMENT M_RAD_OFFSET_ZUSTART "" SWORD _CNV_R_R_Umr_1_zu_1_42_CM_S2 1 0 0 4000 FORMAT "%2.0" ECU_ADDRESS 0xFFF90A1A /end MEASUREMENT
/begin MEASUREMENT M_RAD_OFFSET_ZUSTART_INSTAT "" SWORD _CNV_R_R_Umr_1_zu_1_42_CM_S2 1 0 0 4000 FORMAT "%2.0" ECU_ADDRESS 0xFFF90A1C /end MEASUREMENT
/begin MEASUREMENT M_REKUP_DBM "" SWORD _CNV_R_R_Umr_1_zu_1_42_CM_S2 1 0 -1023 1023 FORMAT "%2.0" ECU_ADDRESS 0xFFF90A1E /end MEASUREMENT
/begin MEASUREMENT N_AB_ARSSTD "" SWORD _CNV_R_R_Umr_1_zu_1_3_CM_S2 1 0 -32768 32767 FORMAT "%2.0" ARRAY_SIZE 9 ECU_ADDRESS 0xFFF90938 MATRIX_DIM 9 1 1 /end MEASUREMENT
/begin MEASUREMENT N_AB_ARSSTD_DBM "" SWORD _CNV_R_R_Umr_1_zu_1_3_CM_S2 1 0 -32768 32767 FORMAT "%2.0" ARRAY_SIZE 9 ECU_ADDRESS 0xFFF9094A MATRIX_DIM 9 1 1 /end MEASUREMENT
/begin MEASUREMENT N_AB_ARSSTD_EXKL "" SWORD _CNV_R_R_Umr_1_zu_1_3_CM_S2 1 0 -32768 32767 FORMAT "%2.0" ARRAY_SIZE 9 ECU_ADDRESS 0xFFF9095C MATRIX_DIM 9 1 1 /end MEASUREMENT
/begin MEASUREMENT N_AB_DELTANMOTHS_DBM "" SWORD _CNV_R_R_Umr_1_zu_1_3_CM_S2 1 0 -32000 32000 FORMAT "%2.0" ECU_ADDRESS 0xFFF90A20 /end MEASUREMENT
/begin MEASUREMENT N_AB_HSZIELKD_DBM "" UWORD _CNV_R_R_Umr_1_zu_1_3_CM_S2 1 0 0 20000 FORMAT "%2.0" ECU_ADDRESS 0xFFF90A22 /end MEASUREMENT
/begin MEASUREMENT N_AB_HSZIEL_DBM "" UWORD _CNV_R_R_Umr_1_zu_1_3_CM_S2 1 0 0 20000 FORMAT "%2.0" ECU_ADDRESS 0xFFF90A24 /end MEASUREMENT
/begin MEASUREMENT N_AB_RSZIELKD_DBM "" UWORD _CNV_R_R_Umr_1_zu_1_3_CM_S2 1 0 0 20000 FORMAT "%2.0" ECU_ADDRESS 0xFFF90A26 /end MEASUREMENT
/begin MEASUREMENT N_AB_RSZIEL_DBM "" UWORD _CNV_R_R_Umr_1_zu_1_3_CM_S2 1 0 0 20000 FORMAT "%2.0" ECU_ADDRESS 0xFFF90A28 /end MEASUREMENT
/begin MEASUREMENT N_AKT_MAX_DBM "" SWORD _CNV_R_R_Umr_1_zu_1_3_CM_S2 1 0 -32768 32767 FORMAT "%2.0" ECU_ADDRESS 0xFFF90A2A /end MEASUREMENT
/begin MEASUREMENT N_AKT_MIN_DBM "" SWORD _CNV_R_R_Umr_1_zu_1_3_CM_S2 1 0 -32768 32767 FORMAT "%2.0" ECU_ADDRESS 0xFFF90A2C /end MEASUREMENT
/begin MEASUREMENT N_DSPV_DBM "" SWORD _CNV_R_R_Umr_1_zu_1_3_CM_S2 1 0 -32768 32767 ARRAY_SIZE 9 ECU_ADDRESS 0xFFF90A2E MATRIX_DIM 9 1 1 /end MEASUREMENT
/begin MEASUREMENT N_EM_ECK "" UWORD _CNV_R_R_Umr_1_zu_1_3_CM_S2 1 0 0 8000 FORMAT "%2.0" ECU_ADDRESS 0xFFF90A40 /end MEASUREMENT
/begin MEASUREMENT N_GETR_EINVIRT_MODWHYB "" SWORD _CNV_R_R_Umr_1_zu_1_3_CM_S2 1 0 -32768 32767 FORMAT "%2.0" ARRAY_SIZE 9 ECU_ADDRESS 0xFFF9096E MATRIX_DIM 9 1 1 /end MEASUREMENT
/begin MEASUREMENT N_MOT_HSZIELKD_DBM "" UWORD _CNV_R_R_Umr_1_zu_1_3_CM_S2 1 0 0 20000 FORMAT "%2.0" ECU_ADDRESS 0xFFF90A42 /end MEASUREMENT
/begin MEASUREMENT N_MOT_HSZIEL_DBM "" UWORD _CNV_R_R_Umr_1_zu_1_3_CM_S2 1 0 0 20000 FORMAT "%2.0" ECU_ADDRESS 0xFFF90A44 /end MEASUREMENT
/begin MEASUREMENT N_MOT_RSZIELKD_DBM "" UWORD _CNV_R_R_Umr_1_zu_1_3_CM_S2 1 0 0 20000 FORMAT "%2.0" ECU_ADDRESS 0xFFF90A46 /end MEASUREMENT
/begin MEASUREMENT N_MOT_RSZIEL_DBM "" UWORD _CNV_R_R_Umr_1_zu_1_3_CM_S2 1 0 0 20000 FORMAT "%2.0" ECU_ADDRESS 0xFFF90A48 /end MEASUREMENT
/begin MEASUREMENT N_MOT_SOLLLL_DBM "" UWORD _CNV_R_R_Umr_1_zu_1_3_CM_S2 1 0 0 3000 FORMAT "%2.0" ECU_ADDRESS 0xFFF90A4A /end MEASUREMENT
/begin MEASUREMENT N_STABI_DBM "" SWORD _CNV_R_R_Umr_1_zu_1_3_CM_S2 1 0 -32768 32767 FORMAT "%2.0" ARRAY_SIZE 9 ECU_ADDRESS 0xFFF90A4C MATRIX_DIM 9 1 1 /end MEASUREMENT
/begin MEASUREMENT N_TMIN_ARSDYN_DBM "" SWORD _CNV_R_R_Umr_1_zu_1_3_CM_S2 1 0 -32768 32767 FORMAT "%2.0" ARRAY_SIZE 9 ECU_ADDRESS 0xFFF90980 MATRIX_DIM 9 1 1 /end MEASUREMENT
/begin MEASUREMENT N_T_ARSSTD "" SWORD _CNV_R_R_Umr_1_zu_1_3_CM_S2 1 0 -32768 32767 FORMAT "%2.0" ARRAY_SIZE 9 ECU_ADDRESS 0xFFF90992 MATRIX_DIM 9 1 1 /end MEASUREMENT
/begin MEASUREMENT ON_T_ARSDYNMAX_DBM "" SWORD _CNV_R_R_Umr_1_zu_1_3_CM_S2 1 0 -32768 32767 FORMAT "%2.0" ARRAY_SIZE 9 ECU_ADDRESS 0xFFF909A4 MATRIX_DIM 9 1 1 /end MEASUREMENT
/begin MEASUREMENT ON_T_ARSDYN_DBM "" SWORD _CNV_R_R_Umr_1_zu_1_3_CM_S2 1 0 -32768 32767 FORMAT "%2.0" ARRAY_SIZE 9 ECU_ADDRESS 0xFFF909B6 MATRIX_DIM 9 1 1 /end MEASUREMENT
/begin MEASUREMENT SCHN_ABAKTSTRAT_MAX_DBM "" SWORD _CNV_R_R_Umr_1_zu_1_3_CM_S2 1 0 -32768 32767 FORMAT "%2.0" ECU_ADDRESS 0xFFF90A5E /end MEASUREMENT
/begin MEASUREMENT SCHN_ABAKTSTRAT_MIN_DBM "" SWORD _CNV_R_R_Umr_1_zu_1_3_CM_S2 1 0 -32768 32767 FORMAT "%2.0" ECU_ADDRESS 0xFFF90A60 /end MEASUREMENT
/begin MEASUREMENT SCHN_ABAKT_DSPORT_MIN_DBM "" SWORD _CNV_R_R_Umr_1_zu_1_3_CM_S2 1 0 -32768 32767 FORMAT "%2.0" ECU_ADDRESS 0xFFF90A62 /end MEASUREMENT
/begin MEASUREMENT SCHN_ABAKT_LPA_MIN_DBM "" SWORD _CNV_R_R_Umr_1_zu_1_3_CM_S2 1 0 -32768 32767 FORMAT "%2.0" ECU_ADDRESS 0xFFF909EC /end MEASUREMENT
/begin MEASUREMENT SCHN_ABHISTRAT_MAX_DBM "" SWORD _CNV_R_R_Umr_1_zu_1_3_CM_S2 1 0 -32768 32767 FORMAT "%2.0" ECU_ADDRESS 0xFFF90A64 /end MEASUREMENT
/begin MEASUREMENT SCHN_ABLOSTRAT_MIN_DBM "" SWORD _CNV_R_R_Umr_1_zu_1_3_CM_S2 1 0 -32768 32767 FORMAT "%2.0" ECU_ADDRESS 0xFFF90A66 /end MEASUREMENT
/begin MEASUREMENT SCHN_ABLO_DSPORT_MIN_DBM "" SWORD _CNV_R_R_Umr_1_zu_1_3_CM_S2 1 0 -32768 32767 FORMAT "%2.0" ECU_ADDRESS 0xFFF90A68 /end MEASUREMENT
/begin MEASUREMENT SCHN_ABLO_LPA_MIN_DBM "" SWORD _CNV_R_R_Umr_1_zu_1_3_CM_S2 1 0 -32768 32767 FORMAT "%2.0" ECU_ADDRESS 0xFFF909EE /end MEASUREMENT
/begin MEASUREMENT SCHN_ABSEGELN_MAX_DBM "" SWORD _CNV_R_R_Umr_1_zu_1_3_CM_S2 1 0 0 10000 FORMAT "%2.0" ECU_ADDRESS 0xFFF90A6A /end MEASUREMENT
/begin MEASUREMENT SCHN_ABSEGELN_MIN_DBM "" SWORD _CNV_R_R_Umr_1_zu_1_3_CM_S2 1 0 0 10000 FORMAT "%2.0" ECU_ADDRESS 0xFFF90A6C /end MEASUREMENT
/begin MEASUREMENT SCHN_AKTABREGELDSCERR_MAX_DBM "" SWORD _CNV_R_R_Umr_1_zu_1_3_CM_S2 1 0 -32768 32767 FORMAT "%2.0" ECU_ADDRESS 0xFFF90A6E /end MEASUREMENT
/begin MEASUREMENT SCHN_AKTBAUTSCHUTZ_MAX_DBM "" SWORD _CNV_R_R_Umr_1_zu_1_3_CM_S2 1 0 -32768 32767 FORMAT "%2.0" ECU_ADDRESS 0xFFF90A70 /end MEASUREMENT
/begin MEASUREMENT SCHN_AKTBAUTSCHUTZ_MIN_DBM "" SWORD _CNV_R_R_Umr_1_zu_1_3_CM_S2 1 0 -32768 32767 FORMAT "%2.0" ECU_ADDRESS 0xFFF90A72 /end MEASUREMENT
/begin MEASUREMENT SCHN_AKTUMWELT_MAX_DBM "" SWORD _CNV_R_R_Umr_1_zu_1_3_CM_S2 1 0 -32768 32767 FORMAT "%2.0" ECU_ADDRESS 0xFFF90A74 /end MEASUREMENT
/begin MEASUREMENT SCHN_AKTUMWELT_MIN_DBM "" SWORD _CNV_R_R_Umr_1_zu_1_3_CM_S2 1 0 -32768 32767 FORMAT "%2.0" ECU_ADDRESS 0xFFF90A76 /end MEASUREMENT
/begin MEASUREMENT SCHN_HIABREGELDSCERR_MAX_DBM "" SWORD _CNV_R_R_Umr_1_zu_1_3_CM_S2 1 0 -32768 32767 FORMAT "%2.0" ECU_ADDRESS 0xFFF90A78 /end MEASUREMENT
/begin MEASUREMENT SCHN_HIBAUTSCHUTZ_MAX_DBM "" SWORD _CNV_R_R_Umr_1_zu_1_3_CM_S2 1 0 -32768 32767 FORMAT "%2.0" ECU_ADDRESS 0xFFF90A7A /end MEASUREMENT
/begin MEASUREMENT SCHN_HIUMWELT_MAX_DBM "" SWORD _CNV_R_R_Umr_1_zu_1_3_CM_S2 1 0 -32768 32767 FORMAT "%2.0" ECU_ADDRESS 0xFFF90A7C /end MEASUREMENT
/begin MEASUREMENT SCHN_LOBAUTSCHUTZ_MIN_DBM "" SWORD _CNV_R_R_Umr_1_zu_1_3_CM_S2 1 0 -32768 32767 FORMAT "%2.0" ECU_ADDRESS 0xFFF90A7E /end MEASUREMENT
/begin MEASUREMENT SCHN_LOUMWELT_MIN_DBM "" SWORD _CNV_R_R_Umr_1_zu_1_3_CM_S2 1 0 -32768 32767 FORMAT "%2.0" ECU_ADDRESS 0xFFF90A80 /end MEASUREMENT
/begin MEASUREMENT SCHN_MAX_K0 "" SWORD _CNV_R_R_Umr_1_zu_1_3_CM_S2 1 0 -32768 32767 FORMAT "%2.0" ECU_ADDRESS 0xFFF90A82 /end MEASUREMENT
/begin MEASUREMENT SCHN_MIN_K0 "" SWORD _CNV_R_R_Umr_1_zu_1_3_CM_S2 1 0 -32768 32767 FORMAT "%2.0" ECU_ADDRESS 0xFFF90A84 /end MEASUREMENT
/begin MEASUREMENT SCHN_MIN_MOTSOLLLL_DBM "" SWORD _CNV_R_R_Umr_1_zu_1_3_CM_S2 1 0 -32768 32767 FORMAT "%2.0" ECU_ADDRESS 0xFFF90A86 /end MEASUREMENT
/begin MEASUREMENT SCHN_TAKTBAUTSCHUTZ_MIN_DBM "" SWORD _CNV_R_R_Umr_1_zu_1_3_CM_S2 1 0 -32768 32767 FORMAT "%2.0" ECU_ADDRESS 0xFFF90A88 /end MEASUREMENT
/begin MEASUREMENT SCHN_TAKTUMWELT_MIN_DBM "" SWORD _CNV_R_R_Umr_1_zu_1_3_CM_S2 1 0 -32768 32767 FORMAT "%2.0" ECU_ADDRESS 0xFFF90A8A /end MEASUREMENT
/begin MEASUREMENT SCHN_TLOBAUTSCHUTZ_MIN_DBM "" SWORD _CNV_R_R_Umr_1_zu_1_3_CM_S2 1 0 -32768 32767 FORMAT "%2.0" ECU_ADDRESS 0xFFF90A8C /end MEASUREMENT
/begin MEASUREMENT SCHN_TLOUMWELT_MIN_DBM "" SWORD _CNV_R_R_Umr_1_zu_1_3_CM_S2 1 0 -32768 32767 FORMAT "%2.0" ECU_ADDRESS 0xFFF90A8E /end MEASUREMENT
/begin MEASUREMENT SCHN_TMAX_MODBEDEL_DBM "" SWORD _CNV_R_R_Umr_1_zu_1_3_CM_S2 1 0 -32768 32767 FORMAT "%2.0" ECU_ADDRESS 0xFFF90A90 /end MEASUREMENT
/begin MEASUREMENT S_ARSDYN_DBM "" UBYTE _CNV_R_R_Umr_1_zu_1_2_CM_S2 1 0 0 1 FORMAT "%2.0" ECU_ADDRESS 0xFFF9128A /end MEASUREMENT
/begin MEASUREMENT S_BEGRENZT_DBM "" ULONG _CNV_R_R_Umr_1_zu_1_2_CM_S2 1 0 0 4294967295 FORMAT "%2.0" ECU_ADDRESS 0xFFF90154 /end MEASUREMENT
/begin MEASUREMENT S_DMRS_DBM "" ULONG _CNV_R_R_Umr_1_zu_1_2_CM_S2 1 0 0 4294967295 FORMAT "%2.0" ECU_ADDRESS 0xFFF90158 /end MEASUREMENT
/begin MEASUREMENT S_DSPV_DBM "" UBYTE _CNV_R_R_Umr_1_zu_1_2_CM_S2 1 0 0 255 FORMAT "%2.0" ECU_ADDRESS 0xFFF9128B /end MEASUREMENT
/begin MEASUREMENT S_ENBL_LPA "" UBYTE _CNV_R_R_Umr_1_zu_1_2_CM_S2 1 0 0 1 FORMAT "%2.0" ECU_ADDRESS 0xFFF915E9 /end MEASUREMENT
/begin MEASUREMENT S_REQUEST_LPA "" UBYTE _CNV_R_R_Umr_1_zu_1_2_CM_S2 1 0 0 1 FORMAT "%2.0" ECU_ADDRESS 0xFFF915EA /end MEASUREMENT
/begin MEASUREMENT S_VALID_DBM "" UBYTE _CNV_R_R_Umr_1_zu_1_2_CM_S2 1 0 0 255 FORMAT "%2.0" ECU_ADDRESS 0xFFF91289 /end MEASUREMENT
/begin MEASUREMENT S_VALID_ZIELALT_DBM "" UBYTE _CNV_R_R_Umr_1_zu_1_2_CM_S2 1 0 0 255 FORMAT "%2.0" ECU_ADDRESS 0xFFF9128C /end MEASUREMENT
/begin MEASUREMENT T_AUSROLLRS_DBM "" SWORD _CNV_R_R_Umr_1_zu_1_6_CM_S2 1 0 0 12500 FORMAT "%2.0" ARRAY_SIZE 9 ECU_ADDRESS 0xFFF90A92 MATRIX_DIM 9 1 1 /end MEASUREMENT
/begin MEASUREMENT T_HSZEIT_KOR_MODWHYB "" SWORD _CNV_R_R_Umr_1_zu_1_146_CM_S2 1 0 -32768 32767 FORMAT "%2.0" ARRAY_SIZE 9 ECU_ADDRESS 0xFFF909C8 MATRIX_DIM 9 1 1 /end MEASUREMENT
/begin MEASUREMENT VALID_GEARS_DBM "" SWORD _CNV_S_4_Enum_EVALI_331_CM_S2 1 0 0 10 ARRAY_SIZE 9 ECU_ADDRESS 0xFFF90AA4 MATRIX_DIM 9 1 1 /end MEASUREMENT
/begin MEASUREMENT Z_DSPV_DBM "" UBYTE _CNV_S_3_Enum_EDSPV_332_CM_S2 1 0 0 2 ECU_ADDRESS 0xFFF9128D /end MEASUREMENT
/begin MEASUREMENT Z_EXCFKT_DBM "" UBYTE _CNV_S_4_Enum_EEXCF_101_CM_S2 1 0 0 3 ECU_ADDRESS 0xFFF9128E /end MEASUREMENT
/begin MEASUREMENT Z_GANG_MAX_DBM "" UBYTE _CNV_S_9_Enum_EGANG_30_CM_S2 1 0 0 8 ECU_ADDRESS 0xFFF9128F /end MEASUREMENT
/begin MEASUREMENT Z_GANG_MIN_DBM "" UBYTE _CNV_S_9_Enum_EGANG_30_CM_S2 1 0 0 8 ECU_ADDRESS 0xFFF91290 /end MEASUREMENT
/begin MEASUREMENT Z_GEARS_DBM_MASK "" UBYTE _CNV_R_R_Umr_1_zu_1_2_CM_S2 1 0 0 255 FORMAT "%2.0" ECU_ADDRESS 0xFFF91291 /end MEASUREMENT
/begin MEASUREMENT Z_HIENBL_DBM_MASK "" UBYTE _CNV_R_R_Umr_1_zu_1_2_CM_S2 1 0 0 255 FORMAT "%2.0" ECU_ADDRESS 0xFFF91292 /end MEASUREMENT
/begin MEASUREMENT Z_KRIT_PRIOARR_DBM "" SWORD _CNV_R_R_Umr_1_zu_1_2_CM_S2 1 0 0 500 FORMAT "%2.0" ARRAY_SIZE 17 ECU_ADDRESS 0xFFF90AB6 MATRIX_DIM 17 1 1 /end MEASUREMENT
/begin MEASUREMENT Z_KRIT_PRIO_DBM "" SWORD _CNV_R_R_Umr_1_zu_1_2_CM_S2 1 0 -32768 32767 FORMAT "%2.0" ARRAY_SIZE 9 ECU_ADDRESS 0xFFF909DA MATRIX_DIM 9 1 1 /end MEASUREMENT
/begin MEASUREMENT Z_LOENBL_DBM_MASK "" UWORD _CNV_R_R_Umr_1_zu_1_2_CM_S2 1 0 0 65535 FORMAT "%2.0" ECU_ADDRESS 0xFFF90AD8 /end MEASUREMENT
/begin MEASUREMENT Z_MODWHYB "" UBYTE _CNV_R_R_Umr_1_zu_1_2_CM_S2 1 0 0 255 FORMAT "%2.0" ECU_ADDRESS 0xFFF91293 /end MEASUREMENT
/begin MEASUREMENT Z_PRISQ_IDX_DBM "" SBYTE _CNV_S_10_Enum_EDBMT_317_CM_S2 1 0 0 9 ARRAY_SIZE 2 ECU_ADDRESS 0xFFF90ADC MATRIX_DIM 2 1 1 /end MEASUREMENT
/begin MEASUREMENT Z_PRISQ_IDX_MAXEXC_DBM "" SBYTE _CNV_S_10_Enum_EDBMT_317_CM_S2 1 0 0 9 ECU_ADDRESS 0xFFF91294 /end MEASUREMENT
/begin MEASUREMENT Z_PRISQ_IDX_MINEXC_DBM "" SBYTE _CNV_S_10_Enum_EDBMT_317_CM_S2 1 0 0 9 ECU_ADDRESS 0xFFF91295 /end MEASUREMENT
/begin MEASUREMENT Z_REKUP_IDX_ALT_DBM "" UBYTE _CNV_S_5_Enum_REKUP_320_CM_S2 1 0 0 4 ECU_ADDRESS 0xFFF91296 /end MEASUREMENT
/begin MEASUREMENT Z_REKUP_IDX_DBM "" UBYTE _CNV_S_5_Enum_REKUP_320_CM_S2 1 0 0 4 ECU_ADDRESS 0xFFF91297 /end MEASUREMENT
/begin MEASUREMENT Z_RFWS_STATE_DBM "" UBYTE _CNV_R_R_Umr_1_zu_1_2_CM_S2 1 0 0 1 FORMAT "%2.0" ECU_ADDRESS 0xFFF91298 /end MEASUREMENT
/begin MEASUREMENT Z_SCHUB_ERK_DBM "" UBYTE _CNV_R_R_Umr_1_zu_1_2_CM_S2 1 0 0 1 FORMAT "%2.0" ECU_ADDRESS 0xFFF91299 /end MEASUREMENT
/begin MEASUREMENT S_TID_ERK "" UBYTE _CNV_P_2_A_I_5_CM_S2 1 0 0 255 ECU_ADDRESS 0xFFF91538 /end MEASUREMENT
/begin MEASUREMENT S_TID_IM_STAND "" UBYTE _CNV_P_2_A_I_5_CM_S2 1 0 0 255 ECU_ADDRESS 0xFFF91782 /end MEASUREMENT
/begin MEASUREMENT S_TID_REINIT "" UBYTE _CNV_P_2_A_I_5_CM_S2 1 0 0 255 ECU_ADDRESS 0xFFF91539 /end MEASUREMENT
/begin MEASUREMENT T_BUFFER_TID_AUSSTIEG "" ULONG _CNV_R_R_Umr_1_zu_1_6_CM_S2 1 0 0 4294967295 FORMAT "%2.0" ECU_ADDRESS 0xFFF90898 /end MEASUREMENT
/begin MEASUREMENT T_BUF_ENTPR_FLANKW_EINSTIEG_TID "" ULONG _CNV_R_R_Umr_1_zu_1_6_CM_S2 1 0 0 4294967295 FORMAT "%2.0" ECU_ADDRESS 0xFFF9089C /end MEASUREMENT
/begin MEASUREMENT T_ENTPRELL_FLANKW_EINSTIEG_TID "" ULONG _CNV_R_R_Umr_1_zu_1_6_CM_S2 1 0 0 4294967295 FORMAT "%2.0" ECU_ADDRESS 0xFFF908A0 /end MEASUREMENT
/begin MEASUREMENT T_TID_AUSSTIEG "" UWORD _CNV_R_R_Umr_1_zu_1_6_CM_S2 1 0 0 65535 FORMAT "%2.0" ECU_ADDRESS 0xFFF911B2 /end MEASUREMENT
/begin MEASUREMENT W_DKKD_TID_AUSMAX "" UWORD _CNV_R_R_Umr_10_zu__9_CM_S2 1 0 0 110 FORMAT "%3.1" ECU_ADDRESS 0xFFF911B0 /end MEASUREMENT
/begin MEASUREMENT CONTROL_DMRS_PRUEFUNG "" UWORD _CNV_S_3_Enum_ECONT_340_CM_S2 1 0 0 2 ECU_ADDRESS 0xFFF90DFC /end MEASUREMENT
/begin MEASUREMENT C_MAX_EXC_RS "" UBYTE _CNV_P_2_A_I_5_CM_S2 1 0 0 255 ECU_ADDRESS 0xFFF9158B /end MEASUREMENT
/begin MEASUREMENT DW_DKKD_REST_VOLLGAS "" UWORD _CNV_R_R_Umr_1_zu_1_339_CM_S2 1 0 0 100 FORMAT "%2.0" ECU_ADDRESS 0xFFF90D04 /end MEASUREMENT
/begin MEASUREMENT GW_FPFILT_DMRS "" SWORD _CNV_R_R_Umr_1_zu_1_7_CM_S2 1 0 -32768 32767 FORMAT "%2.0" ECU_ADDRESS 0xFFF90D06 /end MEASUREMENT
/begin MEASUREMENT GW_FPFILT_DMRS_ALT "" SWORD _CNV_R_R_Umr_1_zu_1_7_CM_S2 1 0 -32768 32767 FORMAT "%2.0" ECU_ADDRESS 0xFFF90D08 /end MEASUREMENT
/begin MEASUREMENT GW_FPFILT_DMRS_REST "" SWORD _CNV_R_R_Umr_1_zu_1_7_CM_S2 1 0 -32768 32767 FORMAT "%2.0" ECU_ADDRESS 0xFFF90D0A /end MEASUREMENT
/begin MEASUREMENT N_MOT_NACHDMRS "" UWORD _CNV_R_R_Umr_1_zu_1_3_CM_S2 1 0 0 20000 FORMAT "%2.0" ECU_ADDRESS 0xFFF90DFE /end MEASUREMENT
/begin MEASUREMENT SCHDW_DKKD_REST "" SWORD _CNV_R_R_Umr_1_zu_1_339_CM_S2 1 0 -100 100 FORMAT "%2.0" ECU_ADDRESS 0xFFF90E00 /end MEASUREMENT
/begin MEASUREMENT SCHGW_FP_DMRS "" SLONG _CNV_R_R_Umr_1_zu_1_131_CM_S2 1 0 -2147483647 2147483647 FORMAT "%2.0" ECU_ADDRESS 0xFFF90244 /end MEASUREMENT
/begin MEASUREMENT SCHGW_FP_DMRSKORRFAKT "" UWORD _CNV_R_R_Umr_1_zu_1_2_CM_S2 1 0 0 200 FORMAT "%2.0" ECU_ADDRESS 0xFFF90D0C /end MEASUREMENT
/begin MEASUREMENT S_DMRS_ARR "" UWORD _CNV_P_2_A_I_68_CM_S2 1 0 0 65535 ARRAY_SIZE 9 ECU_ADDRESS 0xFFF90E02 MATRIX_DIM 9 1 1 /end MEASUREMENT
/begin MEASUREMENT S_DMRS_ENBL "" UBYTE _CNV_P_2_A_I_5_CM_S2 1 0 0 255 ECU_ADDRESS 0xFFF9158C /end MEASUREMENT
/begin MEASUREMENT S_DMRS_ERK "" UBYTE _CNV_P_2_A_I_5_CM_S2 1 0 0 255 ECU_ADDRESS 0xFFF914D8 /end MEASUREMENT
/begin MEASUREMENT S_DMRS_PRUEFT "" UBYTE _CNV_P_2_A_I_5_CM_S2 1 0 0 255 ECU_ADDRESS 0xFFF9158D /end MEASUREMENT
/begin MEASUREMENT S_DMRS_PRUEFT_ALT "" UBYTE _CNV_P_2_A_I_5_CM_S2 1 0 0 255 ECU_ADDRESS 0xFFF9158E /end MEASUREMENT
/begin MEASUREMENT S_GWFP_UP "" UBYTE _CNV_P_2_A_I_5_CM_S2 1 0 0 255 ECU_ADDRESS 0xFFF914D9 /end MEASUREMENT
/begin MEASUREMENT S_PRUEFGANG_AUSG_DMRS "" UBYTE _CNV_P_2_A_I_5_CM_S2 1 0 0 255 ECU_ADDRESS 0xFFF9158F /end MEASUREMENT
/begin MEASUREMENT S_T_DMRSSTART "" UBYTE _CNV_P_2_A_I_5_CM_S2 1 0 0 255 ECU_ADDRESS 0xFFF91590 /end MEASUREMENT
/begin MEASUREMENT T_DMRS "" ULONG _CNV_R_R_Umr_1_zu_1_6_CM_S2 1 0 0 2147483647 FORMAT "%2.0" ECU_ADDRESS 0xFFF904BC /end MEASUREMENT
/begin MEASUREMENT T_RUNTIME_DMRS "" UWORD _CNV_R_R_Umr_1_zu_1_132_CM_S2 1 0 0 65535 FORMAT "%2.0" ECU_ADDRESS 0xFFF90E14 /end MEASUREMENT
/begin MEASUREMENT T_STARTBUF_DMRS "" ULONG _CNV_R_R_Umr_1_zu_1_6_CM_S2 1 0 0 2147483647 FORMAT "%2.0" ECU_ADDRESS 0xFFF904C0 /end MEASUREMENT
/begin MEASUREMENT W_DKKD_DMRS "" UWORD _CNV_R_R_Umr_10_zu__9_CM_S2 1 0 0 110 FORMAT "%3.1" ECU_ADDRESS 0xFFF90E16 /end MEASUREMENT
/begin MEASUREMENT W_DKKD_DMRSSTART "" UWORD _CNV_R_R_Umr_10_zu__9_CM_S2 1 0 0 110 FORMAT "%3.1" ECU_ADDRESS 0xFFF90D0E /end MEASUREMENT
/begin MEASUREMENT Z_BEREICH_GWFP "" UBYTE _CNV_S_7_Enum_EDMRS_341_CM_S2 1 0 0 6 ECU_ADDRESS 0xFFF914DA /end MEASUREMENT
/begin MEASUREMENT Z_DMRS_FINDTABIDX "" UBYTE _CNV_R_R_Umr_1_zu_1_2_CM_S2 1 0 0 19 FORMAT "%2.0" ECU_ADDRESS 0xFFF91591 /end MEASUREMENT
/begin MEASUREMENT Z_DWDKKD_DMRS_AGS "" UBYTE _CNV_S_10_Enum_EDMRS_31_CM_S2 1 0 0 9 ECU_ADDRESS 0xFFF91592 /end MEASUREMENT
/begin MEASUREMENT Z_DWDKKD_KL_IDX "" UBYTE _CNV_P_2_A_I_5_CM_S2 1 0 0 255 ECU_ADDRESS 0xFFF91593 /end MEASUREMENT
/begin MEASUREMENT Z_GANG_DMRS "" UBYTE _CNV_S_9_Enum_EGANG_30_CM_S2 1 0 0 8 ECU_ADDRESS 0xFFF91594 /end MEASUREMENT
/begin MEASUREMENT Z_GANG_DMRSKD "" UBYTE _CNV_S_9_Enum_EGANG_30_CM_S2 1 0 0 8 ECU_ADDRESS 0xFFF91595 /end MEASUREMENT
/begin MEASUREMENT Z_GANG_KOOP_DMRS "" UBYTE _CNV_S_9_Enum_EGANG_30_CM_S2 1 0 0 8 ECU_ADDRESS 0xFFF91596 /end MEASUREMENT
/begin MEASUREMENT Z_GANG_ZIELSTART_DMRS "" UBYTE _CNV_S_9_Enum_EGANG_30_CM_S2 1 0 0 8 ECU_ADDRESS 0xFFF91597 /end MEASUREMENT
/begin MEASUREMENT Z_GWFP_DMRS_AGS "" UBYTE _CNV_S_10_Enum_EDMRS_31_CM_S2 1 0 0 9 ECU_ADDRESS 0xFFF914DB /end MEASUREMENT
/begin MEASUREMENT Z_PRUEFBEREICH "" UBYTE _CNV_S_7_Enum_EDMRS_341_CM_S2 1 0 0 6 ECU_ADDRESS 0xFFF91598 /end MEASUREMENT
/begin MEASUREMENT Z_PRUEFBEREICH_EIN "" UBYTE _CNV_S_7_Enum_EDMRS_341_CM_S2 1 0 0 6 ECU_ADDRESS 0xFFF914DC /end MEASUREMENT
/begin MEASUREMENT C_FENSTER_SOLLSTB_ZHK "" UBYTE _CNV_R_R_Umr_1_zu_1_2_CM_S2 1 0 0 255 FORMAT "%2.0" ECU_ADDRESS 0xFFF91565 /end MEASUREMENT
/begin MEASUREMENT C_GANGGENERATOR_SOLLSTB "" UBYTE _CNV_R_R_Umr_1_zu_1_2_CM_S2 1 0 0 19 FORMAT "%2.0" ECU_ADDRESS 0xFFF91573 /end MEASUREMENT
/begin MEASUREMENT C_GANGW_SOLLSTB_FLW "" UBYTE _CNV_R_R_Umr_1_zu_1_2_CM_S2 1 0 0 255 FORMAT "%2.0" ECU_ADDRESS 0xFFF91566 /end MEASUREMENT
/begin MEASUREMENT C_GANGW_SOLLSTB_ZHK "" UBYTE _CNV_R_R_Umr_1_zu_1_2_CM_S2 1 0 0 255 FORMAT "%2.0" ECU_ADDRESS 0xFFF91567 /end MEASUREMENT
/begin MEASUREMENT C_GANG_SOLLSTB "" UBYTE _CNV_R_R_Umr_1_zu_1_2_CM_S2 1 0 0 31 FORMAT "%2.0" ECU_ADDRESS 0xFFF91568 /end MEASUREMENT
/begin MEASUREMENT C_TESTFALL_SOLLSTB "" UBYTE _CNV_R_R_Umr_1_zu_1_2_CM_S2 1 0 0 4 FORMAT "%2.0" ECU_ADDRESS 0xFFF91574 /end MEASUREMENT
/begin MEASUREMENT S_ABBRUCH_GANG_SOLLSTB "" UBYTE _CNV_R_R_Umr_1_zu_1_2_CM_S2 1 0 0 1 FORMAT "%2.0" ECU_ADDRESS 0xFFF91569 /end MEASUREMENT
/begin MEASUREMENT S_GANGW_SOLLSTB_FLW "" UBYTE _CNV_R_R_Umr_1_zu_1_2_CM_S2 1 0 0 1 FORMAT "%2.0" ECU_ADDRESS 0xFFF9156A /end MEASUREMENT
/begin MEASUREMENT S_GANGW_SOLLSTB_ZHK "" UBYTE _CNV_R_R_Umr_1_zu_1_2_CM_S2 1 0 0 1 FORMAT "%2.0" ECU_ADDRESS 0xFFF9156B /end MEASUREMENT
/begin MEASUREMENT S_GANG_SOLLSTB "" UBYTE _CNV_R_R_Umr_1_zu_1_2_CM_S2 1 0 0 1 FORMAT "%2.0" ECU_ADDRESS 0xFFF9156C /end MEASUREMENT
/begin MEASUREMENT S_GANG_SOLLSTB_ENBL "" UBYTE _CNV_R_R_Umr_1_zu_1_2_CM_S2 1 0 0 1 FORMAT "%2.0" ECU_ADDRESS 0xFFF9156D /end MEASUREMENT
/begin MEASUREMENT S_GANG_TGG_ENBL "" UBYTE _CNV_R_R_Umr_1_zu_1_2_CM_S2 1 0 0 1 FORMAT "%2.0" ECU_ADDRESS 0xFFF91575 /end MEASUREMENT
/begin MEASUREMENT S_STABIL_SCHALT_SOLLAGS "" UBYTE _CNV_R_R_Umr_1_zu_1_2_CM_S2 1 0 0 255 FORMAT "%2.0" ECU_ADDRESS 0xFFF9156E /end MEASUREMENT
/begin MEASUREMENT S_ZUG_SOLLSTB "" UBYTE _CNV_R_R_Umr_1_zu_1_2_CM_S2 1 0 0 1 FORMAT "%2.0" ECU_ADDRESS 0xFFF9156F /end MEASUREMENT
/begin MEASUREMENT S_ZUG_SOLLSTB_ALT "" UBYTE _CNV_R_R_Umr_1_zu_1_2_CM_S2 1 0 0 1 FORMAT "%2.0" ECU_ADDRESS 0xFFF91570 /end MEASUREMENT
/begin MEASUREMENT T_GANG_SOLLSTB "" UWORD _CNV_R_R_Umr_1_zu_1_2_CM_S2 1 0 0 2550 FORMAT "%2.0" ECU_ADDRESS 0xFFF90DDC /end MEASUREMENT
/begin MEASUREMENT T_MIN_ZUG_SOLLSTB "" UWORD _CNV_R_R_Umr_1_zu_1_2_CM_S2 1 0 0 2550 FORMAT "%2.0" ECU_ADDRESS 0xFFF90DDE /end MEASUREMENT
/begin MEASUREMENT Z_BITMASK_GANG_SOLLAGS[0] "" ULONG _CNV_R_R_Umr_1_zu_1_2_CM_S2 1 0 0 4294967295 FORMAT "%2.0" ECU_ADDRESS 0xFFF90494 /end MEASUREMENT
/begin MEASUREMENT Z_BITMASK_GANG_SOLLAGS[1] "" ULONG _CNV_R_R_Umr_1_zu_1_2_CM_S2 1 0 0 4294967295 FORMAT "%2.0" ECU_ADDRESS 0xFFF90498 /end MEASUREMENT
/begin MEASUREMENT Z_BITMASK_GANG_SOLLAGS[2] "" ULONG _CNV_R_R_Umr_1_zu_1_2_CM_S2 1 0 0 4294967295 FORMAT "%2.0" ECU_ADDRESS 0xFFF9049C /end MEASUREMENT
/begin MEASUREMENT Z_BITMASK_GANG_SOLLAGS[3] "" ULONG _CNV_R_R_Umr_1_zu_1_2_CM_S2 1 0 0 4294967295 FORMAT "%2.0" ECU_ADDRESS 0xFFF904A0 /end MEASUREMENT
/begin MEASUREMENT Z_BITMASK_GANG_SOLLAGS[4] "" ULONG _CNV_R_R_Umr_1_zu_1_2_CM_S2 1 0 0 4294967295 FORMAT "%2.0" ECU_ADDRESS 0xFFF904A4 /end MEASUREMENT
/begin MEASUREMENT Z_BITMASK_GANG_SOLLAGS[5] "" ULONG _CNV_R_R_Umr_1_zu_1_2_CM_S2 1 0 0 4294967295 FORMAT "%2.0" ECU_ADDRESS 0xFFF904A8 /end MEASUREMENT
/begin MEASUREMENT Z_BITMASK_GANG_SOLLAGS[6] "" ULONG _CNV_R_R_Umr_1_zu_1_2_CM_S2 1 0 0 4294967295 FORMAT "%2.0" ECU_ADDRESS 0xFFF904AC /end MEASUREMENT
/begin MEASUREMENT Z_BITMASK_GANG_SOLLAGS[7] "" ULONG _CNV_R_R_Umr_1_zu_1_2_CM_S2 1 0 0 4294967295 FORMAT "%2.0" ECU_ADDRESS 0xFFF904B0 /end MEASUREMENT
/begin MEASUREMENT Z_GANG_BER_SOLLSTB "" UBYTE _CNV_S_9_Enum_EGANG_30_CM_S2 1 0 0 8 ECU_ADDRESS 0xFFF91571 /end MEASUREMENT
/begin MEASUREMENT Z_GANG_REF_SOLLSTB "" UBYTE _CNV_S_9_Enum_EGANG_30_CM_S2 1 0 0 8 ECU_ADDRESS 0xFFF91572 /end MEASUREMENT
/begin MEASUREMENT Z_TESTFALL_SOLLSTB "" UBYTE _CNV_S_3_Enum_ETEST_344_CM_S2 1 0 0 2 ECU_ADDRESS 0xFFF91576 /end MEASUREMENT
/begin MEASUREMENT N_MOT_NACHRS_RSUMUELOW "" UWORD _CNV_R_R_Umr_1_zu_1_3_CM_S2 1 0 0 20000 FORMAT "%2.0" ECU_ADDRESS 0xFFF911C4 /end MEASUREMENT
/begin MEASUREMENT SCHN_MOT_MAX_RSUMUELOW "" UWORD _CNV_P_2_A_I_68_CM_S2 1 0 0 65535 ECU_ADDRESS 0xFFF91180 /end MEASUREMENT
/begin MEASUREMENT S_RSUMUELOW "" UBYTE _CNV_P_2_A_I_5_CM_S2 1 0 0 255 ECU_ADDRESS 0xFFF91788 /end MEASUREMENT
/begin MEASUREMENT S_RSU_MUELOW_ERK "" UBYTE _CNV_P_2_A_I_5_CM_S2 1 0 0 255 ECU_ADDRESS 0xFFF914FF /end MEASUREMENT
/begin MEASUREMENT T_BUF_SEQ_RSUMUELOW "" ULONG _CNV_R_R_Umr_1_zu_1_6_CM_S2 1 0 0 4294967295 FORMAT "%2.0" ECU_ADDRESS 0xFFF908BC /end MEASUREMENT
/begin MEASUREMENT T_SEQ_RSUMUELOW "" SLONG _CNV_R_R_Umr_1_zu_1_6_CM_S2 1 0 -2147483647 2147483647 FORMAT "%2.0" ECU_ADDRESS 0xFFF908C0 /end MEASUREMENT
/begin MEASUREMENT Z_GANG_RSUMUELOW "" UBYTE _CNV_S_9_Enum_EGANG_30_CM_S2 1 0 0 8 ECU_ADDRESS 0xFFF9175C /end MEASUREMENT
/begin MEASUREMENT Z_GANG_RSUMUELOW_IN "" UBYTE _CNV_S_9_Enum_EGANG_30_CM_S2 1 0 0 8 ECU_ADDRESS 0xFFF9175D /end MEASUREMENT
/begin MEASUREMENT Z_GANG_RSUMUELOW_IN_ALT "" UBYTE _CNV_S_9_Enum_EGANG_30_CM_S2 1 0 0 8 ECU_ADDRESS 0xFFF9175E /end MEASUREMENT
/begin MEASUREMENT Z_GANG_RSUMUELOW_MOTMAX "" UBYTE _CNV_S_9_Enum_EGANG_30_CM_S2 1 0 0 8 ECU_ADDRESS 0xFFF9175F /end MEASUREMENT
/begin MEASUREMENT C_QS3_EEPROM "" UWORD _CNV_R_R_Umr_1_zu_1_2_CM_S2 1 0 0 65535 FORMAT "%2.0" ECU_ADDRESS 0xFFF9092C /end MEASUREMENT
/begin MEASUREMENT OEM_EEPROM_MIRROR_PTR "" ULONG _CNV_R_R_Umr_1_zu_1_2_CM_S2 1 0 0 4294967295 FORMAT "%2.0" ECU_ADDRESS 0xFFF900D8 /end MEASUREMENT
/begin MEASUREMENT S_INIT_EEPROM_DATA "" UBYTE _CNV_R_R_Umr_1_zu_1_2_CM_S2 1 0 0 255 FORMAT "%2.0" ECU_ADDRESS 0xFFF91217 /end MEASUREMENT
/begin MEASUREMENT SCHN_AB_BRS_HSURE_COS "" UWORD _CNV_R_R_Umr_1_zu_1_3_CM_S2 1 0 0 20000 FORMAT "%2.0" ECU_ADDRESS 0xFFF90DE6 /end MEASUREMENT
/begin MEASUREMENT SCHN_GEMAX_BRS_COS "" UWORD _CNV_R_R_Umr_1_zu_1_3_CM_S2 1 0 0 20000 FORMAT "%2.0" ECU_ADDRESS 0xFFF90DE8 /end MEASUREMENT
/begin MEASUREMENT S_BRS_COS_AKTION "" UBYTE _CNV_P_2_A_I_5_CM_S2 1 0 0 255 ECU_ADDRESS 0xFFF9157E /end MEASUREMENT
/begin MEASUREMENT S_BRS_COS_ERK "" UBYTE _CNV_P_2_A_I_5_CM_S2 1 0 0 255 ECU_ADDRESS 0xFFF914C9 /end MEASUREMENT
/begin MEASUREMENT Z_BRS_COS "" UBYTE _CNV_R_R_Umr_1_zu_1_2_CM_S2 1 0 0 3 FORMAT "%2.0" ECU_ADDRESS 0xFFF914CA /end MEASUREMENT
/begin MEASUREMENT Z_GANG_BRS_COS "" UBYTE _CNV_S_9_Enum_EGANG_30_CM_S2 1 0 0 8 ECU_ADDRESS 0xFFF9157F /end MEASUREMENT
/begin MEASUREMENT Z_GANG_BRS_COS_ERS "" UBYTE _CNV_S_9_Enum_EGANG_30_CM_S2 1 0 0 8 ECU_ADDRESS 0xFFF91580 /end MEASUREMENT
/begin MEASUREMENT Z_GANG_BRS_COS_IN "" UBYTE _CNV_S_9_Enum_EGANG_30_CM_S2 1 0 0 8 ECU_ADDRESS 0xFFF91581 /end MEASUREMENT
/begin MEASUREMENT Z_MASK_BRS_COS "" UBYTE _CNV_R_R_Umr_1_zu_1_2_CM_S2 1 0 0 255 FORMAT "%2.0" ECU_ADDRESS 0xFFF914CB /end MEASUREMENT
/begin MEASUREMENT DBG_SCHN_GEMAX_DERS_COS "" UWORD _CNV_R_R_Umr_1_zu_1_3_CM_S2 1 0 0 65535 FORMAT "%2.0" ECU_ADDRESS 0xFFF90DF0 /end MEASUREMENT
/begin MEASUREMENT SCHN_AB_DERS_HSURE_COS "" UWORD _CNV_R_R_Umr_1_zu_1_3_CM_S2 1 0 0 20000 FORMAT "%2.0" ECU_ADDRESS 0xFFF90DF8 /end MEASUREMENT
/begin MEASUREMENT SCHN_GEMAX_DERS_COS "" UWORD _CNV_R_R_Umr_1_zu_1_3_CM_S2 1 0 0 65535 FORMAT "%2.0" ECU_ADDRESS 0xFFF90DFA /end MEASUREMENT
/begin MEASUREMENT S_DERS_COS "" UBYTE _CNV_R_R_Umr_1_zu_1_2_CM_S2 1 0 0 1 FORMAT "%2.0" ECU_ADDRESS 0xFFF91585 /end MEASUREMENT
/begin MEASUREMENT S_DERS_COS_ERK "" UBYTE _CNV_R_R_Umr_1_zu_1_2_CM_S2 1 0 0 255 FORMAT "%2.0" ECU_ADDRESS 0xFFF914CC /end MEASUREMENT
/begin MEASUREMENT Z_DERS_COS "" UBYTE _CNV_R_R_Umr_1_zu_1_2_CM_S2 1 0 0 3 FORMAT "%2.0" ECU_ADDRESS 0xFFF91586 /end MEASUREMENT
/begin MEASUREMENT Z_DERS_COS_ERK "" UBYTE _CNV_R_R_Umr_1_zu_1_2_CM_S2 1 0 0 255 FORMAT "%2.0" ECU_ADDRESS 0xFFF914CD /end MEASUREMENT
/begin MEASUREMENT Z_GANG_DERS_COS "" UBYTE _CNV_S_9_Enum_EGANG_30_CM_S2 1 0 0 8 ECU_ADDRESS 0xFFF91587 /end MEASUREMENT
/begin MEASUREMENT Z_GANG_DERS_COS_1RS "" UBYTE _CNV_S_9_Enum_EGANG_30_CM_S2 1 0 0 8 ECU_ADDRESS 0xFFF91588 /end MEASUREMENT
/begin MEASUREMENT Z_GANG_DERS_COS_IN "" UBYTE _CNV_S_9_Enum_EGANG_30_CM_S2 1 0 0 8 ECU_ADDRESS 0xFFF91589 /end MEASUREMENT
/begin MEASUREMENT Z_MASK_DERS_COS "" UBYTE _CNV_R_R_Umr_1_zu_1_2_CM_S2 1 0 0 255 FORMAT "%2.0" ECU_ADDRESS 0xFFF9158A /end MEASUREMENT
/begin MEASUREMENT GW_FP_FILT_REST_SPA "" SWORD _CNV_R_R_Umr_1_zu_1_7_CM_S2 1 0 -32768 32767 FORMAT "%2.0" ECU_ADDRESS 0xFFF90CC6 /end MEASUREMENT
/begin MEASUREMENT GW_FP_FILT_SPA "" SWORD _CNV_R_R_Umr_1_zu_1_7_CM_S2 1 0 -32768 32767 FORMAT "%2.0" ECU_ADDRESS 0xFFF90CC8 /end MEASUREMENT
/begin MEASUREMENT N_GETR_EINGANG_SPA "" UWORD _CNV_R_R_Umr_1_zu_1_3_CM_S2 1 0 0 20000 FORMAT "%2.0" ECU_ADDRESS 0xFFF90CCA /end MEASUREMENT
/begin MEASUREMENT N_HS_MIN_STEPS_SPA "" UWORD _CNV_R_R_Umr_1_zu_1_3_CM_S2 1 0 0 20000 FORMAT "%2.0" ECU_ADDRESS 0xFFF90CCC /end MEASUREMENT
/begin MEASUREMENT SCHN_AB_HIGH_SKL_SPA "" UWORD _CNV_R_R_Umr_1_zu_1_3_CM_S2 1 0 0 32000 FORMAT "%2.0" ECU_ADDRESS 0xFFF90CCE /end MEASUREMENT
/begin MEASUREMENT SCHN_AB_LOW_SKL_SPA "" UWORD _CNV_R_R_Umr_1_zu_1_3_CM_S2 1 0 0 32000 FORMAT "%2.0" ECU_ADDRESS 0xFFF90CD0 /end MEASUREMENT
/begin MEASUREMENT SCHW_DKKD_HIGH_SKL_SPA "" UWORD _CNV_R_R_Umr_10_zu__9_CM_S2 1 0 0 220 FORMAT "%3.1" ECU_ADDRESS 0xFFF90CD2 /end MEASUREMENT
/begin MEASUREMENT SCHW_DKKD_LOW_SKL_SPA "" UWORD _CNV_R_R_Umr_10_zu__9_CM_S2 1 0 0 110 FORMAT "%3.1" ECU_ADDRESS 0xFFF90CD4 /end MEASUREMENT
/begin MEASUREMENT S_FKT_SPA "" UBYTE _CNV_P_2_A_I_5_CM_S2 1 0 0 255 ARRAY_SIZE 11 ECU_ADDRESS 0xFFF9145E MATRIX_DIM 11 1 1 /end MEASUREMENT
/begin MEASUREMENT S_LAEUFT_T_SPERR_SPA "" UBYTE _CNV_S_2_Schalter_A_4_CM_S2 1 0 0 1 ECU_ADDRESS 0xFFF91469 /end MEASUREMENT
/begin MEASUREMENT S_SKL_HYS_BEREICH_SPA "" UBYTE _CNV_S_2_Schalter_A_4_CM_S2 1 0 0 1 ECU_ADDRESS 0xFFF9146A /end MEASUREMENT
/begin MEASUREMENT S_SPA_AKTIV "" UBYTE _CNV_S_2_Schalter_A_4_CM_S2 1 0 0 1 ECU_ADDRESS 0xFFF9146B /end MEASUREMENT
/begin MEASUREMENT T_BUFF_GWFP_SPA "" ULONG _CNV_R_R_Umr_1_zu_1_6_CM_S2 1 0 0 4294967295 FORMAT "%2.0" ECU_ADDRESS 0xFFF90210 /end MEASUREMENT
/begin MEASUREMENT T_BUFF_SPERR_SPA "" ULONG _CNV_R_R_Umr_1_zu_1_6_CM_S2 1 0 0 4294967295 FORMAT "%2.0" ECU_ADDRESS 0xFFF90214 /end MEASUREMENT
/begin MEASUREMENT T_BUFF_TIPP_SPA "" ULONG _CNV_R_R_Umr_1_zu_1_6_CM_S2 1 0 0 4294967295 FORMAT "%2.0" ECU_ADDRESS 0xFFF90218 /end MEASUREMENT
/begin MEASUREMENT T_DUNKEL_AKTIV_SPA "" UWORD _CNV_R_R_Umr_1_zu_1_6_CM_S2 1 0 0 65535 FORMAT "%2.0" ECU_ADDRESS 0xFFF90CD6 /end MEASUREMENT
/begin MEASUREMENT T_GWFP_SPA "" UWORD _CNV_R_R_Umr_1_zu_1_6_CM_S2 1 0 0 65535 FORMAT "%2.0" ECU_ADDRESS 0xFFF90CD8 /end MEASUREMENT
/begin MEASUREMENT T_SPERR_SPA "" UWORD _CNV_R_R_Umr_1_zu_1_6_CM_S2 1 0 0 65535 FORMAT "%2.0" ECU_ADDRESS 0xFFF90CDA /end MEASUREMENT
/begin MEASUREMENT T_TIPP_SPA "" UWORD _CNV_R_R_Umr_1_zu_1_6_CM_S2 1 0 0 65535 FORMAT "%2.0" ECU_ADDRESS 0xFFF90CDC /end MEASUREMENT
/begin MEASUREMENT T_WDKKD_SPA "" UWORD _CNV_R_R_Umr_1_zu_1_6_CM_S2 1 0 0 65535 FORMAT "%2.0" ECU_ADDRESS 0xFFF90CDE /end MEASUREMENT
/begin MEASUREMENT Z_GANG_KOOP_SPA_ALT "" UBYTE _CNV_S_9_Enum_EGANG_30_CM_S2 1 0 0 8 ECU_ADDRESS 0xFFF9146C /end MEASUREMENT
/begin MEASUREMENT Z_GANG_KOOP_SPA_HYS "" UBYTE _CNV_S_9_Enum_EGANG_30_CM_S2 1 0 0 8 ECU_ADDRESS 0xFFF9146D /end MEASUREMENT
/begin MEASUREMENT Z_GANG_SPA "" UBYTE _CNV_S_9_Enum_EGANG_30_CM_S2 1 0 0 8 ECU_ADDRESS 0xFFF9146E /end MEASUREMENT
/begin MEASUREMENT Z_GANG_SPA_ALT "" UBYTE _CNV_S_9_Enum_EGANG_30_CM_S2 1 0 0 8 ECU_ADDRESS 0xFFF9146F /end MEASUREMENT
/begin MEASUREMENT Z_GANG_SPA_FILT "" UBYTE _CNV_S_9_Enum_EGANG_30_CM_S2 1 0 0 8 ECU_ADDRESS 0xFFF91470 /end MEASUREMENT
/begin MEASUREMENT Z_GANG_SPA_SKL "" UBYTE _CNV_S_9_Enum_EGANG_30_CM_S2 1 0 0 8 ECU_ADDRESS 0xFFF91471 /end MEASUREMENT
/begin MEASUREMENT Z_PRISQ_SPA_PRIOIDX "" UBYTE _CNV_S_15_Enum_EPRIS_351_CM_S2 1 0 0 14 ECU_ADDRESS 0xFFF91472 /end MEASUREMENT
/begin MEASUREMENT Z_PROG_SPA "" UBYTE _CNV_S_21_Enum_EPROG_40_CM_S2 1 0 0 20 ECU_ADDRESS 0xFFF91473 /end MEASUREMENT
/begin MEASUREMENT Z_SCHALTUNGSTYP_SPA "" UBYTE _CNV_S_3_Enum_EST_S_352_CM_S2 1 0 0 2 ECU_ADDRESS 0xFFF91474 /end MEASUREMENT
/begin MEASUREMENT Z_SPA_DUNKELGANG_MASK "" UWORD _CNV_R_R_Umr_1_zu_1_2_CM_S2 1 0 0 65535 ECU_ADDRESS 0xFFF90CE0 /end MEASUREMENT
/begin MEASUREMENT SCHW_DKKD_RS_VGANGBEGR "" UWORD _CNV_R_R_Umr_10_zu__45_CM_S2 1 0 0 6553.5 FORMAT "%3.1" ECU_ADDRESS 0xFFF91188 /end MEASUREMENT
/begin MEASUREMENT SCHW_DKKD_RS_VGANGBEGR_ALT "" UWORD _CNV_R_R_Umr_10_zu__45_CM_S2 1 0 0 6553.5 FORMAT "%3.1" ECU_ADDRESS 0xFFF9118A /end MEASUREMENT
/begin MEASUREMENT S_GANGVBEGR_HSU "" UBYTE _CNV_R_R_Umr_1_zu_1_2_CM_S2 1 0 0 255 FORMAT "%2.0" ECU_ADDRESS 0xFFF91769 /end MEASUREMENT
/begin MEASUREMENT S_RS_ENBL_VGANGBEGR "" UBYTE _CNV_R_R_Umr_1_zu_1_2_CM_S2 1 0 0 255 FORMAT "%2.0" ECU_ADDRESS 0xFFF9176A /end MEASUREMENT
/begin MEASUREMENT S_RS_PRUEFT_VGANGBEGR "" UBYTE _CNV_R_R_Umr_1_zu_1_2_CM_S2 1 0 0 255 FORMAT "%2.0" ECU_ADDRESS 0xFFF9176B /end MEASUREMENT
/begin MEASUREMENT T_GANGVBEGR_AUS "" UWORD _CNV_R_R_Umr_1_zu_1_2_CM_S2 1 0 0 65535 FORMAT "%2.0" ECU_ADDRESS 0xFFF9118C /end MEASUREMENT
/begin MEASUREMENT V_HIGH_GANGVBEGR "" UWORD _CNV_R_R_Umr_1_zu_1_8_CM_S2 1 0 0 255 FORMAT "%2.0" ECU_ADDRESS 0xFFF91190 /end MEASUREMENT
/begin MEASUREMENT V_HYS_GANGVBEGR "" UWORD _CNV_R_R_Umr_1_zu_1_8_CM_S2 1 0 0 65535 FORMAT "%2.0" ECU_ADDRESS 0xFFF9118E /end MEASUREMENT
/begin MEASUREMENT V_LOW_GANGVBEGR "" UWORD _CNV_R_R_Umr_1_zu_1_8_CM_S2 1 0 0 255 FORMAT "%2.0" ECU_ADDRESS 0xFFF91192 /end MEASUREMENT
/begin MEASUREMENT Z_GANG_VGANGBEGR_IN "" UBYTE _CNV_S_9_Enum_EGANG_30_CM_S2 1 0 0 8 ECU_ADDRESS 0xFFF9176C /end MEASUREMENT
/begin MEASUREMENT S_RSU_MODWHYB "" UBYTE _CNV_S_2_Schalter_A_4_CM_S2 1 0 0 1 ECU_ADDRESS 0xFFF91760 /end MEASUREMENT
/begin MEASUREMENT S_RSU_MODWHYB_VORHALT "" UBYTE _CNV_S_2_Schalter_A_4_CM_S2 1 0 0 1 ECU_ADDRESS 0xFFF91761 /end MEASUREMENT
/begin MEASUREMENT T_RSUMODWHYB_AUS_AKTGANG "" UWORD _CNV_R_R_Umr_1_zu_1_6_CM_S2 1 0 0 10000 FORMAT "%2.0" ECU_ADDRESS 0xFFF91184 /end MEASUREMENT
/begin MEASUREMENT T_RSUMODWHYB_AUS_HIGANG "" UWORD _CNV_R_R_Umr_1_zu_1_6_CM_S2 1 0 0 10000 FORMAT "%2.0" ECU_ADDRESS 0xFFF91186 /end MEASUREMENT
/begin MEASUREMENT T_RSUMODWHYB_VORHALT_AUS "" UWORD _CNV_R_R_Umr_1_zu_1_6_CM_S2 1 0 0 10000 FORMAT "%2.0" ECU_ADDRESS 0xFFF91182 /end MEASUREMENT
/begin MEASUREMENT T_VIRT_AKTGANG "" SLONG _CNV_R_R_Umr_1_zu_1_6_CM_S2 1 0 0 10000 FORMAT "%2.0" ECU_ADDRESS 0xFFF9085C /end MEASUREMENT
/begin MEASUREMENT T_VIRT_HIGANG "" SLONG _CNV_R_R_Umr_1_zu_1_6_CM_S2 1 0 0 10000 FORMAT "%2.0" ECU_ADDRESS 0xFFF90860 /end MEASUREMENT
/begin MEASUREMENT Z_EFAHREN_ERK "" UBYTE _CNV_S_4_Enum_Z_EFA_354_CM_S2 1 0 0 3 ECU_ADDRESS 0xFFF91762 /end MEASUREMENT
/begin MEASUREMENT Z_GANG_RSUMODWHYB "" UBYTE _CNV_S_9_Enum_EGANG_30_CM_S2 1 0 0 8 ECU_ADDRESS 0xFFF91763 /end MEASUREMENT
/begin MEASUREMENT Z_GANG_RSUMODWHYBVORHALT "" UBYTE _CNV_S_9_Enum_EGANG_30_CM_S2 1 0 0 8 ECU_ADDRESS 0xFFF91764 /end MEASUREMENT
/begin MEASUREMENT Z_GANG_RSUMODWHYBVORHALT_IN "" UBYTE _CNV_S_9_Enum_EGANG_30_CM_S2 1 0 0 8 ECU_ADDRESS 0xFFF91765 /end MEASUREMENT
/begin MEASUREMENT Z_GANG_RSUMODWHYB_IN "" UBYTE _CNV_S_9_Enum_EGANG_30_CM_S2 1 0 0 8 ECU_ADDRESS 0xFFF91766 /end MEASUREMENT
/begin COMPU_METHOD _CNV_R_R_Umr_1_zu_1_2_CM_S2 "" RAT_FUNC "%6.3" "" COEFFS 0 1 0 0 0 1 /end COMPU_METHOD
/begin COMPU_METHOD _CNV_R_R_Umr_1_zu_1_3_CM_S2 "" RAT_FUNC "%6.3" "U/min" COEFFS 0 1 0 0 0 1 /end COMPU_METHOD
/begin COMPU_METHOD _CNV_S_2_Schalter_A_4_CM_S2 "Schalter: 0 = AUS, 1 = EIN" TAB_VERB "%6.3" "" COMPU_TAB_REF _CNV_S_2_Schalter_A_4_S2 /end COMPU_METHOD
/begin COMPU_METHOD _CNV_P_2_A_I_5_CM_S2 "" TAB_INTP "%6.3" "" COMPU_TAB_REF _CNV_P_2_A_I_5_S2 /end COMPU_METHOD
/begin COMPU_METHOD _CNV_R_R_Umr_1_zu_1_6_CM_S2 "" RAT_FUNC "%6.3" "ms" COEFFS 0 1 0 0 0 1 /end COMPU_METHOD
/begin COMPU_METHOD _CNV_R_R_Umr_1_zu_1_7_CM_S2 "" RAT_FUNC "%6.3" "%/s" COEFFS 0 1 0 0 0 1 /end COMPU_METHOD
/begin COMPU_METHOD _CNV_R_R_Umr_1_zu_1_8_CM_S2 "" RAT_FUNC "%6.3" "km/h" COEFFS 0 1 0 0 0 1 /end COMPU_METHOD
/begin COMPU_METHOD _CNV_R_R_Umr_10_zu__9_CM_S2 "" RAT_FUNC "%6.3" "%" COEFFS 0 10 0 0 0 1 /end COMPU_METHOD
/begin COMPU_METHOD _CNV_R_R_Umr_10_zu__10_CM_S2 "" RAT_FUNC "%6.3" "°" COEFFS 0 10 0 0 0 1 /end COMPU_METHOD
/begin COMPU_METHOD _CNV_S_6_Enum_EDL_11_CM_S2 "" TAB_VERB "%6.3" "" COMPU_TAB_REF _CNV_S_6_Enum_EDL_11_S2 /end COMPU_METHOD
/begin COMPU_METHOD _CNV_S_11_Enum_STATU_14_CM_S2 "" TAB_VERB "%6.3" "" COMPU_TAB_REF _CNV_S_11_Enum_STATU_14_S2 /end COMPU_METHOD
/begin COMPU_METHOD _CNV_S_3_Enum_ENOTL_18_CM_S2 "" TAB_VERB "%6.3" "" COMPU_TAB_REF _CNV_S_3_Enum_ENOTL_18_S2 /end COMPU_METHOD
/begin COMPU_METHOD _CNV_S_3_Enum_EDSCS_28_CM_S2 "" TAB_VERB "%6.3" "" COMPU_TAB_REF _CNV_S_3_Enum_EDSCS_28_S2 /end COMPU_METHOD
/begin COMPU_METHOD _CNV_S_9_Enum_EGANG_30_CM_S2 "" TAB_VERB "%6.3" "" COMPU_TAB_REF _CNV_S_9_Enum_EGANG_30_S2 /end COMPU_METHOD
/begin COMPU_METHOD _CNV_S_10_Enum_EDMRS_31_CM_S2 "" TAB_VERB "%6.3" "" COMPU_TAB_REF _CNV_S_10_Enum_EDMRS_31_S2 /end COMPU_METHOD
/begin COMPU_METHOD _CNV_S_8_Enum_EPOS_33_CM_S2 "" TAB_VERB "%6.3" "" COMPU_TAB_REF _CNV_S_8_Enum_EPOS_33_S2 /end COMPU_METHOD
/begin COMPU_METHOD _CNV_S_4_Enum_EPROG_35_CM_S2 "" TAB_VERB "%6.3" "" COMPU_TAB_REF _CNV_S_4_Enum_EPROG_35_S2 /end COMPU_METHOD
/begin COMPU_METHOD _CNV_S_21_Enum_EPROG_40_CM_S2 "" TAB_VERB "%6.3" "" COMPU_TAB_REF _CNV_S_21_Enum_EPROG_40_S2 /end COMPU_METHOD
/begin COMPU_METHOD _CNV_R_R_Umr_1_zu_1_42_CM_S2 "" RAT_FUNC "%6.3" "Nm" COEFFS 0 1 0 0 0 1 /end COMPU_METHOD
/begin COMPU_METHOD _CNV_S_4_Enum_EPOSA_43_CM_S2 "" TAB_VERB "%6.3" "" COMPU_TAB_REF _CNV_S_4_Enum_EPOSA_43_S2 /end COMPU_METHOD
/begin COMPU_METHOD _CNV_R_R_Umr_10_zu__45_CM_S2 "" RAT_FUNC "%6.3" "" COEFFS 0 10 0 0 0 1 /end COMPU_METHOD
/begin COMPU_METHOD _CNV_R_R_Umr_10_zu__46_CM_S2 "" RAT_FUNC "%6.3" "m/s*s" COEFFS 0 10 0 0 0 1 /end COMPU_METHOD
/begin COMPU_METHOD _CNV_R_R_Umr_1_zu_1_53_CM_S2 "" RAT_FUNC "%6.3" "%" COEFFS 0 1 0 0 0 1 /end COMPU_METHOD
/begin COMPU_METHOD _CNV_R_R_Umr_1000_z_57_CM_S2 "" RAT_FUNC "%6.3" "" COEFFS 0 1000 0 0 0 1 /end COMPU_METHOD
/begin COMPU_METHOD _CNV_S_3_Enum_EANH_65_CM_S2 "" TAB_VERB "%6.3" "" COMPU_TAB_REF _CNV_S_3_Enum_EANH_65_S2 /end COMPU_METHOD
/begin COMPU_METHOD _CNV_P_2_A_I_68_CM_S2 "" TAB_INTP "%6.3" "" COMPU_TAB_REF _CNV_P_2_A_I_68_S2 /end COMPU_METHOD
/begin COMPU_METHOD _CNV_S_3_Enum_EQ_79_CM_S2 "" TAB_VERB "%6.3" "" COMPU_TAB_REF _CNV_S_3_Enum_EQ_79_S2 /end COMPU_METHOD
/begin COMPU_METHOD _CNV_S_3_Enum_ERRDS_86_CM_S2 "" TAB_VERB "%6.3" "" COMPU_TAB_REF _CNV_S_3_Enum_ERRDS_86_S2 /end COMPU_METHOD
/begin COMPU_METHOD _CNV_S_12_Enum_EK0_S_91_CM_S2 "" TAB_VERB "%6.3" "" COMPU_TAB_REF _CNV_S_12_Enum_EK0_S_91_S2 /end COMPU_METHOD
/begin COMPU_METHOD _CNV_S_4_Enum_EEXCF_101_CM_S2 "" TAB_VERB "%6.3" "" COMPU_TAB_REF _CNV_S_4_Enum_EEXCF_101_S2 /end COMPU_METHOD
/begin COMPU_METHOD _CNV_S_4_Enum_EPOWE_103_CM_S2 "" TAB_VERB "%6.3" "" COMPU_TAB_REF _CNV_S_4_Enum_EPOWE_103_S2 /end COMPU_METHOD
/begin COMPU_METHOD _CNV_S_3_Enum_EREQA_118_CM_S2 "" TAB_VERB "%6.3" "" COMPU_TAB_REF _CNV_S_3_Enum_EREQA_118_S2 /end COMPU_METHOD
/begin COMPU_METHOD _CNV_R_R_Umr_1_zu_1_131_CM_S2 "" RAT_FUNC "%6.3" "°/s" COEFFS 0 1 0 0 0 1 /end COMPU_METHOD
/begin COMPU_METHOD _CNV_R_R_Umr_1_zu_1_132_CM_S2 "" RAT_FUNC "%6.3" "usec" COEFFS 0 1 0 0 0 1 /end COMPU_METHOD
/begin COMPU_METHOD _CNV_S_6_Enum_EEFAH_140_CM_S2 "" TAB_VERB "%6.3" "" COMPU_TAB_REF _CNV_S_6_Enum_EEFAH_140_S2 /end COMPU_METHOD
/begin COMPU_METHOD _CNV_S_9_Enum_EHASS_141_CM_S2 "" TAB_VERB "%6.3" "" COMPU_TAB_REF _CNV_S_9_Enum_EHASS_141_S2 /end COMPU_METHOD
/begin COMPU_METHOD _CNV_S_4_Enum_ESOCM_142_CM_S2 "Status SOC MODE" TAB_VERB "%6.3" "" COMPU_TAB_REF _CNV_S_4_Enum_ESOCM_142_S2 /end COMPU_METHOD
/begin COMPU_METHOD _CNV_R_R_Umr_1_zu_1_146_CM_S2 "" RAT_FUNC "%6.3" "s" COEFFS 0 1 0 0 0 1 /end COMPU_METHOD
/begin COMPU_METHOD _CNV_S_3_Enum_EWK_153_CM_S2 "" TAB_VERB "%6.3" "" COMPU_TAB_REF _CNV_S_3_Enum_EWK_153_S2 /end COMPU_METHOD
/begin COMPU_METHOD _CNV_R_R_Umr_10_zu__181_CM_S2 "" RAT_FUNC "%6.3" "1/s²" COEFFS 0 10 0 0 0 1 /end COMPU_METHOD
/begin COMPU_METHOD _CNV_S_4_Enum_EBLIN_194_CM_S2 "" TAB_VERB "%6.3" "" COMPU_TAB_REF _CNV_S_4_Enum_EBLIN_194_S2 /end COMPU_METHOD
/begin COMPU_METHOD _CNV_S_7_Enum_EDRIV_207_CM_S2 "" TAB_VERB "%6.3" "" COMPU_TAB_REF _CNV_S_7_Enum_EDRIV_207_S2 /end COMPU_METHOD
/begin COMPU_METHOD _CNV_S_9_Enum_EMAPD_224_CM_S2 "" TAB_VERB "%6.3" "" COMPU_TAB_REF _CNV_S_9_Enum_EMAPD_224_S2 /end COMPU_METHOD
/begin COMPU_METHOD _CNV_S_4_Enum_EBSMO_258_CM_S2 "" TAB_VERB "%6.3" "" COMPU_TAB_REF _CNV_S_4_Enum_EBSMO_258_S2 /end COMPU_METHOD
/begin COMPU_METHOD _CNV_S_7_Enum_EGEAR_267_CM_S2 "" TAB_VERB "%6.3" "" COMPU_TAB_REF _CNV_S_7_Enum_EGEAR_267_S2 /end COMPU_METHOD
/begin COMPU_METHOD _CNV_R_R_Umr_1_zu_1_270_CM_S2 "" RAT_FUNC "%6.3" "kg" COEFFS 0 1 0 0 0 1 /end COMPU_METHOD
/begin COMPU_METHOD _CNV_S_3_Enum_EANTR_272_CM_S2 "" TAB_VERB "%6.3" "" COMPU_TAB_REF _CNV_S_3_Enum_EANTR_272_S2 /end COMPU_METHOD
/begin COMPU_METHOD _CNV_S_7_Enum_EDRDY_273_CM_S2 "" TAB_VERB "%6.3" "" COMPU_TAB_REF _CNV_S_7_Enum_EDRDY_273_S2 /end COMPU_METHOD
/begin COMPU_METHOD _CNV_S_5_Enum_EDRDY_274_CM_S2 "" TAB_VERB "%6.3" "" COMPU_TAB_REF _CNV_S_5_Enum_EDRDY_274_S2 /end COMPU_METHOD
/begin COMPU_METHOD _CNV_S_4_Enum_eEGS__275_CM_S2 "" TAB_VERB "%6.3" "" COMPU_TAB_REF _CNV_S_4_Enum_eEGS__275_S2 /end COMPU_METHOD
/begin COMPU_METHOD _CNV_S_4_Enum_EEIN__276_CM_S2 "" TAB_VERB "%6.3" "" COMPU_TAB_REF _CNV_S_4_Enum_EEIN__276_S2 /end COMPU_METHOD
/begin COMPU_METHOD _CNV_S_8_Enum_EHDC_277_CM_S2 "" TAB_VERB "%6.3" "" COMPU_TAB_REF _CNV_S_8_Enum_EHDC_277_S2 /end COMPU_METHOD
/begin COMPU_METHOD _CNV_S_4_Enum_EHDC__278_CM_S2 "" TAB_VERB "%6.3" "" COMPU_TAB_REF _CNV_S_4_Enum_EHDC__278_S2 /end COMPU_METHOD
/begin COMPU_METHOD _CNV_S_2_Enum_ESTAT_279_CM_S2 "" TAB_VERB "%6.3" "" COMPU_TAB_REF _CNV_S_2_Enum_ESTAT_279_S2 /end COMPU_METHOD
/begin COMPU_METHOD _CNV_S_6_Enum_EK0_280_CM_S2 "" TAB_VERB "%6.3" "" COMPU_TAB_REF _CNV_S_6_Enum_EK0_280_S2 /end COMPU_METHOD
/begin COMPU_METHOD _CNV_S_3_Enum_eLW_V_281_CM_S2 "" TAB_VERB "%6.3" "" COMPU_TAB_REF _CNV_S_3_Enum_eLW_V_281_S2 /end COMPU_METHOD
/begin COMPU_METHOD _CNV_S_5_Enum_EMOTS_282_CM_S2 "" TAB_VERB "%6.3" "" COMPU_TAB_REF _CNV_S_5_Enum_EMOTS_282_S2 /end COMPU_METHOD
/begin COMPU_METHOD _CNV_S_3_Enum_EV_RI_283_CM_S2 "" TAB_VERB "%6.3" "" COMPU_TAB_REF _CNV_S_3_Enum_EV_RI_283_S2 /end COMPU_METHOD
/begin COMPU_METHOD _CNV_S_16_Enum_EPOSW_284_CM_S2 "" TAB_VERB "%6.3" "" COMPU_TAB_REF _CNV_S_16_Enum_EPOSW_284_S2 /end COMPU_METHOD
/begin COMPU_METHOD _CNV_S_3_Enum_EABSS_285_CM_S2 "" TAB_VERB "%6.3" "" COMPU_TAB_REF _CNV_S_3_Enum_EABSS_285_S2 /end COMPU_METHOD
/begin COMPU_METHOD _CNV_S_8_Enum_E_Z_R_286_CM_S2 "" TAB_VERB "%6.3" "" COMPU_TAB_REF _CNV_S_8_Enum_E_Z_R_286_S2 /end COMPU_METHOD
/begin COMPU_METHOD _CNV_S_3_Enum_EWARM_287_CM_S2 "" TAB_VERB "%6.3" "" COMPU_TAB_REF _CNV_S_3_Enum_EWARM_287_S2 /end COMPU_METHOD
/begin COMPU_METHOD _CNV_R_R_Umr_10_zu__305_CM_S2 "" RAT_FUNC "%6.3" "1/s³" COEFFS 0 10 0 0 0 1 /end COMPU_METHOD
/begin COMPU_METHOD _CNV_S_3_Enum_EGDM__308_CM_S2 "Definitionen der Werte fuer Z_GDM_RAD_KOMP" TAB_VERB "%6.3" "" COMPU_TAB_REF _CNV_S_3_Enum_EGDM__308_S2 /end COMPU_METHOD
/begin COMPU_METHOD _CNV_S_5_Enum_EKURV_310_CM_S2 "" TAB_VERB "%6.3" "" COMPU_TAB_REF _CNV_S_5_Enum_EKURV_310_S2 /end COMPU_METHOD
/begin COMPU_METHOD _CNV_S_4_Enum_EKURV_311_CM_S2 "" TAB_VERB "%6.3" "" COMPU_TAB_REF _CNV_S_4_Enum_EKURV_311_S2 /end COMPU_METHOD
/begin COMPU_METHOD _CNV_S_3_Enum_EAGST_312_CM_S2 "" TAB_VERB "%6.3" "" COMPU_TAB_REF _CNV_S_3_Enum_EAGST_312_S2 /end COMPU_METHOD
/begin COMPU_METHOD _CNV_S_3_Enum_EKURV_313_CM_S2 "" TAB_VERB "%6.3" "" COMPU_TAB_REF _CNV_S_3_Enum_EKURV_313_S2 /end COMPU_METHOD
/begin COMPU_METHOD _CNV_S_10_Enum_EDBMT_317_CM_S2 "" TAB_VERB "%6.3" "" COMPU_TAB_REF _CNV_S_10_Enum_EDBMT_317_S2 /end COMPU_METHOD
/begin COMPU_METHOD _CNV_S_5_Enum_REKUP_320_CM_S2 "" TAB_VERB "%6.3" "" COMPU_TAB_REF _CNV_S_5_Enum_REKUP_320_S2 /end COMPU_METHOD
/begin COMPU_METHOD _CNV_R_R_Umr_100_zu_329_CM_S2 "" RAT_FUNC "%6.3" "m/s*s" COEFFS 0 100 0 0 0 1 /end COMPU_METHOD
/begin COMPU_METHOD _CNV_S_2_Enum_EINVA_330_CM_S2 "" TAB_VERB "%6.3" "" COMPU_TAB_REF _CNV_S_2_Enum_EINVA_330_S2 /end COMPU_METHOD
/begin COMPU_METHOD _CNV_S_4_Enum_EVALI_331_CM_S2 "" TAB_VERB "%6.3" "" COMPU_TAB_REF _CNV_S_4_Enum_EVALI_331_S2 /end COMPU_METHOD
/begin COMPU_METHOD _CNV_S_3_Enum_EDSPV_332_CM_S2 "" TAB_VERB "%6.3" "" COMPU_TAB_REF _CNV_S_3_Enum_EDSPV_332_S2 /end COMPU_METHOD
/begin COMPU_METHOD _CNV_R_R_Umr_1_zu_1_339_CM_S2 "" RAT_FUNC "%6.3" "% von %" COEFFS 0 1 0 0 0 1 /end COMPU_METHOD
/begin COMPU_METHOD _CNV_S_3_Enum_ECONT_340_CM_S2 "" TAB_VERB "%6.3" "" COMPU_TAB_REF _CNV_S_3_Enum_ECONT_340_S2 /end COMPU_METHOD
/begin COMPU_METHOD _CNV_S_7_Enum_EDMRS_341_CM_S2 "" TAB_VERB "%6.3" "" COMPU_TAB_REF _CNV_S_7_Enum_EDMRS_341_S2 /end COMPU_METHOD
/begin COMPU_METHOD _CNV_S_3_Enum_ETEST_344_CM_S2 "" TAB_VERB "%6.3" "" COMPU_TAB_REF _CNV_S_3_Enum_ETEST_344_S2 /end COMPU_METHOD
/begin COMPU_METHOD _CNV_S_15_Enum_EPRIS_351_CM_S2 "" TAB_VERB "%6.3" "" COMPU_TAB_REF _CNV_S_15_Enum_EPRIS_351_S2 /end COMPU_METHOD
/begin COMPU_METHOD _CNV_S_3_Enum_EST_S_352_CM_S2 "" TAB_VERB "%6.3" "" COMPU_TAB_REF _CNV_S_3_Enum_EST_S_352_S2 /end COMPU_METHOD
/begin COMPU_METHOD _CNV_S_4_Enum_Z_EFA_354_CM_S2 "" TAB_VERB "%6.3" "" COMPU_TAB_REF _CNV_S_4_Enum_Z_EFA_354_S2 /end COMPU_METHOD
/begin COMPU_TAB _CNV_P_2_A_I_5_S2 "" TAB_INTP 2 0 0 255 255 /end COMPU_TAB
/begin COMPU_TAB _CNV_P_2_A_I_68_S2 "" TAB_INTP 2 0 0 65535 65535 /end COMPU_TAB
/begin COMPU_VTAB _CNV_S_2_Schalter_A_4_S2 "Schalter: 0 = AUS, 1 = EIN" TAB_VERB 2 0 "AUS" 1 "EIN" /end COMPU_VTAB
/begin COMPU_VTAB _CNV_S_6_Enum_EDL_11_S2 "" TAB_VERB 6 1 "DL_1" 2 "DL_2" 3 "DL_3" 4 "DL_4" 5 "DL_5" 6 "DL_6" /end COMPU_VTAB
/begin COMPU_VTAB _CNV_S_11_Enum_STATU_14_S2 "" TAB_VERB 11 0 "INIT_UNB" 1 "PASSIV" 2 "MOT_AN" 3 "STOPANKU" 4 "STOPA_GA" 5 "STOPA_NU" 6 "STOPPBEF" 7 "MOT_AUS" 8 "STARTER" 9 "DURCHSTA" 10 "TASTER" /end COMPU_VTAB
/begin COMPU_VTAB _CNV_S_3_Enum_ENOTL_18_S2 "" TAB_VERB 3 0 "MOTOR_KEIN_NOTLAUF" 1 "MOTOR_NOTLAUF_1" 2 "MOTOR_NOTLAUF_2" /end COMPU_VTAB
/begin COMPU_VTAB _CNV_S_3_Enum_EDSCS_28_S2 "" TAB_VERB 3 0 "DSC_ACTIVE" 1 "DSC_PASSIVE" 2 "DTC_ACTIVE" /end COMPU_VTAB
/begin COMPU_VTAB _CNV_S_9_Enum_EGANG_30_S2 "" TAB_VERB 9 0 "GANG_1" 1 "GANG_2" 2 "GANG_3" 3 "GANG_4" 4 "GANG_5" 5 "GANG_6" 6 "GANG_7" 7 "GANG_8" 8 "GANG_9" /end COMPU_VTAB
/begin COMPU_VTAB _CNV_S_10_Enum_EDMRS_31_S2 "" TAB_VERB 10 0 "D2RS_A_AGS" 1 "D3RS_A_AGS" 2 "D4RS_A_AGS" 3 "D5RS_A_AGS" 4 "D6RS_A_AGS" 5 "D2RS_S_AGS" 6 "D3RS_S_AGS" 7 "D4RS_S_AGS" 8 "D5RS_S_AGS" 9 "D6RS_S_AGS" /end COMPU_VTAB
/begin COMPU_VTAB _CNV_S_8_Enum_EPOS_33_S2 "" TAB_VERB 8 0 "POS_1" 1 "POS_2" 2 "POS_3" 3 "POS_4" 4 "POS_D" 5 "POS_N" 6 "POS_R" 7 "POS_P" /end COMPU_VTAB
/begin COMPU_VTAB _CNV_S_4_Enum_EPROG_35_S2 "" TAB_VERB 4 0 "NORMAL_MODE" 1 "SPORT_MODE" 2 "STEPTRONIC_MODE" 3 "L_MODE" /end COMPU_VTAB
/begin COMPU_VTAB _CNV_S_21_Enum_EPROG_40_S2 "" TAB_VERB 21 0 "EXTREME_ECONOMY_PROG" 1 "ECONOMY_PROG" 2 "SPORT_PROG" 3 "EXTREME_SPORT_PROG" 4 "A1_PROG" 5 "A2_PROG" 6 "A3_PROG" 7 "A4_PROG" 8 "A5_PROG" 9 "SA1_PROG" 10 "SA2_PROG" 11 "SA3_PROG" 12 "SA4_PROG" 13 "WL1_PROG" 14 "WL2_PROG" 15 "ECO_PROG" 16 "ECOA1_PROG" 17 "ECOA2_PROG" 18 "ECOWL2_PROG" 19 "SO1_PROG" 20 "SO2_PROG" /end COMPU_VTAB
/begin COMPU_VTAB _CNV_S_4_Enum_EPOSA_43_S2 "" TAB_VERB 4 0 "POS_D" 1 "POS_N" 2 "POS_R" 3 "POS_P" /end COMPU_VTAB
/begin COMPU_VTAB _CNV_S_3_Enum_EANH_65_S2 "" TAB_VERB 3 0 "KEIN_ANHAENGER" 1 "ANHAENGER" 2 "ANHAENGER_ODER_KEIN_ANHAENGER" /end COMPU_VTAB
/begin COMPU_VTAB _CNV_S_3_Enum_EQ_79_S2 "" TAB_VERB 3 0 "SIGNAL_OK" 1 "ERSATZWERT" 2 "FEHLER" /end COMPU_VTAB
/begin COMPU_VTAB _CNV_S_3_Enum_ERRDS_86_S2 "" TAB_VERB 3 0 "ABS_DSC_Ok" 1 "ABS_DSC_ERR_RolleCAN_False" 2 "ABS_DSC_ERR_RolleCAN_True" /end COMPU_VTAB
/begin COMPU_VTAB _CNV_S_12_Enum_EK0_S_91_S2 "" TAB_VERB 12 0 "OFFEN_ASDINAKT" 1 "ANGELEGT_ASDINAKT" 2 "DRUCKSTELLUNG_ASDINAKT" 3 "SCHLUPFGEREGELT_ASDINAKT" 4 "GEREGELTGESCHLOSSEN_ASDINAKT" 5 "GESCHLOSSEN_ASDINAKT" 6 "OFFEN_ASDAKT" 7 "ANGELEGT_ASDAKT" 8 "DRUCKSTELLUNG_ASDAKT" 9 "SCHLUPFGEREGELT_ASDAKT" 10 "GEREGELTGESCHLOSSEN_ASDAKT" 11 "GESCHLOSSEN_ASDAKT" /end COMPU_VTAB
/begin COMPU_VTAB _CNV_S_4_Enum_EEXCF_101_S2 "" TAB_VERB 4 0 "AUTOMAT" 1 "MANUELL" 2 "FAHRERASSISTENT" 3 "ZUGKRAFTALGO" /end COMPU_VTAB
/begin COMPU_VTAB _CNV_S_4_Enum_EPOWE_103_S2 "" TAB_VERB 4 0 "PS_FREI" 1 "PS_KOMFORT" 2 "PS_SPORT" 3 "PS_SPORT_PLUS" /end COMPU_VTAB
/begin COMPU_VTAB _CNV_S_3_Enum_EREQA_118_S2 "" TAB_VERB 3 0 "NO_REQUEST" 1 "REQUEST_PRIO_LOW" 2 "REQUEST_PRIO_HIGH" /end COMPU_VTAB
/begin COMPU_VTAB _CNV_S_6_Enum_EEFAH_140_S2 "" TAB_VERB 6 0 "KEIN_E_FAHREN" 1 "MSA_KENNLINIE" 2 "HOCHEFFIZIENZ_KL" 3 "EFFIZIENZ_KL" 4 "KUNDENWERTE_KL" 5 "EDRIVE_KL" /end COMPU_VTAB
/begin COMPU_VTAB _CNV_S_9_Enum_EHASS_141_S2 "" TAB_VERB 9 0 "INIT_INAKTIV" 1 "ANGEKOPPELT" 2 "ENTKOPPELT" 3 "E_FAHREN" 4 "STOP" 5 "LADEN" 6 "ENTKOPPELT_VM_EIN" 7 "E_FAHREN_VM_EIN" 8 "HYBRIDFAHREN" /end COMPU_VTAB
/begin COMPU_VTAB _CNV_S_4_Enum_ESOCM_142_S2 "Status SOC MODE" TAB_VERB 4 0 "Depleting" 1 "Sustaining" 2 "Hold" 3 "Failure" /end COMPU_VTAB
/begin COMPU_VTAB _CNV_S_3_Enum_EWK_153_S2 "" TAB_VERB 3 0 "OFFEN" 1 "GEREGELT" 2 "ZU" /end COMPU_VTAB
/begin COMPU_VTAB _CNV_S_4_Enum_EBLIN_194_S2 "" TAB_VERB 4 0 "BLINKER_AUS" 1 "BLINKER_LINKS" 2 "BLINKER_RECHTS" 3 "BLINKER_BEIDE" /end COMPU_VTAB
/begin COMPU_VTAB _CNV_S_7_Enum_EDRIV_207_S2 "" TAB_VERB 7 0 "DRIVEDYN_BASIS" 1 "DRIVEDYN_KOMFORT" 2 "DRIVEDYN_TRAKTION" 3 "DRIVEDYN_SPORT" 4 "DRIVEDYN_SPORT_PLUS" 5 "DRIVEDYN_RACE" 6 "DRIVEDYN_ECO" /end COMPU_VTAB
/begin COMPU_VTAB _CNV_S_9_Enum_EMAPD_224_S2 "" TAB_VERB 9 0 "LMODE_DL" 1 "FDC_DL" 2 "FDS_BASIS" 3 "FDS_KOMFORT" 4 "FDS_TRAKTION" 5 "FDS_SPORT" 6 "FDS_SPORT_PLUS" 7 "FDS_RACE" 8 "FDS_ECO" /end COMPU_VTAB
/begin COMPU_VTAB _CNV_S_4_Enum_EBSMO_258_S2 "" TAB_VERB 4 0 "BSMODE_INIT" 1 "BSMODE_STBY" 2 "BSMODE_CRUISE" 3 "BSMODE_LMPH" /end COMPU_VTAB
/begin COMPU_VTAB _CNV_S_7_Enum_EGEAR_267_S2 "" TAB_VERB 7 0 "NO_GEAR_REDUCTION" 1 "REDUCE_GEAR_1" 2 "REDUCE_GEAR_2" 3 "REDUCE_GEAR_3" 4 "REDUCE_GEAR_4" 5 "REDUCE_GEAR_5" 6 "REDUCE_GEAR_6" /end COMPU_VTAB
/begin COMPU_VTAB _CNV_S_3_Enum_EANTR_272_S2 "" TAB_VERB 3 0 "HECK" 1 "ALLRAD" 2 "FRONT" /end COMPU_VTAB
/begin COMPU_VTAB _CNV_S_7_Enum_EDRDY_273_S2 "" TAB_VERB 7 0 "DRDY_BASIS" 2 "DRDY_KOMFORT" 4 "DRDY_TRAKTION" 9 "DRDY_SPORT" 10 "DRDY_ECO" 11 "DRDY_SPORT_PLUS" 13 "DRDY_RACE" /end COMPU_VTAB
/begin COMPU_VTAB _CNV_S_5_Enum_EDRDY_274_S2 "" TAB_VERB 5 0 "DRDY_DSC_ON" 1 "DRDY_DTC" 2 "DRDY_DSC_ON_1" 3 "DRDY_DSC_ON_2" 4 "DRDY_DSC_OFF" /end COMPU_VTAB
/begin COMPU_VTAB _CNV_S_4_Enum_eEGS__275_S2 "" TAB_VERB 4 0 "KEINE_RPM_RED" 1 "RPM_RED_AKS" 2 "RPM_RED_EWP_ERR" 3 "RPM_RED_3" /end COMPU_VTAB
/begin COMPU_VTAB _CNV_S_4_Enum_EEIN__276_S2 "" TAB_VERB 4 0 "KEINE_ANFORDERUNG" 1 "HOHE_STRANGVERSTAERKUNG" 2 "KEINE_LASTWECHSEL" 3 "LASTREDUKTION" /end COMPU_VTAB
/begin COMPU_VTAB _CNV_S_8_Enum_EHDC_277_S2 "" TAB_VERB 8 0 "HDC_OFF" 1 "HDC_DSBL_GANG" 2 "HDC_DSBL_LOW" 3 "HDC_DSBL_SPD" 4 "HDC_UNDEF" 5 "HDC_ENBL" 6 "HDC_ACTIVE" 7 "HDC_ERROR" /end COMPU_VTAB
/begin COMPU_VTAB _CNV_S_4_Enum_EHDC__278_S2 "" TAB_VERB 4 0 "HDCSBE_NO_SBE" 1 "HDCSBE_RS" 2 "HDCSBE_HS" 3 "HDCSBE_NEUTRAL" /end COMPU_VTAB
/begin COMPU_VTAB _CNV_S_2_Enum_ESTAT_279_S2 "" TAB_VERB 2 0 "KEINE_BEEINFLUSSUNG" 1 "SCHUBABSCHALTUNG_AKTIV" /end COMPU_VTAB
/begin COMPU_VTAB _CNV_S_6_Enum_EK0_280_S2 "" TAB_VERB 6 0 "OFFEN" 1 "ANGELEGT" 2 "DRUCKSTELLUNG" 3 "SCHLUPFGEREGELT" 4 "GEREGELTGESCHLOSSEN" 5 "GESCHLOSSEN" /end COMPU_VTAB
/begin COMPU_VTAB _CNV_S_3_Enum_eLW_V_281_S2 "" TAB_VERB 3 0 "LWVA_GUELTIG" 1 "LWVA_UNSICHER" 2 "LWVA_UNGUELTIG" /end COMPU_VTAB
/begin COMPU_VTAB _CNV_S_5_Enum_EMOTS_282_S2 "" TAB_VERB 5 0 "KEIN_MOTSTART" 1 "START_SGR" 2 "START_EM" 3 "START_SGR_EM" 4 "START_RS" /end COMPU_VTAB
/begin COMPU_VTAB _CNV_S_3_Enum_EV_RI_283_S2 "" TAB_VERB 3 0 "V_VOR" 1 "V_RUECK" 2 "V_UNDEF" /end COMPU_VTAB
/begin COMPU_VTAB _CNV_S_16_Enum_EPOSW_284_S2 "" TAB_VERB 16 11 "P_P" 12 "P_R" 13 "P_N" 14 "P_D" 21 "R_P" 22 "-" 23 "R_N" 24 "R_D" 31 "N_P" 32 "N_R" 33 "-" 34 "N_D" 41 "D_P" 42 "D_R" 43 "D_N" 44 "-" /end COMPU_VTAB
/begin COMPU_VTAB _CNV_S_3_Enum_EABSS_285_S2 "" TAB_VERB 3 0 "ABS_NOT_IN_ACTION" 1 "ABS_IN_ACTION" 2 "ABS_FAILURE" /end COMPU_VTAB
/begin COMPU_VTAB _CNV_S_8_Enum_E_Z_R_286_S2 "" TAB_VERB 8 0 "keine Anforderung" 1 "Rueckschaltanforderung" 2 "Hochschaltanforderung" 3 "Rueckschaltunterdrueckung" 4 "Hochschaltunterdrueckung" 5 "Funktionsschnittstelle ist nicht verfuegbar" 6 "Funktion meldet Fehler" 7 "Signal unbefuellt" /end COMPU_VTAB
/begin COMPU_VTAB _CNV_S_3_Enum_EWARM_287_S2 "" TAB_VERB 3 0 "WL_IMWARMLAUF" 1 "WL_BETRIEBSWARM" 2 "WL_ZUWARM" /end COMPU_VTAB
/begin COMPU_VTAB _CNV_S_3_Enum_EGDM__308_S2 "Definitionen der Werte fuer Z_GDM_RAD_KOMP" TAB_VERB 3 0 "ZU_STEIL_NEG" 1 "KEINE_UEBERSCHREITUNG" 2 "ZU_STEIL_POS" /end COMPU_VTAB
/begin COMPU_VTAB _CNV_S_5_Enum_EKURV_310_S2 "" TAB_VERB 5 0 "KURVETYP_NORMAL" 1 "KURVETYP_NORMAL_S_AGS" 2 "KURVETYP_SERP" 3 "KURVETYP_LDM" 4 "KURVETYP_NORMAL_TID" /end COMPU_VTAB
/begin COMPU_VTAB _CNV_S_4_Enum_EKURV_311_S2 "" TAB_VERB 4 0 "KURVEVORL_A_AGS" 1 "KURVEVORL_S_AGS" 2 "KURVEVORL_LDM" 3 "KURVEVORL_TID" /end COMPU_VTAB
/begin COMPU_VTAB _CNV_S_3_Enum_EAGST_312_S2 "" TAB_VERB 3 0 "A_AGS_KU" 1 "S_AGS_KU" 2 "TID_KU" /end COMPU_VTAB
/begin COMPU_VTAB _CNV_S_3_Enum_EKURV_313_S2 "" TAB_VERB 3 0 "KEINE_KURVE" 1 "KURVE" 2 "KURVE_UNPLAUSIBEL" /end COMPU_VTAB
/begin COMPU_VTAB _CNV_S_10_Enum_EDBMT_317_S2 "" TAB_VERB 10 0 "DBMZKA_IDX1" 1 "DBMZKA_IDX2" 2 "DBMZKA_IDX3" 3 "DBMZKA_IDX4" 4 "DBMZKA_IDX5" 5 "DBMZKA_IDX6" 6 "DBMZKA_IDX7" 7 "DBMZKA_IDX8" 8 "DBMZKA_IDX9" 9 "DBMZKA_IDX10" /end COMPU_VTAB
/begin COMPU_VTAB _CNV_S_5_Enum_REKUP_320_S2 "" TAB_VERB 5 0 "REKUP_IDX1" 1 "REKUP_IDX2" 2 "REKUP_IDX3" 3 "REKUP_IDX4" 4 "REKUP_IDX5" /end COMPU_VTAB
/begin COMPU_VTAB _CNV_S_2_Enum_EINVA_330_S2 "" TAB_VERB 2 0 "VALID" 1 "INVALID_LMPH" /end COMPU_VTAB
/begin COMPU_VTAB _CNV_S_4_Enum_EVALI_331_S2 "" TAB_VERB 4 0 "INVALID" 2 "INVALID_LDM" 5 "DREHZAHLGRENZEN" 10 "VALID" /end COMPU_VTAB
/begin COMPU_VTAB _CNV_S_3_Enum_EDSPV_332_S2 "" TAB_VERB 3 0 "KEINE_DSPV" 1 "HSEARLIER_AKTIV" 2 "HSLATER_AKTIV" /end COMPU_VTAB
/begin COMPU_VTAB _CNV_S_3_Enum_ECONT_340_S2 "" TAB_VERB 3 0 "PRUEFUNG_ENDE" 1 "PRUEFUNG_START" 2 "PRUEFUNG_NEU" /end COMPU_VTAB
/begin COMPU_VTAB _CNV_S_7_Enum_EDMRS_341_S2 "" TAB_VERB 7 0 "KEIN_BEREICH" 1 "BEREICH_1RS" 2 "BEREICH_D2RS" 3 "BEREICH_D3RS" 4 "BEREICH_D4RS" 5 "BEREICH_D5RS" 6 "BEREICH_D6RS" /end COMPU_VTAB
/begin COMPU_VTAB _CNV_S_3_Enum_ETEST_344_S2 "" TAB_VERB 3 0 "TESTFALL_1" 1 "TESTFALL_2" 2 "SOLLGANGAGS" /end COMPU_VTAB
/begin COMPU_VTAB _CNV_S_15_Enum_EPRIS_351_S2 "" TAB_VERB 15 0 "SPA_PRSIQ_1" 1 "SPA_PRSIQ_2" 2 "SPA_PRSIQ_3" 3 "SPA_PRSIQ_4" 4 "SPA_PRSIQ_5" 5 "SPA_PRSIQ_6" 6 "SPA_PRSIQ_7" 7 "SPA_PRSIQ_8" 8 "SPA_PRSIQ_9" 9 "SPA_PRSIQ_10" 10 "SPA_PRSIQ_11" 11 "SPA_PRSIQ_12" 12 "SPA_PRSIQ_13" 13 "SPA_PRSIQ_14" 14 "SPA_PRSIQ_15" /end COMPU_VTAB
/begin COMPU_VTAB _CNV_S_3_Enum_EST_S_352_S2 "" TAB_VERB 3 0 "KS_SPA" 1 "HS_SPA" 2 "RS_SPA" /end COMPU_VTAB
/begin COMPU_VTAB _CNV_S_4_Enum_Z_EFA_354_S2 "" TAB_VERB 4 0 "ES_EFAHREN_1_ERK" 1 "ES_EFAHREN_2_ERK" 2 "ES_EFAHREN_3_ERK" 3 "ES_EFAHREN_4_ERK" /end COMPU_VTAB
/begin RECORD_LAYOUT _REC_A2AXS_31_u2_S2 AXIS_PTS_X 2 UWORD INDEX_INCR DIRECT NO_AXIS_PTS_X 1 UWORD /end RECORD_LAYOUT
/begin RECORD_LAYOUT ZF_TAB_OI_INT8_S3_S3 FNC_VALUES 1 SBYTE COLUMN_DIR DIRECT /end RECORD_LAYOUT
/begin RECORD_LAYOUT ZF_TAB_OI_INT16_S3_S3 FNC_VALUES 1 SWORD COLUMN_DIR DIRECT /end RECORD_LAYOUT
/begin RECORD_LAYOUT ZF_TAB_OI_INT32_S3_S3 FNC_VALUES 1 SLONG COLUMN_DIR DIRECT /end RECORD_LAYOUT
/begin RECORD_LAYOUT ZF_TAB2D_NAT16_S3_S3 FNC_VALUES 3 UWORD ROW_DIR DIRECT NO_AXIS_PTS_X 1 ULONG NO_AXIS_PTS_Y 2 ULONG /end RECORD_LAYOUT
/begin RECORD_LAYOUT ZF_TAB2D_NAT32_S3_S3 FNC_VALUES 3 ULONG ROW_DIR DIRECT NO_AXIS_PTS_X 1 ULONG NO_AXIS_PTS_Y 2 ULONG /end RECORD_LAYOUT
/begin RECORD_LAYOUT ZF_TAB2D_INT8_S3_S3 FNC_VALUES 3 SBYTE ROW_DIR DIRECT NO_AXIS_PTS_X 1 ULONG NO_AXIS_PTS_Y 2 ULONG /end RECORD_LAYOUT
/begin RECORD_LAYOUT ZF_TAB2D_INT16_S3_S3 FNC_VALUES 3 SWORD ROW_DIR DIRECT NO_AXIS_PTS_X 1 ULONG NO_AXIS_PTS_Y 2 ULONG /end RECORD_LAYOUT
/begin RECORD_LAYOUT ZF_TAB2D_INT32_S3_S3 FNC_VALUES 3 SLONG ROW_DIR DIRECT NO_AXIS_PTS_X 1 ULONG NO_AXIS_PTS_Y 2 ULONG /end RECORD_LAYOUT
/begin RECORD_LAYOUT ZF_TAB2D_OI_NAT8_S3_S3 FNC_VALUES 1 UBYTE ROW_DIR DIRECT /end RECORD_LAYOUT
/begin RECORD_LAYOUT ZF_TAB2D_OI_NAT16_S3_S3 FNC_VALUES 1 UWORD ROW_DIR DIRECT /end RECORD_LAYOUT
/begin RECORD_LAYOUT ZF_TAB2D_OI_NAT32_S3_S3 FNC_VALUES 1 ULONG ROW_DIR DIRECT /end RECORD_LAYOUT
/begin RECORD_LAYOUT ZF_TAB2D_OI_INT8_S3_S3 FNC_VALUES 1 SBYTE ROW_DIR DIRECT /end RECORD_LAYOUT
/begin RECORD_LAYOUT ZF_TAB2D_OI_INT16_S3_S3 FNC_VALUES 1 SWORD ROW_DIR DIRECT /end RECORD_LAYOUT
/begin RECORD_LAYOUT ZF_TAB2D_OI_INT32_S3_S3 FNC_VALUES 1 SLONG ROW_DIR DIRECT /end RECORD_LAYOUT
/begin RECORD_LAYOUT ZF_KL_NAT8_S3_S3 FNC_VALUES 3 UBYTE COLUMN_DIR DIRECT AXIS_PTS_X 2 UBYTE INDEX_INCR DIRECT NO_AXIS_PTS_X 1 ULONG /end RECORD_LAYOUT
/begin RECORD_LAYOUT ZF_KL_NAT16_S3_S3 FNC_VALUES 3 UWORD COLUMN_DIR DIRECT AXIS_PTS_X 2 UWORD INDEX_INCR DIRECT NO_AXIS_PTS_X 1 ULONG /end RECORD_LAYOUT
/begin RECORD_LAYOUT ZF_KL_NAT32_S3_S3 FNC_VALUES 3 ULONG COLUMN_DIR DIRECT AXIS_PTS_X 2 ULONG INDEX_INCR DIRECT NO_AXIS_PTS_X 1 ULONG /end RECORD_LAYOUT
/begin RECORD_LAYOUT ZF_KL_INT8_S3_S3 FNC_VALUES 3 SBYTE COLUMN_DIR DIRECT AXIS_PTS_X 2 SBYTE INDEX_INCR DIRECT NO_AXIS_PTS_X 1 ULONG /end RECORD_LAYOUT
/begin RECORD_LAYOUT ZF_KL_INT16_S3_S3 FNC_VALUES 3 SWORD COLUMN_DIR DIRECT AXIS_PTS_X 2 SWORD INDEX_INCR DIRECT NO_AXIS_PTS_X 1 ULONG /end RECORD_LAYOUT
/begin RECORD_LAYOUT ZF_KL_INT32_S3_S3 FNC_VALUES 3 SLONG COLUMN_DIR DIRECT AXIS_PTS_X 2 SLONG INDEX_INCR DIRECT NO_AXIS_PTS_X 1 ULONG /end RECORD_LAYOUT
/begin RECORD_LAYOUT ZF_KF_NAT8_S3_S3 FNC_VALUES 5 UBYTE ROW_DIR DIRECT AXIS_PTS_X 3 UBYTE INDEX_INCR DIRECT AXIS_PTS_Y 4 UBYTE INDEX_INCR DIRECT NO_AXIS_PTS_X 1 ULONG NO_AXIS_PTS_Y 2 ULONG /end RECORD_LAYOUT
/begin RECORD_LAYOUT ZF_KF_NAT16_S3_S3 FNC_VALUES 5 UWORD ROW_DIR DIRECT AXIS_PTS_X 3 UWORD INDEX_INCR DIRECT AXIS_PTS_Y 4 UWORD INDEX_INCR DIRECT NO_AXIS_PTS_X 1 ULONG NO_AXIS_PTS_Y 2 ULONG /end RECORD_LAYOUT
/begin RECORD_LAYOUT ZF_KF_NAT32_S3_S3 FNC_VALUES 5 ULONG ROW_DIR DIRECT AXIS_PTS_X 3 ULONG INDEX_INCR DIRECT AXIS_PTS_Y 4 ULONG INDEX_INCR DIRECT NO_AXIS_PTS_X 1 ULONG NO_AXIS_PTS_Y 2 ULONG /end RECORD_LAYOUT
/begin RECORD_LAYOUT ZF_KF_INT8_S3_S3 FNC_VALUES 5 SBYTE ROW_DIR DIRECT AXIS_PTS_X 3 SBYTE INDEX_INCR DIRECT AXIS_PTS_Y 4 SBYTE INDEX_INCR DIRECT NO_AXIS_PTS_X 1 ULONG NO_AXIS_PTS_Y 2 ULONG /end RECORD_LAYOUT
/begin RECORD_LAYOUT ZF_KF_INT16_S3_S3 FNC_VALUES 5 SWORD ROW_DIR DIRECT AXIS_PTS_X 3 SWORD INDEX_INCR DIRECT AXIS_PTS_Y 4 SWORD INDEX_INCR DIRECT NO_AXIS_PTS_X 1 ULONG NO_AXIS_PTS_Y 2 ULONG /end RECORD_LAYOUT
/begin RECORD_LAYOUT ZF_KF_INT32_S3_S3 FNC_VALUES 5 SLONG ROW_DIR DIRECT AXIS_PTS_X 3 SLONG INDEX_INCR DIRECT AXIS_PTS_Y 4 SLONG INDEX_INCR DIRECT NO_AXIS_PTS_X 1 ULONG NO_AXIS_PTS_Y 2 ULONG /end RECORD_LAYOUT
/begin RECORD_LAYOUT ZF_kw_si8_S5_S3 FNC_VALUES 1 SBYTE COLUMN_DIR DIRECT /end RECORD_LAYOUT
/begin RECORD_LAYOUT ZF_kw_si16_S5_S3 FNC_VALUES 1 SWORD COLUMN_DIR DIRECT /end RECORD_LAYOUT
/begin RECORD_LAYOUT ZF_kw_si32_S5_S3 FNC_VALUES 1 SLONG COLUMN_DIR DIRECT /end RECORD_LAYOUT
/begin RECORD_LAYOUT ZF_tab_ui32_S5_S3 FNC_VALUES 2 ULONG COLUMN_DIR DIRECT NO_AXIS_PTS_X 1 ULONG /end RECORD_LAYOUT
/begin RECORD_LAYOUT ZF_tab_si8_S5_S3 FNC_VALUES 2 SBYTE COLUMN_DIR DIRECT NO_AXIS_PTS_X 1 ULONG /end RECORD_LAYOUT
/begin RECORD_LAYOUT ZF_tab_si16_S5_S3 FNC_VALUES 2 SWORD COLUMN_DIR DIRECT NO_AXIS_PTS_X 1 ULONG /end RECORD_LAYOUT
/begin RECORD_LAYOUT ZF_tab_si32_S5_S3 FNC_VALUES 2 SLONG COLUMN_DIR DIRECT NO_AXIS_PTS_X 1 ULONG /end RECORD_LAYOUT
/begin RECORD_LAYOUT ZF_tab_nx_ui8_S5_S3 FNC_VALUES 1 UBYTE COLUMN_DIR DIRECT /end RECORD_LAYOUT
/begin RECORD_LAYOUT ZF_tab_nx_ui32_S5_S3 FNC_VALUES 1 ULONG COLUMN_DIR DIRECT /end RECORD_LAYOUT
/begin RECORD_LAYOUT ZF_tab_nx_si8_S5_S3 FNC_VALUES 1 SBYTE COLUMN_DIR DIRECT /end RECORD_LAYOUT
/begin RECORD_LAYOUT ZF_tab_nx_si16_S5_S3 FNC_VALUES 1 SWORD COLUMN_DIR DIRECT /end RECORD_LAYOUT
/begin RECORD_LAYOUT ZF_tab_nx_si32_S5_S3 FNC_VALUES 1 SLONG COLUMN_DIR DIRECT /end RECORD_LAYOUT
/begin RECORD_LAYOUT ZF_tab2d_ui8_S5_S3 FNC_VALUES 3 UBYTE ROW_DIR DIRECT NO_AXIS_PTS_X 1 ULONG NO_AXIS_PTS_Y 2 ULONG /end RECORD_LAYOUT
/begin RECORD_LAYOUT ZF_tab2d_ui16_S5_S3 FNC_VALUES 3 UWORD ROW_DIR DIRECT NO_AXIS_PTS_X 1 ULONG NO_AXIS_PTS_Y 2 ULONG /end RECORD_LAYOUT
/begin RECORD_LAYOUT ZF_tab2d_si8_S5_S3 FNC_VALUES 3 SBYTE ROW_DIR DIRECT NO_AXIS_PTS_X 1 ULONG NO_AXIS_PTS_Y 2 ULONG /end RECORD_LAYOUT
/begin RECORD_LAYOUT ZF_tab2d_si16_S5_S3 FNC_VALUES 3 SWORD ROW_DIR DIRECT NO_AXIS_PTS_X 1 ULONG NO_AXIS_PTS_Y 2 ULONG /end RECORD_LAYOUT
/begin RECORD_LAYOUT ZF_tab2d_si32_S5_S3 FNC_VALUES 3 SLONG ROW_DIR DIRECT NO_AXIS_PTS_X 1 ULONG NO_AXIS_PTS_Y 2 ULONG /end RECORD_LAYOUT
/begin RECORD_LAYOUT ZF_tab2d_nx_ny_ui32_S5_S3 FNC_VALUES 1 ULONG ROW_DIR DIRECT /end RECORD_LAYOUT
/begin RECORD_LAYOUT ZF_tab2d_nx_ny_si8_S5_S3 FNC_VALUES 1 SBYTE ROW_DIR DIRECT /end RECORD_LAYOUT
/begin RECORD_LAYOUT ZF_tab2d_nx_ny_si16_S5_S3 FNC_VALUES 1 SWORD ROW_DIR DIRECT /end RECORD_LAYOUT
/begin RECORD_LAYOUT ZF_tab2d_nx_ny_si32_S5_S3 FNC_VALUES 1 SLONG ROW_DIR DIRECT /end RECORD_LAYOUT
/begin RECORD_LAYOUT ZF_kl_ui8_S5_S3 FNC_VALUES 3 UBYTE COLUMN_DIR DIRECT AXIS_PTS_X 2 UBYTE INDEX_INCR DIRECT NO_AXIS_PTS_X 1 ULONG /end RECORD_LAYOUT
/begin RECORD_LAYOUT ZF_kl_ui16_S5_S3 FNC_VALUES 3 UWORD COLUMN_DIR DIRECT AXIS_PTS_X 2 UWORD INDEX_INCR DIRECT NO_AXIS_PTS_X 1 ULONG /end RECORD_LAYOUT
/begin RECORD_LAYOUT ZF_kl_ui32_S5_S3 FNC_VALUES 3 ULONG COLUMN_DIR DIRECT AXIS_PTS_X 2 ULONG INDEX_INCR DIRECT NO_AXIS_PTS_X 1 ULONG /end RECORD_LAYOUT
/begin RECORD_LAYOUT ZF_kl_si8_S5_S3 FNC_VALUES 3 SBYTE COLUMN_DIR DIRECT AXIS_PTS_X 2 SBYTE INDEX_INCR DIRECT NO_AXIS_PTS_X 1 ULONG /end RECORD_LAYOUT
/begin RECORD_LAYOUT ZF_kl_si16_S5_S3 FNC_VALUES 3 SWORD COLUMN_DIR DIRECT AXIS_PTS_X 2 SWORD INDEX_INCR DIRECT NO_AXIS_PTS_X 1 ULONG /end RECORD_LAYOUT
/begin RECORD_LAYOUT ZF_kl_si32_S5_S3 FNC_VALUES 3 SLONG COLUMN_DIR DIRECT AXIS_PTS_X 2 SLONG INDEX_INCR DIRECT NO_AXIS_PTS_X 1 ULONG /end RECORD_LAYOUT
/begin RECORD_LAYOUT ZF_kf_ui8_S5_S3 FNC_VALUES 5 UBYTE ROW_DIR DIRECT AXIS_PTS_X 3 UBYTE INDEX_INCR DIRECT AXIS_PTS_Y 4 UBYTE INDEX_INCR DIRECT NO_AXIS_PTS_X 1 ULONG NO_AXIS_PTS_Y 2 ULONG /end RECORD_LAYOUT
/begin RECORD_LAYOUT ZF_kf_ui16_S5_S3 FNC_VALUES 5 UWORD ROW_DIR DIRECT AXIS_PTS_X 3 UWORD INDEX_INCR DIRECT AXIS_PTS_Y 4 UWORD INDEX_INCR DIRECT NO_AXIS_PTS_X 1 ULONG NO_AXIS_PTS_Y 2 ULONG /end RECORD_LAYOUT
/begin RECORD_LAYOUT ZF_kf_ui32_S5_S3 FNC_VALUES 5 ULONG ROW_DIR DIRECT AXIS_PTS_X 3 ULONG INDEX_INCR DIRECT AXIS_PTS_Y 4 ULONG INDEX_INCR DIRECT NO_AXIS_PTS_X 1 ULONG NO_AXIS_PTS_Y 2 ULONG /end RECORD_LAYOUT
/begin RECORD_LAYOUT ZF_kf_si8_S5_S3 FNC_VALUES 5 SBYTE ROW_DIR DIRECT AXIS_PTS_X 3 SBYTE INDEX_INCR DIRECT AXIS_PTS_Y 4 SBYTE INDEX_INCR DIRECT NO_AXIS_PTS_X 1 ULONG NO_AXIS_PTS_Y 2 ULONG /end RECORD_LAYOUT
/begin RECORD_LAYOUT ZF_kf_si16_S5_S3 FNC_VALUES 5 SWORD ROW_DIR DIRECT AXIS_PTS_X 3 SWORD INDEX_INCR DIRECT AXIS_PTS_Y 4 SWORD INDEX_INCR DIRECT NO_AXIS_PTS_X 1 ULONG NO_AXIS_PTS_Y 2 ULONG /end RECORD_LAYOUT
/begin RECORD_LAYOUT ZF_kf_si32_S5_S3 FNC_VALUES 5 SLONG ROW_DIR DIRECT AXIS_PTS_X 3 SLONG INDEX_INCR DIRECT AXIS_PTS_Y 4 SLONG INDEX_INCR DIRECT NO_AXIS_PTS_X 1 ULONG NO_AXIS_PTS_Y 2 ULONG /end RECORD_LAYOUT
/begin RECORD_LAYOUT kw_tGang_S6_S3 FNC_VALUES 1 SBYTE COLUMN_DIR DIRECT /end RECORD_LAYOUT
/begin RECORD_LAYOUT kw_si32_S6_S3 FNC_VALUES 1 SLONG COLUMN_DIR DIRECT /end RECORD_LAYOUT
/begin RECORD_LAYOUT tab_tGang_S6_S3 FNC_VALUES 2 SBYTE COLUMN_DIR DIRECT NO_AXIS_PTS_X 1 ULONG /end RECORD_LAYOUT
/begin RECORD_LAYOUT tab_si8_S6_S3 FNC_VALUES 2 SBYTE COLUMN_DIR DIRECT NO_AXIS_PTS_X 1 ULONG /end RECORD_LAYOUT
/begin RECORD_LAYOUT tab_fl32_S6_S3 FNC_VALUES 2 FLOAT32_IEEE COLUMN_DIR DIRECT NO_AXIS_PTS_X 1 ULONG /end RECORD_LAYOUT
/begin RECORD_LAYOUT tab2d_tGang_S6_S3 FNC_VALUES 3 SBYTE ROW_DIR DIRECT NO_AXIS_PTS_X 1 ULONG NO_AXIS_PTS_Y 2 ULONG /end RECORD_LAYOUT
/begin RECORD_LAYOUT tab2d_si8_S6_S3 FNC_VALUES 3 SBYTE ROW_DIR DIRECT NO_AXIS_PTS_X 1 ULONG NO_AXIS_PTS_Y 2 ULONG /end RECORD_LAYOUT
/end MODULE
/end PROJECT
