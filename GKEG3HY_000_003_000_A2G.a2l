ASAP2_VERSION 1 51
/begin PROJECT _929_929 "Gen2_BMW_System_Supplier_Lib"
/begin HEADER "" VERSION "C_03_03" PROJECT_NO _929_929 /end HEADER
/begin MODULE DIM ""
/begin MOD_COMMON "" BYTE_ORDER MSB_FIRST ALIGNMENT_BYTE 1 ALIGNMENT_WORD 2 ALIGNMENT_LONG 4 ALIGNMENT_FLOAT32_IEEE 4 /end MOD_COMMON
/begin CHARACTERISTIC D_st_IEPToGbxSt "mapping beween IEP-state and gearbox systempressure state" CURVE 0x218076 ZF_UINT8_COL_DIRECT_S4_S3 255 SABAL_STANDARD_S4_S3 0 255
 /begin AXIS_DESCR FIX_AXIS GbxSt_iv_IEPSt VOID_SCALING_S4_S3 5 0 4 FIX_AXIS_PAR_DIST 0 1 5 /end AXIS_DESCR
/end CHARACTERISTIC
/begin CHARACTERISTIC D_T_GrbToDetSysPbyNEng "Field to determine the gearbox temperature area to influence the threshold to detect systempressur by engine speed" CURVE 0x21806E ZF_UINT8_COL_DIRECT_S4_S3 255 SABAL_C_1CEL_M40_S4_S3 -40 215
 /begin AXIS_DESCR FIX_AXIS NO_INPUT_QUANTITY VOID_SCALING_S4_S3 3 0 2 FIX_AXIS_PAR_DIST 0 1 3 /end AXIS_DESCR
/end CHARACTERISTIC
/begin CHARACTERISTIC D_n_ColdPwrUpDlyAbort "Speed threshold for cold power up delay abort" VALUE 0x218342 ZF_UINT16_COL_DIRECT_S4_S3 65535 SABAL_N_1RPM_S4_S3 0 65535 /end CHARACTERISTIC
/begin CHARACTERISTIC D_t_HoldGbxSt_W "time, how long the state gearbox ready to drive must be hold, if the state gearbox ready to drive is not longer availabel" CURVE 0x21834C ZF_UINT8_COL_DIRECT_S4_S3 2550 SABAL_T_TIMER_10MS_S4_S3 0 2550
 /begin AXIS_DESCR COM_AXIS GbxSt_loc_c_OilTrans SABAL_C_1CEL_M40_S4_S3 6 -40 215 AXIS_PTS_REF D_t_HoldGbxSt_X MONOTONY MON_INCREASE /end AXIS_DESCR
/end CHARACTERISTIC
/begin CHARACTERISTIC D_t_HoldGbxStDefault "time, to hold the state system pressur if systempressur is not availabel anymore" VALUE 0x21807B ZF_UINT8_COL_DIRECT_S4_S3 2550 SABAL_T_TIMER_10MS_S4_S3 0 2550 /end CHARACTERISTIC
/begin CHARACTERISTIC D_n_EngToGbxSt "mapping beween systempressure state based on engine speed and gearbox systempressure state" CURVE 0x218071 ZF_UINT8_COL_DIRECT_S4_S3 255 SABAL_STANDARD_S4_S3 0 255
 /begin AXIS_DESCR FIX_AXIS GbxSt_p_SysFromEngSpd SABAL_STANDARD_S4_S3 5 0 4 FIX_AXIS_PAR_DIST 0 1 5 /end AXIS_DESCR
/end CHARACTERISTIC
/begin CHARACTERISTIC SWI_EnaCalcSubstInpSpd "Switch to enable the calculation of the substitute value for engine speed. 0 = calulation off 1 = Calulation on" VALUE 0x21807D ZF_UINT8_COL_DIRECT_S4_S3 1 SABAL_STANDARD_S4_S3 0 1 /end CHARACTERISTIC
/begin CHARACTERISTIC D_n_EngThd "Thd to differ between systempressure is available or not available according to the Gearboxtemp. Columne5 is used as Default values if no valid GearboxTemp. is available. Additional the columne 5 is used in the OneTimeIinit to calculate the Init-state" MAP 0x207E30 ZF_UINT16_COL_DIRECT_S4_S3 65535 SABAL_N_1RPM_S4_S3 0 65535
 /begin AXIS_DESCR FIX_AXIS NO_INPUT_QUANTITY VOID_SCALING_S4_S3 5 0 4 FIX_AXIS_PAR_DIST 0 1 5 /end AXIS_DESCR
 /begin AXIS_DESCR FIX_AXIS NO_INPUT_QUANTITY VOID_SCALING_S4_S3 2 0 1 FIX_AXIS_PAR_DIST 0 1 2 /end AXIS_DESCR
/end CHARACTERISTIC
/begin CHARACTERISTIC D_tmr_DlyRdyToDrvColdPwrUpbyInSpd_W "Calibratable time to delay ready to drive by gaerbox input speed during a cold start up in according to the gearbox temperature" CURVE 0x218358 ZF_UINT8_COL_DIRECT_S4_S3 15000 SABAL_T_TIMER_100MS_S4_S3 0 15000
 /begin AXIS_DESCR COM_AXIS GbxSt_loc_c_OilTrans SABAL_C_1CEL_M40_S4_S3 6 -40 215 AXIS_PTS_REF D_tmr_DlyRdyToDrvColdPwrUpbyInSpd_X MONOTONY MON_INCREASE /end AXIS_DESCR
/end CHARACTERISTIC
/begin CHARACTERISTIC D_v_VehColdPwrUpThr "upper Vehicle speed threshold to calculate the cold power up delay time" VALUE 0x21834A ZF_UINT16_COL_DIRECT_S4_S3 4095 SABAL_V_1KMH16_S4_S3 0 4095 /end CHARACTERISTIC
/begin CHARACTERISTIC SWI_EnaColdPwrUpDly "Switch to enable the calulation of the gearbox ready to drive delay time during cold power up. 0 = calulation off 1 = Calulation on" VALUE 0x21807E ZF_UINT8_COL_DIRECT_S4_S3 1 SABAL_STANDARD_S4_S3 0 1 /end CHARACTERISTIC
/begin CHARACTERISTIC D_n_EngThdHys "hysteresis between systempresure is available and is not available" CURVE 0x218344 ZF_UINT16_COL_DIRECT_S4_S3 65535 SABAL_N_1RPM_S4_S3 0 65535
 /begin AXIS_DESCR FIX_AXIS NO_INPUT_QUANTITY VOID_SCALING_S4_S3 3 0 2 FIX_AXIS_PAR_DIST 0 1 3 /end AXIS_DESCR
/end CHARACTERISTIC
/begin CHARACTERISTIC D_tmr_DebGbxSt2ToGbxSt3 "time to debounce to detect systempressure available" VALUE 0x21807C ZF_UINT8_COL_DIRECT_S4_S3 2550 SABAL_T_TIMER_10MS_S4_S3 0 2550 /end CHARACTERISTIC
/begin CHARACTERISTIC D_m_GearboxGuardActiveHys_TqReqMon "Hysteresis for changing between active to inactive gearbox guard - Value should be indentical to D_m_GearboxGuardActiveHys" VALUE 0x21837A ZF_UINT16_COL_DIRECT_S4_S3 1000 SABAL_M_1NM_S4_S3 0 1000 /end CHARACTERISTIC
/begin CHARACTERISTIC D_ctl_BasicConditionsFulfilled "Bitmask for relevant Basic-Conditions" VALUE 0x218378 ZF_UINT16_COL_DIRECT_S4_S3 65535 SABAL_STANDARD_S4_S3 0 65535 /end CHARACTERISTIC
/begin CHARACTERISTIC D_c_OilTrans_EIMon "Minimum allowable oil temperature for monitoring" VALUE 0x218080 ZF_UINT8_COL_DIRECT_S4_S3 255 SABAL_C_1CEL_M40_S4_S3 -40 215 /end CHARACTERISTIC
/begin CHARACTERISTIC D_n_Eng_EIMon "Minimum allowable engine speed for monitoring" VALUE 0x21837C ZF_UINT16_COL_DIRECT_S4_S3 10000 SABAL_N_1RPM_S4_S3 0 10000 /end CHARACTERISTIC
/begin CHARACTERISTIC D_t_EIMonActivDelay "Time delay for stopping the integration" VALUE 0x218082 ZF_UINT8_COL_DIRECT_S4_S3 2550 SABAL_T_TIMER_10MS_S4_S3 0 2550 /end CHARACTERISTIC
/begin CHARACTERISTIC D_t_EIMonDelay "Time delay for starting the integration" VALUE 0x218083 ZF_UINT8_COL_DIRECT_S4_S3 2550 SABAL_T_TIMER_10MS_S4_S3 0 2550 /end CHARACTERISTIC
/begin CHARACTERISTIC D_t_EI_IntegrationMin "Minimum possible integration time" VALUE 0x218084 ZF_UINT8_COL_DIRECT_S4_S3 2540 SABAL_T_TIMER_10MS_S4_S3 10 2550 /end CHARACTERISTIC
/begin CHARACTERISTIC D_t_EI_IntegrationMax "Maximum possible integration time" VALUE 0x21837E ZF_UINT16_COL_DIRECT_S4_S3 16000 SABAL_T_TIMER_10MS_S4_S3 0 16000 /end CHARACTERISTIC
/begin CHARACTERISTIC D_ctl_EIMonBreak "Bitmask for relevant Break-Conditions" VALUE 0x218081 ZF_UINT8_COL_DIRECT_S4_S3 255 SABAL_STANDARD_S4_S3 0 255 /end CHARACTERISTIC
/begin CHARACTERISTIC D_EIMon_m_EngDifNeg "Maximum allowable negativ differ of engine torque during integration term" VALUE 0x21836A ZF_UINT16_COL_DIRECT_S4_S3 1640 SABAL_M_1NM_S4_S3 0 1640 /end CHARACTERISTIC
/begin CHARACTERISTIC D_EIMon_m_EngDifPos "Maximum allowable positiv differ of engine torque during integration term" VALUE 0x21836C ZF_UINT16_COL_DIRECT_S4_S3 1640 SABAL_M_1NM_S4_S3 0 1640 /end CHARACTERISTIC
/begin CHARACTERISTIC D_EIMonThrottlePositionDifNeg "Maximum allowable negativ differ of throttle flap during integration term" VALUE 0x218364 ZF_UINT16_COL_DIRECT_S4_S3 100 SABAL_100PROZENT254_S4_S3 0 100 /end CHARACTERISTIC
/begin CHARACTERISTIC D_EIMonThrottlePositionDifPos "Maximum allowable positiv differ of throttle flap during integration term" VALUE 0x218366 ZF_UINT16_COL_DIRECT_S4_S3 100 SABAL_100PROZENT254_S4_S3 0 100 /end CHARACTERISTIC
/begin CHARACTERISTIC D_EIMonTrqTh "Maximum allowable engine torque at downshift during integration term" VALUE 0x218368 ZF_INT16_COL_DIRECT_S4_S3 65535 SABAL_M_1NM_S4_S3 -32768 32767 /end CHARACTERISTIC
/begin CHARACTERISTIC SWI_t_EI_IntAnalysis "Activation of fault analysis by integration timer max value" VALUE 0x218088 ZF_BOOL_COL_DIRECT_S4_S3 1 SABAL_STANDARD_S4_S3 0 1 /end CHARACTERISTIC
/begin CHARACTERISTIC D_mIntegral_EIMonTh "Minimum value of integration for analysis positiv/reducing engine intervention during down-/upshift (0=PosUp, 1=PosDown, 2=RedUp, 3=RedDown)" CURVE 0x207E98 ZF_UINT8_COL_DIRECT_S4_S3 50 SABAL_MI_1NMS_S4_S3 0 50
 /begin AXIS_DESCR FIX_AXIS TqReqMon_idx_EIMonTh SABAL_STANDARD_S4_S3 4 0 3 FIX_AXIS_PAR_DIST 0 1 4 /end AXIS_DESCR
/end CHARACTERISTIC
/begin CHARACTERISTIC D_EI_RealizedThP "Threshold engine intervention intensity thresholds for primary fault" MAP 0x207E44 ZF_INT16_COL_DIRECT_S4_S3 2000 SABAL_PROZENT_S4_S3 -1000 1000
 /begin AXIS_DESCR COM_AXIS TqReqMon_idx_EIMode_Uth SABAL_STANDARD_S4_S3 4 0 4 AXIS_PTS_REF D_EI_Mode_X MONOTONY MON_INCREASE /end AXIS_DESCR
 /begin AXIS_DESCR COM_AXIS TqReqMon_m_Eng_EIStart SABAL_M_1NM_S4_S3 5 -1000 2000 AXIS_PTS_REF D_EI_Tq_Y MONOTONY MON_INCREASE /end AXIS_DESCR
/end CHARACTERISTIC
/begin CHARACTERISTIC D_EI_RealizedThS "Threshold engine intervention intensity thresholds for secondary fault" MAP 0x207E6C ZF_INT16_COL_DIRECT_S4_S3 2000 SABAL_PROZENT_S4_S3 -1000 1000
 /begin AXIS_DESCR COM_AXIS TqReqMon_idx_EIMode_Uth SABAL_STANDARD_S4_S3 4 0 4 AXIS_PTS_REF D_EI_Mode_X MONOTONY MON_INCREASE /end AXIS_DESCR
 /begin AXIS_DESCR COM_AXIS TqReqMon_m_Eng_EIStart SABAL_M_1NM_S4_S3 5 -1000 2000 AXIS_PTS_REF D_EI_Tq_Y MONOTONY MON_INCREASE /end AXIS_DESCR
/end CHARACTERISTIC
/begin CHARACTERISTIC SWI_EIMon_SErrMem "Activation of secondary fault memory" VALUE 0x218086 ZF_BOOL_COL_DIRECT_S4_S3 1 SABAL_STANDARD_S4_S3 0 1 /end CHARACTERISTIC
/begin CHARACTERISTIC SWI_EIMon_PErrMem "Activation of primary fault memory" VALUE 0x218085 ZF_BOOL_COL_DIRECT_S4_S3 1 SABAL_STANDARD_S4_S3 0 1 /end CHARACTERISTIC
/begin CHARACTERISTIC SWI_m_EIReqMode "Selection of correction of requested integral" VALUE 0x218087 ZF_UINT8_COL_DIRECT_S4_S3 3 SABAL_STANDARD_S4_S3 0 3 /end CHARACTERISTIC
/begin AXIS_PTS D_t_HoldGbxSt_X "Gearbox temperature threshold to determine the time to to hold the state gearbox ready to drive at the output" 0x218352 GbxSt_loc_c_OilTrans ZF_UINT8_X_INCR_DIRECT_S4_S3 255 SABAL_C_1CEL_M40_S4_S3 6 -40 215 /end AXIS_PTS
/begin AXIS_PTS D_tmr_DlyRdyToDrvColdPwrUpbyInSpd_X "Gearbox temperature threshold to determine the time to delay ready to drive by gearbox input speed during cold start up" 0x21835E GbxSt_loc_c_OilTrans ZF_UINT8_X_INCR_DIRECT_S4_S3 255 SABAL_C_1CEL_M40_S4_S3 6 -40 215 /end AXIS_PTS
/begin AXIS_PTS D_EI_Mode_X "Shiftmode und Interventiontype" 0x207E94 TqReqMon_idx_EIMode_Uth ZF_UINT8_X_INCR_DIRECT_S4_S3 4 SABAL_STANDARD_S4_S3 4 0 4 /end AXIS_PTS
/begin AXIS_PTS D_EI_Tq_Y "Engine torque at start of limitation for driveline protection - enginespeed axis" 0x21836E TqReqMon_m_Eng_EIStart ZF_INT16_X_INCR_DIRECT_S4_S3 3000 SABAL_M_1NM_S4_S3 5 -1000 2000 /end AXIS_PTS
/begin MEASUREMENT ZFEH_EepromData.ydiBackupMemory_xau16[0].amb_cond.ambient_condition[0][0] "ambient condition shot [0 .. 2-1] with 25 data bytes [0 .. 25-1] for the error code stored in this error memory slot" UBYTE EH_STANDARD_S5_S3 1 100 0 255 DISPLAY_IDENTIFIER ambient_condition[0][0].amb_cond.ydiBackupMemory_xau16[0].ZFEH_EepromData ECU_ADDRESS 0xFFF82DC0 /end MEASUREMENT
/begin MEASUREMENT ZFEH_EepromData.ydiBackupMemory_xau16[0].amb_cond.ambient_condition[0][1] "ambient condition shot [0 .. 2-1] with 25 data bytes [0 .. 25-1] for the error code stored in this error memory slot" UBYTE EH_STANDARD_S5_S3 1 100 0 255 DISPLAY_IDENTIFIER ambient_condition[0][1].amb_cond.ydiBackupMemory_xau16[0].ZFEH_EepromData ECU_ADDRESS 0xFFF82DC1 /end MEASUREMENT
/begin MEASUREMENT ZFEH_EepromData.ydiBackupMemory_xau16[0].amb_cond.ambient_condition[0][2] "ambient condition shot [0 .. 2-1] with 25 data bytes [0 .. 25-1] for the error code stored in this error memory slot" UBYTE EH_STANDARD_S5_S3 1 100 0 255 DISPLAY_IDENTIFIER ambient_condition[0][2].amb_cond.ydiBackupMemory_xau16[0].ZFEH_EepromData ECU_ADDRESS 0xFFF82DC2 /end MEASUREMENT
/begin MEASUREMENT ZFEH_EepromData.ydiBackupMemory_xau16[0].amb_cond.ambient_condition[0][3] "ambient condition shot [0 .. 2-1] with 25 data bytes [0 .. 25-1] for the error code stored in this error memory slot" UBYTE EH_STANDARD_S5_S3 1 100 0 255 DISPLAY_IDENTIFIER ambient_condition[0][3].amb_cond.ydiBackupMemory_xau16[0].ZFEH_EepromData ECU_ADDRESS 0xFFF82DC3 /end MEASUREMENT
/begin MEASUREMENT ZFEH_EepromData.ydiBackupMemory_xau16[0].amb_cond.ambient_condition[0][4] "ambient condition shot [0 .. 2-1] with 25 data bytes [0 .. 25-1] for the error code stored in this error memory slot" UBYTE EH_STANDARD_S5_S3 1 100 0 255 DISPLAY_IDENTIFIER ambient_condition[0][4].amb_cond.ydiBackupMemory_xau16[0].ZFEH_EepromData ECU_ADDRESS 0xFFF82DC4 /end MEASUREMENT
/begin MEASUREMENT ZFEH_EepromData.ydiBackupMemory_xau16[0].amb_cond.ambient_condition[0][5] "ambient condition shot [0 .. 2-1] with 25 data bytes [0 .. 25-1] for the error code stored in this error memory slot" UBYTE EH_STANDARD_S5_S3 1 100 0 255 DISPLAY_IDENTIFIER ambient_condition[0][5].amb_cond.ydiBackupMemory_xau16[0].ZFEH_EepromData ECU_ADDRESS 0xFFF82DC5 /end MEASUREMENT
/begin MEASUREMENT ZFEH_EepromData.ydiBackupMemory_xau16[0].amb_cond.ambient_condition[0][6] "ambient condition shot [0 .. 2-1] with 25 data bytes [0 .. 25-1] for the error code stored in this error memory slot" UBYTE EH_STANDARD_S5_S3 1 100 0 255 DISPLAY_IDENTIFIER ambient_condition[0][6].amb_cond.ydiBackupMemory_xau16[0].ZFEH_EepromData ECU_ADDRESS 0xFFF82DC6 /end MEASUREMENT
/begin MEASUREMENT ZFEH_EepromData.ydiBackupMemory_xau16[0].amb_cond.ambient_condition[0][7] "ambient condition shot [0 .. 2-1] with 25 data bytes [0 .. 25-1] for the error code stored in this error memory slot" UBYTE EH_STANDARD_S5_S3 1 100 0 255 DISPLAY_IDENTIFIER ambient_condition[0][7].amb_cond.ydiBackupMemory_xau16[0].ZFEH_EepromData ECU_ADDRESS 0xFFF82DC7 /end MEASUREMENT
/begin MEASUREMENT ZFEH_EepromData.ydiBackupMemory_xau16[0].amb_cond.ambient_condition[0][8] "ambient condition shot [0 .. 2-1] with 25 data bytes [0 .. 25-1] for the error code stored in this error memory slot" UBYTE EH_STANDARD_S5_S3 1 100 0 255 DISPLAY_IDENTIFIER ambient_condition[0][8].amb_cond.ydiBackupMemory_xau16[0].ZFEH_EepromData ECU_ADDRESS 0xFFF82DC8 /end MEASUREMENT
/begin MEASUREMENT ZFEH_EepromData.ydiBackupMemory_xau16[0].amb_cond.ambient_condition[0][9] "ambient condition shot [0 .. 2-1] with 25 data bytes [0 .. 25-1] for the error code stored in this error memory slot" UBYTE EH_STANDARD_S5_S3 1 100 0 255 DISPLAY_IDENTIFIER ambient_condition[0][9].amb_cond.ydiBackupMemory_xau16[0].ZFEH_EepromData ECU_ADDRESS 0xFFF82DC9 /end MEASUREMENT
/begin MEASUREMENT ZFEH_EepromData.ydiBackupMemory_xau16[0].amb_cond.ambient_condition[0][10] "ambient condition shot [0 .. 2-1] with 25 data bytes [0 .. 25-1] for the error code stored in this error memory slot" UBYTE EH_STANDARD_S5_S3 1 100 0 255 DISPLAY_IDENTIFIER ambient_condition[0][10].amb_cond.ydiBackupMemory_xau16[0].ZFEH_EepromData ECU_ADDRESS 0xFFF82DCA /end MEASUREMENT
/begin MEASUREMENT ZFEH_EepromData.ydiBackupMemory_xau16[0].amb_cond.ambient_condition[0][11] "ambient condition shot [0 .. 2-1] with 25 data bytes [0 .. 25-1] for the error code stored in this error memory slot" UBYTE EH_STANDARD_S5_S3 1 100 0 255 DISPLAY_IDENTIFIER ambient_condition[0][11].amb_cond.ydiBackupMemory_xau16[0].ZFEH_EepromData ECU_ADDRESS 0xFFF82DCB /end MEASUREMENT
/begin MEASUREMENT ZFEH_EepromData.ydiBackupMemory_xau16[0].amb_cond.ambient_condition[0][12] "ambient condition shot [0 .. 2-1] with 25 data bytes [0 .. 25-1] for the error code stored in this error memory slot" UBYTE EH_STANDARD_S5_S3 1 100 0 255 DISPLAY_IDENTIFIER ambient_condition[0][12].amb_cond.ydiBackupMemory_xau16[0].ZFEH_EepromData ECU_ADDRESS 0xFFF82DCC /end MEASUREMENT
/begin MEASUREMENT ZFEH_EepromData.ydiBackupMemory_xau16[0].amb_cond.ambient_condition[0][13] "ambient condition shot [0 .. 2-1] with 25 data bytes [0 .. 25-1] for the error code stored in this error memory slot" UBYTE EH_STANDARD_S5_S3 1 100 0 255 DISPLAY_IDENTIFIER ambient_condition[0][13].amb_cond.ydiBackupMemory_xau16[0].ZFEH_EepromData ECU_ADDRESS 0xFFF82DCD /end MEASUREMENT
/begin MEASUREMENT ZFEH_EepromData.ydiBackupMemory_xau16[0].amb_cond.ambient_condition[0][14] "ambient condition shot [0 .. 2-1] with 25 data bytes [0 .. 25-1] for the error code stored in this error memory slot" UBYTE EH_STANDARD_S5_S3 1 100 0 255 DISPLAY_IDENTIFIER ambient_condition[0][14].amb_cond.ydiBackupMemory_xau16[0].ZFEH_EepromData ECU_ADDRESS 0xFFF82DCE /end MEASUREMENT
/begin MEASUREMENT ZFEH_EepromData.ydiBackupMemory_xau16[0].amb_cond.ambient_condition[0][15] "ambient condition shot [0 .. 2-1] with 25 data bytes [0 .. 25-1] for the error code stored in this error memory slot" UBYTE EH_STANDARD_S5_S3 1 100 0 255 DISPLAY_IDENTIFIER ambient_condition[0][15].amb_cond.ydiBackupMemory_xau16[0].ZFEH_EepromData ECU_ADDRESS 0xFFF82DCF /end MEASUREMENT
/begin MEASUREMENT ZFEH_EepromData.ydiBackupMemory_xau16[0].amb_cond.ambient_condition[0][16] "ambient condition shot [0 .. 2-1] with 25 data bytes [0 .. 25-1] for the error code stored in this error memory slot" UBYTE EH_STANDARD_S5_S3 1 100 0 255 DISPLAY_IDENTIFIER ambient_condition[0][16].amb_cond.ydiBackupMemory_xau16[0].ZFEH_EepromData ECU_ADDRESS 0xFFF82DD0 /end MEASUREMENT
/begin MEASUREMENT ZFEH_EepromData.ydiBackupMemory_xau16[0].amb_cond.ambient_condition[0][17] "ambient condition shot [0 .. 2-1] with 25 data bytes [0 .. 25-1] for the error code stored in this error memory slot" UBYTE EH_STANDARD_S5_S3 1 100 0 255 DISPLAY_IDENTIFIER ambient_condition[0][17].amb_cond.ydiBackupMemory_xau16[0].ZFEH_EepromData ECU_ADDRESS 0xFFF82DD1 /end MEASUREMENT
/begin MEASUREMENT ZFEH_EepromData.ydiBackupMemory_xau16[0].amb_cond.ambient_condition[0][18] "ambient condition shot [0 .. 2-1] with 25 data bytes [0 .. 25-1] for the error code stored in this error memory slot" UBYTE EH_STANDARD_S5_S3 1 100 0 255 DISPLAY_IDENTIFIER ambient_condition[0][18].amb_cond.ydiBackupMemory_xau16[0].ZFEH_EepromData ECU_ADDRESS 0xFFF82DD2 /end MEASUREMENT
/begin MEASUREMENT ZFEH_EepromData.ydiBackupMemory_xau16[0].amb_cond.ambient_condition[0][19] "ambient condition shot [0 .. 2-1] with 25 data bytes [0 .. 25-1] for the error code stored in this error memory slot" UBYTE EH_STANDARD_S5_S3 1 100 0 255 DISPLAY_IDENTIFIER ambient_condition[0][19].amb_cond.ydiBackupMemory_xau16[0].ZFEH_EepromData ECU_ADDRESS 0xFFF82DD3 /end MEASUREMENT
/begin MEASUREMENT ZFEH_EepromData.ydiBackupMemory_xau16[0].amb_cond.ambient_condition[0][20] "ambient condition shot [0 .. 2-1] with 25 data bytes [0 .. 25-1] for the error code stored in this error memory slot" UBYTE EH_STANDARD_S5_S3 1 100 0 255 DISPLAY_IDENTIFIER ambient_condition[0][20].amb_cond.ydiBackupMemory_xau16[0].ZFEH_EepromData ECU_ADDRESS 0xFFF82DD4 /end MEASUREMENT
/begin MEASUREMENT ZFEH_EepromData.ydiBackupMemory_xau16[0].amb_cond.ambient_condition[0][21] "ambient condition shot [0 .. 2-1] with 25 data bytes [0 .. 25-1] for the error code stored in this error memory slot" UBYTE EH_STANDARD_S5_S3 1 100 0 255 DISPLAY_IDENTIFIER ambient_condition[0][21].amb_cond.ydiBackupMemory_xau16[0].ZFEH_EepromData ECU_ADDRESS 0xFFF82DD5 /end MEASUREMENT
/begin MEASUREMENT ZFEH_EepromData.ydiBackupMemory_xau16[0].amb_cond.ambient_condition[0][22] "ambient condition shot [0 .. 2-1] with 25 data bytes [0 .. 25-1] for the error code stored in this error memory slot" UBYTE EH_STANDARD_S5_S3 1 100 0 255 DISPLAY_IDENTIFIER ambient_condition[0][22].amb_cond.ydiBackupMemory_xau16[0].ZFEH_EepromData ECU_ADDRESS 0xFFF82DD6 /end MEASUREMENT
/begin MEASUREMENT ZFEH_EepromData.ydiBackupMemory_xau16[0].amb_cond.ambient_condition[0][23] "ambient condition shot [0 .. 2-1] with 25 data bytes [0 .. 25-1] for the error code stored in this error memory slot" UBYTE EH_STANDARD_S5_S3 1 100 0 255 DISPLAY_IDENTIFIER ambient_condition[0][23].amb_cond.ydiBackupMemory_xau16[0].ZFEH_EepromData ECU_ADDRESS 0xFFF82DD7 /end MEASUREMENT
/begin MEASUREMENT ZFEH_EepromData.ydiBackupMemory_xau16[0].amb_cond.ambient_condition[0][24] "ambient condition shot [0 .. 2-1] with 25 data bytes [0 .. 25-1] for the error code stored in this error memory slot" UBYTE EH_STANDARD_S5_S3 1 100 0 255 DISPLAY_IDENTIFIER ambient_condition[0][24].amb_cond.ydiBackupMemory_xau16[0].ZFEH_EepromData ECU_ADDRESS 0xFFF82DD8 /end MEASUREMENT
/begin MEASUREMENT ZFEH_EepromData.ydiBackupMemory_xau16[0].amb_cond.ambient_condition[1][0] "ambient condition shot [0 .. 2-1] with 25 data bytes [0 .. 25-1] for the error code stored in this error memory slot" UBYTE EH_STANDARD_S5_S3 1 100 0 255 DISPLAY_IDENTIFIER ambient_condition[1][0].amb_cond.ydiBackupMemory_xau16[0].ZFEH_EepromData ECU_ADDRESS 0xFFF82DD9 /end MEASUREMENT
/begin MEASUREMENT ZFEH_EepromData.ydiBackupMemory_xau16[0].amb_cond.ambient_condition[1][1] "ambient condition shot [0 .. 2-1] with 25 data bytes [0 .. 25-1] for the error code stored in this error memory slot" UBYTE EH_STANDARD_S5_S3 1 100 0 255 DISPLAY_IDENTIFIER ambient_condition[1][1].amb_cond.ydiBackupMemory_xau16[0].ZFEH_EepromData ECU_ADDRESS 0xFFF82DDA /end MEASUREMENT
/begin MEASUREMENT ZFEH_EepromData.ydiBackupMemory_xau16[0].amb_cond.ambient_condition[1][2] "ambient condition shot [0 .. 2-1] with 25 data bytes [0 .. 25-1] for the error code stored in this error memory slot" UBYTE EH_STANDARD_S5_S3 1 100 0 255 DISPLAY_IDENTIFIER ambient_condition[1][2].amb_cond.ydiBackupMemory_xau16[0].ZFEH_EepromData ECU_ADDRESS 0xFFF82DDB /end MEASUREMENT
/begin MEASUREMENT ZFEH_EepromData.ydiBackupMemory_xau16[0].amb_cond.ambient_condition[1][3] "ambient condition shot [0 .. 2-1] with 25 data bytes [0 .. 25-1] for the error code stored in this error memory slot" UBYTE EH_STANDARD_S5_S3 1 100 0 255 DISPLAY_IDENTIFIER ambient_condition[1][3].amb_cond.ydiBackupMemory_xau16[0].ZFEH_EepromData ECU_ADDRESS 0xFFF82DDC /end MEASUREMENT
/begin MEASUREMENT ZFEH_EepromData.ydiBackupMemory_xau16[0].amb_cond.ambient_condition[1][4] "ambient condition shot [0 .. 2-1] with 25 data bytes [0 .. 25-1] for the error code stored in this error memory slot" UBYTE EH_STANDARD_S5_S3 1 100 0 255 DISPLAY_IDENTIFIER ambient_condition[1][4].amb_cond.ydiBackupMemory_xau16[0].ZFEH_EepromData ECU_ADDRESS 0xFFF82DDD /end MEASUREMENT
/begin MEASUREMENT ZFEH_EepromData.ydiBackupMemory_xau16[0].amb_cond.ambient_condition[1][5] "ambient condition shot [0 .. 2-1] with 25 data bytes [0 .. 25-1] for the error code stored in this error memory slot" UBYTE EH_STANDARD_S5_S3 1 100 0 255 DISPLAY_IDENTIFIER ambient_condition[1][5].amb_cond.ydiBackupMemory_xau16[0].ZFEH_EepromData ECU_ADDRESS 0xFFF82DDE /end MEASUREMENT
/begin MEASUREMENT ZFEH_EepromData.ydiBackupMemory_xau16[0].amb_cond.ambient_condition[1][6] "ambient condition shot [0 .. 2-1] with 25 data bytes [0 .. 25-1] for the error code stored in this error memory slot" UBYTE EH_STANDARD_S5_S3 1 100 0 255 DISPLAY_IDENTIFIER ambient_condition[1][6].amb_cond.ydiBackupMemory_xau16[0].ZFEH_EepromData ECU_ADDRESS 0xFFF82DDF /end MEASUREMENT
/begin MEASUREMENT ZFEH_EepromData.ydiBackupMemory_xau16[0].amb_cond.ambient_condition[1][7] "ambient condition shot [0 .. 2-1] with 25 data bytes [0 .. 25-1] for the error code stored in this error memory slot" UBYTE EH_STANDARD_S5_S3 1 100 0 255 DISPLAY_IDENTIFIER ambient_condition[1][7].amb_cond.ydiBackupMemory_xau16[0].ZFEH_EepromData ECU_ADDRESS 0xFFF82DE0 /end MEASUREMENT
/begin MEASUREMENT ZFEH_EepromData.ydiBackupMemory_xau16[0].amb_cond.ambient_condition[1][8] "ambient condition shot [0 .. 2-1] with 25 data bytes [0 .. 25-1] for the error code stored in this error memory slot" UBYTE EH_STANDARD_S5_S3 1 100 0 255 DISPLAY_IDENTIFIER ambient_condition[1][8].amb_cond.ydiBackupMemory_xau16[0].ZFEH_EepromData ECU_ADDRESS 0xFFF82DE1 /end MEASUREMENT
/begin MEASUREMENT ZFEH_EepromData.ydiBackupMemory_xau16[0].amb_cond.ambient_condition[1][9] "ambient condition shot [0 .. 2-1] with 25 data bytes [0 .. 25-1] for the error code stored in this error memory slot" UBYTE EH_STANDARD_S5_S3 1 100 0 255 DISPLAY_IDENTIFIER ambient_condition[1][9].amb_cond.ydiBackupMemory_xau16[0].ZFEH_EepromData ECU_ADDRESS 0xFFF82DE2 /end MEASUREMENT
/begin MEASUREMENT ZFEH_EepromData.ydiBackupMemory_xau16[0].amb_cond.ambient_condition[1][10] "ambient condition shot [0 .. 2-1] with 25 data bytes [0 .. 25-1] for the error code stored in this error memory slot" UBYTE EH_STANDARD_S5_S3 1 100 0 255 DISPLAY_IDENTIFIER ambient_condition[1][10].amb_cond.ydiBackupMemory_xau16[0].ZFEH_EepromData ECU_ADDRESS 0xFFF82DE3 /end MEASUREMENT
/begin MEASUREMENT ZFEH_EepromData.ydiBackupMemory_xau16[0].amb_cond.ambient_condition[1][11] "ambient condition shot [0 .. 2-1] with 25 data bytes [0 .. 25-1] for the error code stored in this error memory slot" UBYTE EH_STANDARD_S5_S3 1 100 0 255 DISPLAY_IDENTIFIER ambient_condition[1][11].amb_cond.ydiBackupMemory_xau16[0].ZFEH_EepromData ECU_ADDRESS 0xFFF82DE4 /end MEASUREMENT
/begin MEASUREMENT ZFEH_EepromData.ydiBackupMemory_xau16[0].amb_cond.ambient_condition[1][12] "ambient condition shot [0 .. 2-1] with 25 data bytes [0 .. 25-1] for the error code stored in this error memory slot" UBYTE EH_STANDARD_S5_S3 1 100 0 255 DISPLAY_IDENTIFIER ambient_condition[1][12].amb_cond.ydiBackupMemory_xau16[0].ZFEH_EepromData ECU_ADDRESS 0xFFF82DE5 /end MEASUREMENT
/begin MEASUREMENT ZFEH_EepromData.ydiBackupMemory_xau16[0].amb_cond.ambient_condition[1][13] "ambient condition shot [0 .. 2-1] with 25 data bytes [0 .. 25-1] for the error code stored in this error memory slot" UBYTE EH_STANDARD_S5_S3 1 100 0 255 DISPLAY_IDENTIFIER ambient_condition[1][13].amb_cond.ydiBackupMemory_xau16[0].ZFEH_EepromData ECU_ADDRESS 0xFFF82DE6 /end MEASUREMENT
/begin MEASUREMENT ZFEH_EepromData.ydiBackupMemory_xau16[0].amb_cond.ambient_condition[1][14] "ambient condition shot [0 .. 2-1] with 25 data bytes [0 .. 25-1] for the error code stored in this error memory slot" UBYTE EH_STANDARD_S5_S3 1 100 0 255 DISPLAY_IDENTIFIER ambient_condition[1][14].amb_cond.ydiBackupMemory_xau16[0].ZFEH_EepromData ECU_ADDRESS 0xFFF82DE7 /end MEASUREMENT
/begin MEASUREMENT ZFEH_EepromData.ydiBackupMemory_xau16[0].amb_cond.ambient_condition[1][15] "ambient condition shot [0 .. 2-1] with 25 data bytes [0 .. 25-1] for the error code stored in this error memory slot" UBYTE EH_STANDARD_S5_S3 1 100 0 255 DISPLAY_IDENTIFIER ambient_condition[1][15].amb_cond.ydiBackupMemory_xau16[0].ZFEH_EepromData ECU_ADDRESS 0xFFF82DE8 /end MEASUREMENT
/begin MEASUREMENT ZFEH_EepromData.ydiBackupMemory_xau16[0].amb_cond.ambient_condition[1][16] "ambient condition shot [0 .. 2-1] with 25 data bytes [0 .. 25-1] for the error code stored in this error memory slot" UBYTE EH_STANDARD_S5_S3 1 100 0 255 DISPLAY_IDENTIFIER ambient_condition[1][16].amb_cond.ydiBackupMemory_xau16[0].ZFEH_EepromData ECU_ADDRESS 0xFFF82DE9 /end MEASUREMENT
/begin MEASUREMENT ZFEH_EepromData.ydiBackupMemory_xau16[0].amb_cond.ambient_condition[1][17] "ambient condition shot [0 .. 2-1] with 25 data bytes [0 .. 25-1] for the error code stored in this error memory slot" UBYTE EH_STANDARD_S5_S3 1 100 0 255 DISPLAY_IDENTIFIER ambient_condition[1][17].amb_cond.ydiBackupMemory_xau16[0].ZFEH_EepromData ECU_ADDRESS 0xFFF82DEA /end MEASUREMENT
/begin MEASUREMENT ZFEH_EepromData.ydiBackupMemory_xau16[0].amb_cond.ambient_condition[1][18] "ambient condition shot [0 .. 2-1] with 25 data bytes [0 .. 25-1] for the error code stored in this error memory slot" UBYTE EH_STANDARD_S5_S3 1 100 0 255 DISPLAY_IDENTIFIER ambient_condition[1][18].amb_cond.ydiBackupMemory_xau16[0].ZFEH_EepromData ECU_ADDRESS 0xFFF82DEB /end MEASUREMENT
/begin MEASUREMENT ZFEH_EepromData.ydiBackupMemory_xau16[0].amb_cond.ambient_condition[1][19] "ambient condition shot [0 .. 2-1] with 25 data bytes [0 .. 25-1] for the error code stored in this error memory slot" UBYTE EH_STANDARD_S5_S3 1 100 0 255 DISPLAY_IDENTIFIER ambient_condition[1][19].amb_cond.ydiBackupMemory_xau16[0].ZFEH_EepromData ECU_ADDRESS 0xFFF82DEC /end MEASUREMENT
/begin MEASUREMENT ZFEH_EepromData.ydiBackupMemory_xau16[0].amb_cond.ambient_condition[1][20] "ambient condition shot [0 .. 2-1] with 25 data bytes [0 .. 25-1] for the error code stored in this error memory slot" UBYTE EH_STANDARD_S5_S3 1 100 0 255 DISPLAY_IDENTIFIER ambient_condition[1][20].amb_cond.ydiBackupMemory_xau16[0].ZFEH_EepromData ECU_ADDRESS 0xFFF82DED /end MEASUREMENT
/begin MEASUREMENT ZFEH_EepromData.ydiBackupMemory_xau16[0].amb_cond.ambient_condition[1][21] "ambient condition shot [0 .. 2-1] with 25 data bytes [0 .. 25-1] for the error code stored in this error memory slot" UBYTE EH_STANDARD_S5_S3 1 100 0 255 DISPLAY_IDENTIFIER ambient_condition[1][21].amb_cond.ydiBackupMemory_xau16[0].ZFEH_EepromData ECU_ADDRESS 0xFFF82DEE /end MEASUREMENT
/begin MEASUREMENT ZFEH_EepromData.ydiBackupMemory_xau16[0].amb_cond.ambient_condition[1][22] "ambient condition shot [0 .. 2-1] with 25 data bytes [0 .. 25-1] for the error code stored in this error memory slot" UBYTE EH_STANDARD_S5_S3 1 100 0 255 DISPLAY_IDENTIFIER ambient_condition[1][22].amb_cond.ydiBackupMemory_xau16[0].ZFEH_EepromData ECU_ADDRESS 0xFFF82DEF /end MEASUREMENT
/begin MEASUREMENT ZFEH_EepromData.ydiBackupMemory_xau16[0].amb_cond.ambient_condition[1][23] "ambient condition shot [0 .. 2-1] with 25 data bytes [0 .. 25-1] for the error code stored in this error memory slot" UBYTE EH_STANDARD_S5_S3 1 100 0 255 DISPLAY_IDENTIFIER ambient_condition[1][23].amb_cond.ydiBackupMemory_xau16[0].ZFEH_EepromData ECU_ADDRESS 0xFFF82DF0 /end MEASUREMENT
/begin MEASUREMENT ZFEH_EepromData.ydiBackupMemory_xau16[0].amb_cond.ambient_condition[1][24] "ambient condition shot [0 .. 2-1] with 25 data bytes [0 .. 25-1] for the error code stored in this error memory slot" UBYTE EH_STANDARD_S5_S3 1 100 0 255 DISPLAY_IDENTIFIER ambient_condition[1][24].amb_cond.ydiBackupMemory_xau16[0].ZFEH_EepromData ECU_ADDRESS 0xFFF82DF1 /end MEASUREMENT
/begin MEASUREMENT ZFEH_EepromData.ydiBackupMemory_xau16[0].amb_cond.status_of_ambient_conditions[0] "status of ambient condition shot x: 0=invalid 1=valid" UBYTE EH_STANDARD_S5_S3 1 100 0 1 DISPLAY_IDENTIFIER status_of_ambient_conditions[0].amb_cond.ydiBackupMemory_xau16[0].ZFEH_EepromData ECU_ADDRESS 0xFFF82DF2 /end MEASUREMENT
/begin MEASUREMENT ZFEH_EepromData.ydiBackupMemory_xau16[0].amb_cond.status_of_ambient_conditions[1] "status of ambient condition shot x: 0=invalid 1=valid" UBYTE EH_STANDARD_S5_S3 1 100 0 1 DISPLAY_IDENTIFIER status_of_ambient_conditions[1].amb_cond.ydiBackupMemory_xau16[0].ZFEH_EepromData ECU_ADDRESS 0xFFF82DF3 /end MEASUREMENT
/begin MEASUREMENT ZFEH_EepromData.ydiBackupMemory_xau16[0].error_code "error code stored in error memory slot" UWORD EH_STANDARD_S5_S3 1 100 0 65535 DISPLAY_IDENTIFIER error_code.ydiBackupMemory_xau16[0].ZFEH_EepromData ECU_ADDRESS 0xFFF82DAC /end MEASUREMENT
/begin MEASUREMENT ZFEH_EepromData.ydiBackupMemory_xau16[0].error_type "error type of error code stored in error memory slot" UWORD EH_STANDARD_S5_S3 1 100 0 65535 DISPLAY_IDENTIFIER error_type.ydiBackupMemory_xau16[0].ZFEH_EepromData ECU_ADDRESS 0xFFF82DAE /end MEASUREMENT
/begin MEASUREMENT ZFEH_EepromData.ydiBackupMemory_xau16[0].status_word "status word of error code stored in error memory slot" UWORD EH_STANDARD_S5_S3 1 100 0 65535 DISPLAY_IDENTIFIER status_word.ydiBackupMemory_xau16[0].ZFEH_EepromData ECU_ADDRESS 0xFFF82DB0 /end MEASUREMENT
/begin MEASUREMENT ZFEH_EepromData.ydiBackupMemory_xau16[0].frequency_counter "frequency counter of error code stored in error memory slot" UBYTE EH_STANDARD_S5_S3 1 100 0 255 DISPLAY_IDENTIFIER frequency_counter.ydiBackupMemory_xau16[0].ZFEH_EepromData ECU_ADDRESS 0xFFF82DB2 /end MEASUREMENT
/begin MEASUREMENT ZFEH_EepromData.ydiBackupMemory_xau16[0].backwards_counter "backwards counter of error code stored in error memory slot" UBYTE EH_STANDARD_S5_S3 1 100 0 255 DISPLAY_IDENTIFIER backwards_counter.ydiBackupMemory_xau16[0].ZFEH_EepromData ECU_ADDRESS 0xFFF82DB3 /end MEASUREMENT
/begin MEASUREMENT ZFEH_EepromData.ydiBackupMemory_xau16[0].permanent_counter "counter of permanent error codes stored in error memory slot" UBYTE EH_STANDARD_S5_S3 1 100 0 255 DISPLAY_IDENTIFIER permanent_counter.ydiBackupMemory_xau16[0].ZFEH_EepromData ECU_ADDRESS 0xFFF82DB4 /end MEASUREMENT
/begin MEASUREMENT ZFEH_EepromData.ydiBackupMemory_xau16[0].sequence_counter "sequence counter of error code stored in error memory slot" UBYTE EH_STANDARD_S5_S3 1 100 0 255 DISPLAY_IDENTIFIER sequence_counter.ydiBackupMemory_xau16[0].ZFEH_EepromData ECU_ADDRESS 0xFFF82DB5 /end MEASUREMENT
/begin MEASUREMENT ZFEH_EepromData.ydiBackupMemory_xau16[0].master_time "master time of error code stored in error memory slot" ULONG EH_STANDARD_S5_S3 1 100 0 4294967295 DISPLAY_IDENTIFIER master_time.ydiBackupMemory_xau16[0].ZFEH_EepromData ECU_ADDRESS 0xFFF82DB8 /end MEASUREMENT
/begin MEASUREMENT ZFEH_EepromData.ydiBackupMemory_xau16[0].condition_byte "condition byte of error code stored in error memory slot" UBYTE EH_STANDARD_S5_S3 1 100 0 255 DISPLAY_IDENTIFIER condition_byte.ydiBackupMemory_xau16[0].ZFEH_EepromData ECU_ADDRESS 0xFFF82DBD /end MEASUREMENT
/begin MEASUREMENT ZFEH_EepromData.ydiBackupMemory_xau16[0].obd_driving_cycle_counter "obd driving cycle counter of error code stored in error memory slot" UWORD EH_STANDARD_S5_S3 1 100 0 65535 DISPLAY_IDENTIFIER obd_driving_cycle_counter.ydiBackupMemory_xau16[0].ZFEH_EepromData ECU_ADDRESS 0xFFF82DBE /end MEASUREMENT
/begin MEASUREMENT ZFEH_EepromData.ydiBackupMemory_xau16[1].amb_cond.ambient_condition[0][0] "ambient condition shot [0 .. 2-1] with 25 data bytes [0 .. 25-1] for the error code stored in this error memory slot" UBYTE EH_STANDARD_S5_S3 1 100 0 255 DISPLAY_IDENTIFIER ambient_condition[0][0].amb_cond.ydiBackupMemory_xau16[1].ZFEH_EepromData ECU_ADDRESS 0xFFF82E08 /end MEASUREMENT
/begin MEASUREMENT ZFEH_EepromData.ydiBackupMemory_xau16[1].amb_cond.ambient_condition[0][1] "ambient condition shot [0 .. 2-1] with 25 data bytes [0 .. 25-1] for the error code stored in this error memory slot" UBYTE EH_STANDARD_S5_S3 1 100 0 255 DISPLAY_IDENTIFIER ambient_condition[0][1].amb_cond.ydiBackupMemory_xau16[1].ZFEH_EepromData ECU_ADDRESS 0xFFF82E09 /end MEASUREMENT
/begin MEASUREMENT ZFEH_EepromData.ydiBackupMemory_xau16[1].amb_cond.ambient_condition[0][2] "ambient condition shot [0 .. 2-1] with 25 data bytes [0 .. 25-1] for the error code stored in this error memory slot" UBYTE EH_STANDARD_S5_S3 1 100 0 255 DISPLAY_IDENTIFIER ambient_condition[0][2].amb_cond.ydiBackupMemory_xau16[1].ZFEH_EepromData ECU_ADDRESS 0xFFF82E0A /end MEASUREMENT
/begin MEASUREMENT ZFEH_EepromData.ydiBackupMemory_xau16[1].amb_cond.ambient_condition[0][3] "ambient condition shot [0 .. 2-1] with 25 data bytes [0 .. 25-1] for the error code stored in this error memory slot" UBYTE EH_STANDARD_S5_S3 1 100 0 255 DISPLAY_IDENTIFIER ambient_condition[0][3].amb_cond.ydiBackupMemory_xau16[1].ZFEH_EepromData ECU_ADDRESS 0xFFF82E0B /end MEASUREMENT
/begin MEASUREMENT ZFEH_EepromData.ydiBackupMemory_xau16[1].amb_cond.ambient_condition[0][4] "ambient condition shot [0 .. 2-1] with 25 data bytes [0 .. 25-1] for the error code stored in this error memory slot" UBYTE EH_STANDARD_S5_S3 1 100 0 255 DISPLAY_IDENTIFIER ambient_condition[0][4].amb_cond.ydiBackupMemory_xau16[1].ZFEH_EepromData ECU_ADDRESS 0xFFF82E0C /end MEASUREMENT
/begin MEASUREMENT ZFEH_EepromData.ydiBackupMemory_xau16[1].amb_cond.ambient_condition[0][5] "ambient condition shot [0 .. 2-1] with 25 data bytes [0 .. 25-1] for the error code stored in this error memory slot" UBYTE EH_STANDARD_S5_S3 1 100 0 255 DISPLAY_IDENTIFIER ambient_condition[0][5].amb_cond.ydiBackupMemory_xau16[1].ZFEH_EepromData ECU_ADDRESS 0xFFF82E0D /end MEASUREMENT
/begin MEASUREMENT ZFEH_EepromData.ydiBackupMemory_xau16[1].amb_cond.ambient_condition[0][6] "ambient condition shot [0 .. 2-1] with 25 data bytes [0 .. 25-1] for the error code stored in this error memory slot" UBYTE EH_STANDARD_S5_S3 1 100 0 255 DISPLAY_IDENTIFIER ambient_condition[0][6].amb_cond.ydiBackupMemory_xau16[1].ZFEH_EepromData ECU_ADDRESS 0xFFF82E0E /end MEASUREMENT
/begin MEASUREMENT ZFEH_EepromData.ydiBackupMemory_xau16[1].amb_cond.ambient_condition[0][7] "ambient condition shot [0 .. 2-1] with 25 data bytes [0 .. 25-1] for the error code stored in this error memory slot" UBYTE EH_STANDARD_S5_S3 1 100 0 255 DISPLAY_IDENTIFIER ambient_condition[0][7].amb_cond.ydiBackupMemory_xau16[1].ZFEH_EepromData ECU_ADDRESS 0xFFF82E0F /end MEASUREMENT
/begin MEASUREMENT ZFEH_EepromData.ydiBackupMemory_xau16[1].amb_cond.ambient_condition[0][8] "ambient condition shot [0 .. 2-1] with 25 data bytes [0 .. 25-1] for the error code stored in this error memory slot" UBYTE EH_STANDARD_S5_S3 1 100 0 255 DISPLAY_IDENTIFIER ambient_condition[0][8].amb_cond.ydiBackupMemory_xau16[1].ZFEH_EepromData ECU_ADDRESS 0xFFF82E10 /end MEASUREMENT
/begin MEASUREMENT ZFEH_EepromData.ydiBackupMemory_xau16[1].amb_cond.ambient_condition[0][9] "ambient condition shot [0 .. 2-1] with 25 data bytes [0 .. 25-1] for the error code stored in this error memory slot" UBYTE EH_STANDARD_S5_S3 1 100 0 255 DISPLAY_IDENTIFIER ambient_condition[0][9].amb_cond.ydiBackupMemory_xau16[1].ZFEH_EepromData ECU_ADDRESS 0xFFF82E11 /end MEASUREMENT
/begin MEASUREMENT ZFEH_EepromData.ydiBackupMemory_xau16[1].amb_cond.ambient_condition[0][10] "ambient condition shot [0 .. 2-1] with 25 data bytes [0 .. 25-1] for the error code stored in this error memory slot" UBYTE EH_STANDARD_S5_S3 1 100 0 255 DISPLAY_IDENTIFIER ambient_condition[0][10].amb_cond.ydiBackupMemory_xau16[1].ZFEH_EepromData ECU_ADDRESS 0xFFF82E12 /end MEASUREMENT
/begin MEASUREMENT ZFEH_EepromData.ydiBackupMemory_xau16[1].amb_cond.ambient_condition[0][11] "ambient condition shot [0 .. 2-1] with 25 data bytes [0 .. 25-1] for the error code stored in this error memory slot" UBYTE EH_STANDARD_S5_S3 1 100 0 255 DISPLAY_IDENTIFIER ambient_condition[0][11].amb_cond.ydiBackupMemory_xau16[1].ZFEH_EepromData ECU_ADDRESS 0xFFF82E13 /end MEASUREMENT
/begin MEASUREMENT ZFEH_EepromData.ydiBackupMemory_xau16[1].amb_cond.ambient_condition[0][12] "ambient condition shot [0 .. 2-1] with 25 data bytes [0 .. 25-1] for the error code stored in this error memory slot" UBYTE EH_STANDARD_S5_S3 1 100 0 255 DISPLAY_IDENTIFIER ambient_condition[0][12].amb_cond.ydiBackupMemory_xau16[1].ZFEH_EepromData ECU_ADDRESS 0xFFF82E14 /end MEASUREMENT
/begin MEASUREMENT ZFEH_EepromData.ydiBackupMemory_xau16[1].amb_cond.ambient_condition[0][13] "ambient condition shot [0 .. 2-1] with 25 data bytes [0 .. 25-1] for the error code stored in this error memory slot" UBYTE EH_STANDARD_S5_S3 1 100 0 255 DISPLAY_IDENTIFIER ambient_condition[0][13].amb_cond.ydiBackupMemory_xau16[1].ZFEH_EepromData ECU_ADDRESS 0xFFF82E15 /end MEASUREMENT
/begin MEASUREMENT ZFEH_EepromData.ydiBackupMemory_xau16[1].amb_cond.ambient_condition[0][14] "ambient condition shot [0 .. 2-1] with 25 data bytes [0 .. 25-1] for the error code stored in this error memory slot" UBYTE EH_STANDARD_S5_S3 1 100 0 255 DISPLAY_IDENTIFIER ambient_condition[0][14].amb_cond.ydiBackupMemory_xau16[1].ZFEH_EepromData ECU_ADDRESS 0xFFF82E16 /end MEASUREMENT
/begin MEASUREMENT ZFEH_EepromData.ydiBackupMemory_xau16[1].amb_cond.ambient_condition[0][15] "ambient condition shot [0 .. 2-1] with 25 data bytes [0 .. 25-1] for the error code stored in this error memory slot" UBYTE EH_STANDARD_S5_S3 1 100 0 255 DISPLAY_IDENTIFIER ambient_condition[0][15].amb_cond.ydiBackupMemory_xau16[1].ZFEH_EepromData ECU_ADDRESS 0xFFF82E17 /end MEASUREMENT
/begin MEASUREMENT ZFEH_EepromData.ydiBackupMemory_xau16[1].amb_cond.ambient_condition[0][16] "ambient condition shot [0 .. 2-1] with 25 data bytes [0 .. 25-1] for the error code stored in this error memory slot" UBYTE EH_STANDARD_S5_S3 1 100 0 255 DISPLAY_IDENTIFIER ambient_condition[0][16].amb_cond.ydiBackupMemory_xau16[1].ZFEH_EepromData ECU_ADDRESS 0xFFF82E18 /end MEASUREMENT
/begin MEASUREMENT ZFEH_EepromData.ydiBackupMemory_xau16[1].amb_cond.ambient_condition[0][17] "ambient condition shot [0 .. 2-1] with 25 data bytes [0 .. 25-1] for the error code stored in this error memory slot" UBYTE EH_STANDARD_S5_S3 1 100 0 255 DISPLAY_IDENTIFIER ambient_condition[0][17].amb_cond.ydiBackupMemory_xau16[1].ZFEH_EepromData ECU_ADDRESS 0xFFF82E19 /end MEASUREMENT
/begin MEASUREMENT ZFEH_EepromData.ydiBackupMemory_xau16[1].amb_cond.ambient_condition[0][18] "ambient condition shot [0 .. 2-1] with 25 data bytes [0 .. 25-1] for the error code stored in this error memory slot" UBYTE EH_STANDARD_S5_S3 1 100 0 255 DISPLAY_IDENTIFIER ambient_condition[0][18].amb_cond.ydiBackupMemory_xau16[1].ZFEH_EepromData ECU_ADDRESS 0xFFF82E1A /end MEASUREMENT
/begin MEASUREMENT ZFEH_EepromData.ydiBackupMemory_xau16[1].amb_cond.ambient_condition[0][19] "ambient condition shot [0 .. 2-1] with 25 data bytes [0 .. 25-1] for the error code stored in this error memory slot" UBYTE EH_STANDARD_S5_S3 1 100 0 255 DISPLAY_IDENTIFIER ambient_condition[0][19].amb_cond.ydiBackupMemory_xau16[1].ZFEH_EepromData ECU_ADDRESS 0xFFF82E1B /end MEASUREMENT
/begin MEASUREMENT ZFEH_EepromData.ydiBackupMemory_xau16[1].amb_cond.ambient_condition[0][20] "ambient condition shot [0 .. 2-1] with 25 data bytes [0 .. 25-1] for the error code stored in this error memory slot" UBYTE EH_STANDARD_S5_S3 1 100 0 255 DISPLAY_IDENTIFIER ambient_condition[0][20].amb_cond.ydiBackupMemory_xau16[1].ZFEH_EepromData ECU_ADDRESS 0xFFF82E1C /end MEASUREMENT
/begin MEASUREMENT ZFEH_EepromData.ydiBackupMemory_xau16[1].amb_cond.ambient_condition[0][21] "ambient condition shot [0 .. 2-1] with 25 data bytes [0 .. 25-1] for the error code stored in this error memory slot" UBYTE EH_STANDARD_S5_S3 1 100 0 255 DISPLAY_IDENTIFIER ambient_condition[0][21].amb_cond.ydiBackupMemory_xau16[1].ZFEH_EepromData ECU_ADDRESS 0xFFF82E1D /end MEASUREMENT
/begin MEASUREMENT ZFEH_EepromData.ydiBackupMemory_xau16[1].amb_cond.ambient_condition[0][22] "ambient condition shot [0 .. 2-1] with 25 data bytes [0 .. 25-1] for the error code stored in this error memory slot" UBYTE EH_STANDARD_S5_S3 1 100 0 255 DISPLAY_IDENTIFIER ambient_condition[0][22].amb_cond.ydiBackupMemory_xau16[1].ZFEH_EepromData ECU_ADDRESS 0xFFF82E1E /end MEASUREMENT
/begin MEASUREMENT ZFEH_EepromData.ydiBackupMemory_xau16[1].amb_cond.ambient_condition[0][23] "ambient condition shot [0 .. 2-1] with 25 data bytes [0 .. 25-1] for the error code stored in this error memory slot" UBYTE EH_STANDARD_S5_S3 1 100 0 255 DISPLAY_IDENTIFIER ambient_condition[0][23].amb_cond.ydiBackupMemory_xau16[1].ZFEH_EepromData ECU_ADDRESS 0xFFF82E1F /end MEASUREMENT
/begin MEASUREMENT ZFEH_EepromData.ydiBackupMemory_xau16[1].amb_cond.ambient_condition[0][24] "ambient condition shot [0 .. 2-1] with 25 data bytes [0 .. 25-1] for the error code stored in this error memory slot" UBYTE EH_STANDARD_S5_S3 1 100 0 255 DISPLAY_IDENTIFIER ambient_condition[0][24].amb_cond.ydiBackupMemory_xau16[1].ZFEH_EepromData ECU_ADDRESS 0xFFF82E20 /end MEASUREMENT
/begin MEASUREMENT ZFEH_EepromData.ydiBackupMemory_xau16[1].amb_cond.ambient_condition[1][0] "ambient condition shot [0 .. 2-1] with 25 data bytes [0 .. 25-1] for the error code stored in this error memory slot" UBYTE EH_STANDARD_S5_S3 1 100 0 255 DISPLAY_IDENTIFIER ambient_condition[1][0].amb_cond.ydiBackupMemory_xau16[1].ZFEH_EepromData ECU_ADDRESS 0xFFF82E21 /end MEASUREMENT
/begin MEASUREMENT ZFEH_EepromData.ydiBackupMemory_xau16[1].amb_cond.ambient_condition[1][1] "ambient condition shot [0 .. 2-1] with 25 data bytes [0 .. 25-1] for the error code stored in this error memory slot" UBYTE EH_STANDARD_S5_S3 1 100 0 255 DISPLAY_IDENTIFIER ambient_condition[1][1].amb_cond.ydiBackupMemory_xau16[1].ZFEH_EepromData ECU_ADDRESS 0xFFF82E22 /end MEASUREMENT
/begin MEASUREMENT ZFEH_EepromData.ydiBackupMemory_xau16[1].amb_cond.ambient_condition[1][2] "ambient condition shot [0 .. 2-1] with 25 data bytes [0 .. 25-1] for the error code stored in this error memory slot" UBYTE EH_STANDARD_S5_S3 1 100 0 255 DISPLAY_IDENTIFIER ambient_condition[1][2].amb_cond.ydiBackupMemory_xau16[1].ZFEH_EepromData ECU_ADDRESS 0xFFF82E23 /end MEASUREMENT
/begin MEASUREMENT ZFEH_EepromData.ydiBackupMemory_xau16[1].amb_cond.ambient_condition[1][3] "ambient condition shot [0 .. 2-1] with 25 data bytes [0 .. 25-1] for the error code stored in this error memory slot" UBYTE EH_STANDARD_S5_S3 1 100 0 255 DISPLAY_IDENTIFIER ambient_condition[1][3].amb_cond.ydiBackupMemory_xau16[1].ZFEH_EepromData ECU_ADDRESS 0xFFF82E24 /end MEASUREMENT
/begin MEASUREMENT ZFEH_EepromData.ydiBackupMemory_xau16[1].amb_cond.ambient_condition[1][4] "ambient condition shot [0 .. 2-1] with 25 data bytes [0 .. 25-1] for the error code stored in this error memory slot" UBYTE EH_STANDARD_S5_S3 1 100 0 255 DISPLAY_IDENTIFIER ambient_condition[1][4].amb_cond.ydiBackupMemory_xau16[1].ZFEH_EepromData ECU_ADDRESS 0xFFF82E25 /end MEASUREMENT
/begin MEASUREMENT ZFEH_EepromData.ydiBackupMemory_xau16[1].amb_cond.ambient_condition[1][5] "ambient condition shot [0 .. 2-1] with 25 data bytes [0 .. 25-1] for the error code stored in this error memory slot" UBYTE EH_STANDARD_S5_S3 1 100 0 255 DISPLAY_IDENTIFIER ambient_condition[1][5].amb_cond.ydiBackupMemory_xau16[1].ZFEH_EepromData ECU_ADDRESS 0xFFF82E26 /end MEASUREMENT
/begin MEASUREMENT ZFEH_EepromData.ydiBackupMemory_xau16[1].amb_cond.ambient_condition[1][6] "ambient condition shot [0 .. 2-1] with 25 data bytes [0 .. 25-1] for the error code stored in this error memory slot" UBYTE EH_STANDARD_S5_S3 1 100 0 255 DISPLAY_IDENTIFIER ambient_condition[1][6].amb_cond.ydiBackupMemory_xau16[1].ZFEH_EepromData ECU_ADDRESS 0xFFF82E27 /end MEASUREMENT
/begin MEASUREMENT ZFEH_EepromData.ydiBackupMemory_xau16[1].amb_cond.ambient_condition[1][7] "ambient condition shot [0 .. 2-1] with 25 data bytes [0 .. 25-1] for the error code stored in this error memory slot" UBYTE EH_STANDARD_S5_S3 1 100 0 255 DISPLAY_IDENTIFIER ambient_condition[1][7].amb_cond.ydiBackupMemory_xau16[1].ZFEH_EepromData ECU_ADDRESS 0xFFF82E28 /end MEASUREMENT
/begin MEASUREMENT ZFEH_EepromData.ydiBackupMemory_xau16[1].amb_cond.ambient_condition[1][8] "ambient condition shot [0 .. 2-1] with 25 data bytes [0 .. 25-1] for the error code stored in this error memory slot" UBYTE EH_STANDARD_S5_S3 1 100 0 255 DISPLAY_IDENTIFIER ambient_condition[1][8].amb_cond.ydiBackupMemory_xau16[1].ZFEH_EepromData ECU_ADDRESS 0xFFF82E29 /end MEASUREMENT
/begin MEASUREMENT ZFEH_EepromData.ydiBackupMemory_xau16[1].amb_cond.ambient_condition[1][9] "ambient condition shot [0 .. 2-1] with 25 data bytes [0 .. 25-1] for the error code stored in this error memory slot" UBYTE EH_STANDARD_S5_S3 1 100 0 255 DISPLAY_IDENTIFIER ambient_condition[1][9].amb_cond.ydiBackupMemory_xau16[1].ZFEH_EepromData ECU_ADDRESS 0xFFF82E2A /end MEASUREMENT
/begin MEASUREMENT ZFEH_EepromData.ydiBackupMemory_xau16[1].amb_cond.ambient_condition[1][10] "ambient condition shot [0 .. 2-1] with 25 data bytes [0 .. 25-1] for the error code stored in this error memory slot" UBYTE EH_STANDARD_S5_S3 1 100 0 255 DISPLAY_IDENTIFIER ambient_condition[1][10].amb_cond.ydiBackupMemory_xau16[1].ZFEH_EepromData ECU_ADDRESS 0xFFF82E2B /end MEASUREMENT
/begin MEASUREMENT ZFEH_EepromData.ydiBackupMemory_xau16[1].amb_cond.ambient_condition[1][11] "ambient condition shot [0 .. 2-1] with 25 data bytes [0 .. 25-1] for the error code stored in this error memory slot" UBYTE EH_STANDARD_S5_S3 1 100 0 255 DISPLAY_IDENTIFIER ambient_condition[1][11].amb_cond.ydiBackupMemory_xau16[1].ZFEH_EepromData ECU_ADDRESS 0xFFF82E2C /end MEASUREMENT
/begin MEASUREMENT ZFEH_EepromData.ydiBackupMemory_xau16[1].amb_cond.ambient_condition[1][12] "ambient condition shot [0 .. 2-1] with 25 data bytes [0 .. 25-1] for the error code stored in this error memory slot" UBYTE EH_STANDARD_S5_S3 1 100 0 255 DISPLAY_IDENTIFIER ambient_condition[1][12].amb_cond.ydiBackupMemory_xau16[1].ZFEH_EepromData ECU_ADDRESS 0xFFF82E2D /end MEASUREMENT
/begin MEASUREMENT ZFEH_EepromData.ydiBackupMemory_xau16[1].amb_cond.ambient_condition[1][13] "ambient condition shot [0 .. 2-1] with 25 data bytes [0 .. 25-1] for the error code stored in this error memory slot" UBYTE EH_STANDARD_S5_S3 1 100 0 255 DISPLAY_IDENTIFIER ambient_condition[1][13].amb_cond.ydiBackupMemory_xau16[1].ZFEH_EepromData ECU_ADDRESS 0xFFF82E2E /end MEASUREMENT
/begin MEASUREMENT ZFEH_EepromData.ydiBackupMemory_xau16[1].amb_cond.ambient_condition[1][14] "ambient condition shot [0 .. 2-1] with 25 data bytes [0 .. 25-1] for the error code stored in this error memory slot" UBYTE EH_STANDARD_S5_S3 1 100 0 255 DISPLAY_IDENTIFIER ambient_condition[1][14].amb_cond.ydiBackupMemory_xau16[1].ZFEH_EepromData ECU_ADDRESS 0xFFF82E2F /end MEASUREMENT
/begin MEASUREMENT ZFEH_EepromData.ydiBackupMemory_xau16[1].amb_cond.ambient_condition[1][15] "ambient condition shot [0 .. 2-1] with 25 data bytes [0 .. 25-1] for the error code stored in this error memory slot" UBYTE EH_STANDARD_S5_S3 1 100 0 255 DISPLAY_IDENTIFIER ambient_condition[1][15].amb_cond.ydiBackupMemory_xau16[1].ZFEH_EepromData ECU_ADDRESS 0xFFF82E30 /end MEASUREMENT
/begin MEASUREMENT ZFEH_EepromData.ydiBackupMemory_xau16[1].amb_cond.ambient_condition[1][16] "ambient condition shot [0 .. 2-1] with 25 data bytes [0 .. 25-1] for the error code stored in this error memory slot" UBYTE EH_STANDARD_S5_S3 1 100 0 255 DISPLAY_IDENTIFIER ambient_condition[1][16].amb_cond.ydiBackupMemory_xau16[1].ZFEH_EepromData ECU_ADDRESS 0xFFF82E31 /end MEASUREMENT
/begin MEASUREMENT ZFEH_EepromData.ydiBackupMemory_xau16[1].amb_cond.ambient_condition[1][17] "ambient condition shot [0 .. 2-1] with 25 data bytes [0 .. 25-1] for the error code stored in this error memory slot" UBYTE EH_STANDARD_S5_S3 1 100 0 255 DISPLAY_IDENTIFIER ambient_condition[1][17].amb_cond.ydiBackupMemory_xau16[1].ZFEH_EepromData ECU_ADDRESS 0xFFF82E32 /end MEASUREMENT
/begin MEASUREMENT ZFEH_EepromData.ydiBackupMemory_xau16[1].amb_cond.ambient_condition[1][18] "ambient condition shot [0 .. 2-1] with 25 data bytes [0 .. 25-1] for the error code stored in this error memory slot" UBYTE EH_STANDARD_S5_S3 1 100 0 255 DISPLAY_IDENTIFIER ambient_condition[1][18].amb_cond.ydiBackupMemory_xau16[1].ZFEH_EepromData ECU_ADDRESS 0xFFF82E33 /end MEASUREMENT
/begin MEASUREMENT ZFEH_EepromData.ydiBackupMemory_xau16[1].amb_cond.ambient_condition[1][19] "ambient condition shot [0 .. 2-1] with 25 data bytes [0 .. 25-1] for the error code stored in this error memory slot" UBYTE EH_STANDARD_S5_S3 1 100 0 255 DISPLAY_IDENTIFIER ambient_condition[1][19].amb_cond.ydiBackupMemory_xau16[1].ZFEH_EepromData ECU_ADDRESS 0xFFF82E34 /end MEASUREMENT
/begin MEASUREMENT ZFEH_EepromData.ydiBackupMemory_xau16[1].amb_cond.ambient_condition[1][20] "ambient condition shot [0 .. 2-1] with 25 data bytes [0 .. 25-1] for the error code stored in this error memory slot" UBYTE EH_STANDARD_S5_S3 1 100 0 255 DISPLAY_IDENTIFIER ambient_condition[1][20].amb_cond.ydiBackupMemory_xau16[1].ZFEH_EepromData ECU_ADDRESS 0xFFF82E35 /end MEASUREMENT
/begin MEASUREMENT ZFEH_EepromData.ydiBackupMemory_xau16[1].amb_cond.ambient_condition[1][21] "ambient condition shot [0 .. 2-1] with 25 data bytes [0 .. 25-1] for the error code stored in this error memory slot" UBYTE EH_STANDARD_S5_S3 1 100 0 255 DISPLAY_IDENTIFIER ambient_condition[1][21].amb_cond.ydiBackupMemory_xau16[1].ZFEH_EepromData ECU_ADDRESS 0xFFF82E36 /end MEASUREMENT
/begin MEASUREMENT ZFEH_EepromData.ydiBackupMemory_xau16[1].amb_cond.ambient_condition[1][22] "ambient condition shot [0 .. 2-1] with 25 data bytes [0 .. 25-1] for the error code stored in this error memory slot" UBYTE EH_STANDARD_S5_S3 1 100 0 255 DISPLAY_IDENTIFIER ambient_condition[1][22].amb_cond.ydiBackupMemory_xau16[1].ZFEH_EepromData ECU_ADDRESS 0xFFF82E37 /end MEASUREMENT
/begin MEASUREMENT ZFEH_EepromData.ydiBackupMemory_xau16[1].amb_cond.ambient_condition[1][23] "ambient condition shot [0 .. 2-1] with 25 data bytes [0 .. 25-1] for the error code stored in this error memory slot" UBYTE EH_STANDARD_S5_S3 1 100 0 255 DISPLAY_IDENTIFIER ambient_condition[1][23].amb_cond.ydiBackupMemory_xau16[1].ZFEH_EepromData ECU_ADDRESS 0xFFF82E38 /end MEASUREMENT
/begin MEASUREMENT ZFEH_EepromData.ydiBackupMemory_xau16[1].amb_cond.ambient_condition[1][24] "ambient condition shot [0 .. 2-1] with 25 data bytes [0 .. 25-1] for the error code stored in this error memory slot" UBYTE EH_STANDARD_S5_S3 1 100 0 255 DISPLAY_IDENTIFIER ambient_condition[1][24].amb_cond.ydiBackupMemory_xau16[1].ZFEH_EepromData ECU_ADDRESS 0xFFF82E39 /end MEASUREMENT
/begin MEASUREMENT ZFEH_EepromData.ydiBackupMemory_xau16[1].amb_cond.status_of_ambient_conditions[0] "status of ambient condition shot x: 0=invalid 1=valid" UBYTE EH_STANDARD_S5_S3 1 100 0 1 DISPLAY_IDENTIFIER status_of_ambient_conditions[0].amb_cond.ydiBackupMemory_xau16[1].ZFEH_EepromData ECU_ADDRESS 0xFFF82E3A /end MEASUREMENT
/begin MEASUREMENT ZFEH_EepromData.ydiBackupMemory_xau16[1].amb_cond.status_of_ambient_conditions[1] "status of ambient condition shot x: 0=invalid 1=valid" UBYTE EH_STANDARD_S5_S3 1 100 0 1 DISPLAY_IDENTIFIER status_of_ambient_conditions[1].amb_cond.ydiBackupMemory_xau16[1].ZFEH_EepromData ECU_ADDRESS 0xFFF82E3B /end MEASUREMENT
/begin MEASUREMENT ZFEH_EepromData.ydiBackupMemory_xau16[1].error_code "error code stored in error memory slot" UWORD EH_STANDARD_S5_S3 1 100 0 65535 DISPLAY_IDENTIFIER error_code.ydiBackupMemory_xau16[1].ZFEH_EepromData ECU_ADDRESS 0xFFF82DF4 /end MEASUREMENT
/begin MEASUREMENT ZFEH_EepromData.ydiBackupMemory_xau16[1].error_type "error type of error code stored in error memory slot" UWORD EH_STANDARD_S5_S3 1 100 0 65535 DISPLAY_IDENTIFIER error_type.ydiBackupMemory_xau16[1].ZFEH_EepromData ECU_ADDRESS 0xFFF82DF6 /end MEASUREMENT
/begin MEASUREMENT ZFEH_EepromData.ydiBackupMemory_xau16[1].status_word "status word of error code stored in error memory slot" UWORD EH_STANDARD_S5_S3 1 100 0 65535 DISPLAY_IDENTIFIER status_word.ydiBackupMemory_xau16[1].ZFEH_EepromData ECU_ADDRESS 0xFFF82DF8 /end MEASUREMENT
/begin MEASUREMENT ZFEH_EepromData.ydiBackupMemory_xau16[1].frequency_counter "frequency counter of error code stored in error memory slot" UBYTE EH_STANDARD_S5_S3 1 100 0 255 DISPLAY_IDENTIFIER frequency_counter.ydiBackupMemory_xau16[1].ZFEH_EepromData ECU_ADDRESS 0xFFF82DFA /end MEASUREMENT
/begin MEASUREMENT ZFEH_EepromData.ydiBackupMemory_xau16[1].backwards_counter "backwards counter of error code stored in error memory slot" UBYTE EH_STANDARD_S5_S3 1 100 0 255 DISPLAY_IDENTIFIER backwards_counter.ydiBackupMemory_xau16[1].ZFEH_EepromData ECU_ADDRESS 0xFFF82DFB /end MEASUREMENT
/begin MEASUREMENT ZFEH_EepromData.ydiBackupMemory_xau16[1].permanent_counter "counter of permanent error codes stored in error memory slot" UBYTE EH_STANDARD_S5_S3 1 100 0 255 DISPLAY_IDENTIFIER permanent_counter.ydiBackupMemory_xau16[1].ZFEH_EepromData ECU_ADDRESS 0xFFF82DFC /end MEASUREMENT
/begin MEASUREMENT ZFEH_EepromData.ydiBackupMemory_xau16[1].sequence_counter "sequence counter of error code stored in error memory slot" UBYTE EH_STANDARD_S5_S3 1 100 0 255 DISPLAY_IDENTIFIER sequence_counter.ydiBackupMemory_xau16[1].ZFEH_EepromData ECU_ADDRESS 0xFFF82DFD /end MEASUREMENT
/begin MEASUREMENT ZFEH_EepromData.ydiBackupMemory_xau16[1].master_time "master time of error code stored in error memory slot" ULONG EH_STANDARD_S5_S3 1 100 0 4294967295 DISPLAY_IDENTIFIER master_time.ydiBackupMemory_xau16[1].ZFEH_EepromData ECU_ADDRESS 0xFFF82E00 /end MEASUREMENT
/begin MEASUREMENT ZFEH_EepromData.ydiBackupMemory_xau16[1].condition_byte "condition byte of error code stored in error memory slot" UBYTE EH_STANDARD_S5_S3 1 100 0 255 DISPLAY_IDENTIFIER condition_byte.ydiBackupMemory_xau16[1].ZFEH_EepromData ECU_ADDRESS 0xFFF82E05 /end MEASUREMENT
/begin MEASUREMENT ZFEH_EepromData.ydiBackupMemory_xau16[1].obd_driving_cycle_counter "obd driving cycle counter of error code stored in error memory slot" UWORD EH_STANDARD_S5_S3 1 100 0 65535 DISPLAY_IDENTIFIER obd_driving_cycle_counter.ydiBackupMemory_xau16[1].ZFEH_EepromData ECU_ADDRESS 0xFFF82E06 /end MEASUREMENT
/begin MEASUREMENT ZFEH_EepromData.ydiBackupMemory_xau16[2].amb_cond.ambient_condition[0][0] "ambient condition shot [0 .. 2-1] with 25 data bytes [0 .. 25-1] for the error code stored in this error memory slot" UBYTE EH_STANDARD_S5_S3 1 100 0 255 DISPLAY_IDENTIFIER ambient_condition[0][0].amb_cond.ydiBackupMemory_xau16[2].ZFEH_EepromData ECU_ADDRESS 0xFFF82E50 /end MEASUREMENT
/begin MEASUREMENT ZFEH_EepromData.ydiBackupMemory_xau16[2].amb_cond.ambient_condition[0][1] "ambient condition shot [0 .. 2-1] with 25 data bytes [0 .. 25-1] for the error code stored in this error memory slot" UBYTE EH_STANDARD_S5_S3 1 100 0 255 DISPLAY_IDENTIFIER ambient_condition[0][1].amb_cond.ydiBackupMemory_xau16[2].ZFEH_EepromData ECU_ADDRESS 0xFFF82E51 /end MEASUREMENT
/begin MEASUREMENT ZFEH_EepromData.ydiBackupMemory_xau16[2].amb_cond.ambient_condition[0][2] "ambient condition shot [0 .. 2-1] with 25 data bytes [0 .. 25-1] for the error code stored in this error memory slot" UBYTE EH_STANDARD_S5_S3 1 100 0 255 DISPLAY_IDENTIFIER ambient_condition[0][2].amb_cond.ydiBackupMemory_xau16[2].ZFEH_EepromData ECU_ADDRESS 0xFFF82E52 /end MEASUREMENT
/begin MEASUREMENT ZFEH_EepromData.ydiBackupMemory_xau16[2].amb_cond.ambient_condition[0][3] "ambient condition shot [0 .. 2-1] with 25 data bytes [0 .. 25-1] for the error code stored in this error memory slot" UBYTE EH_STANDARD_S5_S3 1 100 0 255 DISPLAY_IDENTIFIER ambient_condition[0][3].amb_cond.ydiBackupMemory_xau16[2].ZFEH_EepromData ECU_ADDRESS 0xFFF82E53 /end MEASUREMENT
/begin MEASUREMENT ZFEH_EepromData.ydiBackupMemory_xau16[2].amb_cond.ambient_condition[0][4] "ambient condition shot [0 .. 2-1] with 25 data bytes [0 .. 25-1] for the error code stored in this error memory slot" UBYTE EH_STANDARD_S5_S3 1 100 0 255 DISPLAY_IDENTIFIER ambient_condition[0][4].amb_cond.ydiBackupMemory_xau16[2].ZFEH_EepromData ECU_ADDRESS 0xFFF82E54 /end MEASUREMENT
/begin MEASUREMENT ZFEH_EepromData.ydiBackupMemory_xau16[2].amb_cond.ambient_condition[0][5] "ambient condition shot [0 .. 2-1] with 25 data bytes [0 .. 25-1] for the error code stored in this error memory slot" UBYTE EH_STANDARD_S5_S3 1 100 0 255 DISPLAY_IDENTIFIER ambient_condition[0][5].amb_cond.ydiBackupMemory_xau16[2].ZFEH_EepromData ECU_ADDRESS 0xFFF82E55 /end MEASUREMENT
/begin MEASUREMENT ZFEH_EepromData.ydiBackupMemory_xau16[2].amb_cond.ambient_condition[0][6] "ambient condition shot [0 .. 2-1] with 25 data bytes [0 .. 25-1] for the error code stored in this error memory slot" UBYTE EH_STANDARD_S5_S3 1 100 0 255 DISPLAY_IDENTIFIER ambient_condition[0][6].amb_cond.ydiBackupMemory_xau16[2].ZFEH_EepromData ECU_ADDRESS 0xFFF82E56 /end MEASUREMENT
/begin MEASUREMENT ZFEH_EepromData.ydiBackupMemory_xau16[2].amb_cond.ambient_condition[0][7] "ambient condition shot [0 .. 2-1] with 25 data bytes [0 .. 25-1] for the error code stored in this error memory slot" UBYTE EH_STANDARD_S5_S3 1 100 0 255 DISPLAY_IDENTIFIER ambient_condition[0][7].amb_cond.ydiBackupMemory_xau16[2].ZFEH_EepromData ECU_ADDRESS 0xFFF82E57 /end MEASUREMENT
/begin MEASUREMENT ZFEH_EepromData.ydiBackupMemory_xau16[2].amb_cond.ambient_condition[0][8] "ambient condition shot [0 .. 2-1] with 25 data bytes [0 .. 25-1] for the error code stored in this error memory slot" UBYTE EH_STANDARD_S5_S3 1 100 0 255 DISPLAY_IDENTIFIER ambient_condition[0][8].amb_cond.ydiBackupMemory_xau16[2].ZFEH_EepromData ECU_ADDRESS 0xFFF82E58 /end MEASUREMENT
/begin MEASUREMENT ZFEH_EepromData.ydiBackupMemory_xau16[2].amb_cond.ambient_condition[0][9] "ambient condition shot [0 .. 2-1] with 25 data bytes [0 .. 25-1] for the error code stored in this error memory slot" UBYTE EH_STANDARD_S5_S3 1 100 0 255 DISPLAY_IDENTIFIER ambient_condition[0][9].amb_cond.ydiBackupMemory_xau16[2].ZFEH_EepromData ECU_ADDRESS 0xFFF82E59 /end MEASUREMENT
/begin MEASUREMENT ZFEH_EepromData.ydiBackupMemory_xau16[2].amb_cond.ambient_condition[0][10] "ambient condition shot [0 .. 2-1] with 25 data bytes [0 .. 25-1] for the error code stored in this error memory slot" UBYTE EH_STANDARD_S5_S3 1 100 0 255 DISPLAY_IDENTIFIER ambient_condition[0][10].amb_cond.ydiBackupMemory_xau16[2].ZFEH_EepromData ECU_ADDRESS 0xFFF82E5A /end MEASUREMENT
/begin MEASUREMENT ZFEH_EepromData.ydiBackupMemory_xau16[2].amb_cond.ambient_condition[0][11] "ambient condition shot [0 .. 2-1] with 25 data bytes [0 .. 25-1] for the error code stored in this error memory slot" UBYTE EH_STANDARD_S5_S3 1 100 0 255 DISPLAY_IDENTIFIER ambient_condition[0][11].amb_cond.ydiBackupMemory_xau16[2].ZFEH_EepromData ECU_ADDRESS 0xFFF82E5B /end MEASUREMENT
/begin MEASUREMENT ZFEH_EepromData.ydiBackupMemory_xau16[2].amb_cond.ambient_condition[0][12] "ambient condition shot [0 .. 2-1] with 25 data bytes [0 .. 25-1] for the error code stored in this error memory slot" UBYTE EH_STANDARD_S5_S3 1 100 0 255 DISPLAY_IDENTIFIER ambient_condition[0][12].amb_cond.ydiBackupMemory_xau16[2].ZFEH_EepromData ECU_ADDRESS 0xFFF82E5C /end MEASUREMENT
/begin MEASUREMENT ZFEH_EepromData.ydiBackupMemory_xau16[2].amb_cond.ambient_condition[0][13] "ambient condition shot [0 .. 2-1] with 25 data bytes [0 .. 25-1] for the error code stored in this error memory slot" UBYTE EH_STANDARD_S5_S3 1 100 0 255 DISPLAY_IDENTIFIER ambient_condition[0][13].amb_cond.ydiBackupMemory_xau16[2].ZFEH_EepromData ECU_ADDRESS 0xFFF82E5D /end MEASUREMENT
/begin MEASUREMENT ZFEH_EepromData.ydiBackupMemory_xau16[2].amb_cond.ambient_condition[0][14] "ambient condition shot [0 .. 2-1] with 25 data bytes [0 .. 25-1] for the error code stored in this error memory slot" UBYTE EH_STANDARD_S5_S3 1 100 0 255 DISPLAY_IDENTIFIER ambient_condition[0][14].amb_cond.ydiBackupMemory_xau16[2].ZFEH_EepromData ECU_ADDRESS 0xFFF82E5E /end MEASUREMENT
/begin MEASUREMENT ZFEH_EepromData.ydiBackupMemory_xau16[2].amb_cond.ambient_condition[0][15] "ambient condition shot [0 .. 2-1] with 25 data bytes [0 .. 25-1] for the error code stored in this error memory slot" UBYTE EH_STANDARD_S5_S3 1 100 0 255 DISPLAY_IDENTIFIER ambient_condition[0][15].amb_cond.ydiBackupMemory_xau16[2].ZFEH_EepromData ECU_ADDRESS 0xFFF82E5F /end MEASUREMENT
/begin MEASUREMENT ZFEH_EepromData.ydiBackupMemory_xau16[2].amb_cond.ambient_condition[0][16] "ambient condition shot [0 .. 2-1] with 25 data bytes [0 .. 25-1] for the error code stored in this error memory slot" UBYTE EH_STANDARD_S5_S3 1 100 0 255 DISPLAY_IDENTIFIER ambient_condition[0][16].amb_cond.ydiBackupMemory_xau16[2].ZFEH_EepromData ECU_ADDRESS 0xFFF82E60 /end MEASUREMENT
/begin MEASUREMENT ZFEH_EepromData.ydiBackupMemory_xau16[2].amb_cond.ambient_condition[0][17] "ambient condition shot [0 .. 2-1] with 25 data bytes [0 .. 25-1] for the error code stored in this error memory slot" UBYTE EH_STANDARD_S5_S3 1 100 0 255 DISPLAY_IDENTIFIER ambient_condition[0][17].amb_cond.ydiBackupMemory_xau16[2].ZFEH_EepromData ECU_ADDRESS 0xFFF82E61 /end MEASUREMENT
/begin MEASUREMENT ZFEH_EepromData.ydiBackupMemory_xau16[2].amb_cond.ambient_condition[0][18] "ambient condition shot [0 .. 2-1] with 25 data bytes [0 .. 25-1] for the error code stored in this error memory slot" UBYTE EH_STANDARD_S5_S3 1 100 0 255 DISPLAY_IDENTIFIER ambient_condition[0][18].amb_cond.ydiBackupMemory_xau16[2].ZFEH_EepromData ECU_ADDRESS 0xFFF82E62 /end MEASUREMENT
/begin MEASUREMENT ZFEH_EepromData.ydiBackupMemory_xau16[2].amb_cond.ambient_condition[0][19] "ambient condition shot [0 .. 2-1] with 25 data bytes [0 .. 25-1] for the error code stored in this error memory slot" UBYTE EH_STANDARD_S5_S3 1 100 0 255 DISPLAY_IDENTIFIER ambient_condition[0][19].amb_cond.ydiBackupMemory_xau16[2].ZFEH_EepromData ECU_ADDRESS 0xFFF82E63 /end MEASUREMENT
/begin MEASUREMENT ZFEH_EepromData.ydiBackupMemory_xau16[2].amb_cond.ambient_condition[0][20] "ambient condition shot [0 .. 2-1] with 25 data bytes [0 .. 25-1] for the error code stored in this error memory slot" UBYTE EH_STANDARD_S5_S3 1 100 0 255 DISPLAY_IDENTIFIER ambient_condition[0][20].amb_cond.ydiBackupMemory_xau16[2].ZFEH_EepromData ECU_ADDRESS 0xFFF82E64 /end MEASUREMENT
/begin MEASUREMENT ZFEH_EepromData.ydiBackupMemory_xau16[2].amb_cond.ambient_condition[0][21] "ambient condition shot [0 .. 2-1] with 25 data bytes [0 .. 25-1] for the error code stored in this error memory slot" UBYTE EH_STANDARD_S5_S3 1 100 0 255 DISPLAY_IDENTIFIER ambient_condition[0][21].amb_cond.ydiBackupMemory_xau16[2].ZFEH_EepromData ECU_ADDRESS 0xFFF82E65 /end MEASUREMENT
/begin MEASUREMENT ZFEH_EepromData.ydiBackupMemory_xau16[2].amb_cond.ambient_condition[0][22] "ambient condition shot [0 .. 2-1] with 25 data bytes [0 .. 25-1] for the error code stored in this error memory slot" UBYTE EH_STANDARD_S5_S3 1 100 0 255 DISPLAY_IDENTIFIER ambient_condition[0][22].amb_cond.ydiBackupMemory_xau16[2].ZFEH_EepromData ECU_ADDRESS 0xFFF82E66 /end MEASUREMENT
/begin MEASUREMENT ZFEH_EepromData.ydiBackupMemory_xau16[2].amb_cond.ambient_condition[0][23] "ambient condition shot [0 .. 2-1] with 25 data bytes [0 .. 25-1] for the error code stored in this error memory slot" UBYTE EH_STANDARD_S5_S3 1 100 0 255 DISPLAY_IDENTIFIER ambient_condition[0][23].amb_cond.ydiBackupMemory_xau16[2].ZFEH_EepromData ECU_ADDRESS 0xFFF82E67 /end MEASUREMENT
/begin MEASUREMENT ZFEH_EepromData.ydiBackupMemory_xau16[2].amb_cond.ambient_condition[0][24] "ambient condition shot [0 .. 2-1] with 25 data bytes [0 .. 25-1] for the error code stored in this error memory slot" UBYTE EH_STANDARD_S5_S3 1 100 0 255 DISPLAY_IDENTIFIER ambient_condition[0][24].amb_cond.ydiBackupMemory_xau16[2].ZFEH_EepromData ECU_ADDRESS 0xFFF82E68 /end MEASUREMENT
/begin MEASUREMENT ZFEH_EepromData.ydiBackupMemory_xau16[2].amb_cond.ambient_condition[1][0] "ambient condition shot [0 .. 2-1] with 25 data bytes [0 .. 25-1] for the error code stored in this error memory slot" UBYTE EH_STANDARD_S5_S3 1 100 0 255 DISPLAY_IDENTIFIER ambient_condition[1][0].amb_cond.ydiBackupMemory_xau16[2].ZFEH_EepromData ECU_ADDRESS 0xFFF82E69 /end MEASUREMENT
/begin MEASUREMENT ZFEH_EepromData.ydiBackupMemory_xau16[2].amb_cond.ambient_condition[1][1] "ambient condition shot [0 .. 2-1] with 25 data bytes [0 .. 25-1] for the error code stored in this error memory slot" UBYTE EH_STANDARD_S5_S3 1 100 0 255 DISPLAY_IDENTIFIER ambient_condition[1][1].amb_cond.ydiBackupMemory_xau16[2].ZFEH_EepromData ECU_ADDRESS 0xFFF82E6A /end MEASUREMENT
/begin MEASUREMENT ZFEH_EepromData.ydiBackupMemory_xau16[2].amb_cond.ambient_condition[1][2] "ambient condition shot [0 .. 2-1] with 25 data bytes [0 .. 25-1] for the error code stored in this error memory slot" UBYTE EH_STANDARD_S5_S3 1 100 0 255 DISPLAY_IDENTIFIER ambient_condition[1][2].amb_cond.ydiBackupMemory_xau16[2].ZFEH_EepromData ECU_ADDRESS 0xFFF82E6B /end MEASUREMENT
/begin MEASUREMENT ZFEH_EepromData.ydiBackupMemory_xau16[2].amb_cond.ambient_condition[1][3] "ambient condition shot [0 .. 2-1] with 25 data bytes [0 .. 25-1] for the error code stored in this error memory slot" UBYTE EH_STANDARD_S5_S3 1 100 0 255 DISPLAY_IDENTIFIER ambient_condition[1][3].amb_cond.ydiBackupMemory_xau16[2].ZFEH_EepromData ECU_ADDRESS 0xFFF82E6C /end MEASUREMENT
/begin MEASUREMENT ZFEH_EepromData.ydiBackupMemory_xau16[2].amb_cond.ambient_condition[1][4] "ambient condition shot [0 .. 2-1] with 25 data bytes [0 .. 25-1] for the error code stored in this error memory slot" UBYTE EH_STANDARD_S5_S3 1 100 0 255 DISPLAY_IDENTIFIER ambient_condition[1][4].amb_cond.ydiBackupMemory_xau16[2].ZFEH_EepromData ECU_ADDRESS 0xFFF82E6D /end MEASUREMENT
/begin MEASUREMENT ZFEH_EepromData.ydiBackupMemory_xau16[2].amb_cond.ambient_condition[1][5] "ambient condition shot [0 .. 2-1] with 25 data bytes [0 .. 25-1] for the error code stored in this error memory slot" UBYTE EH_STANDARD_S5_S3 1 100 0 255 DISPLAY_IDENTIFIER ambient_condition[1][5].amb_cond.ydiBackupMemory_xau16[2].ZFEH_EepromData ECU_ADDRESS 0xFFF82E6E /end MEASUREMENT
/begin MEASUREMENT ZFEH_EepromData.ydiBackupMemory_xau16[2].amb_cond.ambient_condition[1][6] "ambient condition shot [0 .. 2-1] with 25 data bytes [0 .. 25-1] for the error code stored in this error memory slot" UBYTE EH_STANDARD_S5_S3 1 100 0 255 DISPLAY_IDENTIFIER ambient_condition[1][6].amb_cond.ydiBackupMemory_xau16[2].ZFEH_EepromData ECU_ADDRESS 0xFFF82E6F /end MEASUREMENT
/begin MEASUREMENT ZFEH_EepromData.ydiBackupMemory_xau16[2].amb_cond.ambient_condition[1][7] "ambient condition shot [0 .. 2-1] with 25 data bytes [0 .. 25-1] for the error code stored in this error memory slot" UBYTE EH_STANDARD_S5_S3 1 100 0 255 DISPLAY_IDENTIFIER ambient_condition[1][7].amb_cond.ydiBackupMemory_xau16[2].ZFEH_EepromData ECU_ADDRESS 0xFFF82E70 /end MEASUREMENT
/begin MEASUREMENT ZFEH_EepromData.ydiBackupMemory_xau16[2].amb_cond.ambient_condition[1][8] "ambient condition shot [0 .. 2-1] with 25 data bytes [0 .. 25-1] for the error code stored in this error memory slot" UBYTE EH_STANDARD_S5_S3 1 100 0 255 DISPLAY_IDENTIFIER ambient_condition[1][8].amb_cond.ydiBackupMemory_xau16[2].ZFEH_EepromData ECU_ADDRESS 0xFFF82E71 /end MEASUREMENT
/begin MEASUREMENT ZFEH_EepromData.ydiBackupMemory_xau16[2].amb_cond.ambient_condition[1][9] "ambient condition shot [0 .. 2-1] with 25 data bytes [0 .. 25-1] for the error code stored in this error memory slot" UBYTE EH_STANDARD_S5_S3 1 100 0 255 DISPLAY_IDENTIFIER ambient_condition[1][9].amb_cond.ydiBackupMemory_xau16[2].ZFEH_EepromData ECU_ADDRESS 0xFFF82E72 /end MEASUREMENT
/begin MEASUREMENT ZFEH_EepromData.ydiBackupMemory_xau16[2].amb_cond.ambient_condition[1][10] "ambient condition shot [0 .. 2-1] with 25 data bytes [0 .. 25-1] for the error code stored in this error memory slot" UBYTE EH_STANDARD_S5_S3 1 100 0 255 DISPLAY_IDENTIFIER ambient_condition[1][10].amb_cond.ydiBackupMemory_xau16[2].ZFEH_EepromData ECU_ADDRESS 0xFFF82E73 /end MEASUREMENT
/begin MEASUREMENT ZFEH_EepromData.ydiBackupMemory_xau16[2].amb_cond.ambient_condition[1][11] "ambient condition shot [0 .. 2-1] with 25 data bytes [0 .. 25-1] for the error code stored in this error memory slot" UBYTE EH_STANDARD_S5_S3 1 100 0 255 DISPLAY_IDENTIFIER ambient_condition[1][11].amb_cond.ydiBackupMemory_xau16[2].ZFEH_EepromData ECU_ADDRESS 0xFFF82E74 /end MEASUREMENT
/begin MEASUREMENT ZFEH_EepromData.ydiBackupMemory_xau16[2].amb_cond.ambient_condition[1][12] "ambient condition shot [0 .. 2-1] with 25 data bytes [0 .. 25-1] for the error code stored in this error memory slot" UBYTE EH_STANDARD_S5_S3 1 100 0 255 DISPLAY_IDENTIFIER ambient_condition[1][12].amb_cond.ydiBackupMemory_xau16[2].ZFEH_EepromData ECU_ADDRESS 0xFFF82E75 /end MEASUREMENT
/begin MEASUREMENT ZFEH_EepromData.ydiBackupMemory_xau16[2].amb_cond.ambient_condition[1][13] "ambient condition shot [0 .. 2-1] with 25 data bytes [0 .. 25-1] for the error code stored in this error memory slot" UBYTE EH_STANDARD_S5_S3 1 100 0 255 DISPLAY_IDENTIFIER ambient_condition[1][13].amb_cond.ydiBackupMemory_xau16[2].ZFEH_EepromData ECU_ADDRESS 0xFFF82E76 /end MEASUREMENT
/begin MEASUREMENT ZFEH_EepromData.ydiBackupMemory_xau16[2].amb_cond.ambient_condition[1][14] "ambient condition shot [0 .. 2-1] with 25 data bytes [0 .. 25-1] for the error code stored in this error memory slot" UBYTE EH_STANDARD_S5_S3 1 100 0 255 DISPLAY_IDENTIFIER ambient_condition[1][14].amb_cond.ydiBackupMemory_xau16[2].ZFEH_EepromData ECU_ADDRESS 0xFFF82E77 /end MEASUREMENT
/begin MEASUREMENT ZFEH_EepromData.ydiBackupMemory_xau16[2].amb_cond.ambient_condition[1][15] "ambient condition shot [0 .. 2-1] with 25 data bytes [0 .. 25-1] for the error code stored in this error memory slot" UBYTE EH_STANDARD_S5_S3 1 100 0 255 DISPLAY_IDENTIFIER ambient_condition[1][15].amb_cond.ydiBackupMemory_xau16[2].ZFEH_EepromData ECU_ADDRESS 0xFFF82E78 /end MEASUREMENT
/begin MEASUREMENT ZFEH_EepromData.ydiBackupMemory_xau16[2].amb_cond.ambient_condition[1][16] "ambient condition shot [0 .. 2-1] with 25 data bytes [0 .. 25-1] for the error code stored in this error memory slot" UBYTE EH_STANDARD_S5_S3 1 100 0 255 DISPLAY_IDENTIFIER ambient_condition[1][16].amb_cond.ydiBackupMemory_xau16[2].ZFEH_EepromData ECU_ADDRESS 0xFFF82E79 /end MEASUREMENT
/begin MEASUREMENT ZFEH_EepromData.ydiBackupMemory_xau16[2].amb_cond.ambient_condition[1][17] "ambient condition shot [0 .. 2-1] with 25 data bytes [0 .. 25-1] for the error code stored in this error memory slot" UBYTE EH_STANDARD_S5_S3 1 100 0 255 DISPLAY_IDENTIFIER ambient_condition[1][17].amb_cond.ydiBackupMemory_xau16[2].ZFEH_EepromData ECU_ADDRESS 0xFFF82E7A /end MEASUREMENT
/begin MEASUREMENT ZFEH_EepromData.ydiBackupMemory_xau16[2].amb_cond.ambient_condition[1][18] "ambient condition shot [0 .. 2-1] with 25 data bytes [0 .. 25-1] for the error code stored in this error memory slot" UBYTE EH_STANDARD_S5_S3 1 100 0 255 DISPLAY_IDENTIFIER ambient_condition[1][18].amb_cond.ydiBackupMemory_xau16[2].ZFEH_EepromData ECU_ADDRESS 0xFFF82E7B /end MEASUREMENT
/begin MEASUREMENT ZFEH_EepromData.ydiBackupMemory_xau16[2].amb_cond.ambient_condition[1][19] "ambient condition shot [0 .. 2-1] with 25 data bytes [0 .. 25-1] for the error code stored in this error memory slot" UBYTE EH_STANDARD_S5_S3 1 100 0 255 DISPLAY_IDENTIFIER ambient_condition[1][19].amb_cond.ydiBackupMemory_xau16[2].ZFEH_EepromData ECU_ADDRESS 0xFFF82E7C /end MEASUREMENT
/begin MEASUREMENT ZFEH_EepromData.ydiBackupMemory_xau16[2].amb_cond.ambient_condition[1][20] "ambient condition shot [0 .. 2-1] with 25 data bytes [0 .. 25-1] for the error code stored in this error memory slot" UBYTE EH_STANDARD_S5_S3 1 100 0 255 DISPLAY_IDENTIFIER ambient_condition[1][20].amb_cond.ydiBackupMemory_xau16[2].ZFEH_EepromData ECU_ADDRESS 0xFFF82E7D /end MEASUREMENT
/begin MEASUREMENT ZFEH_EepromData.ydiBackupMemory_xau16[2].amb_cond.ambient_condition[1][21] "ambient condition shot [0 .. 2-1] with 25 data bytes [0 .. 25-1] for the error code stored in this error memory slot" UBYTE EH_STANDARD_S5_S3 1 100 0 255 DISPLAY_IDENTIFIER ambient_condition[1][21].amb_cond.ydiBackupMemory_xau16[2].ZFEH_EepromData ECU_ADDRESS 0xFFF82E7E /end MEASUREMENT
/begin MEASUREMENT ZFEH_EepromData.ydiBackupMemory_xau16[2].amb_cond.ambient_condition[1][22] "ambient condition shot [0 .. 2-1] with 25 data bytes [0 .. 25-1] for the error code stored in this error memory slot" UBYTE EH_STANDARD_S5_S3 1 100 0 255 DISPLAY_IDENTIFIER ambient_condition[1][22].amb_cond.ydiBackupMemory_xau16[2].ZFEH_EepromData ECU_ADDRESS 0xFFF82E7F /end MEASUREMENT
/begin MEASUREMENT ZFEH_EepromData.ydiBackupMemory_xau16[2].amb_cond.ambient_condition[1][23] "ambient condition shot [0 .. 2-1] with 25 data bytes [0 .. 25-1] for the error code stored in this error memory slot" UBYTE EH_STANDARD_S5_S3 1 100 0 255 DISPLAY_IDENTIFIER ambient_condition[1][23].amb_cond.ydiBackupMemory_xau16[2].ZFEH_EepromData ECU_ADDRESS 0xFFF82E80 /end MEASUREMENT
/begin MEASUREMENT ZFEH_EepromData.ydiBackupMemory_xau16[2].amb_cond.ambient_condition[1][24] "ambient condition shot [0 .. 2-1] with 25 data bytes [0 .. 25-1] for the error code stored in this error memory slot" UBYTE EH_STANDARD_S5_S3 1 100 0 255 DISPLAY_IDENTIFIER ambient_condition[1][24].amb_cond.ydiBackupMemory_xau16[2].ZFEH_EepromData ECU_ADDRESS 0xFFF82E81 /end MEASUREMENT
/begin MEASUREMENT ZFEH_EepromData.ydiBackupMemory_xau16[2].amb_cond.status_of_ambient_conditions[0] "status of ambient condition shot x: 0=invalid 1=valid" UBYTE EH_STANDARD_S5_S3 1 100 0 1 DISPLAY_IDENTIFIER status_of_ambient_conditions[0].amb_cond.ydiBackupMemory_xau16[2].ZFEH_EepromData ECU_ADDRESS 0xFFF82E82 /end MEASUREMENT
/begin MEASUREMENT ZFEH_EepromData.ydiBackupMemory_xau16[2].amb_cond.status_of_ambient_conditions[1] "status of ambient condition shot x: 0=invalid 1=valid" UBYTE EH_STANDARD_S5_S3 1 100 0 1 DISPLAY_IDENTIFIER status_of_ambient_conditions[1].amb_cond.ydiBackupMemory_xau16[2].ZFEH_EepromData ECU_ADDRESS 0xFFF82E83 /end MEASUREMENT
/begin MEASUREMENT ZFEH_EepromData.ydiBackupMemory_xau16[2].error_code "error code stored in error memory slot" UWORD EH_STANDARD_S5_S3 1 100 0 65535 DISPLAY_IDENTIFIER error_code.ydiBackupMemory_xau16[2].ZFEH_EepromData ECU_ADDRESS 0xFFF82E3C /end MEASUREMENT
/begin MEASUREMENT ZFEH_EepromData.ydiBackupMemory_xau16[2].error_type "error type of error code stored in error memory slot" UWORD EH_STANDARD_S5_S3 1 100 0 65535 DISPLAY_IDENTIFIER error_type.ydiBackupMemory_xau16[2].ZFEH_EepromData ECU_ADDRESS 0xFFF82E3E /end MEASUREMENT
/begin MEASUREMENT ZFEH_EepromData.ydiBackupMemory_xau16[2].status_word "status word of error code stored in error memory slot" UWORD EH_STANDARD_S5_S3 1 100 0 65535 DISPLAY_IDENTIFIER status_word.ydiBackupMemory_xau16[2].ZFEH_EepromData ECU_ADDRESS 0xFFF82E40 /end MEASUREMENT
/begin MEASUREMENT ZFEH_EepromData.ydiBackupMemory_xau16[2].frequency_counter "frequency counter of error code stored in error memory slot" UBYTE EH_STANDARD_S5_S3 1 100 0 255 DISPLAY_IDENTIFIER frequency_counter.ydiBackupMemory_xau16[2].ZFEH_EepromData ECU_ADDRESS 0xFFF82E42 /end MEASUREMENT
/begin MEASUREMENT ZFEH_EepromData.ydiBackupMemory_xau16[2].backwards_counter "backwards counter of error code stored in error memory slot" UBYTE EH_STANDARD_S5_S3 1 100 0 255 DISPLAY_IDENTIFIER backwards_counter.ydiBackupMemory_xau16[2].ZFEH_EepromData ECU_ADDRESS 0xFFF82E43 /end MEASUREMENT
/begin MEASUREMENT ZFEH_EepromData.ydiBackupMemory_xau16[2].permanent_counter "counter of permanent error codes stored in error memory slot" UBYTE EH_STANDARD_S5_S3 1 100 0 255 DISPLAY_IDENTIFIER permanent_counter.ydiBackupMemory_xau16[2].ZFEH_EepromData ECU_ADDRESS 0xFFF82E44 /end MEASUREMENT
/begin MEASUREMENT ZFEH_EepromData.ydiBackupMemory_xau16[2].sequence_counter "sequence counter of error code stored in error memory slot" UBYTE EH_STANDARD_S5_S3 1 100 0 255 DISPLAY_IDENTIFIER sequence_counter.ydiBackupMemory_xau16[2].ZFEH_EepromData ECU_ADDRESS 0xFFF82E45 /end MEASUREMENT
/begin MEASUREMENT ZFEH_EepromData.ydiBackupMemory_xau16[2].master_time "master time of error code stored in error memory slot" ULONG EH_STANDARD_S5_S3 1 100 0 4294967295 DISPLAY_IDENTIFIER master_time.ydiBackupMemory_xau16[2].ZFEH_EepromData ECU_ADDRESS 0xFFF82E48 /end MEASUREMENT
/begin MEASUREMENT ZFEH_EepromData.ydiBackupMemory_xau16[2].condition_byte "condition byte of error code stored in error memory slot" UBYTE EH_STANDARD_S5_S3 1 100 0 255 DISPLAY_IDENTIFIER condition_byte.ydiBackupMemory_xau16[2].ZFEH_EepromData ECU_ADDRESS 0xFFF82E4D /end MEASUREMENT
/begin MEASUREMENT ZFEH_EepromData.ydiBackupMemory_xau16[2].obd_driving_cycle_counter "obd driving cycle counter of error code stored in error memory slot" UWORD EH_STANDARD_S5_S3 1 100 0 65535 DISPLAY_IDENTIFIER obd_driving_cycle_counter.ydiBackupMemory_xau16[2].ZFEH_EepromData ECU_ADDRESS 0xFFF82E4E /end MEASUREMENT
/begin MEASUREMENT ZFEH_EepromData.ydiBackupMemory_xau16[3].amb_cond.ambient_condition[0][0] "ambient condition shot [0 .. 2-1] with 25 data bytes [0 .. 25-1] for the error code stored in this error memory slot" UBYTE EH_STANDARD_S5_S3 1 100 0 255 DISPLAY_IDENTIFIER ambient_condition[0][0].amb_cond.ydiBackupMemory_xau16[3].ZFEH_EepromData ECU_ADDRESS 0xFFF82E98 /end MEASUREMENT
/begin MEASUREMENT ZFEH_EepromData.ydiBackupMemory_xau16[3].amb_cond.ambient_condition[0][1] "ambient condition shot [0 .. 2-1] with 25 data bytes [0 .. 25-1] for the error code stored in this error memory slot" UBYTE EH_STANDARD_S5_S3 1 100 0 255 DISPLAY_IDENTIFIER ambient_condition[0][1].amb_cond.ydiBackupMemory_xau16[3].ZFEH_EepromData ECU_ADDRESS 0xFFF82E99 /end MEASUREMENT
/begin MEASUREMENT ZFEH_EepromData.ydiBackupMemory_xau16[3].amb_cond.ambient_condition[0][2] "ambient condition shot [0 .. 2-1] with 25 data bytes [0 .. 25-1] for the error code stored in this error memory slot" UBYTE EH_STANDARD_S5_S3 1 100 0 255 DISPLAY_IDENTIFIER ambient_condition[0][2].amb_cond.ydiBackupMemory_xau16[3].ZFEH_EepromData ECU_ADDRESS 0xFFF82E9A /end MEASUREMENT
/begin MEASUREMENT ZFEH_EepromData.ydiBackupMemory_xau16[3].amb_cond.ambient_condition[0][3] "ambient condition shot [0 .. 2-1] with 25 data bytes [0 .. 25-1] for the error code stored in this error memory slot" UBYTE EH_STANDARD_S5_S3 1 100 0 255 DISPLAY_IDENTIFIER ambient_condition[0][3].amb_cond.ydiBackupMemory_xau16[3].ZFEH_EepromData ECU_ADDRESS 0xFFF82E9B /end MEASUREMENT
/begin MEASUREMENT ZFEH_EepromData.ydiBackupMemory_xau16[3].amb_cond.ambient_condition[0][4] "ambient condition shot [0 .. 2-1] with 25 data bytes [0 .. 25-1] for the error code stored in this error memory slot" UBYTE EH_STANDARD_S5_S3 1 100 0 255 DISPLAY_IDENTIFIER ambient_condition[0][4].amb_cond.ydiBackupMemory_xau16[3].ZFEH_EepromData ECU_ADDRESS 0xFFF82E9C /end MEASUREMENT
/begin MEASUREMENT ZFEH_EepromData.ydiBackupMemory_xau16[3].amb_cond.ambient_condition[0][5] "ambient condition shot [0 .. 2-1] with 25 data bytes [0 .. 25-1] for the error code stored in this error memory slot" UBYTE EH_STANDARD_S5_S3 1 100 0 255 DISPLAY_IDENTIFIER ambient_condition[0][5].amb_cond.ydiBackupMemory_xau16[3].ZFEH_EepromData ECU_ADDRESS 0xFFF82E9D /end MEASUREMENT
/begin MEASUREMENT ZFEH_EepromData.ydiBackupMemory_xau16[3].amb_cond.ambient_condition[0][6] "ambient condition shot [0 .. 2-1] with 25 data bytes [0 .. 25-1] for the error code stored in this error memory slot" UBYTE EH_STANDARD_S5_S3 1 100 0 255 DISPLAY_IDENTIFIER ambient_condition[0][6].amb_cond.ydiBackupMemory_xau16[3].ZFEH_EepromData ECU_ADDRESS 0xFFF82E9E /end MEASUREMENT
/begin MEASUREMENT ZFEH_EepromData.ydiBackupMemory_xau16[3].amb_cond.ambient_condition[0][7] "ambient condition shot [0 .. 2-1] with 25 data bytes [0 .. 25-1] for the error code stored in this error memory slot" UBYTE EH_STANDARD_S5_S3 1 100 0 255 DISPLAY_IDENTIFIER ambient_condition[0][7].amb_cond.ydiBackupMemory_xau16[3].ZFEH_EepromData ECU_ADDRESS 0xFFF82E9F /end MEASUREMENT
/begin MEASUREMENT ZFEH_EepromData.ydiBackupMemory_xau16[3].amb_cond.ambient_condition[0][8] "ambient condition shot [0 .. 2-1] with 25 data bytes [0 .. 25-1] for the error code stored in this error memory slot" UBYTE EH_STANDARD_S5_S3 1 100 0 255 DISPLAY_IDENTIFIER ambient_condition[0][8].amb_cond.ydiBackupMemory_xau16[3].ZFEH_EepromData ECU_ADDRESS 0xFFF82EA0 /end MEASUREMENT
/begin MEASUREMENT ZFEH_EepromData.ydiBackupMemory_xau16[3].amb_cond.ambient_condition[0][9] "ambient condition shot [0 .. 2-1] with 25 data bytes [0 .. 25-1] for the error code stored in this error memory slot" UBYTE EH_STANDARD_S5_S3 1 100 0 255 DISPLAY_IDENTIFIER ambient_condition[0][9].amb_cond.ydiBackupMemory_xau16[3].ZFEH_EepromData ECU_ADDRESS 0xFFF82EA1 /end MEASUREMENT
/begin MEASUREMENT ZFEH_EepromData.ydiBackupMemory_xau16[3].amb_cond.ambient_condition[0][10] "ambient condition shot [0 .. 2-1] with 25 data bytes [0 .. 25-1] for the error code stored in this error memory slot" UBYTE EH_STANDARD_S5_S3 1 100 0 255 DISPLAY_IDENTIFIER ambient_condition[0][10].amb_cond.ydiBackupMemory_xau16[3].ZFEH_EepromData ECU_ADDRESS 0xFFF82EA2 /end MEASUREMENT
/begin MEASUREMENT ZFEH_EepromData.ydiBackupMemory_xau16[3].amb_cond.ambient_condition[0][11] "ambient condition shot [0 .. 2-1] with 25 data bytes [0 .. 25-1] for the error code stored in this error memory slot" UBYTE EH_STANDARD_S5_S3 1 100 0 255 DISPLAY_IDENTIFIER ambient_condition[0][11].amb_cond.ydiBackupMemory_xau16[3].ZFEH_EepromData ECU_ADDRESS 0xFFF82EA3 /end MEASUREMENT
/begin MEASUREMENT ZFEH_EepromData.ydiBackupMemory_xau16[3].amb_cond.ambient_condition[0][12] "ambient condition shot [0 .. 2-1] with 25 data bytes [0 .. 25-1] for the error code stored in this error memory slot" UBYTE EH_STANDARD_S5_S3 1 100 0 255 DISPLAY_IDENTIFIER ambient_condition[0][12].amb_cond.ydiBackupMemory_xau16[3].ZFEH_EepromData ECU_ADDRESS 0xFFF82EA4 /end MEASUREMENT
/begin MEASUREMENT ZFEH_EepromData.ydiBackupMemory_xau16[3].amb_cond.ambient_condition[0][13] "ambient condition shot [0 .. 2-1] with 25 data bytes [0 .. 25-1] for the error code stored in this error memory slot" UBYTE EH_STANDARD_S5_S3 1 100 0 255 DISPLAY_IDENTIFIER ambient_condition[0][13].amb_cond.ydiBackupMemory_xau16[3].ZFEH_EepromData ECU_ADDRESS 0xFFF82EA5 /end MEASUREMENT
/begin MEASUREMENT ZFEH_EepromData.ydiBackupMemory_xau16[3].amb_cond.ambient_condition[0][14] "ambient condition shot [0 .. 2-1] with 25 data bytes [0 .. 25-1] for the error code stored in this error memory slot" UBYTE EH_STANDARD_S5_S3 1 100 0 255 DISPLAY_IDENTIFIER ambient_condition[0][14].amb_cond.ydiBackupMemory_xau16[3].ZFEH_EepromData ECU_ADDRESS 0xFFF82EA6 /end MEASUREMENT
/begin MEASUREMENT ZFEH_EepromData.ydiBackupMemory_xau16[3].amb_cond.ambient_condition[0][15] "ambient condition shot [0 .. 2-1] with 25 data bytes [0 .. 25-1] for the error code stored in this error memory slot" UBYTE EH_STANDARD_S5_S3 1 100 0 255 DISPLAY_IDENTIFIER ambient_condition[0][15].amb_cond.ydiBackupMemory_xau16[3].ZFEH_EepromData ECU_ADDRESS 0xFFF82EA7 /end MEASUREMENT
/begin MEASUREMENT ZFEH_EepromData.ydiBackupMemory_xau16[3].amb_cond.ambient_condition[0][16] "ambient condition shot [0 .. 2-1] with 25 data bytes [0 .. 25-1] for the error code stored in this error memory slot" UBYTE EH_STANDARD_S5_S3 1 100 0 255 DISPLAY_IDENTIFIER ambient_condition[0][16].amb_cond.ydiBackupMemory_xau16[3].ZFEH_EepromData ECU_ADDRESS 0xFFF82EA8 /end MEASUREMENT
/begin MEASUREMENT ZFEH_EepromData.ydiBackupMemory_xau16[3].amb_cond.ambient_condition[0][17] "ambient condition shot [0 .. 2-1] with 25 data bytes [0 .. 25-1] for the error code stored in this error memory slot" UBYTE EH_STANDARD_S5_S3 1 100 0 255 DISPLAY_IDENTIFIER ambient_condition[0][17].amb_cond.ydiBackupMemory_xau16[3].ZFEH_EepromData ECU_ADDRESS 0xFFF82EA9 /end MEASUREMENT
/begin MEASUREMENT ZFEH_EepromData.ydiBackupMemory_xau16[3].amb_cond.ambient_condition[0][18] "ambient condition shot [0 .. 2-1] with 25 data bytes [0 .. 25-1] for the error code stored in this error memory slot" UBYTE EH_STANDARD_S5_S3 1 100 0 255 DISPLAY_IDENTIFIER ambient_condition[0][18].amb_cond.ydiBackupMemory_xau16[3].ZFEH_EepromData ECU_ADDRESS 0xFFF82EAA /end MEASUREMENT
/begin MEASUREMENT ZFEH_EepromData.ydiBackupMemory_xau16[3].amb_cond.ambient_condition[0][19] "ambient condition shot [0 .. 2-1] with 25 data bytes [0 .. 25-1] for the error code stored in this error memory slot" UBYTE EH_STANDARD_S5_S3 1 100 0 255 DISPLAY_IDENTIFIER ambient_condition[0][19].amb_cond.ydiBackupMemory_xau16[3].ZFEH_EepromData ECU_ADDRESS 0xFFF82EAB /end MEASUREMENT
/begin MEASUREMENT ZFEH_EepromData.ydiBackupMemory_xau16[3].amb_cond.ambient_condition[0][20] "ambient condition shot [0 .. 2-1] with 25 data bytes [0 .. 25-1] for the error code stored in this error memory slot" UBYTE EH_STANDARD_S5_S3 1 100 0 255 DISPLAY_IDENTIFIER ambient_condition[0][20].amb_cond.ydiBackupMemory_xau16[3].ZFEH_EepromData ECU_ADDRESS 0xFFF82EAC /end MEASUREMENT
/begin MEASUREMENT ZFEH_EepromData.ydiBackupMemory_xau16[3].amb_cond.ambient_condition[0][21] "ambient condition shot [0 .. 2-1] with 25 data bytes [0 .. 25-1] for the error code stored in this error memory slot" UBYTE EH_STANDARD_S5_S3 1 100 0 255 DISPLAY_IDENTIFIER ambient_condition[0][21].amb_cond.ydiBackupMemory_xau16[3].ZFEH_EepromData ECU_ADDRESS 0xFFF82EAD /end MEASUREMENT
/begin MEASUREMENT ZFEH_EepromData.ydiBackupMemory_xau16[3].amb_cond.ambient_condition[0][22] "ambient condition shot [0 .. 2-1] with 25 data bytes [0 .. 25-1] for the error code stored in this error memory slot" UBYTE EH_STANDARD_S5_S3 1 100 0 255 DISPLAY_IDENTIFIER ambient_condition[0][22].amb_cond.ydiBackupMemory_xau16[3].ZFEH_EepromData ECU_ADDRESS 0xFFF82EAE /end MEASUREMENT
/begin MEASUREMENT ZFEH_EepromData.ydiBackupMemory_xau16[3].amb_cond.ambient_condition[0][23] "ambient condition shot [0 .. 2-1] with 25 data bytes [0 .. 25-1] for the error code stored in this error memory slot" UBYTE EH_STANDARD_S5_S3 1 100 0 255 DISPLAY_IDENTIFIER ambient_condition[0][23].amb_cond.ydiBackupMemory_xau16[3].ZFEH_EepromData ECU_ADDRESS 0xFFF82EAF /end MEASUREMENT
/begin MEASUREMENT ZFEH_EepromData.ydiBackupMemory_xau16[3].amb_cond.ambient_condition[0][24] "ambient condition shot [0 .. 2-1] with 25 data bytes [0 .. 25-1] for the error code stored in this error memory slot" UBYTE EH_STANDARD_S5_S3 1 100 0 255 DISPLAY_IDENTIFIER ambient_condition[0][24].amb_cond.ydiBackupMemory_xau16[3].ZFEH_EepromData ECU_ADDRESS 0xFFF82EB0 /end MEASUREMENT
/begin MEASUREMENT ZFEH_EepromData.ydiBackupMemory_xau16[3].amb_cond.ambient_condition[1][0] "ambient condition shot [0 .. 2-1] with 25 data bytes [0 .. 25-1] for the error code stored in this error memory slot" UBYTE EH_STANDARD_S5_S3 1 100 0 255 DISPLAY_IDENTIFIER ambient_condition[1][0].amb_cond.ydiBackupMemory_xau16[3].ZFEH_EepromData ECU_ADDRESS 0xFFF82EB1 /end MEASUREMENT
/begin MEASUREMENT ZFEH_EepromData.ydiBackupMemory_xau16[3].amb_cond.ambient_condition[1][1] "ambient condition shot [0 .. 2-1] with 25 data bytes [0 .. 25-1] for the error code stored in this error memory slot" UBYTE EH_STANDARD_S5_S3 1 100 0 255 DISPLAY_IDENTIFIER ambient_condition[1][1].amb_cond.ydiBackupMemory_xau16[3].ZFEH_EepromData ECU_ADDRESS 0xFFF82EB2 /end MEASUREMENT
/begin MEASUREMENT ZFEH_EepromData.ydiBackupMemory_xau16[3].amb_cond.ambient_condition[1][2] "ambient condition shot [0 .. 2-1] with 25 data bytes [0 .. 25-1] for the error code stored in this error memory slot" UBYTE EH_STANDARD_S5_S3 1 100 0 255 DISPLAY_IDENTIFIER ambient_condition[1][2].amb_cond.ydiBackupMemory_xau16[3].ZFEH_EepromData ECU_ADDRESS 0xFFF82EB3 /end MEASUREMENT
/begin MEASUREMENT ZFEH_EepromData.ydiBackupMemory_xau16[3].amb_cond.ambient_condition[1][3] "ambient condition shot [0 .. 2-1] with 25 data bytes [0 .. 25-1] for the error code stored in this error memory slot" UBYTE EH_STANDARD_S5_S3 1 100 0 255 DISPLAY_IDENTIFIER ambient_condition[1][3].amb_cond.ydiBackupMemory_xau16[3].ZFEH_EepromData ECU_ADDRESS 0xFFF82EB4 /end MEASUREMENT
/begin MEASUREMENT ZFEH_EepromData.ydiBackupMemory_xau16[3].amb_cond.ambient_condition[1][4] "ambient condition shot [0 .. 2-1] with 25 data bytes [0 .. 25-1] for the error code stored in this error memory slot" UBYTE EH_STANDARD_S5_S3 1 100 0 255 DISPLAY_IDENTIFIER ambient_condition[1][4].amb_cond.ydiBackupMemory_xau16[3].ZFEH_EepromData ECU_ADDRESS 0xFFF82EB5 /end MEASUREMENT
/begin MEASUREMENT ZFEH_EepromData.ydiBackupMemory_xau16[3].amb_cond.ambient_condition[1][5] "ambient condition shot [0 .. 2-1] with 25 data bytes [0 .. 25-1] for the error code stored in this error memory slot" UBYTE EH_STANDARD_S5_S3 1 100 0 255 DISPLAY_IDENTIFIER ambient_condition[1][5].amb_cond.ydiBackupMemory_xau16[3].ZFEH_EepromData ECU_ADDRESS 0xFFF82EB6 /end MEASUREMENT
/begin MEASUREMENT ZFEH_EepromData.ydiBackupMemory_xau16[3].amb_cond.ambient_condition[1][6] "ambient condition shot [0 .. 2-1] with 25 data bytes [0 .. 25-1] for the error code stored in this error memory slot" UBYTE EH_STANDARD_S5_S3 1 100 0 255 DISPLAY_IDENTIFIER ambient_condition[1][6].amb_cond.ydiBackupMemory_xau16[3].ZFEH_EepromData ECU_ADDRESS 0xFFF82EB7 /end MEASUREMENT
/begin MEASUREMENT ZFEH_EepromData.ydiBackupMemory_xau16[3].amb_cond.ambient_condition[1][7] "ambient condition shot [0 .. 2-1] with 25 data bytes [0 .. 25-1] for the error code stored in this error memory slot" UBYTE EH_STANDARD_S5_S3 1 100 0 255 DISPLAY_IDENTIFIER ambient_condition[1][7].amb_cond.ydiBackupMemory_xau16[3].ZFEH_EepromData ECU_ADDRESS 0xFFF82EB8 /end MEASUREMENT
/begin MEASUREMENT ZFEH_EepromData.ydiBackupMemory_xau16[3].amb_cond.ambient_condition[1][8] "ambient condition shot [0 .. 2-1] with 25 data bytes [0 .. 25-1] for the error code stored in this error memory slot" UBYTE EH_STANDARD_S5_S3 1 100 0 255 DISPLAY_IDENTIFIER ambient_condition[1][8].amb_cond.ydiBackupMemory_xau16[3].ZFEH_EepromData ECU_ADDRESS 0xFFF82EB9 /end MEASUREMENT
/begin MEASUREMENT ZFEH_EepromData.ydiBackupMemory_xau16[3].amb_cond.ambient_condition[1][9] "ambient condition shot [0 .. 2-1] with 25 data bytes [0 .. 25-1] for the error code stored in this error memory slot" UBYTE EH_STANDARD_S5_S3 1 100 0 255 DISPLAY_IDENTIFIER ambient_condition[1][9].amb_cond.ydiBackupMemory_xau16[3].ZFEH_EepromData ECU_ADDRESS 0xFFF82EBA /end MEASUREMENT
/begin MEASUREMENT ZFEH_EepromData.ydiBackupMemory_xau16[3].amb_cond.ambient_condition[1][10] "ambient condition shot [0 .. 2-1] with 25 data bytes [0 .. 25-1] for the error code stored in this error memory slot" UBYTE EH_STANDARD_S5_S3 1 100 0 255 DISPLAY_IDENTIFIER ambient_condition[1][10].amb_cond.ydiBackupMemory_xau16[3].ZFEH_EepromData ECU_ADDRESS 0xFFF82EBB /end MEASUREMENT
/begin MEASUREMENT ZFEH_EepromData.ydiBackupMemory_xau16[3].amb_cond.ambient_condition[1][11] "ambient condition shot [0 .. 2-1] with 25 data bytes [0 .. 25-1] for the error code stored in this error memory slot" UBYTE EH_STANDARD_S5_S3 1 100 0 255 DISPLAY_IDENTIFIER ambient_condition[1][11].amb_cond.ydiBackupMemory_xau16[3].ZFEH_EepromData ECU_ADDRESS 0xFFF82EBC /end MEASUREMENT
/begin MEASUREMENT ZFEH_EepromData.ydiBackupMemory_xau16[3].amb_cond.ambient_condition[1][12] "ambient condition shot [0 .. 2-1] with 25 data bytes [0 .. 25-1] for the error code stored in this error memory slot" UBYTE EH_STANDARD_S5_S3 1 100 0 255 DISPLAY_IDENTIFIER ambient_condition[1][12].amb_cond.ydiBackupMemory_xau16[3].ZFEH_EepromData ECU_ADDRESS 0xFFF82EBD /end MEASUREMENT
/begin MEASUREMENT ZFEH_EepromData.ydiBackupMemory_xau16[3].amb_cond.ambient_condition[1][13] "ambient condition shot [0 .. 2-1] with 25 data bytes [0 .. 25-1] for the error code stored in this error memory slot" UBYTE EH_STANDARD_S5_S3 1 100 0 255 DISPLAY_IDENTIFIER ambient_condition[1][13].amb_cond.ydiBackupMemory_xau16[3].ZFEH_EepromData ECU_ADDRESS 0xFFF82EBE /end MEASUREMENT
/begin MEASUREMENT ZFEH_EepromData.ydiBackupMemory_xau16[3].amb_cond.ambient_condition[1][14] "ambient condition shot [0 .. 2-1] with 25 data bytes [0 .. 25-1] for the error code stored in this error memory slot" UBYTE EH_STANDARD_S5_S3 1 100 0 255 DISPLAY_IDENTIFIER ambient_condition[1][14].amb_cond.ydiBackupMemory_xau16[3].ZFEH_EepromData ECU_ADDRESS 0xFFF82EBF /end MEASUREMENT
/begin MEASUREMENT ZFEH_EepromData.ydiBackupMemory_xau16[3].amb_cond.ambient_condition[1][15] "ambient condition shot [0 .. 2-1] with 25 data bytes [0 .. 25-1] for the error code stored in this error memory slot" UBYTE EH_STANDARD_S5_S3 1 100 0 255 DISPLAY_IDENTIFIER ambient_condition[1][15].amb_cond.ydiBackupMemory_xau16[3].ZFEH_EepromData ECU_ADDRESS 0xFFF82EC0 /end MEASUREMENT
/begin MEASUREMENT ZFEH_EepromData.ydiBackupMemory_xau16[3].amb_cond.ambient_condition[1][16] "ambient condition shot [0 .. 2-1] with 25 data bytes [0 .. 25-1] for the error code stored in this error memory slot" UBYTE EH_STANDARD_S5_S3 1 100 0 255 DISPLAY_IDENTIFIER ambient_condition[1][16].amb_cond.ydiBackupMemory_xau16[3].ZFEH_EepromData ECU_ADDRESS 0xFFF82EC1 /end MEASUREMENT
/begin MEASUREMENT ZFEH_EepromData.ydiBackupMemory_xau16[3].amb_cond.ambient_condition[1][17] "ambient condition shot [0 .. 2-1] with 25 data bytes [0 .. 25-1] for the error code stored in this error memory slot" UBYTE EH_STANDARD_S5_S3 1 100 0 255 DISPLAY_IDENTIFIER ambient_condition[1][17].amb_cond.ydiBackupMemory_xau16[3].ZFEH_EepromData ECU_ADDRESS 0xFFF82EC2 /end MEASUREMENT
/begin MEASUREMENT ZFEH_EepromData.ydiBackupMemory_xau16[3].amb_cond.ambient_condition[1][18] "ambient condition shot [0 .. 2-1] with 25 data bytes [0 .. 25-1] for the error code stored in this error memory slot" UBYTE EH_STANDARD_S5_S3 1 100 0 255 DISPLAY_IDENTIFIER ambient_condition[1][18].amb_cond.ydiBackupMemory_xau16[3].ZFEH_EepromData ECU_ADDRESS 0xFFF82EC3 /end MEASUREMENT
/begin MEASUREMENT ZFEH_EepromData.ydiBackupMemory_xau16[3].amb_cond.ambient_condition[1][19] "ambient condition shot [0 .. 2-1] with 25 data bytes [0 .. 25-1] for the error code stored in this error memory slot" UBYTE EH_STANDARD_S5_S3 1 100 0 255 DISPLAY_IDENTIFIER ambient_condition[1][19].amb_cond.ydiBackupMemory_xau16[3].ZFEH_EepromData ECU_ADDRESS 0xFFF82EC4 /end MEASUREMENT
/begin MEASUREMENT ZFEH_EepromData.ydiBackupMemory_xau16[3].amb_cond.ambient_condition[1][20] "ambient condition shot [0 .. 2-1] with 25 data bytes [0 .. 25-1] for the error code stored in this error memory slot" UBYTE EH_STANDARD_S5_S3 1 100 0 255 DISPLAY_IDENTIFIER ambient_condition[1][20].amb_cond.ydiBackupMemory_xau16[3].ZFEH_EepromData ECU_ADDRESS 0xFFF82EC5 /end MEASUREMENT
/begin MEASUREMENT ZFEH_EepromData.ydiBackupMemory_xau16[3].amb_cond.ambient_condition[1][21] "ambient condition shot [0 .. 2-1] with 25 data bytes [0 .. 25-1] for the error code stored in this error memory slot" UBYTE EH_STANDARD_S5_S3 1 100 0 255 DISPLAY_IDENTIFIER ambient_condition[1][21].amb_cond.ydiBackupMemory_xau16[3].ZFEH_EepromData ECU_ADDRESS 0xFFF82EC6 /end MEASUREMENT
/begin MEASUREMENT ZFEH_EepromData.ydiBackupMemory_xau16[3].amb_cond.ambient_condition[1][22] "ambient condition shot [0 .. 2-1] with 25 data bytes [0 .. 25-1] for the error code stored in this error memory slot" UBYTE EH_STANDARD_S5_S3 1 100 0 255 DISPLAY_IDENTIFIER ambient_condition[1][22].amb_cond.ydiBackupMemory_xau16[3].ZFEH_EepromData ECU_ADDRESS 0xFFF82EC7 /end MEASUREMENT
/begin MEASUREMENT ZFEH_EepromData.ydiBackupMemory_xau16[3].amb_cond.ambient_condition[1][23] "ambient condition shot [0 .. 2-1] with 25 data bytes [0 .. 25-1] for the error code stored in this error memory slot" UBYTE EH_STANDARD_S5_S3 1 100 0 255 DISPLAY_IDENTIFIER ambient_condition[1][23].amb_cond.ydiBackupMemory_xau16[3].ZFEH_EepromData ECU_ADDRESS 0xFFF82EC8 /end MEASUREMENT
/begin MEASUREMENT ZFEH_EepromData.ydiBackupMemory_xau16[3].amb_cond.ambient_condition[1][24] "ambient condition shot [0 .. 2-1] with 25 data bytes [0 .. 25-1] for the error code stored in this error memory slot" UBYTE EH_STANDARD_S5_S3 1 100 0 255 DISPLAY_IDENTIFIER ambient_condition[1][24].amb_cond.ydiBackupMemory_xau16[3].ZFEH_EepromData ECU_ADDRESS 0xFFF82EC9 /end MEASUREMENT
/begin MEASUREMENT ZFEH_EepromData.ydiBackupMemory_xau16[3].amb_cond.status_of_ambient_conditions[0] "status of ambient condition shot x: 0=invalid 1=valid" UBYTE EH_STANDARD_S5_S3 1 100 0 1 DISPLAY_IDENTIFIER status_of_ambient_conditions[0].amb_cond.ydiBackupMemory_xau16[3].ZFEH_EepromData ECU_ADDRESS 0xFFF82ECA /end MEASUREMENT
/begin MEASUREMENT ZFEH_EepromData.ydiBackupMemory_xau16[3].amb_cond.status_of_ambient_conditions[1] "status of ambient condition shot x: 0=invalid 1=valid" UBYTE EH_STANDARD_S5_S3 1 100 0 1 DISPLAY_IDENTIFIER status_of_ambient_conditions[1].amb_cond.ydiBackupMemory_xau16[3].ZFEH_EepromData ECU_ADDRESS 0xFFF82ECB /end MEASUREMENT
/begin MEASUREMENT ZFEH_EepromData.ydiBackupMemory_xau16[3].error_code "error code stored in error memory slot" UWORD EH_STANDARD_S5_S3 1 100 0 65535 DISPLAY_IDENTIFIER error_code.ydiBackupMemory_xau16[3].ZFEH_EepromData ECU_ADDRESS 0xFFF82E84 /end MEASUREMENT
/begin MEASUREMENT ZFEH_EepromData.ydiBackupMemory_xau16[3].error_type "error type of error code stored in error memory slot" UWORD EH_STANDARD_S5_S3 1 100 0 65535 DISPLAY_IDENTIFIER error_type.ydiBackupMemory_xau16[3].ZFEH_EepromData ECU_ADDRESS 0xFFF82E86 /end MEASUREMENT
/begin MEASUREMENT ZFEH_EepromData.ydiBackupMemory_xau16[3].status_word "status word of error code stored in error memory slot" UWORD EH_STANDARD_S5_S3 1 100 0 65535 DISPLAY_IDENTIFIER status_word.ydiBackupMemory_xau16[3].ZFEH_EepromData ECU_ADDRESS 0xFFF82E88 /end MEASUREMENT
/begin MEASUREMENT ZFEH_EepromData.ydiBackupMemory_xau16[3].frequency_counter "frequency counter of error code stored in error memory slot" UBYTE EH_STANDARD_S5_S3 1 100 0 255 DISPLAY_IDENTIFIER frequency_counter.ydiBackupMemory_xau16[3].ZFEH_EepromData ECU_ADDRESS 0xFFF82E8A /end MEASUREMENT
/begin MEASUREMENT ZFEH_EepromData.ydiBackupMemory_xau16[3].backwards_counter "backwards counter of error code stored in error memory slot" UBYTE EH_STANDARD_S5_S3 1 100 0 255 DISPLAY_IDENTIFIER backwards_counter.ydiBackupMemory_xau16[3].ZFEH_EepromData ECU_ADDRESS 0xFFF82E8B /end MEASUREMENT
/begin MEASUREMENT ZFEH_EepromData.ydiBackupMemory_xau16[3].permanent_counter "counter of permanent error codes stored in error memory slot" UBYTE EH_STANDARD_S5_S3 1 100 0 255 DISPLAY_IDENTIFIER permanent_counter.ydiBackupMemory_xau16[3].ZFEH_EepromData ECU_ADDRESS 0xFFF82E8C /end MEASUREMENT
/begin MEASUREMENT ZFEH_EepromData.ydiBackupMemory_xau16[3].sequence_counter "sequence counter of error code stored in error memory slot" UBYTE EH_STANDARD_S5_S3 1 100 0 255 DISPLAY_IDENTIFIER sequence_counter.ydiBackupMemory_xau16[3].ZFEH_EepromData ECU_ADDRESS 0xFFF82E8D /end MEASUREMENT
/begin MEASUREMENT ZFEH_EepromData.ydiBackupMemory_xau16[3].master_time "master time of error code stored in error memory slot" ULONG EH_STANDARD_S5_S3 1 100 0 4294967295 DISPLAY_IDENTIFIER master_time.ydiBackupMemory_xau16[3].ZFEH_EepromData ECU_ADDRESS 0xFFF82E90 /end MEASUREMENT
/begin MEASUREMENT ZFEH_EepromData.ydiBackupMemory_xau16[3].condition_byte "condition byte of error code stored in error memory slot" UBYTE EH_STANDARD_S5_S3 1 100 0 255 DISPLAY_IDENTIFIER condition_byte.ydiBackupMemory_xau16[3].ZFEH_EepromData ECU_ADDRESS 0xFFF82E95 /end MEASUREMENT
/begin MEASUREMENT ZFEH_EepromData.ydiBackupMemory_xau16[3].obd_driving_cycle_counter "obd driving cycle counter of error code stored in error memory slot" UWORD EH_STANDARD_S5_S3 1 100 0 65535 DISPLAY_IDENTIFIER obd_driving_cycle_counter.ydiBackupMemory_xau16[3].ZFEH_EepromData ECU_ADDRESS 0xFFF82E96 /end MEASUREMENT
/begin MEASUREMENT ZFEH_EepromData.ydiBackupMemory_xau16[4].amb_cond.ambient_condition[0][0] "ambient condition shot [0 .. 2-1] with 25 data bytes [0 .. 25-1] for the error code stored in this error memory slot" UBYTE EH_STANDARD_S5_S3 1 100 0 255 DISPLAY_IDENTIFIER ambient_condition[0][0].amb_cond.ydiBackupMemory_xau16[4].ZFEH_EepromData ECU_ADDRESS 0xFFF82EE0 /end MEASUREMENT
/begin MEASUREMENT ZFEH_EepromData.ydiBackupMemory_xau16[4].amb_cond.ambient_condition[0][1] "ambient condition shot [0 .. 2-1] with 25 data bytes [0 .. 25-1] for the error code stored in this error memory slot" UBYTE EH_STANDARD_S5_S3 1 100 0 255 DISPLAY_IDENTIFIER ambient_condition[0][1].amb_cond.ydiBackupMemory_xau16[4].ZFEH_EepromData ECU_ADDRESS 0xFFF82EE1 /end MEASUREMENT
/begin MEASUREMENT ZFEH_EepromData.ydiBackupMemory_xau16[4].amb_cond.ambient_condition[0][2] "ambient condition shot [0 .. 2-1] with 25 data bytes [0 .. 25-1] for the error code stored in this error memory slot" UBYTE EH_STANDARD_S5_S3 1 100 0 255 DISPLAY_IDENTIFIER ambient_condition[0][2].amb_cond.ydiBackupMemory_xau16[4].ZFEH_EepromData ECU_ADDRESS 0xFFF82EE2 /end MEASUREMENT
/begin MEASUREMENT ZFEH_EepromData.ydiBackupMemory_xau16[4].amb_cond.ambient_condition[0][3] "ambient condition shot [0 .. 2-1] with 25 data bytes [0 .. 25-1] for the error code stored in this error memory slot" UBYTE EH_STANDARD_S5_S3 1 100 0 255 DISPLAY_IDENTIFIER ambient_condition[0][3].amb_cond.ydiBackupMemory_xau16[4].ZFEH_EepromData ECU_ADDRESS 0xFFF82EE3 /end MEASUREMENT
/begin MEASUREMENT ZFEH_EepromData.ydiBackupMemory_xau16[4].amb_cond.ambient_condition[0][4] "ambient condition shot [0 .. 2-1] with 25 data bytes [0 .. 25-1] for the error code stored in this error memory slot" UBYTE EH_STANDARD_S5_S3 1 100 0 255 DISPLAY_IDENTIFIER ambient_condition[0][4].amb_cond.ydiBackupMemory_xau16[4].ZFEH_EepromData ECU_ADDRESS 0xFFF82EE4 /end MEASUREMENT
/begin MEASUREMENT ZFEH_EepromData.ydiBackupMemory_xau16[4].amb_cond.ambient_condition[0][5] "ambient condition shot [0 .. 2-1] with 25 data bytes [0 .. 25-1] for the error code stored in this error memory slot" UBYTE EH_STANDARD_S5_S3 1 100 0 255 DISPLAY_IDENTIFIER ambient_condition[0][5].amb_cond.ydiBackupMemory_xau16[4].ZFEH_EepromData ECU_ADDRESS 0xFFF82EE5 /end MEASUREMENT
/begin MEASUREMENT ZFEH_EepromData.ydiBackupMemory_xau16[4].amb_cond.ambient_condition[0][6] "ambient condition shot [0 .. 2-1] with 25 data bytes [0 .. 25-1] for the error code stored in this error memory slot" UBYTE EH_STANDARD_S5_S3 1 100 0 255 DISPLAY_IDENTIFIER ambient_condition[0][6].amb_cond.ydiBackupMemory_xau16[4].ZFEH_EepromData ECU_ADDRESS 0xFFF82EE6 /end MEASUREMENT
/begin MEASUREMENT ZFEH_EepromData.ydiBackupMemory_xau16[4].amb_cond.ambient_condition[0][7] "ambient condition shot [0 .. 2-1] with 25 data bytes [0 .. 25-1] for the error code stored in this error memory slot" UBYTE EH_STANDARD_S5_S3 1 100 0 255 DISPLAY_IDENTIFIER ambient_condition[0][7].amb_cond.ydiBackupMemory_xau16[4].ZFEH_EepromData ECU_ADDRESS 0xFFF82EE7 /end MEASUREMENT
/begin MEASUREMENT ZFEH_EepromData.ydiBackupMemory_xau16[4].amb_cond.ambient_condition[0][8] "ambient condition shot [0 .. 2-1] with 25 data bytes [0 .. 25-1] for the error code stored in this error memory slot" UBYTE EH_STANDARD_S5_S3 1 100 0 255 DISPLAY_IDENTIFIER ambient_condition[0][8].amb_cond.ydiBackupMemory_xau16[4].ZFEH_EepromData ECU_ADDRESS 0xFFF82EE8 /end MEASUREMENT
/begin MEASUREMENT ZFEH_EepromData.ydiBackupMemory_xau16[4].amb_cond.ambient_condition[0][9] "ambient condition shot [0 .. 2-1] with 25 data bytes [0 .. 25-1] for the error code stored in this error memory slot" UBYTE EH_STANDARD_S5_S3 1 100 0 255 DISPLAY_IDENTIFIER ambient_condition[0][9].amb_cond.ydiBackupMemory_xau16[4].ZFEH_EepromData ECU_ADDRESS 0xFFF82EE9 /end MEASUREMENT
/begin MEASUREMENT ZFEH_EepromData.ydiBackupMemory_xau16[4].amb_cond.ambient_condition[0][10] "ambient condition shot [0 .. 2-1] with 25 data bytes [0 .. 25-1] for the error code stored in this error memory slot" UBYTE EH_STANDARD_S5_S3 1 100 0 255 DISPLAY_IDENTIFIER ambient_condition[0][10].amb_cond.ydiBackupMemory_xau16[4].ZFEH_EepromData ECU_ADDRESS 0xFFF82EEA /end MEASUREMENT
/begin MEASUREMENT ZFEH_EepromData.ydiBackupMemory_xau16[4].amb_cond.ambient_condition[0][11] "ambient condition shot [0 .. 2-1] with 25 data bytes [0 .. 25-1] for the error code stored in this error memory slot" UBYTE EH_STANDARD_S5_S3 1 100 0 255 DISPLAY_IDENTIFIER ambient_condition[0][11].amb_cond.ydiBackupMemory_xau16[4].ZFEH_EepromData ECU_ADDRESS 0xFFF82EEB /end MEASUREMENT
/begin MEASUREMENT ZFEH_EepromData.ydiBackupMemory_xau16[4].amb_cond.ambient_condition[0][12] "ambient condition shot [0 .. 2-1] with 25 data bytes [0 .. 25-1] for the error code stored in this error memory slot" UBYTE EH_STANDARD_S5_S3 1 100 0 255 DISPLAY_IDENTIFIER ambient_condition[0][12].amb_cond.ydiBackupMemory_xau16[4].ZFEH_EepromData ECU_ADDRESS 0xFFF82EEC /end MEASUREMENT
/begin MEASUREMENT ZFEH_EepromData.ydiBackupMemory_xau16[4].amb_cond.ambient_condition[0][13] "ambient condition shot [0 .. 2-1] with 25 data bytes [0 .. 25-1] for the error code stored in this error memory slot" UBYTE EH_STANDARD_S5_S3 1 100 0 255 DISPLAY_IDENTIFIER ambient_condition[0][13].amb_cond.ydiBackupMemory_xau16[4].ZFEH_EepromData ECU_ADDRESS 0xFFF82EED /end MEASUREMENT
/begin MEASUREMENT ZFEH_EepromData.ydiBackupMemory_xau16[4].amb_cond.ambient_condition[0][14] "ambient condition shot [0 .. 2-1] with 25 data bytes [0 .. 25-1] for the error code stored in this error memory slot" UBYTE EH_STANDARD_S5_S3 1 100 0 255 DISPLAY_IDENTIFIER ambient_condition[0][14].amb_cond.ydiBackupMemory_xau16[4].ZFEH_EepromData ECU_ADDRESS 0xFFF82EEE /end MEASUREMENT
/begin MEASUREMENT ZFEH_EepromData.ydiBackupMemory_xau16[4].amb_cond.ambient_condition[0][15] "ambient condition shot [0 .. 2-1] with 25 data bytes [0 .. 25-1] for the error code stored in this error memory slot" UBYTE EH_STANDARD_S5_S3 1 100 0 255 DISPLAY_IDENTIFIER ambient_condition[0][15].amb_cond.ydiBackupMemory_xau16[4].ZFEH_EepromData ECU_ADDRESS 0xFFF82EEF /end MEASUREMENT
/begin MEASUREMENT ZFEH_EepromData.ydiBackupMemory_xau16[4].amb_cond.ambient_condition[0][16] "ambient condition shot [0 .. 2-1] with 25 data bytes [0 .. 25-1] for the error code stored in this error memory slot" UBYTE EH_STANDARD_S5_S3 1 100 0 255 DISPLAY_IDENTIFIER ambient_condition[0][16].amb_cond.ydiBackupMemory_xau16[4].ZFEH_EepromData ECU_ADDRESS 0xFFF82EF0 /end MEASUREMENT
/begin MEASUREMENT ZFEH_EepromData.ydiBackupMemory_xau16[4].amb_cond.ambient_condition[0][17] "ambient condition shot [0 .. 2-1] with 25 data bytes [0 .. 25-1] for the error code stored in this error memory slot" UBYTE EH_STANDARD_S5_S3 1 100 0 255 DISPLAY_IDENTIFIER ambient_condition[0][17].amb_cond.ydiBackupMemory_xau16[4].ZFEH_EepromData ECU_ADDRESS 0xFFF82EF1 /end MEASUREMENT
/begin MEASUREMENT ZFEH_EepromData.ydiBackupMemory_xau16[4].amb_cond.ambient_condition[0][18] "ambient condition shot [0 .. 2-1] with 25 data bytes [0 .. 25-1] for the error code stored in this error memory slot" UBYTE EH_STANDARD_S5_S3 1 100 0 255 DISPLAY_IDENTIFIER ambient_condition[0][18].amb_cond.ydiBackupMemory_xau16[4].ZFEH_EepromData ECU_ADDRESS 0xFFF82EF2 /end MEASUREMENT
/begin MEASUREMENT ZFEH_EepromData.ydiBackupMemory_xau16[4].amb_cond.ambient_condition[0][19] "ambient condition shot [0 .. 2-1] with 25 data bytes [0 .. 25-1] for the error code stored in this error memory slot" UBYTE EH_STANDARD_S5_S3 1 100 0 255 DISPLAY_IDENTIFIER ambient_condition[0][19].amb_cond.ydiBackupMemory_xau16[4].ZFEH_EepromData ECU_ADDRESS 0xFFF82EF3 /end MEASUREMENT
/begin MEASUREMENT ZFEH_EepromData.ydiBackupMemory_xau16[4].amb_cond.ambient_condition[0][20] "ambient condition shot [0 .. 2-1] with 25 data bytes [0 .. 25-1] for the error code stored in this error memory slot" UBYTE EH_STANDARD_S5_S3 1 100 0 255 DISPLAY_IDENTIFIER ambient_condition[0][20].amb_cond.ydiBackupMemory_xau16[4].ZFEH_EepromData ECU_ADDRESS 0xFFF82EF4 /end MEASUREMENT
/begin MEASUREMENT ZFEH_EepromData.ydiBackupMemory_xau16[4].amb_cond.ambient_condition[0][21] "ambient condition shot [0 .. 2-1] with 25 data bytes [0 .. 25-1] for the error code stored in this error memory slot" UBYTE EH_STANDARD_S5_S3 1 100 0 255 DISPLAY_IDENTIFIER ambient_condition[0][21].amb_cond.ydiBackupMemory_xau16[4].ZFEH_EepromData ECU_ADDRESS 0xFFF82EF5 /end MEASUREMENT
/begin MEASUREMENT ZFEH_EepromData.ydiBackupMemory_xau16[4].amb_cond.ambient_condition[0][22] "ambient condition shot [0 .. 2-1] with 25 data bytes [0 .. 25-1] for the error code stored in this error memory slot" UBYTE EH_STANDARD_S5_S3 1 100 0 255 DISPLAY_IDENTIFIER ambient_condition[0][22].amb_cond.ydiBackupMemory_xau16[4].ZFEH_EepromData ECU_ADDRESS 0xFFF82EF6 /end MEASUREMENT
/begin MEASUREMENT ZFEH_EepromData.ydiBackupMemory_xau16[4].amb_cond.ambient_condition[0][23] "ambient condition shot [0 .. 2-1] with 25 data bytes [0 .. 25-1] for the error code stored in this error memory slot" UBYTE EH_STANDARD_S5_S3 1 100 0 255 DISPLAY_IDENTIFIER ambient_condition[0][23].amb_cond.ydiBackupMemory_xau16[4].ZFEH_EepromData ECU_ADDRESS 0xFFF82EF7 /end MEASUREMENT
/begin MEASUREMENT ZFEH_EepromData.ydiBackupMemory_xau16[4].amb_cond.ambient_condition[0][24] "ambient condition shot [0 .. 2-1] with 25 data bytes [0 .. 25-1] for the error code stored in this error memory slot" UBYTE EH_STANDARD_S5_S3 1 100 0 255 DISPLAY_IDENTIFIER ambient_condition[0][24].amb_cond.ydiBackupMemory_xau16[4].ZFEH_EepromData ECU_ADDRESS 0xFFF82EF8 /end MEASUREMENT
/begin MEASUREMENT ZFEH_EepromData.ydiBackupMemory_xau16[4].amb_cond.ambient_condition[1][0] "ambient condition shot [0 .. 2-1] with 25 data bytes [0 .. 25-1] for the error code stored in this error memory slot" UBYTE EH_STANDARD_S5_S3 1 100 0 255 DISPLAY_IDENTIFIER ambient_condition[1][0].amb_cond.ydiBackupMemory_xau16[4].ZFEH_EepromData ECU_ADDRESS 0xFFF82EF9 /end MEASUREMENT
/begin MEASUREMENT ZFEH_EepromData.ydiBackupMemory_xau16[4].amb_cond.ambient_condition[1][1] "ambient condition shot [0 .. 2-1] with 25 data bytes [0 .. 25-1] for the error code stored in this error memory slot" UBYTE EH_STANDARD_S5_S3 1 100 0 255 DISPLAY_IDENTIFIER ambient_condition[1][1].amb_cond.ydiBackupMemory_xau16[4].ZFEH_EepromData ECU_ADDRESS 0xFFF82EFA /end MEASUREMENT
/begin MEASUREMENT ZFEH_EepromData.ydiBackupMemory_xau16[4].amb_cond.ambient_condition[1][2] "ambient condition shot [0 .. 2-1] with 25 data bytes [0 .. 25-1] for the error code stored in this error memory slot" UBYTE EH_STANDARD_S5_S3 1 100 0 255 DISPLAY_IDENTIFIER ambient_condition[1][2].amb_cond.ydiBackupMemory_xau16[4].ZFEH_EepromData ECU_ADDRESS 0xFFF82EFB /end MEASUREMENT
/begin MEASUREMENT ZFEH_EepromData.ydiBackupMemory_xau16[4].amb_cond.ambient_condition[1][3] "ambient condition shot [0 .. 2-1] with 25 data bytes [0 .. 25-1] for the error code stored in this error memory slot" UBYTE EH_STANDARD_S5_S3 1 100 0 255 DISPLAY_IDENTIFIER ambient_condition[1][3].amb_cond.ydiBackupMemory_xau16[4].ZFEH_EepromData ECU_ADDRESS 0xFFF82EFC /end MEASUREMENT
/begin MEASUREMENT ZFEH_EepromData.ydiBackupMemory_xau16[4].amb_cond.ambient_condition[1][4] "ambient condition shot [0 .. 2-1] with 25 data bytes [0 .. 25-1] for the error code stored in this error memory slot" UBYTE EH_STANDARD_S5_S3 1 100 0 255 DISPLAY_IDENTIFIER ambient_condition[1][4].amb_cond.ydiBackupMemory_xau16[4].ZFEH_EepromData ECU_ADDRESS 0xFFF82EFD /end MEASUREMENT
/begin MEASUREMENT ZFEH_EepromData.ydiBackupMemory_xau16[4].amb_cond.ambient_condition[1][5] "ambient condition shot [0 .. 2-1] with 25 data bytes [0 .. 25-1] for the error code stored in this error memory slot" UBYTE EH_STANDARD_S5_S3 1 100 0 255 DISPLAY_IDENTIFIER ambient_condition[1][5].amb_cond.ydiBackupMemory_xau16[4].ZFEH_EepromData ECU_ADDRESS 0xFFF82EFE /end MEASUREMENT
/begin MEASUREMENT ZFEH_EepromData.ydiBackupMemory_xau16[4].amb_cond.ambient_condition[1][6] "ambient condition shot [0 .. 2-1] with 25 data bytes [0 .. 25-1] for the error code stored in this error memory slot" UBYTE EH_STANDARD_S5_S3 1 100 0 255 DISPLAY_IDENTIFIER ambient_condition[1][6].amb_cond.ydiBackupMemory_xau16[4].ZFEH_EepromData ECU_ADDRESS 0xFFF82EFF /end MEASUREMENT
/begin MEASUREMENT ZFEH_EepromData.ydiBackupMemory_xau16[4].amb_cond.ambient_condition[1][7] "ambient condition shot [0 .. 2-1] with 25 data bytes [0 .. 25-1] for the error code stored in this error memory slot" UBYTE EH_STANDARD_S5_S3 1 100 0 255 DISPLAY_IDENTIFIER ambient_condition[1][7].amb_cond.ydiBackupMemory_xau16[4].ZFEH_EepromData ECU_ADDRESS 0xFFF82F00 /end MEASUREMENT
/begin MEASUREMENT ZFEH_EepromData.ydiBackupMemory_xau16[4].amb_cond.ambient_condition[1][8] "ambient condition shot [0 .. 2-1] with 25 data bytes [0 .. 25-1] for the error code stored in this error memory slot" UBYTE EH_STANDARD_S5_S3 1 100 0 255 DISPLAY_IDENTIFIER ambient_condition[1][8].amb_cond.ydiBackupMemory_xau16[4].ZFEH_EepromData ECU_ADDRESS 0xFFF82F01 /end MEASUREMENT
/begin MEASUREMENT ZFEH_EepromData.ydiBackupMemory_xau16[4].amb_cond.ambient_condition[1][9] "ambient condition shot [0 .. 2-1] with 25 data bytes [0 .. 25-1] for the error code stored in this error memory slot" UBYTE EH_STANDARD_S5_S3 1 100 0 255 DISPLAY_IDENTIFIER ambient_condition[1][9].amb_cond.ydiBackupMemory_xau16[4].ZFEH_EepromData ECU_ADDRESS 0xFFF82F02 /end MEASUREMENT
/begin MEASUREMENT ZFEH_EepromData.ydiBackupMemory_xau16[4].amb_cond.ambient_condition[1][10] "ambient condition shot [0 .. 2-1] with 25 data bytes [0 .. 25-1] for the error code stored in this error memory slot" UBYTE EH_STANDARD_S5_S3 1 100 0 255 DISPLAY_IDENTIFIER ambient_condition[1][10].amb_cond.ydiBackupMemory_xau16[4].ZFEH_EepromData ECU_ADDRESS 0xFFF82F03 /end MEASUREMENT
/begin MEASUREMENT ZFEH_EepromData.ydiBackupMemory_xau16[4].amb_cond.ambient_condition[1][11] "ambient condition shot [0 .. 2-1] with 25 data bytes [0 .. 25-1] for the error code stored in this error memory slot" UBYTE EH_STANDARD_S5_S3 1 100 0 255 DISPLAY_IDENTIFIER ambient_condition[1][11].amb_cond.ydiBackupMemory_xau16[4].ZFEH_EepromData ECU_ADDRESS 0xFFF82F04 /end MEASUREMENT
/begin MEASUREMENT ZFEH_EepromData.ydiBackupMemory_xau16[4].amb_cond.ambient_condition[1][12] "ambient condition shot [0 .. 2-1] with 25 data bytes [0 .. 25-1] for the error code stored in this error memory slot" UBYTE EH_STANDARD_S5_S3 1 100 0 255 DISPLAY_IDENTIFIER ambient_condition[1][12].amb_cond.ydiBackupMemory_xau16[4].ZFEH_EepromData ECU_ADDRESS 0xFFF82F05 /end MEASUREMENT
/begin MEASUREMENT ZFEH_EepromData.ydiBackupMemory_xau16[4].amb_cond.ambient_condition[1][13] "ambient condition shot [0 .. 2-1] with 25 data bytes [0 .. 25-1] for the error code stored in this error memory slot" UBYTE EH_STANDARD_S5_S3 1 100 0 255 DISPLAY_IDENTIFIER ambient_condition[1][13].amb_cond.ydiBackupMemory_xau16[4].ZFEH_EepromData ECU_ADDRESS 0xFFF82F06 /end MEASUREMENT
/begin MEASUREMENT ZFEH_EepromData.ydiBackupMemory_xau16[4].amb_cond.ambient_condition[1][14] "ambient condition shot [0 .. 2-1] with 25 data bytes [0 .. 25-1] for the error code stored in this error memory slot" UBYTE EH_STANDARD_S5_S3 1 100 0 255 DISPLAY_IDENTIFIER ambient_condition[1][14].amb_cond.ydiBackupMemory_xau16[4].ZFEH_EepromData ECU_ADDRESS 0xFFF82F07 /end MEASUREMENT
/begin MEASUREMENT ZFEH_EepromData.ydiBackupMemory_xau16[4].amb_cond.ambient_condition[1][15] "ambient condition shot [0 .. 2-1] with 25 data bytes [0 .. 25-1] for the error code stored in this error memory slot" UBYTE EH_STANDARD_S5_S3 1 100 0 255 DISPLAY_IDENTIFIER ambient_condition[1][15].amb_cond.ydiBackupMemory_xau16[4].ZFEH_EepromData ECU_ADDRESS 0xFFF82F08 /end MEASUREMENT
/begin MEASUREMENT ZFEH_EepromData.ydiBackupMemory_xau16[4].amb_cond.ambient_condition[1][16] "ambient condition shot [0 .. 2-1] with 25 data bytes [0 .. 25-1] for the error code stored in this error memory slot" UBYTE EH_STANDARD_S5_S3 1 100 0 255 DISPLAY_IDENTIFIER ambient_condition[1][16].amb_cond.ydiBackupMemory_xau16[4].ZFEH_EepromData ECU_ADDRESS 0xFFF82F09 /end MEASUREMENT
/begin MEASUREMENT ZFEH_EepromData.ydiBackupMemory_xau16[4].amb_cond.ambient_condition[1][17] "ambient condition shot [0 .. 2-1] with 25 data bytes [0 .. 25-1] for the error code stored in this error memory slot" UBYTE EH_STANDARD_S5_S3 1 100 0 255 DISPLAY_IDENTIFIER ambient_condition[1][17].amb_cond.ydiBackupMemory_xau16[4].ZFEH_EepromData ECU_ADDRESS 0xFFF82F0A /end MEASUREMENT
/begin MEASUREMENT ZFEH_EepromData.ydiBackupMemory_xau16[4].amb_cond.ambient_condition[1][18] "ambient condition shot [0 .. 2-1] with 25 data bytes [0 .. 25-1] for the error code stored in this error memory slot" UBYTE EH_STANDARD_S5_S3 1 100 0 255 DISPLAY_IDENTIFIER ambient_condition[1][18].amb_cond.ydiBackupMemory_xau16[4].ZFEH_EepromData ECU_ADDRESS 0xFFF82F0B /end MEASUREMENT
/begin MEASUREMENT ZFEH_EepromData.ydiBackupMemory_xau16[4].amb_cond.ambient_condition[1][19] "ambient condition shot [0 .. 2-1] with 25 data bytes [0 .. 25-1] for the error code stored in this error memory slot" UBYTE EH_STANDARD_S5_S3 1 100 0 255 DISPLAY_IDENTIFIER ambient_condition[1][19].amb_cond.ydiBackupMemory_xau16[4].ZFEH_EepromData ECU_ADDRESS 0xFFF82F0C /end MEASUREMENT
/begin MEASUREMENT ZFEH_EepromData.ydiBackupMemory_xau16[4].amb_cond.ambient_condition[1][20] "ambient condition shot [0 .. 2-1] with 25 data bytes [0 .. 25-1] for the error code stored in this error memory slot" UBYTE EH_STANDARD_S5_S3 1 100 0 255 DISPLAY_IDENTIFIER ambient_condition[1][20].amb_cond.ydiBackupMemory_xau16[4].ZFEH_EepromData ECU_ADDRESS 0xFFF82F0D /end MEASUREMENT
/begin MEASUREMENT ZFEH_EepromData.ydiBackupMemory_xau16[4].amb_cond.ambient_condition[1][21] "ambient condition shot [0 .. 2-1] with 25 data bytes [0 .. 25-1] for the error code stored in this error memory slot" UBYTE EH_STANDARD_S5_S3 1 100 0 255 DISPLAY_IDENTIFIER ambient_condition[1][21].amb_cond.ydiBackupMemory_xau16[4].ZFEH_EepromData ECU_ADDRESS 0xFFF82F0E /end MEASUREMENT
/begin MEASUREMENT ZFEH_EepromData.ydiBackupMemory_xau16[4].amb_cond.ambient_condition[1][22] "ambient condition shot [0 .. 2-1] with 25 data bytes [0 .. 25-1] for the error code stored in this error memory slot" UBYTE EH_STANDARD_S5_S3 1 100 0 255 DISPLAY_IDENTIFIER ambient_condition[1][22].amb_cond.ydiBackupMemory_xau16[4].ZFEH_EepromData ECU_ADDRESS 0xFFF82F0F /end MEASUREMENT
/begin MEASUREMENT ZFEH_EepromData.ydiBackupMemory_xau16[4].amb_cond.ambient_condition[1][23] "ambient condition shot [0 .. 2-1] with 25 data bytes [0 .. 25-1] for the error code stored in this error memory slot" UBYTE EH_STANDARD_S5_S3 1 100 0 255 DISPLAY_IDENTIFIER ambient_condition[1][23].amb_cond.ydiBackupMemory_xau16[4].ZFEH_EepromData ECU_ADDRESS 0xFFF82F10 /end MEASUREMENT
/begin MEASUREMENT ZFEH_EepromData.ydiBackupMemory_xau16[4].amb_cond.ambient_condition[1][24] "ambient condition shot [0 .. 2-1] with 25 data bytes [0 .. 25-1] for the error code stored in this error memory slot" UBYTE EH_STANDARD_S5_S3 1 100 0 255 DISPLAY_IDENTIFIER ambient_condition[1][24].amb_cond.ydiBackupMemory_xau16[4].ZFEH_EepromData ECU_ADDRESS 0xFFF82F11 /end MEASUREMENT
/begin MEASUREMENT ZFEH_EepromData.ydiBackupMemory_xau16[4].amb_cond.status_of_ambient_conditions[0] "status of ambient condition shot x: 0=invalid 1=valid" UBYTE EH_STANDARD_S5_S3 1 100 0 1 DISPLAY_IDENTIFIER status_of_ambient_conditions[0].amb_cond.ydiBackupMemory_xau16[4].ZFEH_EepromData ECU_ADDRESS 0xFFF82F12 /end MEASUREMENT
/begin MEASUREMENT ZFEH_EepromData.ydiBackupMemory_xau16[4].amb_cond.status_of_ambient_conditions[1] "status of ambient condition shot x: 0=invalid 1=valid" UBYTE EH_STANDARD_S5_S3 1 100 0 1 DISPLAY_IDENTIFIER status_of_ambient_conditions[1].amb_cond.ydiBackupMemory_xau16[4].ZFEH_EepromData ECU_ADDRESS 0xFFF82F13 /end MEASUREMENT
/begin MEASUREMENT ZFEH_EepromData.ydiBackupMemory_xau16[4].error_code "error code stored in error memory slot" UWORD EH_STANDARD_S5_S3 1 100 0 65535 DISPLAY_IDENTIFIER error_code.ydiBackupMemory_xau16[4].ZFEH_EepromData ECU_ADDRESS 0xFFF82ECC /end MEASUREMENT
/begin MEASUREMENT ZFEH_EepromData.ydiBackupMemory_xau16[4].error_type "error type of error code stored in error memory slot" UWORD EH_STANDARD_S5_S3 1 100 0 65535 DISPLAY_IDENTIFIER error_type.ydiBackupMemory_xau16[4].ZFEH_EepromData ECU_ADDRESS 0xFFF82ECE /end MEASUREMENT
/begin MEASUREMENT ZFEH_EepromData.ydiBackupMemory_xau16[4].status_word "status word of error code stored in error memory slot" UWORD EH_STANDARD_S5_S3 1 100 0 65535 DISPLAY_IDENTIFIER status_word.ydiBackupMemory_xau16[4].ZFEH_EepromData ECU_ADDRESS 0xFFF82ED0 /end MEASUREMENT
/begin MEASUREMENT ZFEH_EepromData.ydiBackupMemory_xau16[4].frequency_counter "frequency counter of error code stored in error memory slot" UBYTE EH_STANDARD_S5_S3 1 100 0 255 DISPLAY_IDENTIFIER frequency_counter.ydiBackupMemory_xau16[4].ZFEH_EepromData ECU_ADDRESS 0xFFF82ED2 /end MEASUREMENT
/begin MEASUREMENT ZFEH_EepromData.ydiBackupMemory_xau16[4].backwards_counter "backwards counter of error code stored in error memory slot" UBYTE EH_STANDARD_S5_S3 1 100 0 255 DISPLAY_IDENTIFIER backwards_counter.ydiBackupMemory_xau16[4].ZFEH_EepromData ECU_ADDRESS 0xFFF82ED3 /end MEASUREMENT
/begin MEASUREMENT ZFEH_EepromData.ydiBackupMemory_xau16[4].permanent_counter "counter of permanent error codes stored in error memory slot" UBYTE EH_STANDARD_S5_S3 1 100 0 255 DISPLAY_IDENTIFIER permanent_counter.ydiBackupMemory_xau16[4].ZFEH_EepromData ECU_ADDRESS 0xFFF82ED4 /end MEASUREMENT
/begin MEASUREMENT ZFEH_EepromData.ydiBackupMemory_xau16[4].sequence_counter "sequence counter of error code stored in error memory slot" UBYTE EH_STANDARD_S5_S3 1 100 0 255 DISPLAY_IDENTIFIER sequence_counter.ydiBackupMemory_xau16[4].ZFEH_EepromData ECU_ADDRESS 0xFFF82ED5 /end MEASUREMENT
/begin MEASUREMENT ZFEH_EepromData.ydiBackupMemory_xau16[4].master_time "master time of error code stored in error memory slot" ULONG EH_STANDARD_S5_S3 1 100 0 4294967295 DISPLAY_IDENTIFIER master_time.ydiBackupMemory_xau16[4].ZFEH_EepromData ECU_ADDRESS 0xFFF82ED8 /end MEASUREMENT
/begin MEASUREMENT ZFEH_EepromData.ydiBackupMemory_xau16[4].condition_byte "condition byte of error code stored in error memory slot" UBYTE EH_STANDARD_S5_S3 1 100 0 255 DISPLAY_IDENTIFIER condition_byte.ydiBackupMemory_xau16[4].ZFEH_EepromData ECU_ADDRESS 0xFFF82EDD /end MEASUREMENT
/begin MEASUREMENT ZFEH_EepromData.ydiBackupMemory_xau16[4].obd_driving_cycle_counter "obd driving cycle counter of error code stored in error memory slot" UWORD EH_STANDARD_S5_S3 1 100 0 65535 DISPLAY_IDENTIFIER obd_driving_cycle_counter.ydiBackupMemory_xau16[4].ZFEH_EepromData ECU_ADDRESS 0xFFF82EDE /end MEASUREMENT
/begin MEASUREMENT ZFEH_EepromData.ydiBackupMemory_xau16[5].amb_cond.ambient_condition[0][0] "ambient condition shot [0 .. 2-1] with 25 data bytes [0 .. 25-1] for the error code stored in this error memory slot" UBYTE EH_STANDARD_S5_S3 1 100 0 255 DISPLAY_IDENTIFIER ambient_condition[0][0].amb_cond.ydiBackupMemory_xau16[5].ZFEH_EepromData ECU_ADDRESS 0xFFF82F28 /end MEASUREMENT
/begin MEASUREMENT ZFEH_EepromData.ydiBackupMemory_xau16[5].amb_cond.ambient_condition[0][1] "ambient condition shot [0 .. 2-1] with 25 data bytes [0 .. 25-1] for the error code stored in this error memory slot" UBYTE EH_STANDARD_S5_S3 1 100 0 255 DISPLAY_IDENTIFIER ambient_condition[0][1].amb_cond.ydiBackupMemory_xau16[5].ZFEH_EepromData ECU_ADDRESS 0xFFF82F29 /end MEASUREMENT
/begin MEASUREMENT ZFEH_EepromData.ydiBackupMemory_xau16[5].amb_cond.ambient_condition[0][2] "ambient condition shot [0 .. 2-1] with 25 data bytes [0 .. 25-1] for the error code stored in this error memory slot" UBYTE EH_STANDARD_S5_S3 1 100 0 255 DISPLAY_IDENTIFIER ambient_condition[0][2].amb_cond.ydiBackupMemory_xau16[5].ZFEH_EepromData ECU_ADDRESS 0xFFF82F2A /end MEASUREMENT
/begin MEASUREMENT ZFEH_EepromData.ydiBackupMemory_xau16[5].amb_cond.ambient_condition[0][3] "ambient condition shot [0 .. 2-1] with 25 data bytes [0 .. 25-1] for the error code stored in this error memory slot" UBYTE EH_STANDARD_S5_S3 1 100 0 255 DISPLAY_IDENTIFIER ambient_condition[0][3].amb_cond.ydiBackupMemory_xau16[5].ZFEH_EepromData ECU_ADDRESS 0xFFF82F2B /end MEASUREMENT
/begin MEASUREMENT ZFEH_EepromData.ydiBackupMemory_xau16[5].amb_cond.ambient_condition[0][4] "ambient condition shot [0 .. 2-1] with 25 data bytes [0 .. 25-1] for the error code stored in this error memory slot" UBYTE EH_STANDARD_S5_S3 1 100 0 255 DISPLAY_IDENTIFIER ambient_condition[0][4].amb_cond.ydiBackupMemory_xau16[5].ZFEH_EepromData ECU_ADDRESS 0xFFF82F2C /end MEASUREMENT
/begin MEASUREMENT ZFEH_EepromData.ydiBackupMemory_xau16[5].amb_cond.ambient_condition[0][5] "ambient condition shot [0 .. 2-1] with 25 data bytes [0 .. 25-1] for the error code stored in this error memory slot" UBYTE EH_STANDARD_S5_S3 1 100 0 255 DISPLAY_IDENTIFIER ambient_condition[0][5].amb_cond.ydiBackupMemory_xau16[5].ZFEH_EepromData ECU_ADDRESS 0xFFF82F2D /end MEASUREMENT
/begin MEASUREMENT ZFEH_EepromData.ydiBackupMemory_xau16[5].amb_cond.ambient_condition[0][6] "ambient condition shot [0 .. 2-1] with 25 data bytes [0 .. 25-1] for the error code stored in this error memory slot" UBYTE EH_STANDARD_S5_S3 1 100 0 255 DISPLAY_IDENTIFIER ambient_condition[0][6].amb_cond.ydiBackupMemory_xau16[5].ZFEH_EepromData ECU_ADDRESS 0xFFF82F2E /end MEASUREMENT
/begin MEASUREMENT ZFEH_EepromData.ydiBackupMemory_xau16[5].amb_cond.ambient_condition[0][7] "ambient condition shot [0 .. 2-1] with 25 data bytes [0 .. 25-1] for the error code stored in this error memory slot" UBYTE EH_STANDARD_S5_S3 1 100 0 255 DISPLAY_IDENTIFIER ambient_condition[0][7].amb_cond.ydiBackupMemory_xau16[5].ZFEH_EepromData ECU_ADDRESS 0xFFF82F2F /end MEASUREMENT
/begin MEASUREMENT ZFEH_EepromData.ydiBackupMemory_xau16[5].amb_cond.ambient_condition[0][8] "ambient condition shot [0 .. 2-1] with 25 data bytes [0 .. 25-1] for the error code stored in this error memory slot" UBYTE EH_STANDARD_S5_S3 1 100 0 255 DISPLAY_IDENTIFIER ambient_condition[0][8].amb_cond.ydiBackupMemory_xau16[5].ZFEH_EepromData ECU_ADDRESS 0xFFF82F30 /end MEASUREMENT
/begin MEASUREMENT ZFEH_EepromData.ydiBackupMemory_xau16[5].amb_cond.ambient_condition[0][9] "ambient condition shot [0 .. 2-1] with 25 data bytes [0 .. 25-1] for the error code stored in this error memory slot" UBYTE EH_STANDARD_S5_S3 1 100 0 255 DISPLAY_IDENTIFIER ambient_condition[0][9].amb_cond.ydiBackupMemory_xau16[5].ZFEH_EepromData ECU_ADDRESS 0xFFF82F31 /end MEASUREMENT
/begin MEASUREMENT ZFEH_EepromData.ydiBackupMemory_xau16[5].amb_cond.ambient_condition[0][10] "ambient condition shot [0 .. 2-1] with 25 data bytes [0 .. 25-1] for the error code stored in this error memory slot" UBYTE EH_STANDARD_S5_S3 1 100 0 255 DISPLAY_IDENTIFIER ambient_condition[0][10].amb_cond.ydiBackupMemory_xau16[5].ZFEH_EepromData ECU_ADDRESS 0xFFF82F32 /end MEASUREMENT
/begin MEASUREMENT ZFEH_EepromData.ydiBackupMemory_xau16[5].amb_cond.ambient_condition[0][11] "ambient condition shot [0 .. 2-1] with 25 data bytes [0 .. 25-1] for the error code stored in this error memory slot" UBYTE EH_STANDARD_S5_S3 1 100 0 255 DISPLAY_IDENTIFIER ambient_condition[0][11].amb_cond.ydiBackupMemory_xau16[5].ZFEH_EepromData ECU_ADDRESS 0xFFF82F33 /end MEASUREMENT
/begin MEASUREMENT ZFEH_EepromData.ydiBackupMemory_xau16[5].amb_cond.ambient_condition[0][12] "ambient condition shot [0 .. 2-1] with 25 data bytes [0 .. 25-1] for the error code stored in this error memory slot" UBYTE EH_STANDARD_S5_S3 1 100 0 255 DISPLAY_IDENTIFIER ambient_condition[0][12].amb_cond.ydiBackupMemory_xau16[5].ZFEH_EepromData ECU_ADDRESS 0xFFF82F34 /end MEASUREMENT
/begin MEASUREMENT ZFEH_EepromData.ydiBackupMemory_xau16[5].amb_cond.ambient_condition[0][13] "ambient condition shot [0 .. 2-1] with 25 data bytes [0 .. 25-1] for the error code stored in this error memory slot" UBYTE EH_STANDARD_S5_S3 1 100 0 255 DISPLAY_IDENTIFIER ambient_condition[0][13].amb_cond.ydiBackupMemory_xau16[5].ZFEH_EepromData ECU_ADDRESS 0xFFF82F35 /end MEASUREMENT
/begin MEASUREMENT ZFEH_EepromData.ydiBackupMemory_xau16[5].amb_cond.ambient_condition[0][14] "ambient condition shot [0 .. 2-1] with 25 data bytes [0 .. 25-1] for the error code stored in this error memory slot" UBYTE EH_STANDARD_S5_S3 1 100 0 255 DISPLAY_IDENTIFIER ambient_condition[0][14].amb_cond.ydiBackupMemory_xau16[5].ZFEH_EepromData ECU_ADDRESS 0xFFF82F36 /end MEASUREMENT
/begin MEASUREMENT ZFEH_EepromData.ydiBackupMemory_xau16[5].amb_cond.ambient_condition[0][15] "ambient condition shot [0 .. 2-1] with 25 data bytes [0 .. 25-1] for the error code stored in this error memory slot" UBYTE EH_STANDARD_S5_S3 1 100 0 255 DISPLAY_IDENTIFIER ambient_condition[0][15].amb_cond.ydiBackupMemory_xau16[5].ZFEH_EepromData ECU_ADDRESS 0xFFF82F37 /end MEASUREMENT
/begin MEASUREMENT ZFEH_EepromData.ydiBackupMemory_xau16[5].amb_cond.ambient_condition[0][16] "ambient condition shot [0 .. 2-1] with 25 data bytes [0 .. 25-1] for the error code stored in this error memory slot" UBYTE EH_STANDARD_S5_S3 1 100 0 255 DISPLAY_IDENTIFIER ambient_condition[0][16].amb_cond.ydiBackupMemory_xau16[5].ZFEH_EepromData ECU_ADDRESS 0xFFF82F38 /end MEASUREMENT
/begin MEASUREMENT ZFEH_EepromData.ydiBackupMemory_xau16[5].amb_cond.ambient_condition[0][17] "ambient condition shot [0 .. 2-1] with 25 data bytes [0 .. 25-1] for the error code stored in this error memory slot" UBYTE EH_STANDARD_S5_S3 1 100 0 255 DISPLAY_IDENTIFIER ambient_condition[0][17].amb_cond.ydiBackupMemory_xau16[5].ZFEH_EepromData ECU_ADDRESS 0xFFF82F39 /end MEASUREMENT
/begin MEASUREMENT ZFEH_EepromData.ydiBackupMemory_xau16[5].amb_cond.ambient_condition[0][18] "ambient condition shot [0 .. 2-1] with 25 data bytes [0 .. 25-1] for the error code stored in this error memory slot" UBYTE EH_STANDARD_S5_S3 1 100 0 255 DISPLAY_IDENTIFIER ambient_condition[0][18].amb_cond.ydiBackupMemory_xau16[5].ZFEH_EepromData ECU_ADDRESS 0xFFF82F3A /end MEASUREMENT
/begin MEASUREMENT ZFEH_EepromData.ydiBackupMemory_xau16[5].amb_cond.ambient_condition[0][19] "ambient condition shot [0 .. 2-1] with 25 data bytes [0 .. 25-1] for the error code stored in this error memory slot" UBYTE EH_STANDARD_S5_S3 1 100 0 255 DISPLAY_IDENTIFIER ambient_condition[0][19].amb_cond.ydiBackupMemory_xau16[5].ZFEH_EepromData ECU_ADDRESS 0xFFF82F3B /end MEASUREMENT
/begin MEASUREMENT ZFEH_EepromData.ydiBackupMemory_xau16[5].amb_cond.ambient_condition[0][20] "ambient condition shot [0 .. 2-1] with 25 data bytes [0 .. 25-1] for the error code stored in this error memory slot" UBYTE EH_STANDARD_S5_S3 1 100 0 255 DISPLAY_IDENTIFIER ambient_condition[0][20].amb_cond.ydiBackupMemory_xau16[5].ZFEH_EepromData ECU_ADDRESS 0xFFF82F3C /end MEASUREMENT
/begin MEASUREMENT ZFEH_EepromData.ydiBackupMemory_xau16[5].amb_cond.ambient_condition[0][21] "ambient condition shot [0 .. 2-1] with 25 data bytes [0 .. 25-1] for the error code stored in this error memory slot" UBYTE EH_STANDARD_S5_S3 1 100 0 255 DISPLAY_IDENTIFIER ambient_condition[0][21].amb_cond.ydiBackupMemory_xau16[5].ZFEH_EepromData ECU_ADDRESS 0xFFF82F3D /end MEASUREMENT
/begin MEASUREMENT ZFEH_EepromData.ydiBackupMemory_xau16[5].amb_cond.ambient_condition[0][22] "ambient condition shot [0 .. 2-1] with 25 data bytes [0 .. 25-1] for the error code stored in this error memory slot" UBYTE EH_STANDARD_S5_S3 1 100 0 255 DISPLAY_IDENTIFIER ambient_condition[0][22].amb_cond.ydiBackupMemory_xau16[5].ZFEH_EepromData ECU_ADDRESS 0xFFF82F3E /end MEASUREMENT
/begin MEASUREMENT ZFEH_EepromData.ydiBackupMemory_xau16[5].amb_cond.ambient_condition[0][23] "ambient condition shot [0 .. 2-1] with 25 data bytes [0 .. 25-1] for the error code stored in this error memory slot" UBYTE EH_STANDARD_S5_S3 1 100 0 255 DISPLAY_IDENTIFIER ambient_condition[0][23].amb_cond.ydiBackupMemory_xau16[5].ZFEH_EepromData ECU_ADDRESS 0xFFF82F3F /end MEASUREMENT
/begin MEASUREMENT ZFEH_EepromData.ydiBackupMemory_xau16[5].amb_cond.ambient_condition[0][24] "ambient condition shot [0 .. 2-1] with 25 data bytes [0 .. 25-1] for the error code stored in this error memory slot" UBYTE EH_STANDARD_S5_S3 1 100 0 255 DISPLAY_IDENTIFIER ambient_condition[0][24].amb_cond.ydiBackupMemory_xau16[5].ZFEH_EepromData ECU_ADDRESS 0xFFF82F40 /end MEASUREMENT
/begin MEASUREMENT ZFEH_EepromData.ydiBackupMemory_xau16[5].amb_cond.ambient_condition[1][0] "ambient condition shot [0 .. 2-1] with 25 data bytes [0 .. 25-1] for the error code stored in this error memory slot" UBYTE EH_STANDARD_S5_S3 1 100 0 255 DISPLAY_IDENTIFIER ambient_condition[1][0].amb_cond.ydiBackupMemory_xau16[5].ZFEH_EepromData ECU_ADDRESS 0xFFF82F41 /end MEASUREMENT
/begin MEASUREMENT ZFEH_EepromData.ydiBackupMemory_xau16[5].amb_cond.ambient_condition[1][1] "ambient condition shot [0 .. 2-1] with 25 data bytes [0 .. 25-1] for the error code stored in this error memory slot" UBYTE EH_STANDARD_S5_S3 1 100 0 255 DISPLAY_IDENTIFIER ambient_condition[1][1].amb_cond.ydiBackupMemory_xau16[5].ZFEH_EepromData ECU_ADDRESS 0xFFF82F42 /end MEASUREMENT
/begin MEASUREMENT ZFEH_EepromData.ydiBackupMemory_xau16[5].amb_cond.ambient_condition[1][2] "ambient condition shot [0 .. 2-1] with 25 data bytes [0 .. 25-1] for the error code stored in this error memory slot" UBYTE EH_STANDARD_S5_S3 1 100 0 255 DISPLAY_IDENTIFIER ambient_condition[1][2].amb_cond.ydiBackupMemory_xau16[5].ZFEH_EepromData ECU_ADDRESS 0xFFF82F43 /end MEASUREMENT
/begin MEASUREMENT ZFEH_EepromData.ydiBackupMemory_xau16[5].amb_cond.ambient_condition[1][3] "ambient condition shot [0 .. 2-1] with 25 data bytes [0 .. 25-1] for the error code stored in this error memory slot" UBYTE EH_STANDARD_S5_S3 1 100 0 255 DISPLAY_IDENTIFIER ambient_condition[1][3].amb_cond.ydiBackupMemory_xau16[5].ZFEH_EepromData ECU_ADDRESS 0xFFF82F44 /end MEASUREMENT
/begin MEASUREMENT ZFEH_EepromData.ydiBackupMemory_xau16[5].amb_cond.ambient_condition[1][4] "ambient condition shot [0 .. 2-1] with 25 data bytes [0 .. 25-1] for the error code stored in this error memory slot" UBYTE EH_STANDARD_S5_S3 1 100 0 255 DISPLAY_IDENTIFIER ambient_condition[1][4].amb_cond.ydiBackupMemory_xau16[5].ZFEH_EepromData ECU_ADDRESS 0xFFF82F45 /end MEASUREMENT
/begin MEASUREMENT ZFEH_EepromData.ydiBackupMemory_xau16[5].amb_cond.ambient_condition[1][5] "ambient condition shot [0 .. 2-1] with 25 data bytes [0 .. 25-1] for the error code stored in this error memory slot" UBYTE EH_STANDARD_S5_S3 1 100 0 255 DISPLAY_IDENTIFIER ambient_condition[1][5].amb_cond.ydiBackupMemory_xau16[5].ZFEH_EepromData ECU_ADDRESS 0xFFF82F46 /end MEASUREMENT
/begin MEASUREMENT ZFEH_EepromData.ydiBackupMemory_xau16[5].amb_cond.ambient_condition[1][6] "ambient condition shot [0 .. 2-1] with 25 data bytes [0 .. 25-1] for the error code stored in this error memory slot" UBYTE EH_STANDARD_S5_S3 1 100 0 255 DISPLAY_IDENTIFIER ambient_condition[1][6].amb_cond.ydiBackupMemory_xau16[5].ZFEH_EepromData ECU_ADDRESS 0xFFF82F47 /end MEASUREMENT
/begin MEASUREMENT ZFEH_EepromData.ydiBackupMemory_xau16[5].amb_cond.ambient_condition[1][7] "ambient condition shot [0 .. 2-1] with 25 data bytes [0 .. 25-1] for the error code stored in this error memory slot" UBYTE EH_STANDARD_S5_S3 1 100 0 255 DISPLAY_IDENTIFIER ambient_condition[1][7].amb_cond.ydiBackupMemory_xau16[5].ZFEH_EepromData ECU_ADDRESS 0xFFF82F48 /end MEASUREMENT
/begin MEASUREMENT ZFEH_EepromData.ydiBackupMemory_xau16[5].amb_cond.ambient_condition[1][8] "ambient condition shot [0 .. 2-1] with 25 data bytes [0 .. 25-1] for the error code stored in this error memory slot" UBYTE EH_STANDARD_S5_S3 1 100 0 255 DISPLAY_IDENTIFIER ambient_condition[1][8].amb_cond.ydiBackupMemory_xau16[5].ZFEH_EepromData ECU_ADDRESS 0xFFF82F49 /end MEASUREMENT
/begin MEASUREMENT ZFEH_EepromData.ydiBackupMemory_xau16[5].amb_cond.ambient_condition[1][9] "ambient condition shot [0 .. 2-1] with 25 data bytes [0 .. 25-1] for the error code stored in this error memory slot" UBYTE EH_STANDARD_S5_S3 1 100 0 255 DISPLAY_IDENTIFIER ambient_condition[1][9].amb_cond.ydiBackupMemory_xau16[5].ZFEH_EepromData ECU_ADDRESS 0xFFF82F4A /end MEASUREMENT
/begin MEASUREMENT ZFEH_EepromData.ydiBackupMemory_xau16[5].amb_cond.ambient_condition[1][10] "ambient condition shot [0 .. 2-1] with 25 data bytes [0 .. 25-1] for the error code stored in this error memory slot" UBYTE EH_STANDARD_S5_S3 1 100 0 255 DISPLAY_IDENTIFIER ambient_condition[1][10].amb_cond.ydiBackupMemory_xau16[5].ZFEH_EepromData ECU_ADDRESS 0xFFF82F4B /end MEASUREMENT
/begin MEASUREMENT ZFEH_EepromData.ydiBackupMemory_xau16[5].amb_cond.ambient_condition[1][11] "ambient condition shot [0 .. 2-1] with 25 data bytes [0 .. 25-1] for the error code stored in this error memory slot" UBYTE EH_STANDARD_S5_S3 1 100 0 255 DISPLAY_IDENTIFIER ambient_condition[1][11].amb_cond.ydiBackupMemory_xau16[5].ZFEH_EepromData ECU_ADDRESS 0xFFF82F4C /end MEASUREMENT
/begin MEASUREMENT ZFEH_EepromData.ydiBackupMemory_xau16[5].amb_cond.ambient_condition[1][12] "ambient condition shot [0 .. 2-1] with 25 data bytes [0 .. 25-1] for the error code stored in this error memory slot" UBYTE EH_STANDARD_S5_S3 1 100 0 255 DISPLAY_IDENTIFIER ambient_condition[1][12].amb_cond.ydiBackupMemory_xau16[5].ZFEH_EepromData ECU_ADDRESS 0xFFF82F4D /end MEASUREMENT
/begin MEASUREMENT ZFEH_EepromData.ydiBackupMemory_xau16[5].amb_cond.ambient_condition[1][13] "ambient condition shot [0 .. 2-1] with 25 data bytes [0 .. 25-1] for the error code stored in this error memory slot" UBYTE EH_STANDARD_S5_S3 1 100 0 255 DISPLAY_IDENTIFIER ambient_condition[1][13].amb_cond.ydiBackupMemory_xau16[5].ZFEH_EepromData ECU_ADDRESS 0xFFF82F4E /end MEASUREMENT
/begin MEASUREMENT ZFEH_EepromData.ydiBackupMemory_xau16[5].amb_cond.ambient_condition[1][14] "ambient condition shot [0 .. 2-1] with 25 data bytes [0 .. 25-1] for the error code stored in this error memory slot" UBYTE EH_STANDARD_S5_S3 1 100 0 255 DISPLAY_IDENTIFIER ambient_condition[1][14].amb_cond.ydiBackupMemory_xau16[5].ZFEH_EepromData ECU_ADDRESS 0xFFF82F4F /end MEASUREMENT
/begin MEASUREMENT ZFEH_EepromData.ydiBackupMemory_xau16[5].amb_cond.ambient_condition[1][15] "ambient condition shot [0 .. 2-1] with 25 data bytes [0 .. 25-1] for the error code stored in this error memory slot" UBYTE EH_STANDARD_S5_S3 1 100 0 255 DISPLAY_IDENTIFIER ambient_condition[1][15].amb_cond.ydiBackupMemory_xau16[5].ZFEH_EepromData ECU_ADDRESS 0xFFF82F50 /end MEASUREMENT
/begin MEASUREMENT ZFEH_EepromData.ydiBackupMemory_xau16[5].amb_cond.ambient_condition[1][16] "ambient condition shot [0 .. 2-1] with 25 data bytes [0 .. 25-1] for the error code stored in this error memory slot" UBYTE EH_STANDARD_S5_S3 1 100 0 255 DISPLAY_IDENTIFIER ambient_condition[1][16].amb_cond.ydiBackupMemory_xau16[5].ZFEH_EepromData ECU_ADDRESS 0xFFF82F51 /end MEASUREMENT
/begin MEASUREMENT ZFEH_EepromData.ydiBackupMemory_xau16[5].amb_cond.ambient_condition[1][17] "ambient condition shot [0 .. 2-1] with 25 data bytes [0 .. 25-1] for the error code stored in this error memory slot" UBYTE EH_STANDARD_S5_S3 1 100 0 255 DISPLAY_IDENTIFIER ambient_condition[1][17].amb_cond.ydiBackupMemory_xau16[5].ZFEH_EepromData ECU_ADDRESS 0xFFF82F52 /end MEASUREMENT
/begin MEASUREMENT ZFEH_EepromData.ydiBackupMemory_xau16[5].amb_cond.ambient_condition[1][18] "ambient condition shot [0 .. 2-1] with 25 data bytes [0 .. 25-1] for the error code stored in this error memory slot" UBYTE EH_STANDARD_S5_S3 1 100 0 255 DISPLAY_IDENTIFIER ambient_condition[1][18].amb_cond.ydiBackupMemory_xau16[5].ZFEH_EepromData ECU_ADDRESS 0xFFF82F53 /end MEASUREMENT
/begin MEASUREMENT ZFEH_EepromData.ydiBackupMemory_xau16[5].amb_cond.ambient_condition[1][19] "ambient condition shot [0 .. 2-1] with 25 data bytes [0 .. 25-1] for the error code stored in this error memory slot" UBYTE EH_STANDARD_S5_S3 1 100 0 255 DISPLAY_IDENTIFIER ambient_condition[1][19].amb_cond.ydiBackupMemory_xau16[5].ZFEH_EepromData ECU_ADDRESS 0xFFF82F54 /end MEASUREMENT
/begin MEASUREMENT ZFEH_EepromData.ydiBackupMemory_xau16[5].amb_cond.ambient_condition[1][20] "ambient condition shot [0 .. 2-1] with 25 data bytes [0 .. 25-1] for the error code stored in this error memory slot" UBYTE EH_STANDARD_S5_S3 1 100 0 255 DISPLAY_IDENTIFIER ambient_condition[1][20].amb_cond.ydiBackupMemory_xau16[5].ZFEH_EepromData ECU_ADDRESS 0xFFF82F55 /end MEASUREMENT
/begin MEASUREMENT ZFEH_EepromData.ydiBackupMemory_xau16[5].amb_cond.ambient_condition[1][21] "ambient condition shot [0 .. 2-1] with 25 data bytes [0 .. 25-1] for the error code stored in this error memory slot" UBYTE EH_STANDARD_S5_S3 1 100 0 255 DISPLAY_IDENTIFIER ambient_condition[1][21].amb_cond.ydiBackupMemory_xau16[5].ZFEH_EepromData ECU_ADDRESS 0xFFF82F56 /end MEASUREMENT
/begin MEASUREMENT ZFEH_EepromData.ydiBackupMemory_xau16[5].amb_cond.ambient_condition[1][22] "ambient condition shot [0 .. 2-1] with 25 data bytes [0 .. 25-1] for the error code stored in this error memory slot" UBYTE EH_STANDARD_S5_S3 1 100 0 255 DISPLAY_IDENTIFIER ambient_condition[1][22].amb_cond.ydiBackupMemory_xau16[5].ZFEH_EepromData ECU_ADDRESS 0xFFF82F57 /end MEASUREMENT
/begin MEASUREMENT ZFEH_EepromData.ydiBackupMemory_xau16[5].amb_cond.ambient_condition[1][23] "ambient condition shot [0 .. 2-1] with 25 data bytes [0 .. 25-1] for the error code stored in this error memory slot" UBYTE EH_STANDARD_S5_S3 1 100 0 255 DISPLAY_IDENTIFIER ambient_condition[1][23].amb_cond.ydiBackupMemory_xau16[5].ZFEH_EepromData ECU_ADDRESS 0xFFF82F58 /end MEASUREMENT
/begin MEASUREMENT ZFEH_EepromData.ydiBackupMemory_xau16[5].amb_cond.ambient_condition[1][24] "ambient condition shot [0 .. 2-1] with 25 data bytes [0 .. 25-1] for the error code stored in this error memory slot" UBYTE EH_STANDARD_S5_S3 1 100 0 255 DISPLAY_IDENTIFIER ambient_condition[1][24].amb_cond.ydiBackupMemory_xau16[5].ZFEH_EepromData ECU_ADDRESS 0xFFF82F59 /end MEASUREMENT
/begin MEASUREMENT ZFEH_EepromData.ydiBackupMemory_xau16[5].amb_cond.status_of_ambient_conditions[0] "status of ambient condition shot x: 0=invalid 1=valid" UBYTE EH_STANDARD_S5_S3 1 100 0 1 DISPLAY_IDENTIFIER status_of_ambient_conditions[0].amb_cond.ydiBackupMemory_xau16[5].ZFEH_EepromData ECU_ADDRESS 0xFFF82F5A /end MEASUREMENT
/begin MEASUREMENT ZFEH_EepromData.ydiBackupMemory_xau16[5].amb_cond.status_of_ambient_conditions[1] "status of ambient condition shot x: 0=invalid 1=valid" UBYTE EH_STANDARD_S5_S3 1 100 0 1 DISPLAY_IDENTIFIER status_of_ambient_conditions[1].amb_cond.ydiBackupMemory_xau16[5].ZFEH_EepromData ECU_ADDRESS 0xFFF82F5B /end MEASUREMENT
/begin MEASUREMENT ZFEH_EepromData.ydiBackupMemory_xau16[5].error_code "error code stored in error memory slot" UWORD EH_STANDARD_S5_S3 1 100 0 65535 DISPLAY_IDENTIFIER error_code.ydiBackupMemory_xau16[5].ZFEH_EepromData ECU_ADDRESS 0xFFF82F14 /end MEASUREMENT
/begin MEASUREMENT ZFEH_EepromData.ydiBackupMemory_xau16[5].error_type "error type of error code stored in error memory slot" UWORD EH_STANDARD_S5_S3 1 100 0 65535 DISPLAY_IDENTIFIER error_type.ydiBackupMemory_xau16[5].ZFEH_EepromData ECU_ADDRESS 0xFFF82F16 /end MEASUREMENT
/begin MEASUREMENT ZFEH_EepromData.ydiBackupMemory_xau16[5].status_word "status word of error code stored in error memory slot" UWORD EH_STANDARD_S5_S3 1 100 0 65535 DISPLAY_IDENTIFIER status_word.ydiBackupMemory_xau16[5].ZFEH_EepromData ECU_ADDRESS 0xFFF82F18 /end MEASUREMENT
/begin MEASUREMENT ZFEH_EepromData.ydiBackupMemory_xau16[5].frequency_counter "frequency counter of error code stored in error memory slot" UBYTE EH_STANDARD_S5_S3 1 100 0 255 DISPLAY_IDENTIFIER frequency_counter.ydiBackupMemory_xau16[5].ZFEH_EepromData ECU_ADDRESS 0xFFF82F1A /end MEASUREMENT
/begin MEASUREMENT ZFEH_EepromData.ydiBackupMemory_xau16[5].backwards_counter "backwards counter of error code stored in error memory slot" UBYTE EH_STANDARD_S5_S3 1 100 0 255 DISPLAY_IDENTIFIER backwards_counter.ydiBackupMemory_xau16[5].ZFEH_EepromData ECU_ADDRESS 0xFFF82F1B /end MEASUREMENT
/begin MEASUREMENT ZFEH_EepromData.ydiBackupMemory_xau16[5].permanent_counter "counter of permanent error codes stored in error memory slot" UBYTE EH_STANDARD_S5_S3 1 100 0 255 DISPLAY_IDENTIFIER permanent_counter.ydiBackupMemory_xau16[5].ZFEH_EepromData ECU_ADDRESS 0xFFF82F1C /end MEASUREMENT
/begin MEASUREMENT ZFEH_EepromData.ydiBackupMemory_xau16[5].sequence_counter "sequence counter of error code stored in error memory slot" UBYTE EH_STANDARD_S5_S3 1 100 0 255 DISPLAY_IDENTIFIER sequence_counter.ydiBackupMemory_xau16[5].ZFEH_EepromData ECU_ADDRESS 0xFFF82F1D /end MEASUREMENT
/begin MEASUREMENT ZFEH_EepromData.ydiBackupMemory_xau16[5].master_time "master time of error code stored in error memory slot" ULONG EH_STANDARD_S5_S3 1 100 0 4294967295 DISPLAY_IDENTIFIER master_time.ydiBackupMemory_xau16[5].ZFEH_EepromData ECU_ADDRESS 0xFFF82F20 /end MEASUREMENT
/begin MEASUREMENT ZFEH_EepromData.ydiBackupMemory_xau16[5].condition_byte "condition byte of error code stored in error memory slot" UBYTE EH_STANDARD_S5_S3 1 100 0 255 DISPLAY_IDENTIFIER condition_byte.ydiBackupMemory_xau16[5].ZFEH_EepromData ECU_ADDRESS 0xFFF82F25 /end MEASUREMENT
/begin MEASUREMENT ZFEH_EepromData.ydiBackupMemory_xau16[5].obd_driving_cycle_counter "obd driving cycle counter of error code stored in error memory slot" UWORD EH_STANDARD_S5_S3 1 100 0 65535 DISPLAY_IDENTIFIER obd_driving_cycle_counter.ydiBackupMemory_xau16[5].ZFEH_EepromData ECU_ADDRESS 0xFFF82F26 /end MEASUREMENT
/begin MEASUREMENT ZFEH_EepromData.ydiBackupMemory_xau16[6].amb_cond.ambient_condition[0][0] "ambient condition shot [0 .. 2-1] with 25 data bytes [0 .. 25-1] for the error code stored in this error memory slot" UBYTE EH_STANDARD_S5_S3 1 100 0 255 DISPLAY_IDENTIFIER ambient_condition[0][0].amb_cond.ydiBackupMemory_xau16[6].ZFEH_EepromData ECU_ADDRESS 0xFFF82F70 /end MEASUREMENT
/begin MEASUREMENT ZFEH_EepromData.ydiBackupMemory_xau16[6].amb_cond.ambient_condition[0][1] "ambient condition shot [0 .. 2-1] with 25 data bytes [0 .. 25-1] for the error code stored in this error memory slot" UBYTE EH_STANDARD_S5_S3 1 100 0 255 DISPLAY_IDENTIFIER ambient_condition[0][1].amb_cond.ydiBackupMemory_xau16[6].ZFEH_EepromData ECU_ADDRESS 0xFFF82F71 /end MEASUREMENT
/begin MEASUREMENT ZFEH_EepromData.ydiBackupMemory_xau16[6].amb_cond.ambient_condition[0][2] "ambient condition shot [0 .. 2-1] with 25 data bytes [0 .. 25-1] for the error code stored in this error memory slot" UBYTE EH_STANDARD_S5_S3 1 100 0 255 DISPLAY_IDENTIFIER ambient_condition[0][2].amb_cond.ydiBackupMemory_xau16[6].ZFEH_EepromData ECU_ADDRESS 0xFFF82F72 /end MEASUREMENT
/begin MEASUREMENT ZFEH_EepromData.ydiBackupMemory_xau16[6].amb_cond.ambient_condition[0][3] "ambient condition shot [0 .. 2-1] with 25 data bytes [0 .. 25-1] for the error code stored in this error memory slot" UBYTE EH_STANDARD_S5_S3 1 100 0 255 DISPLAY_IDENTIFIER ambient_condition[0][3].amb_cond.ydiBackupMemory_xau16[6].ZFEH_EepromData ECU_ADDRESS 0xFFF82F73 /end MEASUREMENT
/begin MEASUREMENT ZFEH_EepromData.ydiBackupMemory_xau16[6].amb_cond.ambient_condition[0][4] "ambient condition shot [0 .. 2-1] with 25 data bytes [0 .. 25-1] for the error code stored in this error memory slot" UBYTE EH_STANDARD_S5_S3 1 100 0 255 DISPLAY_IDENTIFIER ambient_condition[0][4].amb_cond.ydiBackupMemory_xau16[6].ZFEH_EepromData ECU_ADDRESS 0xFFF82F74 /end MEASUREMENT
/begin MEASUREMENT ZFEH_EepromData.ydiBackupMemory_xau16[6].amb_cond.ambient_condition[0][5] "ambient condition shot [0 .. 2-1] with 25 data bytes [0 .. 25-1] for the error code stored in this error memory slot" UBYTE EH_STANDARD_S5_S3 1 100 0 255 DISPLAY_IDENTIFIER ambient_condition[0][5].amb_cond.ydiBackupMemory_xau16[6].ZFEH_EepromData ECU_ADDRESS 0xFFF82F75 /end MEASUREMENT
/begin MEASUREMENT ZFEH_EepromData.ydiBackupMemory_xau16[6].amb_cond.ambient_condition[0][6] "ambient condition shot [0 .. 2-1] with 25 data bytes [0 .. 25-1] for the error code stored in this error memory slot" UBYTE EH_STANDARD_S5_S3 1 100 0 255 DISPLAY_IDENTIFIER ambient_condition[0][6].amb_cond.ydiBackupMemory_xau16[6].ZFEH_EepromData ECU_ADDRESS 0xFFF82F76 /end MEASUREMENT
/begin MEASUREMENT ZFEH_EepromData.ydiBackupMemory_xau16[6].amb_cond.ambient_condition[0][7] "ambient condition shot [0 .. 2-1] with 25 data bytes [0 .. 25-1] for the error code stored in this error memory slot" UBYTE EH_STANDARD_S5_S3 1 100 0 255 DISPLAY_IDENTIFIER ambient_condition[0][7].amb_cond.ydiBackupMemory_xau16[6].ZFEH_EepromData ECU_ADDRESS 0xFFF82F77 /end MEASUREMENT
/begin MEASUREMENT ZFEH_EepromData.ydiBackupMemory_xau16[6].amb_cond.ambient_condition[0][8] "ambient condition shot [0 .. 2-1] with 25 data bytes [0 .. 25-1] for the error code stored in this error memory slot" UBYTE EH_STANDARD_S5_S3 1 100 0 255 DISPLAY_IDENTIFIER ambient_condition[0][8].amb_cond.ydiBackupMemory_xau16[6].ZFEH_EepromData ECU_ADDRESS 0xFFF82F78 /end MEASUREMENT
/begin MEASUREMENT ZFEH_EepromData.ydiBackupMemory_xau16[6].amb_cond.ambient_condition[0][9] "ambient condition shot [0 .. 2-1] with 25 data bytes [0 .. 25-1] for the error code stored in this error memory slot" UBYTE EH_STANDARD_S5_S3 1 100 0 255 DISPLAY_IDENTIFIER ambient_condition[0][9].amb_cond.ydiBackupMemory_xau16[6].ZFEH_EepromData ECU_ADDRESS 0xFFF82F79 /end MEASUREMENT
/begin MEASUREMENT ZFEH_EepromData.ydiBackupMemory_xau16[6].amb_cond.ambient_condition[0][10] "ambient condition shot [0 .. 2-1] with 25 data bytes [0 .. 25-1] for the error code stored in this error memory slot" UBYTE EH_STANDARD_S5_S3 1 100 0 255 DISPLAY_IDENTIFIER ambient_condition[0][10].amb_cond.ydiBackupMemory_xau16[6].ZFEH_EepromData ECU_ADDRESS 0xFFF82F7A /end MEASUREMENT
/begin MEASUREMENT ZFEH_EepromData.ydiBackupMemory_xau16[6].amb_cond.ambient_condition[0][11] "ambient condition shot [0 .. 2-1] with 25 data bytes [0 .. 25-1] for the error code stored in this error memory slot" UBYTE EH_STANDARD_S5_S3 1 100 0 255 DISPLAY_IDENTIFIER ambient_condition[0][11].amb_cond.ydiBackupMemory_xau16[6].ZFEH_EepromData ECU_ADDRESS 0xFFF82F7B /end MEASUREMENT
/begin MEASUREMENT ZFEH_EepromData.ydiBackupMemory_xau16[6].amb_cond.ambient_condition[0][12] "ambient condition shot [0 .. 2-1] with 25 data bytes [0 .. 25-1] for the error code stored in this error memory slot" UBYTE EH_STANDARD_S5_S3 1 100 0 255 DISPLAY_IDENTIFIER ambient_condition[0][12].amb_cond.ydiBackupMemory_xau16[6].ZFEH_EepromData ECU_ADDRESS 0xFFF82F7C /end MEASUREMENT
/begin MEASUREMENT ZFEH_EepromData.ydiBackupMemory_xau16[6].amb_cond.ambient_condition[0][13] "ambient condition shot [0 .. 2-1] with 25 data bytes [0 .. 25-1] for the error code stored in this error memory slot" UBYTE EH_STANDARD_S5_S3 1 100 0 255 DISPLAY_IDENTIFIER ambient_condition[0][13].amb_cond.ydiBackupMemory_xau16[6].ZFEH_EepromData ECU_ADDRESS 0xFFF82F7D /end MEASUREMENT
/begin MEASUREMENT ZFEH_EepromData.ydiBackupMemory_xau16[6].amb_cond.ambient_condition[0][14] "ambient condition shot [0 .. 2-1] with 25 data bytes [0 .. 25-1] for the error code stored in this error memory slot" UBYTE EH_STANDARD_S5_S3 1 100 0 255 DISPLAY_IDENTIFIER ambient_condition[0][14].amb_cond.ydiBackupMemory_xau16[6].ZFEH_EepromData ECU_ADDRESS 0xFFF82F7E /end MEASUREMENT
/begin MEASUREMENT ZFEH_EepromData.ydiBackupMemory_xau16[6].amb_cond.ambient_condition[0][15] "ambient condition shot [0 .. 2-1] with 25 data bytes [0 .. 25-1] for the error code stored in this error memory slot" UBYTE EH_STANDARD_S5_S3 1 100 0 255 DISPLAY_IDENTIFIER ambient_condition[0][15].amb_cond.ydiBackupMemory_xau16[6].ZFEH_EepromData ECU_ADDRESS 0xFFF82F7F /end MEASUREMENT
/begin MEASUREMENT ZFEH_EepromData.ydiBackupMemory_xau16[6].amb_cond.ambient_condition[0][16] "ambient condition shot [0 .. 2-1] with 25 data bytes [0 .. 25-1] for the error code stored in this error memory slot" UBYTE EH_STANDARD_S5_S3 1 100 0 255 DISPLAY_IDENTIFIER ambient_condition[0][16].amb_cond.ydiBackupMemory_xau16[6].ZFEH_EepromData ECU_ADDRESS 0xFFF82F80 /end MEASUREMENT
/begin MEASUREMENT ZFEH_EepromData.ydiBackupMemory_xau16[6].amb_cond.ambient_condition[0][17] "ambient condition shot [0 .. 2-1] with 25 data bytes [0 .. 25-1] for the error code stored in this error memory slot" UBYTE EH_STANDARD_S5_S3 1 100 0 255 DISPLAY_IDENTIFIER ambient_condition[0][17].amb_cond.ydiBackupMemory_xau16[6].ZFEH_EepromData ECU_ADDRESS 0xFFF82F81 /end MEASUREMENT
/begin MEASUREMENT ZFEH_EepromData.ydiBackupMemory_xau16[6].amb_cond.ambient_condition[0][18] "ambient condition shot [0 .. 2-1] with 25 data bytes [0 .. 25-1] for the error code stored in this error memory slot" UBYTE EH_STANDARD_S5_S3 1 100 0 255 DISPLAY_IDENTIFIER ambient_condition[0][18].amb_cond.ydiBackupMemory_xau16[6].ZFEH_EepromData ECU_ADDRESS 0xFFF82F82 /end MEASUREMENT
/begin MEASUREMENT ZFEH_EepromData.ydiBackupMemory_xau16[6].amb_cond.ambient_condition[0][19] "ambient condition shot [0 .. 2-1] with 25 data bytes [0 .. 25-1] for the error code stored in this error memory slot" UBYTE EH_STANDARD_S5_S3 1 100 0 255 DISPLAY_IDENTIFIER ambient_condition[0][19].amb_cond.ydiBackupMemory_xau16[6].ZFEH_EepromData ECU_ADDRESS 0xFFF82F83 /end MEASUREMENT
/begin MEASUREMENT ZFEH_EepromData.ydiBackupMemory_xau16[6].amb_cond.ambient_condition[0][20] "ambient condition shot [0 .. 2-1] with 25 data bytes [0 .. 25-1] for the error code stored in this error memory slot" UBYTE EH_STANDARD_S5_S3 1 100 0 255 DISPLAY_IDENTIFIER ambient_condition[0][20].amb_cond.ydiBackupMemory_xau16[6].ZFEH_EepromData ECU_ADDRESS 0xFFF82F84 /end MEASUREMENT
/begin MEASUREMENT ZFEH_EepromData.ydiBackupMemory_xau16[6].amb_cond.ambient_condition[0][21] "ambient condition shot [0 .. 2-1] with 25 data bytes [0 .. 25-1] for the error code stored in this error memory slot" UBYTE EH_STANDARD_S5_S3 1 100 0 255 DISPLAY_IDENTIFIER ambient_condition[0][21].amb_cond.ydiBackupMemory_xau16[6].ZFEH_EepromData ECU_ADDRESS 0xFFF82F85 /end MEASUREMENT
/begin MEASUREMENT ZFEH_EepromData.ydiBackupMemory_xau16[6].amb_cond.ambient_condition[0][22] "ambient condition shot [0 .. 2-1] with 25 data bytes [0 .. 25-1] for the error code stored in this error memory slot" UBYTE EH_STANDARD_S5_S3 1 100 0 255 DISPLAY_IDENTIFIER ambient_condition[0][22].amb_cond.ydiBackupMemory_xau16[6].ZFEH_EepromData ECU_ADDRESS 0xFFF82F86 /end MEASUREMENT
/begin MEASUREMENT ZFEH_EepromData.ydiBackupMemory_xau16[6].amb_cond.ambient_condition[0][23] "ambient condition shot [0 .. 2-1] with 25 data bytes [0 .. 25-1] for the error code stored in this error memory slot" UBYTE EH_STANDARD_S5_S3 1 100 0 255 DISPLAY_IDENTIFIER ambient_condition[0][23].amb_cond.ydiBackupMemory_xau16[6].ZFEH_EepromData ECU_ADDRESS 0xFFF82F87 /end MEASUREMENT
/begin MEASUREMENT ZFEH_EepromData.ydiBackupMemory_xau16[6].amb_cond.ambient_condition[0][24] "ambient condition shot [0 .. 2-1] with 25 data bytes [0 .. 25-1] for the error code stored in this error memory slot" UBYTE EH_STANDARD_S5_S3 1 100 0 255 DISPLAY_IDENTIFIER ambient_condition[0][24].amb_cond.ydiBackupMemory_xau16[6].ZFEH_EepromData ECU_ADDRESS 0xFFF82F88 /end MEASUREMENT
/begin MEASUREMENT ZFEH_EepromData.ydiBackupMemory_xau16[6].amb_cond.ambient_condition[1][0] "ambient condition shot [0 .. 2-1] with 25 data bytes [0 .. 25-1] for the error code stored in this error memory slot" UBYTE EH_STANDARD_S5_S3 1 100 0 255 DISPLAY_IDENTIFIER ambient_condition[1][0].amb_cond.ydiBackupMemory_xau16[6].ZFEH_EepromData ECU_ADDRESS 0xFFF82F89 /end MEASUREMENT
/begin MEASUREMENT ZFEH_EepromData.ydiBackupMemory_xau16[6].amb_cond.ambient_condition[1][1] "ambient condition shot [0 .. 2-1] with 25 data bytes [0 .. 25-1] for the error code stored in this error memory slot" UBYTE EH_STANDARD_S5_S3 1 100 0 255 DISPLAY_IDENTIFIER ambient_condition[1][1].amb_cond.ydiBackupMemory_xau16[6].ZFEH_EepromData ECU_ADDRESS 0xFFF82F8A /end MEASUREMENT
/begin MEASUREMENT ZFEH_EepromData.ydiBackupMemory_xau16[6].amb_cond.ambient_condition[1][2] "ambient condition shot [0 .. 2-1] with 25 data bytes [0 .. 25-1] for the error code stored in this error memory slot" UBYTE EH_STANDARD_S5_S3 1 100 0 255 DISPLAY_IDENTIFIER ambient_condition[1][2].amb_cond.ydiBackupMemory_xau16[6].ZFEH_EepromData ECU_ADDRESS 0xFFF82F8B /end MEASUREMENT
/begin MEASUREMENT ZFEH_EepromData.ydiBackupMemory_xau16[6].amb_cond.ambient_condition[1][3] "ambient condition shot [0 .. 2-1] with 25 data bytes [0 .. 25-1] for the error code stored in this error memory slot" UBYTE EH_STANDARD_S5_S3 1 100 0 255 DISPLAY_IDENTIFIER ambient_condition[1][3].amb_cond.ydiBackupMemory_xau16[6].ZFEH_EepromData ECU_ADDRESS 0xFFF82F8C /end MEASUREMENT
/begin MEASUREMENT ZFEH_EepromData.ydiBackupMemory_xau16[6].amb_cond.ambient_condition[1][4] "ambient condition shot [0 .. 2-1] with 25 data bytes [0 .. 25-1] for the error code stored in this error memory slot" UBYTE EH_STANDARD_S5_S3 1 100 0 255 DISPLAY_IDENTIFIER ambient_condition[1][4].amb_cond.ydiBackupMemory_xau16[6].ZFEH_EepromData ECU_ADDRESS 0xFFF82F8D /end MEASUREMENT
/begin MEASUREMENT ZFEH_EepromData.ydiBackupMemory_xau16[6].amb_cond.ambient_condition[1][5] "ambient condition shot [0 .. 2-1] with 25 data bytes [0 .. 25-1] for the error code stored in this error memory slot" UBYTE EH_STANDARD_S5_S3 1 100 0 255 DISPLAY_IDENTIFIER ambient_condition[1][5].amb_cond.ydiBackupMemory_xau16[6].ZFEH_EepromData ECU_ADDRESS 0xFFF82F8E /end MEASUREMENT
/begin MEASUREMENT ZFEH_EepromData.ydiBackupMemory_xau16[6].amb_cond.ambient_condition[1][6] "ambient condition shot [0 .. 2-1] with 25 data bytes [0 .. 25-1] for the error code stored in this error memory slot" UBYTE EH_STANDARD_S5_S3 1 100 0 255 DISPLAY_IDENTIFIER ambient_condition[1][6].amb_cond.ydiBackupMemory_xau16[6].ZFEH_EepromData ECU_ADDRESS 0xFFF82F8F /end MEASUREMENT
/begin MEASUREMENT ZFEH_EepromData.ydiBackupMemory_xau16[6].amb_cond.ambient_condition[1][7] "ambient condition shot [0 .. 2-1] with 25 data bytes [0 .. 25-1] for the error code stored in this error memory slot" UBYTE EH_STANDARD_S5_S3 1 100 0 255 DISPLAY_IDENTIFIER ambient_condition[1][7].amb_cond.ydiBackupMemory_xau16[6].ZFEH_EepromData ECU_ADDRESS 0xFFF82F90 /end MEASUREMENT
/begin MEASUREMENT ZFEH_EepromData.ydiBackupMemory_xau16[6].amb_cond.ambient_condition[1][10] "ambient condition shot [0 .. 2-1] with 25 data bytes [0 .. 25-1] for the error code stored in this error memory slot" UBYTE EH_STANDARD_S5_S3 1 100 0 255 DISPLAY_IDENTIFIER ambient_condition[1][10].amb_cond.ydiBackupMemory_xau16[6].ZFEH_EepromData ECU_ADDRESS 0xFFF82F93 /end MEASUREMENT
/begin MEASUREMENT ZFEH_EepromData.ydiBackupMemory_xau16[6].amb_cond.ambient_condition[1][11] "ambient condition shot [0 .. 2-1] with 25 data bytes [0 .. 25-1] for the error code stored in this error memory slot" UBYTE EH_STANDARD_S5_S3 1 100 0 255 DISPLAY_IDENTIFIER ambient_condition[1][11].amb_cond.ydiBackupMemory_xau16[6].ZFEH_EepromData ECU_ADDRESS 0xFFF82F94 /end MEASUREMENT
/begin MEASUREMENT ZFEH_EepromData.ydiBackupMemory_xau16[6].amb_cond.ambient_condition[1][12] "ambient condition shot [0 .. 2-1] with 25 data bytes [0 .. 25-1] for the error code stored in this error memory slot" UBYTE EH_STANDARD_S5_S3 1 100 0 255 DISPLAY_IDENTIFIER ambient_condition[1][12].amb_cond.ydiBackupMemory_xau16[6].ZFEH_EepromData ECU_ADDRESS 0xFFF82F95 /end MEASUREMENT
/begin MEASUREMENT ZFEH_EepromData.ydiBackupMemory_xau16[6].amb_cond.ambient_condition[1][13] "ambient condition shot [0 .. 2-1] with 25 data bytes [0 .. 25-1] for the error code stored in this error memory slot" UBYTE EH_STANDARD_S5_S3 1 100 0 255 DISPLAY_IDENTIFIER ambient_condition[1][13].amb_cond.ydiBackupMemory_xau16[6].ZFEH_EepromData ECU_ADDRESS 0xFFF82F96 /end MEASUREMENT
/begin MEASUREMENT ZFEH_EepromData.ydiBackupMemory_xau16[6].amb_cond.ambient_condition[1][14] "ambient condition shot [0 .. 2-1] with 25 data bytes [0 .. 25-1] for the error code stored in this error memory slot" UBYTE EH_STANDARD_S5_S3 1 100 0 255 DISPLAY_IDENTIFIER ambient_condition[1][14].amb_cond.ydiBackupMemory_xau16[6].ZFEH_EepromData ECU_ADDRESS 0xFFF82F97 /end MEASUREMENT
/begin MEASUREMENT ZFEH_EepromData.ydiBackupMemory_xau16[6].amb_cond.ambient_condition[1][15] "ambient condition shot [0 .. 2-1] with 25 data bytes [0 .. 25-1] for the error code stored in this error memory slot" UBYTE EH_STANDARD_S5_S3 1 100 0 255 DISPLAY_IDENTIFIER ambient_condition[1][15].amb_cond.ydiBackupMemory_xau16[6].ZFEH_EepromData ECU_ADDRESS 0xFFF82F98 /end MEASUREMENT
/begin MEASUREMENT ZFEH_EepromData.ydiBackupMemory_xau16[6].amb_cond.ambient_condition[1][16] "ambient condition shot [0 .. 2-1] with 25 data bytes [0 .. 25-1] for the error code stored in this error memory slot" UBYTE EH_STANDARD_S5_S3 1 100 0 255 DISPLAY_IDENTIFIER ambient_condition[1][16].amb_cond.ydiBackupMemory_xau16[6].ZFEH_EepromData ECU_ADDRESS 0xFFF82F99 /end MEASUREMENT
/begin MEASUREMENT ZFEH_EepromData.ydiBackupMemory_xau16[6].amb_cond.ambient_condition[1][17] "ambient condition shot [0 .. 2-1] with 25 data bytes [0 .. 25-1] for the error code stored in this error memory slot" UBYTE EH_STANDARD_S5_S3 1 100 0 255 DISPLAY_IDENTIFIER ambient_condition[1][17].amb_cond.ydiBackupMemory_xau16[6].ZFEH_EepromData ECU_ADDRESS 0xFFF82F9A /end MEASUREMENT
/begin MEASUREMENT ZFEH_EepromData.ydiBackupMemory_xau16[6].amb_cond.ambient_condition[1][18] "ambient condition shot [0 .. 2-1] with 25 data bytes [0 .. 25-1] for the error code stored in this error memory slot" UBYTE EH_STANDARD_S5_S3 1 100 0 255 DISPLAY_IDENTIFIER ambient_condition[1][18].amb_cond.ydiBackupMemory_xau16[6].ZFEH_EepromData ECU_ADDRESS 0xFFF82F9B /end MEASUREMENT
/begin MEASUREMENT ZFEH_EepromData.ydiBackupMemory_xau16[6].amb_cond.ambient_condition[1][19] "ambient condition shot [0 .. 2-1] with 25 data bytes [0 .. 25-1] for the error code stored in this error memory slot" UBYTE EH_STANDARD_S5_S3 1 100 0 255 DISPLAY_IDENTIFIER ambient_condition[1][19].amb_cond.ydiBackupMemory_xau16[6].ZFEH_EepromData ECU_ADDRESS 0xFFF82F9C /end MEASUREMENT
/begin MEASUREMENT ZFEH_EepromData.ydiBackupMemory_xau16[6].amb_cond.ambient_condition[1][20] "ambient condition shot [0 .. 2-1] with 25 data bytes [0 .. 25-1] for the error code stored in this error memory slot" UBYTE EH_STANDARD_S5_S3 1 100 0 255 DISPLAY_IDENTIFIER ambient_condition[1][20].amb_cond.ydiBackupMemory_xau16[6].ZFEH_EepromData ECU_ADDRESS 0xFFF82F9D /end MEASUREMENT
/begin MEASUREMENT ZFEH_EepromData.ydiBackupMemory_xau16[6].amb_cond.ambient_condition[1][21] "ambient condition shot [0 .. 2-1] with 25 data bytes [0 .. 25-1] for the error code stored in this error memory slot" UBYTE EH_STANDARD_S5_S3 1 100 0 255 DISPLAY_IDENTIFIER ambient_condition[1][21].amb_cond.ydiBackupMemory_xau16[6].ZFEH_EepromData ECU_ADDRESS 0xFFF82F9E /end MEASUREMENT
/begin MEASUREMENT ZFEH_EepromData.ydiBackupMemory_xau16[6].amb_cond.ambient_condition[1][22] "ambient condition shot [0 .. 2-1] with 25 data bytes [0 .. 25-1] for the error code stored in this error memory slot" UBYTE EH_STANDARD_S5_S3 1 100 0 255 DISPLAY_IDENTIFIER ambient_condition[1][22].amb_cond.ydiBackupMemory_xau16[6].ZFEH_EepromData ECU_ADDRESS 0xFFF82F9F /end MEASUREMENT
/begin MEASUREMENT ZFEH_EepromData.ydiBackupMemory_xau16[6].amb_cond.ambient_condition[1][23] "ambient condition shot [0 .. 2-1] with 25 data bytes [0 .. 25-1] for the error code stored in this error memory slot" UBYTE EH_STANDARD_S5_S3 1 100 0 255 DISPLAY_IDENTIFIER ambient_condition[1][23].amb_cond.ydiBackupMemory_xau16[6].ZFEH_EepromData ECU_ADDRESS 0xFFF82FA0 /end MEASUREMENT
/begin MEASUREMENT ZFEH_EepromData.ydiBackupMemory_xau16[6].amb_cond.ambient_condition[1][24] "ambient condition shot [0 .. 2-1] with 25 data bytes [0 .. 25-1] for the error code stored in this error memory slot" UBYTE EH_STANDARD_S5_S3 1 100 0 255 DISPLAY_IDENTIFIER ambient_condition[1][24].amb_cond.ydiBackupMemory_xau16[6].ZFEH_EepromData ECU_ADDRESS 0xFFF82FA1 /end MEASUREMENT
/begin COMPU_METHOD VOID_SCALING_S4_S3 "int = ((phys * 1) / 1) - (0) " RAT_FUNC "%2.0" "" COEFFS 0 1 -0 0 0 1 /end COMPU_METHOD
/begin COMPU_METHOD SABAL_STANDARD_S4_S3 "int = ((phys * 1) / 1) - (0) " RAT_FUNC "%2.0" "" COEFFS 0 1 -0 0 0 1 /end COMPU_METHOD
/begin COMPU_METHOD SABAL_M_1NM_S4_S3 "int = ((phys * 1) / 1) - (0) Nm" RAT_FUNC "%2.0" "Nm" COEFFS 0 1 -0 0 0 1 /end COMPU_METHOD
/begin COMPU_METHOD SABAL_N_1RPM_S4_S3 "int = ((phys * 1) / 1) - (0) 1/min" RAT_FUNC "%2.0" "1/min" COEFFS 0 1 -0 0 0 1 /end COMPU_METHOD
/begin COMPU_METHOD SABAL_T_TIMER_10MS_S4_S3 "int = ((phys * 1) / 10) - (0) ms" RAT_FUNC "%2.0" "ms" COEFFS 0 1 -0 0 0 10 /end COMPU_METHOD
/begin COMPU_METHOD SABAL_C_1CEL_M40_S4_S3 "int = ((phys * 1) / 1) - (-40) Deg C" RAT_FUNC "%2.0" "Deg C" COEFFS 0 1 40 0 0 1 /end COMPU_METHOD
/begin COMPU_METHOD SABAL_V_1KMH16_S4_S3 "int = ((phys * 1) / 0.0625) - (0) km/h" RAT_FUNC "%4.2" "km/h" COEFFS 0 1 -0 0 0 0.0625 /end COMPU_METHOD
/begin COMPU_METHOD SABAL_T_TIMER_100MS_S4_S3 "int = ((phys * 1) / 100) - (0) ms" RAT_FUNC "%2.0" "ms" COEFFS 0 1 -0 0 0 100 /end COMPU_METHOD
/begin COMPU_METHOD SABAL_100PROZENT254_S4_S3 "int = ((phys * 1) / 0.3937007874015748) - (0) %" RAT_FUNC "%3.1" "%" COEFFS 0 1 -0 0 0 0.393700787402 /end COMPU_METHOD
/begin COMPU_METHOD SABAL_MI_1NMS_S4_S3 "int = ((phys * 1) / 1) - (0) Nms" RAT_FUNC "%2.0" "Nms" COEFFS 0 1 -0 0 0 1 /end COMPU_METHOD
/begin COMPU_METHOD SABAL_PROZENT_S4_S3 "int = ((phys * 1) / 1) - (0) %" RAT_FUNC "%2.0" "%" COEFFS 0 1 -0 0 0 1 /end COMPU_METHOD
/begin COMPU_METHOD EH_STANDARD_S5_S3 "int = ((phys * 1) / 1) - (0) -" RAT_FUNC "%2.0" "-" COEFFS 0 1 -0 0 0 1 /end COMPU_METHOD
/begin FUNCTION jData_SABAL_GbxSt_Fctn "Calibration values of the Instance jData_SABAL_GbxSt"
 /begin DEF_CHARACTERISTIC D_T_GrbToDetSysPbyNEng D_n_ColdPwrUpDlyAbort D_n_EngThd D_n_EngThdHys D_n_EngToGbxSt D_st_IEPToGbxSt D_t_HoldGbxStDefault D_t_HoldGbxSt_W D_t_HoldGbxSt_X D_tmr_DebGbxSt2ToGbxSt3 D_tmr_DlyRdyToDrvColdPwrUpbyInSpd_W D_tmr_DlyRdyToDrvColdPwrUpbyInSpd_X D_v_VehColdPwrUpThr SWI_EnaCalcSubstInpSpd SWI_EnaColdPwrUpDly /end DEF_CHARACTERISTIC
/end FUNCTION
/begin FUNCTION dData_SABAL_TqReqMon_Fctn "Calibration values of the Component dData_SABAL_TqReqMon" /begin SUB_FUNCTION jData_SABAL_TqReqMon_Fctn /end SUB_FUNCTION /end FUNCTION
/begin FUNCTION jData_SABAL_TqReqMon_Fctn "Calibration values of the Instance jData_SABAL_TqReqMon"
 /begin DEF_CHARACTERISTIC D_EIMonThrottlePositionDifNeg D_EIMonThrottlePositionDifPos D_EIMonTrqTh D_EIMon_m_EngDifNeg D_EIMon_m_EngDifPos D_EI_Mode_X D_EI_RealizedThP D_EI_RealizedThS D_EI_Tq_Y D_c_OilTrans_EIMon D_ctl_BasicConditionsFulfilled D_ctl_EIMonBreak D_mIntegral_EIMonTh D_m_GearboxGuardActiveHys_TqReqMon D_n_Eng_EIMon D_t_EIMonActivDelay D_t_EIMonDelay D_t_EI_IntegrationMax D_t_EI_IntegrationMin SWI_EIMon_PErrMem SWI_EIMon_SErrMem SWI_m_EIReqMode SWI_t_EI_IntAnalysis /end DEF_CHARACTERISTIC
/end FUNCTION
/begin FUNCTION zff_EH "data of Errorhandler"
 /begin SUB_FUNCTION zff_EH_Messgroessen zff_EH_Applikationsgroessen zff_EH_Applikationsgroessen.Asil.C /end SUB_FUNCTION
/end FUNCTION
/begin FUNCTION zff_EH_Messgroessen "all measurements of Errorhandler"
 /begin SUB_FUNCTION zff_EH_ErrorMemoryInformation zff_EH_ObdErrorMemoryInformation zff_EH_FaultInformation zff_EH_Obd zff_EH_Interfo zff_EH_Interfi zff_EH_CommonInformation zff_EH_Statemachine zff_EH_Eeprom zff_EH_Erm zff_EH_CarbHandler zff_EH_CvnCalculation /end SUB_FUNCTION
/end FUNCTION
/begin FUNCTION zff_EH_ErrorMemoryInformation "desc_en"
 /begin LOC_MEASUREMENT ZFEH_EepromData.ydiBackupMemory_xau16[0].amb_cond.ambient_condition[0][0] ZFEH_EepromData.ydiBackupMemory_xau16[0].amb_cond.ambient_condition[0][10] ZFEH_EepromData.ydiBackupMemory_xau16[0].amb_cond.ambient_condition[0][11] ZFEH_EepromData.ydiBackupMemory_xau16[0].amb_cond.ambient_condition[0][12] ZFEH_EepromData.ydiBackupMemory_xau16[0].amb_cond.ambient_condition[0][13] ZFEH_EepromData.ydiBackupMemory_xau16[0].amb_cond.ambient_condition[0][14] ZFEH_EepromData.ydiBackupMemory_xau16[0].amb_cond.ambient_condition[0][15] ZFEH_EepromData.ydiBackupMemory_xau16[0].amb_cond.ambient_condition[0][16] ZFEH_EepromData.ydiBackupMemory_xau16[0].amb_cond.ambient_condition[0][17] ZFEH_EepromData.ydiBackupMemory_xau16[0].amb_cond.ambient_condition[0][18] ZFEH_EepromData.ydiBackupMemory_xau16[0].amb_cond.ambient_condition[0][19] ZFEH_EepromData.ydiBackupMemory_xau16[0].amb_cond.ambient_condition[0][1] ZFEH_EepromData.ydiBackupMemory_xau16[0].amb_cond.ambient_condition[0][20] ZFEH_EepromData.ydiBackupMemory_xau16[0].amb_cond.ambient_condition[0][21] ZFEH_EepromData.ydiBackupMemory_xau16[0].amb_cond.ambient_condition[0][22] ZFEH_EepromData.ydiBackupMemory_xau16[0].amb_cond.ambient_condition[0][23] ZFEH_EepromData.ydiBackupMemory_xau16[0].amb_cond.ambient_condition[0][24] ZFEH_EepromData.ydiBackupMemory_xau16[0].amb_cond.ambient_condition[0][2] ZFEH_EepromData.ydiBackupMemory_xau16[0].amb_cond.ambient_condition[0][3] ZFEH_EepromData.ydiBackupMemory_xau16[0].amb_cond.ambient_condition[0][4] ZFEH_EepromData.ydiBackupMemory_xau16[0].amb_cond.ambient_condition[0][5] ZFEH_EepromData.ydiBackupMemory_xau16[0].amb_cond.ambient_condition[0][6] ZFEH_EepromData.ydiBackupMemory_xau16[0].amb_cond.ambient_condition[0][7] ZFEH_EepromData.ydiBackupMemory_xau16[0].amb_cond.ambient_condition[0][8] ZFEH_EepromData.ydiBackupMemory_xau16[0].amb_cond.ambient_condition[0][9] ZFEH_EepromData.ydiBackupMemory_xau16[0].amb_cond.ambient_condition[1][0] ZFEH_EepromData.ydiBackupMemory_xau16[0].amb_cond.ambient_condition[1][10] ZFEH_EepromData.ydiBackupMemory_xau16[0].amb_cond.ambient_condition[1][11] ZFEH_EepromData.ydiBackupMemory_xau16[0].amb_cond.ambient_condition[1][12] ZFEH_EepromData.ydiBackupMemory_xau16[0].amb_cond.ambient_condition[1][13] ZFEH_EepromData.ydiBackupMemory_xau16[0].amb_cond.ambient_condition[1][14] ZFEH_EepromData.ydiBackupMemory_xau16[0].amb_cond.ambient_condition[1][15] ZFEH_EepromData.ydiBackupMemory_xau16[0].amb_cond.ambient_condition[1][16] ZFEH_EepromData.ydiBackupMemory_xau16[0].amb_cond.ambient_condition[1][17] ZFEH_EepromData.ydiBackupMemory_xau16[0].amb_cond.ambient_condition[1][18] ZFEH_EepromData.ydiBackupMemory_xau16[0].amb_cond.ambient_condition[1][19] ZFEH_EepromData.ydiBackupMemory_xau16[0].amb_cond.ambient_condition[1][1] ZFEH_EepromData.ydiBackupMemory_xau16[0].amb_cond.ambient_condition[1][20] ZFEH_EepromData.ydiBackupMemory_xau16[0].amb_cond.ambient_condition[1][21] ZFEH_EepromData.ydiBackupMemory_xau16[0].amb_cond.ambient_condition[1][22] ZFEH_EepromData.ydiBackupMemory_xau16[0].amb_cond.ambient_condition[1][23] ZFEH_EepromData.ydiBackupMemory_xau16[0].amb_cond.ambient_condition[1][24] ZFEH_EepromData.ydiBackupMemory_xau16[0].amb_cond.ambient_condition[1][2] ZFEH_EepromData.ydiBackupMemory_xau16[0].amb_cond.ambient_condition[1][3] ZFEH_EepromData.ydiBackupMemory_xau16[0].amb_cond.ambient_condition[1][4] ZFEH_EepromData.ydiBackupMemory_xau16[0].amb_cond.ambient_condition[1][5] ZFEH_EepromData.ydiBackupMemory_xau16[0].amb_cond.ambient_condition[1][6] ZFEH_EepromData.ydiBackupMemory_xau16[0].amb_cond.ambient_condition[1][7] ZFEH_EepromData.ydiBackupMemory_xau16[0].amb_cond.ambient_condition[1][8] ZFEH_EepromData.ydiBackupMemory_xau16[0].amb_cond.ambient_condition[1][9] ZFEH_EepromData.ydiBackupMemory_xau16[0].amb_cond.status_of_ambient_conditions[0] ZFEH_EepromData.ydiBackupMemory_xau16[0].amb_cond.status_of_ambient_conditions[1] ZFEH_EepromData.ydiBackupMemory_xau16[0].backwards_counter ZFEH_EepromData.ydiBackupMemory_xau16[0].condition_byte ZFEH_EepromData.ydiBackupMemory_xau16[0].error_code ZFEH_EepromData.ydiBackupMemory_xau16[0].error_type ZFEH_EepromData.ydiBackupMemory_xau16[0].frequency_counter ZFEH_EepromData.ydiBackupMemory_xau16[0].master_time ZFEH_EepromData.ydiBackupMemory_xau16[0].obd_driving_cycle_counter ZFEH_EepromData.ydiBackupMemory_xau16[0].permanent_counter ZFEH_EepromData.ydiBackupMemory_xau16[0].sequence_counter ZFEH_EepromData.ydiBackupMemory_xau16[0].status_word ZFEH_EepromData.ydiBackupMemory_xau16[1].amb_cond.ambient_condition[0][0] ZFEH_EepromData.ydiBackupMemory_xau16[1].amb_cond.ambient_condition[0][10] ZFEH_EepromData.ydiBackupMemory_xau16[1].amb_cond.ambient_condition[0][11] ZFEH_EepromData.ydiBackupMemory_xau16[1].amb_cond.ambient_condition[0][12] ZFEH_EepromData.ydiBackupMemory_xau16[1].amb_cond.ambient_condition[0][13] ZFEH_EepromData.ydiBackupMemory_xau16[1].amb_cond.ambient_condition[0][14] ZFEH_EepromData.ydiBackupMemory_xau16[1].amb_cond.ambient_condition[0][15] ZFEH_EepromData.ydiBackupMemory_xau16[1].amb_cond.ambient_condition[0][16] ZFEH_EepromData.ydiBackupMemory_xau16[1].amb_cond.ambient_condition[0][17] ZFEH_EepromData.ydiBackupMemory_xau16[1].amb_cond.ambient_condition[0][18] ZFEH_EepromData.ydiBackupMemory_xau16[1].amb_cond.ambient_condition[0][19] ZFEH_EepromData.ydiBackupMemory_xau16[1].amb_cond.ambient_condition[0][1] ZFEH_EepromData.ydiBackupMemory_xau16[1].amb_cond.ambient_condition[0][20] ZFEH_EepromData.ydiBackupMemory_xau16[1].amb_cond.ambient_condition[0][21] ZFEH_EepromData.ydiBackupMemory_xau16[1].amb_cond.ambient_condition[0][22] ZFEH_EepromData.ydiBackupMemory_xau16[1].amb_cond.ambient_condition[0][23] ZFEH_EepromData.ydiBackupMemory_xau16[1].amb_cond.ambient_condition[0][24] ZFEH_EepromData.ydiBackupMemory_xau16[1].amb_cond.ambient_condition[0][2] ZFEH_EepromData.ydiBackupMemory_xau16[1].amb_cond.ambient_condition[0][3] ZFEH_EepromData.ydiBackupMemory_xau16[1].amb_cond.ambient_condition[0][4] ZFEH_EepromData.ydiBackupMemory_xau16[1].amb_cond.ambient_condition[0][5] ZFEH_EepromData.ydiBackupMemory_xau16[1].amb_cond.ambient_condition[0][6] ZFEH_EepromData.ydiBackupMemory_xau16[1].amb_cond.ambient_condition[0][7] ZFEH_EepromData.ydiBackupMemory_xau16[1].amb_cond.ambient_condition[0][8] ZFEH_EepromData.ydiBackupMemory_xau16[1].amb_cond.ambient_condition[0][9] ZFEH_EepromData.ydiBackupMemory_xau16[1].amb_cond.ambient_condition[1][0] ZFEH_EepromData.ydiBackupMemory_xau16[1].amb_cond.ambient_condition[1][10] ZFEH_EepromData.ydiBackupMemory_xau16[1].amb_cond.ambient_condition[1][11] ZFEH_EepromData.ydiBackupMemory_xau16[1].amb_cond.ambient_condition[1][12] ZFEH_EepromData.ydiBackupMemory_xau16[1].amb_cond.ambient_condition[1][13] ZFEH_EepromData.ydiBackupMemory_xau16[1].amb_cond.ambient_condition[1][14] ZFEH_EepromData.ydiBackupMemory_xau16[1].amb_cond.ambient_condition[1][15] ZFEH_EepromData.ydiBackupMemory_xau16[1].amb_cond.ambient_condition[1][16] ZFEH_EepromData.ydiBackupMemory_xau16[1].amb_cond.ambient_condition[1][17] ZFEH_EepromData.ydiBackupMemory_xau16[1].amb_cond.ambient_condition[1][18] ZFEH_EepromData.ydiBackupMemory_xau16[1].amb_cond.ambient_condition[1][19] ZFEH_EepromData.ydiBackupMemory_xau16[1].amb_cond.ambient_condition[1][1] ZFEH_EepromData.ydiBackupMemory_xau16[1].amb_cond.ambient_condition[1][20] ZFEH_EepromData.ydiBackupMemory_xau16[1].amb_cond.ambient_condition[1][21] ZFEH_EepromData.ydiBackupMemory_xau16[1].amb_cond.ambient_condition[1][22] ZFEH_EepromData.ydiBackupMemory_xau16[1].amb_cond.ambient_condition[1][23] ZFEH_EepromData.ydiBackupMemory_xau16[1].amb_cond.ambient_condition[1][24] ZFEH_EepromData.ydiBackupMemory_xau16[1].amb_cond.ambient_condition[1][2] ZFEH_EepromData.ydiBackupMemory_xau16[1].amb_cond.ambient_condition[1][3] ZFEH_EepromData.ydiBackupMemory_xau16[1].amb_cond.ambient_condition[1][4] ZFEH_EepromData.ydiBackupMemory_xau16[1].amb_cond.ambient_condition[1][5] ZFEH_EepromData.ydiBackupMemory_xau16[1].amb_cond.ambient_condition[1][6] ZFEH_EepromData.ydiBackupMemory_xau16[1].amb_cond.ambient_condition[1][7] ZFEH_EepromData.ydiBackupMemory_xau16[1].amb_cond.ambient_condition[1][8] ZFEH_EepromData.ydiBackupMemory_xau16[1].amb_cond.ambient_condition[1][9] ZFEH_EepromData.ydiBackupMemory_xau16[1].amb_cond.status_of_ambient_conditions[0] ZFEH_EepromData.ydiBackupMemory_xau16[1].amb_cond.status_of_ambient_conditions[1] ZFEH_EepromData.ydiBackupMemory_xau16[1].backwards_counter ZFEH_EepromData.ydiBackupMemory_xau16[1].condition_byte ZFEH_EepromData.ydiBackupMemory_xau16[1].error_code ZFEH_EepromData.ydiBackupMemory_xau16[1].error_type ZFEH_EepromData.ydiBackupMemory_xau16[1].frequency_counter ZFEH_EepromData.ydiBackupMemory_xau16[1].master_time ZFEH_EepromData.ydiBackupMemory_xau16[1].obd_driving_cycle_counter ZFEH_EepromData.ydiBackupMemory_xau16[1].permanent_counter ZFEH_EepromData.ydiBackupMemory_xau16[1].sequence_counter ZFEH_EepromData.ydiBackupMemory_xau16[1].status_word ZFEH_EepromData.ydiBackupMemory_xau16[2].amb_cond.ambient_condition[0][0] ZFEH_EepromData.ydiBackupMemory_xau16[2].amb_cond.ambient_condition[0][10] ZFEH_EepromData.ydiBackupMemory_xau16[2].amb_cond.ambient_condition[0][11] ZFEH_EepromData.ydiBackupMemory_xau16[2].amb_cond.ambient_condition[0][12] ZFEH_EepromData.ydiBackupMemory_xau16[2].amb_cond.ambient_condition[0][13] ZFEH_EepromData.ydiBackupMemory_xau16[2].amb_cond.ambient_condition[0][14] ZFEH_EepromData.ydiBackupMemory_xau16[2].amb_cond.ambient_condition[0][15] ZFEH_EepromData.ydiBackupMemory_xau16[2].amb_cond.ambient_condition[0][16] ZFEH_EepromData.ydiBackupMemory_xau16[2].amb_cond.ambient_condition[0][17] ZFEH_EepromData.ydiBackupMemory_xau16[2].amb_cond.ambient_condition[0][18] ZFEH_EepromData.ydiBackupMemory_xau16[2].amb_cond.ambient_condition[0][19] ZFEH_EepromData.ydiBackupMemory_xau16[2].amb_cond.ambient_condition[0][1] ZFEH_EepromData.ydiBackupMemory_xau16[2].amb_cond.ambient_condition[0][20] ZFEH_EepromData.ydiBackupMemory_xau16[2].amb_cond.ambient_condition[0][21] ZFEH_EepromData.ydiBackupMemory_xau16[2].amb_cond.ambient_condition[0][22] ZFEH_EepromData.ydiBackupMemory_xau16[2].amb_cond.ambient_condition[0][23] ZFEH_EepromData.ydiBackupMemory_xau16[2].amb_cond.ambient_condition[0][24] ZFEH_EepromData.ydiBackupMemory_xau16[2].amb_cond.ambient_condition[0][2] ZFEH_EepromData.ydiBackupMemory_xau16[2].amb_cond.ambient_condition[0][3] ZFEH_EepromData.ydiBackupMemory_xau16[2].amb_cond.ambient_condition[0][4] ZFEH_EepromData.ydiBackupMemory_xau16[2].amb_cond.ambient_condition[0][5] ZFEH_EepromData.ydiBackupMemory_xau16[2].amb_cond.ambient_condition[0][6] ZFEH_EepromData.ydiBackupMemory_xau16[2].amb_cond.ambient_condition[0][7] ZFEH_EepromData.ydiBackupMemory_xau16[2].amb_cond.ambient_condition[0][8] ZFEH_EepromData.ydiBackupMemory_xau16[2].amb_cond.ambient_condition[0][9] ZFEH_EepromData.ydiBackupMemory_xau16[2].amb_cond.ambient_condition[1][0] ZFEH_EepromData.ydiBackupMemory_xau16[2].amb_cond.ambient_condition[1][10] ZFEH_EepromData.ydiBackupMemory_xau16[2].amb_cond.ambient_condition[1][11] ZFEH_EepromData.ydiBackupMemory_xau16[2].amb_cond.ambient_condition[1][12] ZFEH_EepromData.ydiBackupMemory_xau16[2].amb_cond.ambient_condition[1][13] ZFEH_EepromData.ydiBackupMemory_xau16[2].amb_cond.ambient_condition[1][14] ZFEH_EepromData.ydiBackupMemory_xau16[2].amb_cond.ambient_condition[1][15] ZFEH_EepromData.ydiBackupMemory_xau16[2].amb_cond.ambient_condition[1][16] ZFEH_EepromData.ydiBackupMemory_xau16[2].amb_cond.ambient_condition[1][17] ZFEH_EepromData.ydiBackupMemory_xau16[2].amb_cond.ambient_condition[1][18] ZFEH_EepromData.ydiBackupMemory_xau16[2].amb_cond.ambient_condition[1][19] ZFEH_EepromData.ydiBackupMemory_xau16[2].amb_cond.ambient_condition[1][1] ZFEH_EepromData.ydiBackupMemory_xau16[2].amb_cond.ambient_condition[1][20] ZFEH_EepromData.ydiBackupMemory_xau16[2].amb_cond.ambient_condition[1][21] ZFEH_EepromData.ydiBackupMemory_xau16[2].amb_cond.ambient_condition[1][22] ZFEH_EepromData.ydiBackupMemory_xau16[2].amb_cond.ambient_condition[1][23] ZFEH_EepromData.ydiBackupMemory_xau16[2].amb_cond.ambient_condition[1][24] ZFEH_EepromData.ydiBackupMemory_xau16[2].amb_cond.ambient_condition[1][2] ZFEH_EepromData.ydiBackupMemory_xau16[2].amb_cond.ambient_condition[1][3] ZFEH_EepromData.ydiBackupMemory_xau16[2].amb_cond.ambient_condition[1][4] ZFEH_EepromData.ydiBackupMemory_xau16[2].amb_cond.ambient_condition[1][5] ZFEH_EepromData.ydiBackupMemory_xau16[2].amb_cond.ambient_condition[1][6] ZFEH_EepromData.ydiBackupMemory_xau16[2].amb_cond.ambient_condition[1][7] ZFEH_EepromData.ydiBackupMemory_xau16[2].amb_cond.ambient_condition[1][8] ZFEH_EepromData.ydiBackupMemory_xau16[2].amb_cond.ambient_condition[1][9] ZFEH_EepromData.ydiBackupMemory_xau16[2].amb_cond.status_of_ambient_conditions[0] ZFEH_EepromData.ydiBackupMemory_xau16[2].amb_cond.status_of_ambient_conditions[1] ZFEH_EepromData.ydiBackupMemory_xau16[2].backwards_counter ZFEH_EepromData.ydiBackupMemory_xau16[2].condition_byte ZFEH_EepromData.ydiBackupMemory_xau16[2].error_code ZFEH_EepromData.ydiBackupMemory_xau16[2].error_type ZFEH_EepromData.ydiBackupMemory_xau16[2].frequency_counter ZFEH_EepromData.ydiBackupMemory_xau16[2].master_time ZFEH_EepromData.ydiBackupMemory_xau16[2].obd_driving_cycle_counter ZFEH_EepromData.ydiBackupMemory_xau16[2].permanent_counter ZFEH_EepromData.ydiBackupMemory_xau16[2].sequence_counter ZFEH_EepromData.ydiBackupMemory_xau16[2].status_word ZFEH_EepromData.ydiBackupMemory_xau16[3].amb_cond.ambient_condition[0][0] ZFEH_EepromData.ydiBackupMemory_xau16[3].amb_cond.ambient_condition[0][10] ZFEH_EepromData.ydiBackupMemory_xau16[3].amb_cond.ambient_condition[0][11] ZFEH_EepromData.ydiBackupMemory_xau16[3].amb_cond.ambient_condition[0][12] ZFEH_EepromData.ydiBackupMemory_xau16[3].amb_cond.ambient_condition[0][13] ZFEH_EepromData.ydiBackupMemory_xau16[3].amb_cond.ambient_condition[0][14] ZFEH_EepromData.ydiBackupMemory_xau16[3].amb_cond.ambient_condition[0][15] ZFEH_EepromData.ydiBackupMemory_xau16[3].amb_cond.ambient_condition[0][16] ZFEH_EepromData.ydiBackupMemory_xau16[3].amb_cond.ambient_condition[0][17] ZFEH_EepromData.ydiBackupMemory_xau16[3].amb_cond.ambient_condition[0][18] ZFEH_EepromData.ydiBackupMemory_xau16[3].amb_cond.ambient_condition[0][19] ZFEH_EepromData.ydiBackupMemory_xau16[3].amb_cond.ambient_condition[0][1] ZFEH_EepromData.ydiBackupMemory_xau16[3].amb_cond.ambient_condition[0][20] ZFEH_EepromData.ydiBackupMemory_xau16[3].amb_cond.ambient_condition[0][21] ZFEH_EepromData.ydiBackupMemory_xau16[3].amb_cond.ambient_condition[0][22] ZFEH_EepromData.ydiBackupMemory_xau16[3].amb_cond.ambient_condition[0][23] ZFEH_EepromData.ydiBackupMemory_xau16[3].amb_cond.ambient_condition[0][24] ZFEH_EepromData.ydiBackupMemory_xau16[3].amb_cond.ambient_condition[0][2] ZFEH_EepromData.ydiBackupMemory_xau16[3].amb_cond.ambient_condition[0][3] ZFEH_EepromData.ydiBackupMemory_xau16[3].amb_cond.ambient_condition[0][4] ZFEH_EepromData.ydiBackupMemory_xau16[3].amb_cond.ambient_condition[0][5] ZFEH_EepromData.ydiBackupMemory_xau16[3].amb_cond.ambient_condition[0][6] ZFEH_EepromData.ydiBackupMemory_xau16[3].amb_cond.ambient_condition[0][7] ZFEH_EepromData.ydiBackupMemory_xau16[3].amb_cond.ambient_condition[0][8] ZFEH_EepromData.ydiBackupMemory_xau16[3].amb_cond.ambient_condition[0][9] ZFEH_EepromData.ydiBackupMemory_xau16[3].amb_cond.ambient_condition[1][0] ZFEH_EepromData.ydiBackupMemory_xau16[3].amb_cond.ambient_condition[1][10] ZFEH_EepromData.ydiBackupMemory_xau16[3].amb_cond.ambient_condition[1][11] ZFEH_EepromData.ydiBackupMemory_xau16[3].amb_cond.ambient_condition[1][12] ZFEH_EepromData.ydiBackupMemory_xau16[3].amb_cond.ambient_condition[1][13] ZFEH_EepromData.ydiBackupMemory_xau16[3].amb_cond.ambient_condition[1][14] ZFEH_EepromData.ydiBackupMemory_xau16[3].amb_cond.ambient_condition[1][15] ZFEH_EepromData.ydiBackupMemory_xau16[3].amb_cond.ambient_condition[1][16] ZFEH_EepromData.ydiBackupMemory_xau16[3].amb_cond.ambient_condition[1][17] ZFEH_EepromData.ydiBackupMemory_xau16[3].amb_cond.ambient_condition[1][18] ZFEH_EepromData.ydiBackupMemory_xau16[3].amb_cond.ambient_condition[1][19] ZFEH_EepromData.ydiBackupMemory_xau16[3].amb_cond.ambient_condition[1][1] ZFEH_EepromData.ydiBackupMemory_xau16[3].amb_cond.ambient_condition[1][20] ZFEH_EepromData.ydiBackupMemory_xau16[3].amb_cond.ambient_condition[1][21] ZFEH_EepromData.ydiBackupMemory_xau16[3].amb_cond.ambient_condition[1][22] ZFEH_EepromData.ydiBackupMemory_xau16[3].amb_cond.ambient_condition[1][23] ZFEH_EepromData.ydiBackupMemory_xau16[3].amb_cond.ambient_condition[1][24] ZFEH_EepromData.ydiBackupMemory_xau16[3].amb_cond.ambient_condition[1][2] ZFEH_EepromData.ydiBackupMemory_xau16[3].amb_cond.ambient_condition[1][3] ZFEH_EepromData.ydiBackupMemory_xau16[3].amb_cond.ambient_condition[1][4] ZFEH_EepromData.ydiBackupMemory_xau16[3].amb_cond.ambient_condition[1][5] ZFEH_EepromData.ydiBackupMemory_xau16[3].amb_cond.ambient_condition[1][6] ZFEH_EepromData.ydiBackupMemory_xau16[3].amb_cond.ambient_condition[1][7] ZFEH_EepromData.ydiBackupMemory_xau16[3].amb_cond.ambient_condition[1][8] ZFEH_EepromData.ydiBackupMemory_xau16[3].amb_cond.ambient_condition[1][9] ZFEH_EepromData.ydiBackupMemory_xau16[3].amb_cond.status_of_ambient_conditions[0] ZFEH_EepromData.ydiBackupMemory_xau16[3].amb_cond.status_of_ambient_conditions[1] ZFEH_EepromData.ydiBackupMemory_xau16[3].backwards_counter ZFEH_EepromData.ydiBackupMemory_xau16[3].condition_byte ZFEH_EepromData.ydiBackupMemory_xau16[3].error_code ZFEH_EepromData.ydiBackupMemory_xau16[3].error_type ZFEH_EepromData.ydiBackupMemory_xau16[3].frequency_counter ZFEH_EepromData.ydiBackupMemory_xau16[3].master_time ZFEH_EepromData.ydiBackupMemory_xau16[3].obd_driving_cycle_counter ZFEH_EepromData.ydiBackupMemory_xau16[3].permanent_counter ZFEH_EepromData.ydiBackupMemory_xau16[3].sequence_counter ZFEH_EepromData.ydiBackupMemory_xau16[3].status_word ZFEH_EepromData.ydiBackupMemory_xau16[4].amb_cond.ambient_condition[0][0] ZFEH_EepromData.ydiBackupMemory_xau16[4].amb_cond.ambient_condition[0][10] ZFEH_EepromData.ydiBackupMemory_xau16[4].amb_cond.ambient_condition[0][11] ZFEH_EepromData.ydiBackupMemory_xau16[4].amb_cond.ambient_condition[0][12] ZFEH_EepromData.ydiBackupMemory_xau16[4].amb_cond.ambient_condition[0][13] ZFEH_EepromData.ydiBackupMemory_xau16[4].amb_cond.ambient_condition[0][14] ZFEH_EepromData.ydiBackupMemory_xau16[4].amb_cond.ambient_condition[0][15] ZFEH_EepromData.ydiBackupMemory_xau16[4].amb_cond.ambient_condition[0][16] ZFEH_EepromData.ydiBackupMemory_xau16[4].amb_cond.ambient_condition[0][17] ZFEH_EepromData.ydiBackupMemory_xau16[4].amb_cond.ambient_condition[0][18] ZFEH_EepromData.ydiBackupMemory_xau16[4].amb_cond.ambient_condition[0][19] ZFEH_EepromData.ydiBackupMemory_xau16[4].amb_cond.ambient_condition[0][1] ZFEH_EepromData.ydiBackupMemory_xau16[4].amb_cond.ambient_condition[0][20] ZFEH_EepromData.ydiBackupMemory_xau16[4].amb_cond.ambient_condition[0][21] ZFEH_EepromData.ydiBackupMemory_xau16[4].amb_cond.ambient_condition[0][22] ZFEH_EepromData.ydiBackupMemory_xau16[4].amb_cond.ambient_condition[0][23] ZFEH_EepromData.ydiBackupMemory_xau16[4].amb_cond.ambient_condition[0][24] ZFEH_EepromData.ydiBackupMemory_xau16[4].amb_cond.ambient_condition[0][2] ZFEH_EepromData.ydiBackupMemory_xau16[4].amb_cond.ambient_condition[0][3] ZFEH_EepromData.ydiBackupMemory_xau16[4].amb_cond.ambient_condition[0][4] ZFEH_EepromData.ydiBackupMemory_xau16[4].amb_cond.ambient_condition[0][5] ZFEH_EepromData.ydiBackupMemory_xau16[4].amb_cond.ambient_condition[0][6] ZFEH_EepromData.ydiBackupMemory_xau16[4].amb_cond.ambient_condition[0][7] ZFEH_EepromData.ydiBackupMemory_xau16[4].amb_cond.ambient_condition[0][8] ZFEH_EepromData.ydiBackupMemory_xau16[4].amb_cond.ambient_condition[0][9] ZFEH_EepromData.ydiBackupMemory_xau16[4].amb_cond.ambient_condition[1][0] ZFEH_EepromData.ydiBackupMemory_xau16[4].amb_cond.ambient_condition[1][10] ZFEH_EepromData.ydiBackupMemory_xau16[4].amb_cond.ambient_condition[1][11] ZFEH_EepromData.ydiBackupMemory_xau16[4].amb_cond.ambient_condition[1][12] ZFEH_EepromData.ydiBackupMemory_xau16[4].amb_cond.ambient_condition[1][13] ZFEH_EepromData.ydiBackupMemory_xau16[4].amb_cond.ambient_condition[1][14] ZFEH_EepromData.ydiBackupMemory_xau16[4].amb_cond.ambient_condition[1][15] ZFEH_EepromData.ydiBackupMemory_xau16[4].amb_cond.ambient_condition[1][16] ZFEH_EepromData.ydiBackupMemory_xau16[4].amb_cond.ambient_condition[1][17] ZFEH_EepromData.ydiBackupMemory_xau16[4].amb_cond.ambient_condition[1][18] ZFEH_EepromData.ydiBackupMemory_xau16[4].amb_cond.ambient_condition[1][19] ZFEH_EepromData.ydiBackupMemory_xau16[4].amb_cond.ambient_condition[1][1] ZFEH_EepromData.ydiBackupMemory_xau16[4].amb_cond.ambient_condition[1][20] ZFEH_EepromData.ydiBackupMemory_xau16[4].amb_cond.ambient_condition[1][21] ZFEH_EepromData.ydiBackupMemory_xau16[4].amb_cond.ambient_condition[1][22] ZFEH_EepromData.ydiBackupMemory_xau16[4].amb_cond.ambient_condition[1][23] ZFEH_EepromData.ydiBackupMemory_xau16[4].amb_cond.ambient_condition[1][24] ZFEH_EepromData.ydiBackupMemory_xau16[4].amb_cond.ambient_condition[1][2] ZFEH_EepromData.ydiBackupMemory_xau16[4].amb_cond.ambient_condition[1][3] ZFEH_EepromData.ydiBackupMemory_xau16[4].amb_cond.ambient_condition[1][4] ZFEH_EepromData.ydiBackupMemory_xau16[4].amb_cond.ambient_condition[1][5] ZFEH_EepromData.ydiBackupMemory_xau16[4].amb_cond.ambient_condition[1][6] ZFEH_EepromData.ydiBackupMemory_xau16[4].amb_cond.ambient_condition[1][7] ZFEH_EepromData.ydiBackupMemory_xau16[4].amb_cond.ambient_condition[1][8] ZFEH_EepromData.ydiBackupMemory_xau16[4].amb_cond.ambient_condition[1][9] ZFEH_EepromData.ydiBackupMemory_xau16[4].amb_cond.status_of_ambient_conditions[0] ZFEH_EepromData.ydiBackupMemory_xau16[4].amb_cond.status_of_ambient_conditions[1] ZFEH_EepromData.ydiBackupMemory_xau16[4].backwards_counter ZFEH_EepromData.ydiBackupMemory_xau16[4].condition_byte ZFEH_EepromData.ydiBackupMemory_xau16[4].error_code ZFEH_EepromData.ydiBackupMemory_xau16[4].error_type ZFEH_EepromData.ydiBackupMemory_xau16[4].frequency_counter ZFEH_EepromData.ydiBackupMemory_xau16[4].master_time ZFEH_EepromData.ydiBackupMemory_xau16[4].obd_driving_cycle_counter ZFEH_EepromData.ydiBackupMemory_xau16[4].permanent_counter ZFEH_EepromData.ydiBackupMemory_xau16[4].sequence_counter ZFEH_EepromData.ydiBackupMemory_xau16[4].status_word ZFEH_EepromData.ydiBackupMemory_xau16[5].amb_cond.ambient_condition[0][0] ZFEH_EepromData.ydiBackupMemory_xau16[5].amb_cond.ambient_condition[0][10] ZFEH_EepromData.ydiBackupMemory_xau16[5].amb_cond.ambient_condition[0][11] ZFEH_EepromData.ydiBackupMemory_xau16[5].amb_cond.ambient_condition[0][12] ZFEH_EepromData.ydiBackupMemory_xau16[5].amb_cond.ambient_condition[0][13] ZFEH_EepromData.ydiBackupMemory_xau16[5].amb_cond.ambient_condition[0][14] ZFEH_EepromData.ydiBackupMemory_xau16[5].amb_cond.ambient_condition[0][15] ZFEH_EepromData.ydiBackupMemory_xau16[5].amb_cond.ambient_condition[0][16] ZFEH_EepromData.ydiBackupMemory_xau16[5].amb_cond.ambient_condition[0][17] ZFEH_EepromData.ydiBackupMemory_xau16[5].amb_cond.ambient_condition[0][18] ZFEH_EepromData.ydiBackupMemory_xau16[5].amb_cond.ambient_condition[0][19] ZFEH_EepromData.ydiBackupMemory_xau16[5].amb_cond.ambient_condition[0][1] ZFEH_EepromData.ydiBackupMemory_xau16[5].amb_cond.ambient_condition[0][20] ZFEH_EepromData.ydiBackupMemory_xau16[5].amb_cond.ambient_condition[0][21] ZFEH_EepromData.ydiBackupMemory_xau16[5].amb_cond.ambient_condition[0][22] ZFEH_EepromData.ydiBackupMemory_xau16[5].amb_cond.ambient_condition[0][23] ZFEH_EepromData.ydiBackupMemory_xau16[5].amb_cond.ambient_condition[0][24] ZFEH_EepromData.ydiBackupMemory_xau16[5].amb_cond.ambient_condition[0][2] ZFEH_EepromData.ydiBackupMemory_xau16[5].amb_cond.ambient_condition[0][3] ZFEH_EepromData.ydiBackupMemory_xau16[5].amb_cond.ambient_condition[0][4] ZFEH_EepromData.ydiBackupMemory_xau16[5].amb_cond.ambient_condition[0][5] ZFEH_EepromData.ydiBackupMemory_xau16[5].amb_cond.ambient_condition[0][6] ZFEH_EepromData.ydiBackupMemory_xau16[5].amb_cond.ambient_condition[0][7] ZFEH_EepromData.ydiBackupMemory_xau16[5].amb_cond.ambient_condition[0][8] ZFEH_EepromData.ydiBackupMemory_xau16[5].amb_cond.ambient_condition[0][9] ZFEH_EepromData.ydiBackupMemory_xau16[5].amb_cond.ambient_condition[1][0] ZFEH_EepromData.ydiBackupMemory_xau16[5].amb_cond.ambient_condition[1][10] ZFEH_EepromData.ydiBackupMemory_xau16[5].amb_cond.ambient_condition[1][11] ZFEH_EepromData.ydiBackupMemory_xau16[5].amb_cond.ambient_condition[1][12] ZFEH_EepromData.ydiBackupMemory_xau16[5].amb_cond.ambient_condition[1][13] ZFEH_EepromData.ydiBackupMemory_xau16[5].amb_cond.ambient_condition[1][14] ZFEH_EepromData.ydiBackupMemory_xau16[5].amb_cond.ambient_condition[1][15] ZFEH_EepromData.ydiBackupMemory_xau16[5].amb_cond.ambient_condition[1][16] ZFEH_EepromData.ydiBackupMemory_xau16[5].amb_cond.ambient_condition[1][17] ZFEH_EepromData.ydiBackupMemory_xau16[5].amb_cond.ambient_condition[1][18] ZFEH_EepromData.ydiBackupMemory_xau16[5].amb_cond.ambient_condition[1][19] ZFEH_EepromData.ydiBackupMemory_xau16[5].amb_cond.ambient_condition[1][1] ZFEH_EepromData.ydiBackupMemory_xau16[5].amb_cond.ambient_condition[1][20] ZFEH_EepromData.ydiBackupMemory_xau16[5].amb_cond.ambient_condition[1][21] ZFEH_EepromData.ydiBackupMemory_xau16[5].amb_cond.ambient_condition[1][22] ZFEH_EepromData.ydiBackupMemory_xau16[5].amb_cond.ambient_condition[1][23] ZFEH_EepromData.ydiBackupMemory_xau16[5].amb_cond.ambient_condition[1][24] ZFEH_EepromData.ydiBackupMemory_xau16[5].amb_cond.ambient_condition[1][2] ZFEH_EepromData.ydiBackupMemory_xau16[5].amb_cond.ambient_condition[1][3] ZFEH_EepromData.ydiBackupMemory_xau16[5].amb_cond.ambient_condition[1][4] ZFEH_EepromData.ydiBackupMemory_xau16[5].amb_cond.ambient_condition[1][5] ZFEH_EepromData.ydiBackupMemory_xau16[5].amb_cond.ambient_condition[1][6] ZFEH_EepromData.ydiBackupMemory_xau16[5].amb_cond.ambient_condition[1][7] ZFEH_EepromData.ydiBackupMemory_xau16[5].amb_cond.ambient_condition[1][8] ZFEH_EepromData.ydiBackupMemory_xau16[5].amb_cond.ambient_condition[1][9] ZFEH_EepromData.ydiBackupMemory_xau16[5].amb_cond.status_of_ambient_conditions[0] ZFEH_EepromData.ydiBackupMemory_xau16[5].amb_cond.status_of_ambient_conditions[1] ZFEH_EepromData.ydiBackupMemory_xau16[5].backwards_counter ZFEH_EepromData.ydiBackupMemory_xau16[5].condition_byte ZFEH_EepromData.ydiBackupMemory_xau16[5].error_code ZFEH_EepromData.ydiBackupMemory_xau16[5].error_type ZFEH_EepromData.ydiBackupMemory_xau16[5].frequency_counter ZFEH_EepromData.ydiBackupMemory_xau16[5].master_time ZFEH_EepromData.ydiBackupMemory_xau16[5].obd_driving_cycle_counter ZFEH_EepromData.ydiBackupMemory_xau16[5].permanent_counter ZFEH_EepromData.ydiBackupMemory_xau16[5].sequence_counter ZFEH_EepromData.ydiBackupMemory_xau16[5].status_word ZFEH_EepromData.ydiBackupMemory_xau16[6].amb_cond.ambient_condition[0][0] ZFEH_EepromData.ydiBackupMemory_xau16[6].amb_cond.ambient_condition[0][10] ZFEH_EepromData.ydiBackupMemory_xau16[6].amb_cond.ambient_condition[0][11] ZFEH_EepromData.ydiBackupMemory_xau16[6].amb_cond.ambient_condition[0][12] ZFEH_EepromData.ydiBackupMemory_xau16[6].amb_cond.ambient_condition[0][13] ZFEH_EepromData.ydiBackupMemory_xau16[6].amb_cond.ambient_condition[0][14] ZFEH_EepromData.ydiBackupMemory_xau16[6].amb_cond.ambient_condition[0][15] ZFEH_EepromData.ydiBackupMemory_xau16[6].amb_cond.ambient_condition[0][16] ZFEH_EepromData.ydiBackupMemory_xau16[6].amb_cond.ambient_condition[0][17] ZFEH_EepromData.ydiBackupMemory_xau16[6].amb_cond.ambient_condition[0][18] ZFEH_EepromData.ydiBackupMemory_xau16[6].amb_cond.ambient_condition[0][19] ZFEH_EepromData.ydiBackupMemory_xau16[6].amb_cond.ambient_condition[0][1] ZFEH_EepromData.ydiBackupMemory_xau16[6].amb_cond.ambient_condition[0][20] ZFEH_EepromData.ydiBackupMemory_xau16[6].amb_cond.ambient_condition[0][21] ZFEH_EepromData.ydiBackupMemory_xau16[6].amb_cond.ambient_condition[0][22] ZFEH_EepromData.ydiBackupMemory_xau16[6].amb_cond.ambient_condition[0][23] ZFEH_EepromData.ydiBackupMemory_xau16[6].amb_cond.ambient_condition[0][24] ZFEH_EepromData.ydiBackupMemory_xau16[6].amb_cond.ambient_condition[0][2] ZFEH_EepromData.ydiBackupMemory_xau16[6].amb_cond.ambient_condition[0][3] ZFEH_EepromData.ydiBackupMemory_xau16[6].amb_cond.ambient_condition[0][4] ZFEH_EepromData.ydiBackupMemory_xau16[6].amb_cond.ambient_condition[0][5] ZFEH_EepromData.ydiBackupMemory_xau16[6].amb_cond.ambient_condition[0][6] ZFEH_EepromData.ydiBackupMemory_xau16[6].amb_cond.ambient_condition[0][7] ZFEH_EepromData.ydiBackupMemory_xau16[6].amb_cond.ambient_condition[0][8] ZFEH_EepromData.ydiBackupMemory_xau16[6].amb_cond.ambient_condition[0][9] ZFEH_EepromData.ydiBackupMemory_xau16[6].amb_cond.ambient_condition[1][0] ZFEH_EepromData.ydiBackupMemory_xau16[6].amb_cond.ambient_condition[1][10] ZFEH_EepromData.ydiBackupMemory_xau16[6].amb_cond.ambient_condition[1][11] ZFEH_EepromData.ydiBackupMemory_xau16[6].amb_cond.ambient_condition[1][12] ZFEH_EepromData.ydiBackupMemory_xau16[6].amb_cond.ambient_condition[1][13] ZFEH_EepromData.ydiBackupMemory_xau16[6].amb_cond.ambient_condition[1][14] ZFEH_EepromData.ydiBackupMemory_xau16[6].amb_cond.ambient_condition[1][15] ZFEH_EepromData.ydiBackupMemory_xau16[6].amb_cond.ambient_condition[1][16] ZFEH_EepromData.ydiBackupMemory_xau16[6].amb_cond.ambient_condition[1][17] ZFEH_EepromData.ydiBackupMemory_xau16[6].amb_cond.ambient_condition[1][18] ZFEH_EepromData.ydiBackupMemory_xau16[6].amb_cond.ambient_condition[1][19] ZFEH_EepromData.ydiBackupMemory_xau16[6].amb_cond.ambient_condition[1][1] ZFEH_EepromData.ydiBackupMemory_xau16[6].amb_cond.ambient_condition[1][20] ZFEH_EepromData.ydiBackupMemory_xau16[6].amb_cond.ambient_condition[1][21] ZFEH_EepromData.ydiBackupMemory_xau16[6].amb_cond.ambient_condition[1][22] ZFEH_EepromData.ydiBackupMemory_xau16[6].amb_cond.ambient_condition[1][23] ZFEH_EepromData.ydiBackupMemory_xau16[6].amb_cond.ambient_condition[1][24] ZFEH_EepromData.ydiBackupMemory_xau16[6].amb_cond.ambient_condition[1][2] ZFEH_EepromData.ydiBackupMemory_xau16[6].amb_cond.ambient_condition[1][3] ZFEH_EepromData.ydiBackupMemory_xau16[6].amb_cond.ambient_condition[1][4] ZFEH_EepromData.ydiBackupMemory_xau16[6].amb_cond.ambient_condition[1][5] ZFEH_EepromData.ydiBackupMemory_xau16[6].amb_cond.ambient_condition[1][6] ZFEH_EepromData.ydiBackupMemory_xau16[6].amb_cond.ambient_condition[1][7] /end LOC_MEASUREMENT
/end FUNCTION
/begin RECORD_LAYOUT ZF_UINT8_COL_DIRECT_S4_S3 FNC_VALUES 1 UBYTE COLUMN_DIR DIRECT /end RECORD_LAYOUT
/begin RECORD_LAYOUT ZF_INT16_COL_DIRECT_S4_S3 FNC_VALUES 1 SWORD COLUMN_DIR DIRECT /end RECORD_LAYOUT
/begin RECORD_LAYOUT ZF_UINT16_COL_DIRECT_S4_S3 FNC_VALUES 1 UWORD COLUMN_DIR DIRECT /end RECORD_LAYOUT
/begin RECORD_LAYOUT ZF_UINT8_X_INCR_DIRECT_S4_S3 AXIS_PTS_X 1 UBYTE INDEX_INCR DIRECT /end RECORD_LAYOUT
/begin RECORD_LAYOUT ZF_BOOL_COL_DIRECT_S4_S3 FNC_VALUES 1 UBYTE COLUMN_DIR DIRECT /end RECORD_LAYOUT
/begin RECORD_LAYOUT ZF_INT16_X_INCR_DIRECT_S4_S3 AXIS_PTS_X 1 SWORD INDEX_INCR DIRECT /end RECORD_LAYOUT
/end MODULE
/end PROJECT
