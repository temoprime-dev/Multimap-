ASAP2_VERSION 1 51
/begin PROJECT _929_929 "Gen2_BMW_System_Supplier_Lib"
/begin HEADER "" VERSION "C_03_03" PROJECT_NO _929_929 /end HEADER
/begin MODULE DIM ""
/begin MOD_COMMON "" BYTE_ORDER MSB_FIRST ALIGNMENT_BYTE 1 ALIGNMENT_WORD 2 ALIGNMENT_LONG 4 ALIGNMENT_FLOAT32_IEEE 4 /end MOD_COMMON
/begin CHARACTERISTIC SA421 "" CURVE 0x277DE4 _REC_A1CUR_1_u2_u2_S2 15000 _CNV_R_R_Umr_1_zu_1_3_CM_S2 0 15000 FORMAT "%2.0"
 /begin AXIS_DESCR COM_AXIS W_DKKD _CNV_R_R_Umr_10_zu__9_CM_S2 17 0 120 AXIS_PTS_REF SSTSKL_RS_SA4 FORMAT "%3.1" /end AXIS_DESCR
/end CHARACTERISTIC
/begin CHARACTERISTIC SA423 "" CURVE 0x277E06 _REC_A1CUR_1_u2_u2_S2 15000 _CNV_R_R_Umr_1_zu_1_3_CM_S2 0 15000 FORMAT "%2.0"
 /begin AXIS_DESCR COM_AXIS W_DKKD _CNV_R_R_Umr_10_zu__9_CM_S2 13 0 120 AXIS_PTS_REF SSTSKL_HS_SA4 FORMAT "%3.1" /end AXIS_DESCR
/end CHARACTERISTIC
/begin CHARACTERISTIC SA432 "" CURVE 0x277E20 _REC_A1CUR_1_u2_u2_S2 15000 _CNV_R_R_Umr_1_zu_1_3_CM_S2 0 15000 FORMAT "%2.0"
 /begin AXIS_DESCR COM_AXIS W_DKKD _CNV_R_R_Umr_10_zu__9_CM_S2 17 0 120 AXIS_PTS_REF SSTSKL_RS_SA4 FORMAT "%3.1" /end AXIS_DESCR
/end CHARACTERISTIC
/begin CHARACTERISTIC SA434 "" CURVE 0x277E42 _REC_A1CUR_1_u2_u2_S2 15000 _CNV_R_R_Umr_1_zu_1_3_CM_S2 0 15000 FORMAT "%2.0"
 /begin AXIS_DESCR COM_AXIS W_DKKD _CNV_R_R_Umr_10_zu__9_CM_S2 13 0 120 AXIS_PTS_REF SSTSKL_HS_SA4 FORMAT "%3.1" /end AXIS_DESCR
/end CHARACTERISTIC
/begin CHARACTERISTIC SA443 "" CURVE 0x277E5C _REC_A1CUR_1_u2_u2_S2 15000 _CNV_R_R_Umr_1_zu_1_3_CM_S2 0 15000 FORMAT "%2.0"
 /begin AXIS_DESCR COM_AXIS W_DKKD _CNV_R_R_Umr_10_zu__9_CM_S2 17 0 120 AXIS_PTS_REF SSTSKL_RS_SA4 FORMAT "%3.1" /end AXIS_DESCR
/end CHARACTERISTIC
/begin CHARACTERISTIC SA445 "" CURVE 0x277E7E _REC_A1CUR_1_u2_u2_S2 15000 _CNV_R_R_Umr_1_zu_1_3_CM_S2 0 15000 FORMAT "%2.0"
 /begin AXIS_DESCR COM_AXIS W_DKKD _CNV_R_R_Umr_10_zu__9_CM_S2 13 0 120 AXIS_PTS_REF SSTSKL_HS_SA4 FORMAT "%3.1" /end AXIS_DESCR
/end CHARACTERISTIC
/begin CHARACTERISTIC SA454 "" CURVE 0x277E98 _REC_A1CUR_1_u2_u2_S2 15000 _CNV_R_R_Umr_1_zu_1_3_CM_S2 0 15000 FORMAT "%2.0"
 /begin AXIS_DESCR COM_AXIS W_DKKD _CNV_R_R_Umr_10_zu__9_CM_S2 17 0 120 AXIS_PTS_REF SSTSKL_RS_SA4 FORMAT "%3.1" /end AXIS_DESCR
/end CHARACTERISTIC
/begin CHARACTERISTIC SA456 "" CURVE 0x277EBA _REC_A1CUR_1_u2_u2_S2 15000 _CNV_R_R_Umr_1_zu_1_3_CM_S2 0 15000 FORMAT "%2.0"
 /begin AXIS_DESCR COM_AXIS W_DKKD _CNV_R_R_Umr_10_zu__9_CM_S2 13 0 120 AXIS_PTS_REF SSTSKL_HS_SA4 FORMAT "%3.1" /end AXIS_DESCR
/end CHARACTERISTIC
/begin CHARACTERISTIC SA465 "" CURVE 0x277ED4 _REC_A1CUR_1_u2_u2_S2 15000 _CNV_R_R_Umr_1_zu_1_3_CM_S2 0 15000 FORMAT "%2.0"
 /begin AXIS_DESCR COM_AXIS W_DKKD _CNV_R_R_Umr_10_zu__9_CM_S2 17 0 120 AXIS_PTS_REF SSTSKL_RS_SA4 FORMAT "%3.1" /end AXIS_DESCR
/end CHARACTERISTIC
/begin CHARACTERISTIC SA467 "" CURVE 0x278946 _REC_A1CUR_1_u2_u2_S2 15000 _CNV_R_R_Umr_1_zu_1_3_CM_S2 0 15000 FORMAT "%2.0"
 /begin AXIS_DESCR COM_AXIS W_DKKD _CNV_R_R_Umr_10_zu__9_CM_S2 13 0 120 AXIS_PTS_REF SSTSKL_HS_SA4 FORMAT "%3.1" /end AXIS_DESCR
/end CHARACTERISTIC
/begin CHARACTERISTIC SA476 "" CURVE 0x278960 _REC_A1CUR_1_u2_u2_S2 15000 _CNV_R_R_Umr_1_zu_1_3_CM_S2 0 15000 FORMAT "%2.0"
 /begin AXIS_DESCR COM_AXIS W_DKKD _CNV_R_R_Umr_10_zu__9_CM_S2 17 0 120 AXIS_PTS_REF SSTSKL_RS_SA4 FORMAT "%3.1" /end AXIS_DESCR
/end CHARACTERISTIC
/begin CHARACTERISTIC SA478 "" CURVE 0x278E32 _REC_A1CUR_1_u2_u2_S2 15000 _CNV_R_R_Umr_1_zu_1_3_CM_S2 0 15000 FORMAT "%2.0"
 /begin AXIS_DESCR COM_AXIS W_DKKD _CNV_R_R_Umr_10_zu__9_CM_S2 13 0 120 AXIS_PTS_REF SSTSKL_HS_SA4 FORMAT "%3.1" /end AXIS_DESCR
/end CHARACTERISTIC
/begin CHARACTERISTIC SA487 "" CURVE 0x278E4C _REC_A1CUR_1_u2_u2_S2 15000 _CNV_R_R_Umr_1_zu_1_3_CM_S2 0 15000 FORMAT "%2.0"
 /begin AXIS_DESCR COM_AXIS W_DKKD _CNV_R_R_Umr_10_zu__9_CM_S2 17 0 120 AXIS_PTS_REF SSTSKL_RS_SA4 FORMAT "%3.1" /end AXIS_DESCR
/end CHARACTERISTIC
/begin CHARACTERISTIC SO112 "" CURVE 0x277EF6 _REC_A1CUR_1_u2_u2_S2 15000 _CNV_R_R_Umr_1_zu_1_3_CM_S2 0 15000 FORMAT "%2.0"
 /begin AXIS_DESCR COM_AXIS W_DKKD _CNV_R_R_Umr_10_zu__9_CM_S2 13 0 120 AXIS_PTS_REF SSTSKL_HS_SO1 FORMAT "%3.1" /end AXIS_DESCR
/end CHARACTERISTIC
/begin CHARACTERISTIC SO121 "" CURVE 0x277F10 _REC_A1CUR_1_u2_u2_S2 15000 _CNV_R_R_Umr_1_zu_1_3_CM_S2 0 15000 FORMAT "%2.0"
 /begin AXIS_DESCR COM_AXIS W_DKKD _CNV_R_R_Umr_10_zu__9_CM_S2 17 0 120 AXIS_PTS_REF SSTSKL_RS_SO1 FORMAT "%3.1" /end AXIS_DESCR
/end CHARACTERISTIC
/begin CHARACTERISTIC SO123 "" CURVE 0x277F32 _REC_A1CUR_1_u2_u2_S2 15000 _CNV_R_R_Umr_1_zu_1_3_CM_S2 0 15000 FORMAT "%2.0"
 /begin AXIS_DESCR COM_AXIS W_DKKD _CNV_R_R_Umr_10_zu__9_CM_S2 13 0 120 AXIS_PTS_REF SSTSKL_HS_SO1 FORMAT "%3.1" /end AXIS_DESCR
/end CHARACTERISTIC
/begin CHARACTERISTIC SO132 "" CURVE 0x277F4C _REC_A1CUR_1_u2_u2_S2 15000 _CNV_R_R_Umr_1_zu_1_3_CM_S2 0 15000 FORMAT "%2.0"
 /begin AXIS_DESCR COM_AXIS W_DKKD _CNV_R_R_Umr_10_zu__9_CM_S2 17 0 120 AXIS_PTS_REF SSTSKL_RS_SO1 FORMAT "%3.1" /end AXIS_DESCR
/end CHARACTERISTIC
/begin CHARACTERISTIC SO134 "" CURVE 0x277F6E _REC_A1CUR_1_u2_u2_S2 15000 _CNV_R_R_Umr_1_zu_1_3_CM_S2 0 15000 FORMAT "%2.0"
 /begin AXIS_DESCR COM_AXIS W_DKKD _CNV_R_R_Umr_10_zu__9_CM_S2 13 0 120 AXIS_PTS_REF SSTSKL_HS_SO1 FORMAT "%3.1" /end AXIS_DESCR
/end CHARACTERISTIC
/begin CHARACTERISTIC SO143 "" CURVE 0x277F88 _REC_A1CUR_1_u2_u2_S2 15000 _CNV_R_R_Umr_1_zu_1_3_CM_S2 0 15000 FORMAT "%2.0"
 /begin AXIS_DESCR COM_AXIS W_DKKD _CNV_R_R_Umr_10_zu__9_CM_S2 17 0 120 AXIS_PTS_REF SSTSKL_RS_SO1 FORMAT "%3.1" /end AXIS_DESCR
/end CHARACTERISTIC
/begin CHARACTERISTIC SO145 "" CURVE 0x277FAA _REC_A1CUR_1_u2_u2_S2 15000 _CNV_R_R_Umr_1_zu_1_3_CM_S2 0 15000 FORMAT "%2.0"
 /begin AXIS_DESCR COM_AXIS W_DKKD _CNV_R_R_Umr_10_zu__9_CM_S2 13 0 120 AXIS_PTS_REF SSTSKL_HS_SO1 FORMAT "%3.1" /end AXIS_DESCR
/end CHARACTERISTIC
/begin CHARACTERISTIC SO154 "" CURVE 0x277FC4 _REC_A1CUR_1_u2_u2_S2 15000 _CNV_R_R_Umr_1_zu_1_3_CM_S2 0 15000 FORMAT "%2.0"
 /begin AXIS_DESCR COM_AXIS W_DKKD _CNV_R_R_Umr_10_zu__9_CM_S2 17 0 120 AXIS_PTS_REF SSTSKL_RS_SO1 FORMAT "%3.1" /end AXIS_DESCR
/end CHARACTERISTIC
/begin CHARACTERISTIC SO156 "" CURVE 0x277FE6 _REC_A1CUR_1_u2_u2_S2 15000 _CNV_R_R_Umr_1_zu_1_3_CM_S2 0 15000 FORMAT "%2.0"
 /begin AXIS_DESCR COM_AXIS W_DKKD _CNV_R_R_Umr_10_zu__9_CM_S2 13 0 120 AXIS_PTS_REF SSTSKL_HS_SO1 FORMAT "%3.1" /end AXIS_DESCR
/end CHARACTERISTIC
/begin CHARACTERISTIC SO165 "" CURVE 0x278000 _REC_A1CUR_1_u2_u2_S2 15000 _CNV_R_R_Umr_1_zu_1_3_CM_S2 0 15000 FORMAT "%2.0"
 /begin AXIS_DESCR COM_AXIS W_DKKD _CNV_R_R_Umr_10_zu__9_CM_S2 17 0 120 AXIS_PTS_REF SSTSKL_RS_SO1 FORMAT "%3.1" /end AXIS_DESCR
/end CHARACTERISTIC
/begin CHARACTERISTIC SO167 "" CURVE 0x278982 _REC_A1CUR_1_u2_u2_S2 15000 _CNV_R_R_Umr_1_zu_1_3_CM_S2 0 15000 FORMAT "%2.0"
 /begin AXIS_DESCR COM_AXIS W_DKKD _CNV_R_R_Umr_10_zu__9_CM_S2 13 0 120 AXIS_PTS_REF SSTSKL_HS_SO1 FORMAT "%3.1" /end AXIS_DESCR
/end CHARACTERISTIC
/begin CHARACTERISTIC SO176 "" CURVE 0x27899C _REC_A1CUR_1_u2_u2_S2 15000 _CNV_R_R_Umr_1_zu_1_3_CM_S2 0 15000 FORMAT "%2.0"
 /begin AXIS_DESCR COM_AXIS W_DKKD _CNV_R_R_Umr_10_zu__9_CM_S2 17 0 120 AXIS_PTS_REF SSTSKL_RS_SO1 FORMAT "%3.1" /end AXIS_DESCR
/end CHARACTERISTIC
/begin CHARACTERISTIC SO178 "" CURVE 0x278E6E _REC_A1CUR_1_u2_u2_S2 15000 _CNV_R_R_Umr_1_zu_1_3_CM_S2 0 15000 FORMAT "%2.0"
 /begin AXIS_DESCR COM_AXIS W_DKKD _CNV_R_R_Umr_10_zu__9_CM_S2 13 0 120 AXIS_PTS_REF SSTSKL_HS_SO1 FORMAT "%3.1" /end AXIS_DESCR
/end CHARACTERISTIC
/begin CHARACTERISTIC SO187 "" CURVE 0x278E88 _REC_A1CUR_1_u2_u2_S2 15000 _CNV_R_R_Umr_1_zu_1_3_CM_S2 0 15000 FORMAT "%2.0"
 /begin AXIS_DESCR COM_AXIS W_DKKD _CNV_R_R_Umr_10_zu__9_CM_S2 17 0 120 AXIS_PTS_REF SSTSKL_RS_SO1 FORMAT "%3.1" /end AXIS_DESCR
/end CHARACTERISTIC
/begin CHARACTERISTIC SO212 "" CURVE 0x278022 _REC_A1CUR_1_u2_u2_S2 15000 _CNV_R_R_Umr_1_zu_1_3_CM_S2 0 15000 FORMAT "%2.0"
 /begin AXIS_DESCR COM_AXIS W_DKKD _CNV_R_R_Umr_10_zu__9_CM_S2 13 0 120 AXIS_PTS_REF SSTSKL_HS_SO2 FORMAT "%3.1" /end AXIS_DESCR
/end CHARACTERISTIC
/begin CHARACTERISTIC SO221 "" CURVE 0x27803C _REC_A1CUR_1_u2_u2_S2 15000 _CNV_R_R_Umr_1_zu_1_3_CM_S2 0 15000 FORMAT "%2.0"
 /begin AXIS_DESCR COM_AXIS W_DKKD _CNV_R_R_Umr_10_zu__9_CM_S2 17 0 120 AXIS_PTS_REF SSTSKL_RS_SO2 FORMAT "%3.1" /end AXIS_DESCR
/end CHARACTERISTIC
/begin CHARACTERISTIC SO223 "" CURVE 0x27805E _REC_A1CUR_1_u2_u2_S2 15000 _CNV_R_R_Umr_1_zu_1_3_CM_S2 0 15000 FORMAT "%2.0"
 /begin AXIS_DESCR COM_AXIS W_DKKD _CNV_R_R_Umr_10_zu__9_CM_S2 13 0 120 AXIS_PTS_REF SSTSKL_HS_SO2 FORMAT "%3.1" /end AXIS_DESCR
/end CHARACTERISTIC
/begin CHARACTERISTIC SO232 "" CURVE 0x278078 _REC_A1CUR_1_u2_u2_S2 15000 _CNV_R_R_Umr_1_zu_1_3_CM_S2 0 15000 FORMAT "%2.0"
 /begin AXIS_DESCR COM_AXIS W_DKKD _CNV_R_R_Umr_10_zu__9_CM_S2 17 0 120 AXIS_PTS_REF SSTSKL_RS_SO2 FORMAT "%3.1" /end AXIS_DESCR
/end CHARACTERISTIC
/begin CHARACTERISTIC SO234 "" CURVE 0x27809A _REC_A1CUR_1_u2_u2_S2 15000 _CNV_R_R_Umr_1_zu_1_3_CM_S2 0 15000 FORMAT "%2.0"
 /begin AXIS_DESCR COM_AXIS W_DKKD _CNV_R_R_Umr_10_zu__9_CM_S2 13 0 120 AXIS_PTS_REF SSTSKL_HS_SO2 FORMAT "%3.1" /end AXIS_DESCR
/end CHARACTERISTIC
/begin CHARACTERISTIC SO243 "" CURVE 0x2780B4 _REC_A1CUR_1_u2_u2_S2 15000 _CNV_R_R_Umr_1_zu_1_3_CM_S2 0 15000 FORMAT "%2.0"
 /begin AXIS_DESCR COM_AXIS W_DKKD _CNV_R_R_Umr_10_zu__9_CM_S2 17 0 120 AXIS_PTS_REF SSTSKL_RS_SO2 FORMAT "%3.1" /end AXIS_DESCR
/end CHARACTERISTIC
/begin CHARACTERISTIC SO245 "" CURVE 0x2780D6 _REC_A1CUR_1_u2_u2_S2 15000 _CNV_R_R_Umr_1_zu_1_3_CM_S2 0 15000 FORMAT "%2.0"
 /begin AXIS_DESCR COM_AXIS W_DKKD _CNV_R_R_Umr_10_zu__9_CM_S2 13 0 120 AXIS_PTS_REF SSTSKL_HS_SO2 FORMAT "%3.1" /end AXIS_DESCR
/end CHARACTERISTIC
/begin CHARACTERISTIC SO254 "" CURVE 0x2780F0 _REC_A1CUR_1_u2_u2_S2 15000 _CNV_R_R_Umr_1_zu_1_3_CM_S2 0 15000 FORMAT "%2.0"
 /begin AXIS_DESCR COM_AXIS W_DKKD _CNV_R_R_Umr_10_zu__9_CM_S2 17 0 120 AXIS_PTS_REF SSTSKL_RS_SO2 FORMAT "%3.1" /end AXIS_DESCR
/end CHARACTERISTIC
/begin CHARACTERISTIC SO256 "" CURVE 0x278112 _REC_A1CUR_1_u2_u2_S2 15000 _CNV_R_R_Umr_1_zu_1_3_CM_S2 0 15000 FORMAT "%2.0"
 /begin AXIS_DESCR COM_AXIS W_DKKD _CNV_R_R_Umr_10_zu__9_CM_S2 13 0 120 AXIS_PTS_REF SSTSKL_HS_SO2 FORMAT "%3.1" /end AXIS_DESCR
/end CHARACTERISTIC
/begin CHARACTERISTIC SO265 "" CURVE 0x27812C _REC_A1CUR_1_u2_u2_S2 15000 _CNV_R_R_Umr_1_zu_1_3_CM_S2 0 15000 FORMAT "%2.0"
 /begin AXIS_DESCR COM_AXIS W_DKKD _CNV_R_R_Umr_10_zu__9_CM_S2 17 0 120 AXIS_PTS_REF SSTSKL_RS_SO2 FORMAT "%3.1" /end AXIS_DESCR
/end CHARACTERISTIC
/begin CHARACTERISTIC SO267 "" CURVE 0x2789BE _REC_A1CUR_1_u2_u2_S2 15000 _CNV_R_R_Umr_1_zu_1_3_CM_S2 0 15000 FORMAT "%2.0"
 /begin AXIS_DESCR COM_AXIS W_DKKD _CNV_R_R_Umr_10_zu__9_CM_S2 13 0 120 AXIS_PTS_REF SSTSKL_HS_SO2 FORMAT "%3.1" /end AXIS_DESCR
/end CHARACTERISTIC
/begin CHARACTERISTIC SO276 "" CURVE 0x2789D8 _REC_A1CUR_1_u2_u2_S2 15000 _CNV_R_R_Umr_1_zu_1_3_CM_S2 0 15000 FORMAT "%2.0"
 /begin AXIS_DESCR COM_AXIS W_DKKD _CNV_R_R_Umr_10_zu__9_CM_S2 17 0 120 AXIS_PTS_REF SSTSKL_RS_SO2 FORMAT "%3.1" /end AXIS_DESCR
/end CHARACTERISTIC
/begin CHARACTERISTIC SO278 "" CURVE 0x278EAA _REC_A1CUR_1_u2_u2_S2 15000 _CNV_R_R_Umr_1_zu_1_3_CM_S2 0 15000 FORMAT "%2.0"
 /begin AXIS_DESCR COM_AXIS W_DKKD _CNV_R_R_Umr_10_zu__9_CM_S2 13 0 120 AXIS_PTS_REF SSTSKL_HS_SO2 FORMAT "%3.1" /end AXIS_DESCR
/end CHARACTERISTIC
/begin CHARACTERISTIC SO287 "" CURVE 0x278EC4 _REC_A1CUR_1_u2_u2_S2 15000 _CNV_R_R_Umr_1_zu_1_3_CM_S2 0 15000 FORMAT "%2.0"
 /begin AXIS_DESCR COM_AXIS W_DKKD _CNV_R_R_Umr_10_zu__9_CM_S2 17 0 120 AXIS_PTS_REF SSTSKL_RS_SO2 FORMAT "%3.1" /end AXIS_DESCR
/end CHARACTERISTIC
/begin CHARACTERISTIC WL112 "" CURVE 0x27814E _REC_A1CUR_1_u2_u2_S2 15000 _CNV_R_R_Umr_1_zu_1_3_CM_S2 0 15000 FORMAT "%2.0"
 /begin AXIS_DESCR COM_AXIS W_DKKD _CNV_R_R_Umr_10_zu__9_CM_S2 13 0 120 AXIS_PTS_REF SSTSKL_HS_WL1 FORMAT "%3.1" /end AXIS_DESCR
/end CHARACTERISTIC
/begin CHARACTERISTIC WL121 "" CURVE 0x278168 _REC_A1CUR_1_u2_u2_S2 15000 _CNV_R_R_Umr_1_zu_1_3_CM_S2 0 15000 FORMAT "%2.0"
 /begin AXIS_DESCR COM_AXIS W_DKKD _CNV_R_R_Umr_10_zu__9_CM_S2 17 0 120 AXIS_PTS_REF SSTSKL_RS_WL1 FORMAT "%3.1" /end AXIS_DESCR
/end CHARACTERISTIC
/begin CHARACTERISTIC WL123 "" CURVE 0x27818A _REC_A1CUR_1_u2_u2_S2 15000 _CNV_R_R_Umr_1_zu_1_3_CM_S2 0 15000 FORMAT "%2.0"
 /begin AXIS_DESCR COM_AXIS W_DKKD _CNV_R_R_Umr_10_zu__9_CM_S2 13 0 120 AXIS_PTS_REF SSTSKL_HS_WL1 FORMAT "%3.1" /end AXIS_DESCR
/end CHARACTERISTIC
/begin CHARACTERISTIC WL132 "" CURVE 0x2781A4 _REC_A1CUR_1_u2_u2_S2 15000 _CNV_R_R_Umr_1_zu_1_3_CM_S2 0 15000 FORMAT "%2.0"
 /begin AXIS_DESCR COM_AXIS W_DKKD _CNV_R_R_Umr_10_zu__9_CM_S2 17 0 120 AXIS_PTS_REF SSTSKL_RS_WL1 FORMAT "%3.1" /end AXIS_DESCR
/end CHARACTERISTIC
/begin CHARACTERISTIC WL134 "" CURVE 0x2781C6 _REC_A1CUR_1_u2_u2_S2 15000 _CNV_R_R_Umr_1_zu_1_3_CM_S2 0 15000 FORMAT "%2.0"
 /begin AXIS_DESCR COM_AXIS W_DKKD _CNV_R_R_Umr_10_zu__9_CM_S2 13 0 120 AXIS_PTS_REF SSTSKL_HS_WL1 FORMAT "%3.1" /end AXIS_DESCR
/end CHARACTERISTIC
/begin CHARACTERISTIC WL143 "" CURVE 0x2781E0 _REC_A1CUR_1_u2_u2_S2 15000 _CNV_R_R_Umr_1_zu_1_3_CM_S2 0 15000 FORMAT "%2.0"
 /begin AXIS_DESCR COM_AXIS W_DKKD _CNV_R_R_Umr_10_zu__9_CM_S2 17 0 120 AXIS_PTS_REF SSTSKL_RS_WL1 FORMAT "%3.1" /end AXIS_DESCR
/end CHARACTERISTIC
/begin CHARACTERISTIC WL145 "" CURVE 0x278202 _REC_A1CUR_1_u2_u2_S2 15000 _CNV_R_R_Umr_1_zu_1_3_CM_S2 0 15000 FORMAT "%2.0"
 /begin AXIS_DESCR COM_AXIS W_DKKD _CNV_R_R_Umr_10_zu__9_CM_S2 13 0 120 AXIS_PTS_REF SSTSKL_HS_WL1 FORMAT "%3.1" /end AXIS_DESCR
/end CHARACTERISTIC
/begin CHARACTERISTIC WL154 "" CURVE 0x27821C _REC_A1CUR_1_u2_u2_S2 15000 _CNV_R_R_Umr_1_zu_1_3_CM_S2 0 15000 FORMAT "%2.0"
 /begin AXIS_DESCR COM_AXIS W_DKKD _CNV_R_R_Umr_10_zu__9_CM_S2 17 0 120 AXIS_PTS_REF SSTSKL_RS_WL1 FORMAT "%3.1" /end AXIS_DESCR
/end CHARACTERISTIC
/begin CHARACTERISTIC WL156 "" CURVE 0x27823E _REC_A1CUR_1_u2_u2_S2 15000 _CNV_R_R_Umr_1_zu_1_3_CM_S2 0 15000 FORMAT "%2.0"
 /begin AXIS_DESCR COM_AXIS W_DKKD _CNV_R_R_Umr_10_zu__9_CM_S2 13 0 120 AXIS_PTS_REF SSTSKL_HS_WL1 FORMAT "%3.1" /end AXIS_DESCR
/end CHARACTERISTIC
/begin CHARACTERISTIC WL165 "" CURVE 0x278258 _REC_A1CUR_1_u2_u2_S2 15000 _CNV_R_R_Umr_1_zu_1_3_CM_S2 0 15000 FORMAT "%2.0"
 /begin AXIS_DESCR COM_AXIS W_DKKD _CNV_R_R_Umr_10_zu__9_CM_S2 17 0 120 AXIS_PTS_REF SSTSKL_RS_WL1 FORMAT "%3.1" /end AXIS_DESCR
/end CHARACTERISTIC
/begin CHARACTERISTIC WL167 "" CURVE 0x2789FA _REC_A1CUR_1_u2_u2_S2 15000 _CNV_R_R_Umr_1_zu_1_3_CM_S2 0 15000 FORMAT "%2.0"
 /begin AXIS_DESCR COM_AXIS W_DKKD _CNV_R_R_Umr_10_zu__9_CM_S2 13 0 120 AXIS_PTS_REF SSTSKL_HS_WL1 FORMAT "%3.1" /end AXIS_DESCR
/end CHARACTERISTIC
/begin CHARACTERISTIC WL176 "" CURVE 0x278A14 _REC_A1CUR_1_u2_u2_S2 15000 _CNV_R_R_Umr_1_zu_1_3_CM_S2 0 15000 FORMAT "%2.0"
 /begin AXIS_DESCR COM_AXIS W_DKKD _CNV_R_R_Umr_10_zu__9_CM_S2 17 0 120 AXIS_PTS_REF SSTSKL_RS_WL1 FORMAT "%3.1" /end AXIS_DESCR
/end CHARACTERISTIC
/begin CHARACTERISTIC WL178 "" CURVE 0x278EE6 _REC_A1CUR_1_u2_u2_S2 15000 _CNV_R_R_Umr_1_zu_1_3_CM_S2 0 15000 FORMAT "%2.0"
 /begin AXIS_DESCR COM_AXIS W_DKKD _CNV_R_R_Umr_10_zu__9_CM_S2 13 0 120 AXIS_PTS_REF SSTSKL_HS_WL1 FORMAT "%3.1" /end AXIS_DESCR
/end CHARACTERISTIC
/begin CHARACTERISTIC WL187 "" CURVE 0x278F00 _REC_A1CUR_1_u2_u2_S2 15000 _CNV_R_R_Umr_1_zu_1_3_CM_S2 0 15000 FORMAT "%2.0"
 /begin AXIS_DESCR COM_AXIS W_DKKD _CNV_R_R_Umr_10_zu__9_CM_S2 17 0 120 AXIS_PTS_REF SSTSKL_RS_WL1 FORMAT "%3.1" /end AXIS_DESCR
/end CHARACTERISTIC
/begin CHARACTERISTIC WL212 "" CURVE 0x27827A _REC_A1CUR_1_u2_u2_S2 15000 _CNV_R_R_Umr_1_zu_1_3_CM_S2 0 15000 FORMAT "%2.0"
 /begin AXIS_DESCR COM_AXIS W_DKKD _CNV_R_R_Umr_10_zu__9_CM_S2 13 0 120 AXIS_PTS_REF SSTSKL_HS_WL2 FORMAT "%3.1" /end AXIS_DESCR
/end CHARACTERISTIC
/begin CHARACTERISTIC WL221 "" CURVE 0x278294 _REC_A1CUR_1_u2_u2_S2 15000 _CNV_R_R_Umr_1_zu_1_3_CM_S2 0 15000 FORMAT "%2.0"
 /begin AXIS_DESCR COM_AXIS W_DKKD _CNV_R_R_Umr_10_zu__9_CM_S2 17 0 120 AXIS_PTS_REF SSTSKL_RS_WL2 FORMAT "%3.1" /end AXIS_DESCR
/end CHARACTERISTIC
/begin CHARACTERISTIC WL223 "" CURVE 0x2782B6 _REC_A1CUR_1_u2_u2_S2 15000 _CNV_R_R_Umr_1_zu_1_3_CM_S2 0 15000 FORMAT "%2.0"
 /begin AXIS_DESCR COM_AXIS W_DKKD _CNV_R_R_Umr_10_zu__9_CM_S2 13 0 120 AXIS_PTS_REF SSTSKL_HS_WL2 FORMAT "%3.1" /end AXIS_DESCR
/end CHARACTERISTIC
/begin CHARACTERISTIC WL232 "" CURVE 0x2782D0 _REC_A1CUR_1_u2_u2_S2 15000 _CNV_R_R_Umr_1_zu_1_3_CM_S2 0 15000 FORMAT "%2.0"
 /begin AXIS_DESCR COM_AXIS W_DKKD _CNV_R_R_Umr_10_zu__9_CM_S2 17 0 120 AXIS_PTS_REF SSTSKL_RS_WL2 FORMAT "%3.1" /end AXIS_DESCR
/end CHARACTERISTIC
/begin CHARACTERISTIC WL234 "" CURVE 0x2782F2 _REC_A1CUR_1_u2_u2_S2 15000 _CNV_R_R_Umr_1_zu_1_3_CM_S2 0 15000 FORMAT "%2.0"
 /begin AXIS_DESCR COM_AXIS W_DKKD _CNV_R_R_Umr_10_zu__9_CM_S2 13 0 120 AXIS_PTS_REF SSTSKL_HS_WL2 FORMAT "%3.1" /end AXIS_DESCR
/end CHARACTERISTIC
/begin CHARACTERISTIC WL243 "" CURVE 0x27830C _REC_A1CUR_1_u2_u2_S2 15000 _CNV_R_R_Umr_1_zu_1_3_CM_S2 0 15000 FORMAT "%2.0"
 /begin AXIS_DESCR COM_AXIS W_DKKD _CNV_R_R_Umr_10_zu__9_CM_S2 17 0 120 AXIS_PTS_REF SSTSKL_RS_WL2 FORMAT "%3.1" /end AXIS_DESCR
/end CHARACTERISTIC
/begin CHARACTERISTIC WL245 "" CURVE 0x27832E _REC_A1CUR_1_u2_u2_S2 15000 _CNV_R_R_Umr_1_zu_1_3_CM_S2 0 15000 FORMAT "%2.0"
 /begin AXIS_DESCR COM_AXIS W_DKKD _CNV_R_R_Umr_10_zu__9_CM_S2 13 0 120 AXIS_PTS_REF SSTSKL_HS_WL2 FORMAT "%3.1" /end AXIS_DESCR
/end CHARACTERISTIC
/begin CHARACTERISTIC WL254 "" CURVE 0x278348 _REC_A1CUR_1_u2_u2_S2 15000 _CNV_R_R_Umr_1_zu_1_3_CM_S2 0 15000 FORMAT "%2.0"
 /begin AXIS_DESCR COM_AXIS W_DKKD _CNV_R_R_Umr_10_zu__9_CM_S2 17 0 120 AXIS_PTS_REF SSTSKL_RS_WL2 FORMAT "%3.1" /end AXIS_DESCR
/end CHARACTERISTIC
/begin CHARACTERISTIC WL256 "" CURVE 0x27836A _REC_A1CUR_1_u2_u2_S2 15000 _CNV_R_R_Umr_1_zu_1_3_CM_S2 0 15000 FORMAT "%2.0"
 /begin AXIS_DESCR COM_AXIS W_DKKD _CNV_R_R_Umr_10_zu__9_CM_S2 13 0 120 AXIS_PTS_REF SSTSKL_HS_WL2 FORMAT "%3.1" /end AXIS_DESCR
/end CHARACTERISTIC
/begin CHARACTERISTIC WL265 "" CURVE 0x278384 _REC_A1CUR_1_u2_u2_S2 15000 _CNV_R_R_Umr_1_zu_1_3_CM_S2 0 15000 FORMAT "%2.0"
 /begin AXIS_DESCR COM_AXIS W_DKKD _CNV_R_R_Umr_10_zu__9_CM_S2 17 0 120 AXIS_PTS_REF SSTSKL_RS_WL2 FORMAT "%3.1" /end AXIS_DESCR
/end CHARACTERISTIC
/begin CHARACTERISTIC WL267 "" CURVE 0x278A36 _REC_A1CUR_1_u2_u2_S2 15000 _CNV_R_R_Umr_1_zu_1_3_CM_S2 0 15000 FORMAT "%2.0"
 /begin AXIS_DESCR COM_AXIS W_DKKD _CNV_R_R_Umr_10_zu__9_CM_S2 13 0 120 AXIS_PTS_REF SSTSKL_HS_WL2 FORMAT "%3.1" /end AXIS_DESCR
/end CHARACTERISTIC
/begin CHARACTERISTIC WL276 "" CURVE 0x278A50 _REC_A1CUR_1_u2_u2_S2 15000 _CNV_R_R_Umr_1_zu_1_3_CM_S2 0 15000 FORMAT "%2.0"
 /begin AXIS_DESCR COM_AXIS W_DKKD _CNV_R_R_Umr_10_zu__9_CM_S2 17 0 120 AXIS_PTS_REF SSTSKL_RS_WL2 FORMAT "%3.1" /end AXIS_DESCR
/end CHARACTERISTIC
/begin CHARACTERISTIC WL278 "" CURVE 0x278F22 _REC_A1CUR_1_u2_u2_S2 15000 _CNV_R_R_Umr_1_zu_1_3_CM_S2 0 15000 FORMAT "%2.0"
 /begin AXIS_DESCR COM_AXIS W_DKKD _CNV_R_R_Umr_10_zu__9_CM_S2 13 0 120 AXIS_PTS_REF SSTSKL_HS_WL2 FORMAT "%3.1" /end AXIS_DESCR
/end CHARACTERISTIC
/begin CHARACTERISTIC WL287 "" CURVE 0x278F3C _REC_A1CUR_1_u2_u2_S2 15000 _CNV_R_R_Umr_1_zu_1_3_CM_S2 0 15000 FORMAT "%2.0"
 /begin AXIS_DESCR COM_AXIS W_DKKD _CNV_R_R_Umr_10_zu__9_CM_S2 17 0 120 AXIS_PTS_REF SSTSKL_RS_WL2 FORMAT "%3.1" /end AXIS_DESCR
/end CHARACTERISTIC
/begin CHARACTERISTIC XE12 "" CURVE 0x2783A6 _REC_A1CUR_1_u2_u2_S2 15000 _CNV_R_R_Umr_1_zu_1_3_CM_S2 0 15000 FORMAT "%2.0"
 /begin AXIS_DESCR COM_AXIS W_DKKD _CNV_R_R_Umr_10_zu__9_CM_S2 13 0 120 AXIS_PTS_REF SSTSKL_HS_XE FORMAT "%3.1" /end AXIS_DESCR
/end CHARACTERISTIC
/begin CHARACTERISTIC XE21 "" CURVE 0x2783C0 _REC_A1CUR_1_u2_u2_S2 15000 _CNV_R_R_Umr_1_zu_1_3_CM_S2 0 15000 FORMAT "%2.0"
 /begin AXIS_DESCR COM_AXIS W_DKKD _CNV_R_R_Umr_10_zu__9_CM_S2 17 0 120 AXIS_PTS_REF SSTSKL_RS_XE FORMAT "%3.1" /end AXIS_DESCR
/end CHARACTERISTIC
/begin CHARACTERISTIC XE23 "" CURVE 0x2783E2 _REC_A1CUR_1_u2_u2_S2 15000 _CNV_R_R_Umr_1_zu_1_3_CM_S2 0 15000 FORMAT "%2.0"
 /begin AXIS_DESCR COM_AXIS W_DKKD _CNV_R_R_Umr_10_zu__9_CM_S2 13 0 120 AXIS_PTS_REF SSTSKL_HS_XE FORMAT "%3.1" /end AXIS_DESCR
/end CHARACTERISTIC
/begin CHARACTERISTIC XE32 "" CURVE 0x2783FC _REC_A1CUR_1_u2_u2_S2 15000 _CNV_R_R_Umr_1_zu_1_3_CM_S2 0 15000 FORMAT "%2.0"
 /begin AXIS_DESCR COM_AXIS W_DKKD _CNV_R_R_Umr_10_zu__9_CM_S2 17 0 120 AXIS_PTS_REF SSTSKL_RS_XE FORMAT "%3.1" /end AXIS_DESCR
/end CHARACTERISTIC
/begin CHARACTERISTIC XE34 "" CURVE 0x27841E _REC_A1CUR_1_u2_u2_S2 15000 _CNV_R_R_Umr_1_zu_1_3_CM_S2 0 15000 FORMAT "%2.0"
 /begin AXIS_DESCR COM_AXIS W_DKKD _CNV_R_R_Umr_10_zu__9_CM_S2 13 0 120 AXIS_PTS_REF SSTSKL_HS_XE FORMAT "%3.1" /end AXIS_DESCR
/end CHARACTERISTIC
/begin CHARACTERISTIC XE43 "" CURVE 0x278438 _REC_A1CUR_1_u2_u2_S2 15000 _CNV_R_R_Umr_1_zu_1_3_CM_S2 0 15000 FORMAT "%2.0"
 /begin AXIS_DESCR COM_AXIS W_DKKD _CNV_R_R_Umr_10_zu__9_CM_S2 17 0 120 AXIS_PTS_REF SSTSKL_RS_XE FORMAT "%3.1" /end AXIS_DESCR
/end CHARACTERISTIC
/begin CHARACTERISTIC XE45 "" CURVE 0x27845A _REC_A1CUR_1_u2_u2_S2 15000 _CNV_R_R_Umr_1_zu_1_3_CM_S2 0 15000 FORMAT "%2.0"
 /begin AXIS_DESCR COM_AXIS W_DKKD _CNV_R_R_Umr_10_zu__9_CM_S2 13 0 120 AXIS_PTS_REF SSTSKL_HS_XE FORMAT "%3.1" /end AXIS_DESCR
/end CHARACTERISTIC
/begin CHARACTERISTIC XE54 "" CURVE 0x278474 _REC_A1CUR_1_u2_u2_S2 15000 _CNV_R_R_Umr_1_zu_1_3_CM_S2 0 15000 FORMAT "%2.0"
 /begin AXIS_DESCR COM_AXIS W_DKKD _CNV_R_R_Umr_10_zu__9_CM_S2 17 0 120 AXIS_PTS_REF SSTSKL_RS_XE FORMAT "%3.1" /end AXIS_DESCR
/end CHARACTERISTIC
/begin CHARACTERISTIC XE56 "" CURVE 0x278496 _REC_A1CUR_1_u2_u2_S2 15000 _CNV_R_R_Umr_1_zu_1_3_CM_S2 0 15000 FORMAT "%2.0"
 /begin AXIS_DESCR COM_AXIS W_DKKD _CNV_R_R_Umr_10_zu__9_CM_S2 13 0 120 AXIS_PTS_REF SSTSKL_HS_XE FORMAT "%3.1" /end AXIS_DESCR
/end CHARACTERISTIC
/begin CHARACTERISTIC XE65 "" CURVE 0x2784B0 _REC_A1CUR_1_u2_u2_S2 15000 _CNV_R_R_Umr_1_zu_1_3_CM_S2 0 15000 FORMAT "%2.0"
 /begin AXIS_DESCR COM_AXIS W_DKKD _CNV_R_R_Umr_10_zu__9_CM_S2 17 0 120 AXIS_PTS_REF SSTSKL_RS_XE FORMAT "%3.1" /end AXIS_DESCR
/end CHARACTERISTIC
/begin CHARACTERISTIC XE67 "" CURVE 0x278A72 _REC_A1CUR_1_u2_u2_S2 15000 _CNV_R_R_Umr_1_zu_1_3_CM_S2 0 15000 FORMAT "%2.0"
 /begin AXIS_DESCR COM_AXIS W_DKKD _CNV_R_R_Umr_10_zu__9_CM_S2 13 0 120 AXIS_PTS_REF SSTSKL_HS_XE FORMAT "%3.1" /end AXIS_DESCR
/end CHARACTERISTIC
/begin CHARACTERISTIC XE76 "" CURVE 0x278A8C _REC_A1CUR_1_u2_u2_S2 15000 _CNV_R_R_Umr_1_zu_1_3_CM_S2 0 15000 FORMAT "%2.0"
 /begin AXIS_DESCR COM_AXIS W_DKKD _CNV_R_R_Umr_10_zu__9_CM_S2 17 0 120 AXIS_PTS_REF SSTSKL_RS_XE FORMAT "%3.1" /end AXIS_DESCR
/end CHARACTERISTIC
/begin CHARACTERISTIC XE78 "" CURVE 0x278F5E _REC_A1CUR_1_u2_u2_S2 15000 _CNV_R_R_Umr_1_zu_1_3_CM_S2 0 15000 FORMAT "%2.0"
 /begin AXIS_DESCR COM_AXIS W_DKKD _CNV_R_R_Umr_10_zu__9_CM_S2 13 0 120 AXIS_PTS_REF SSTSKL_HS_XE FORMAT "%3.1" /end AXIS_DESCR
/end CHARACTERISTIC
/begin CHARACTERISTIC XE87 "" CURVE 0x278F78 _REC_A1CUR_1_u2_u2_S2 15000 _CNV_R_R_Umr_1_zu_1_3_CM_S2 0 15000 FORMAT "%2.0"
 /begin AXIS_DESCR COM_AXIS W_DKKD _CNV_R_R_Umr_10_zu__9_CM_S2 17 0 120 AXIS_PTS_REF SSTSKL_RS_XE FORMAT "%3.1" /end AXIS_DESCR
/end CHARACTERISTIC
/begin CHARACTERISTIC XS12 "" CURVE 0x2784D2 _REC_A1CUR_1_u2_u2_S2 15000 _CNV_R_R_Umr_1_zu_1_3_CM_S2 0 15000 FORMAT "%2.0"
 /begin AXIS_DESCR COM_AXIS W_DKKD _CNV_R_R_Umr_10_zu__9_CM_S2 13 0 120 AXIS_PTS_REF SSTSKL_HS_XS FORMAT "%3.1" /end AXIS_DESCR
/end CHARACTERISTIC
/begin CHARACTERISTIC XS21 "" CURVE 0x2784EC _REC_A1CUR_1_u2_u2_S2 15000 _CNV_R_R_Umr_1_zu_1_3_CM_S2 0 15000 FORMAT "%2.0"
 /begin AXIS_DESCR COM_AXIS W_DKKD _CNV_R_R_Umr_10_zu__9_CM_S2 17 0 120 AXIS_PTS_REF SSTSKL_RS_XS FORMAT "%3.1" /end AXIS_DESCR
/end CHARACTERISTIC
/begin CHARACTERISTIC XS23 "" CURVE 0x27850E _REC_A1CUR_1_u2_u2_S2 15000 _CNV_R_R_Umr_1_zu_1_3_CM_S2 0 15000 FORMAT "%2.0"
 /begin AXIS_DESCR COM_AXIS W_DKKD _CNV_R_R_Umr_10_zu__9_CM_S2 13 0 120 AXIS_PTS_REF SSTSKL_HS_XS FORMAT "%3.1" /end AXIS_DESCR
/end CHARACTERISTIC
/begin CHARACTERISTIC XS32 "" CURVE 0x278528 _REC_A1CUR_1_u2_u2_S2 15000 _CNV_R_R_Umr_1_zu_1_3_CM_S2 0 15000 FORMAT "%2.0"
 /begin AXIS_DESCR COM_AXIS W_DKKD _CNV_R_R_Umr_10_zu__9_CM_S2 17 0 120 AXIS_PTS_REF SSTSKL_RS_XS FORMAT "%3.1" /end AXIS_DESCR
/end CHARACTERISTIC
/begin CHARACTERISTIC XS34 "" CURVE 0x27854A _REC_A1CUR_1_u2_u2_S2 15000 _CNV_R_R_Umr_1_zu_1_3_CM_S2 0 15000 FORMAT "%2.0"
 /begin AXIS_DESCR COM_AXIS W_DKKD _CNV_R_R_Umr_10_zu__9_CM_S2 13 0 120 AXIS_PTS_REF SSTSKL_HS_XS FORMAT "%3.1" /end AXIS_DESCR
/end CHARACTERISTIC
/begin CHARACTERISTIC XS43 "" CURVE 0x278564 _REC_A1CUR_1_u2_u2_S2 15000 _CNV_R_R_Umr_1_zu_1_3_CM_S2 0 15000 FORMAT "%2.0"
 /begin AXIS_DESCR COM_AXIS W_DKKD _CNV_R_R_Umr_10_zu__9_CM_S2 17 0 120 AXIS_PTS_REF SSTSKL_RS_XS FORMAT "%3.1" /end AXIS_DESCR
/end CHARACTERISTIC
/begin CHARACTERISTIC XS45 "" CURVE 0x278586 _REC_A1CUR_1_u2_u2_S2 15000 _CNV_R_R_Umr_1_zu_1_3_CM_S2 0 15000 FORMAT "%2.0"
 /begin AXIS_DESCR COM_AXIS W_DKKD _CNV_R_R_Umr_10_zu__9_CM_S2 13 0 120 AXIS_PTS_REF SSTSKL_HS_XS FORMAT "%3.1" /end AXIS_DESCR
/end CHARACTERISTIC
/begin CHARACTERISTIC XS54 "" CURVE 0x2785A0 _REC_A1CUR_1_u2_u2_S2 15000 _CNV_R_R_Umr_1_zu_1_3_CM_S2 0 15000 FORMAT "%2.0"
 /begin AXIS_DESCR COM_AXIS W_DKKD _CNV_R_R_Umr_10_zu__9_CM_S2 17 0 120 AXIS_PTS_REF SSTSKL_RS_XS FORMAT "%3.1" /end AXIS_DESCR
/end CHARACTERISTIC
/begin CHARACTERISTIC XS56 "" CURVE 0x2785C2 _REC_A1CUR_1_u2_u2_S2 15000 _CNV_R_R_Umr_1_zu_1_3_CM_S2 0 15000 FORMAT "%2.0"
 /begin AXIS_DESCR COM_AXIS W_DKKD _CNV_R_R_Umr_10_zu__9_CM_S2 13 0 120 AXIS_PTS_REF SSTSKL_HS_XS FORMAT "%3.1" /end AXIS_DESCR
/end CHARACTERISTIC
/begin CHARACTERISTIC XS65 "" CURVE 0x2785DC _REC_A1CUR_1_u2_u2_S2 15000 _CNV_R_R_Umr_1_zu_1_3_CM_S2 0 15000 FORMAT "%2.0"
 /begin AXIS_DESCR COM_AXIS W_DKKD _CNV_R_R_Umr_10_zu__9_CM_S2 17 0 120 AXIS_PTS_REF SSTSKL_RS_XS FORMAT "%3.1" /end AXIS_DESCR
/end CHARACTERISTIC
/begin CHARACTERISTIC XS67 "" CURVE 0x278AAE _REC_A1CUR_1_u2_u2_S2 15000 _CNV_R_R_Umr_1_zu_1_3_CM_S2 0 15000 FORMAT "%2.0"
 /begin AXIS_DESCR COM_AXIS W_DKKD _CNV_R_R_Umr_10_zu__9_CM_S2 13 0 120 AXIS_PTS_REF SSTSKL_HS_XS FORMAT "%3.1" /end AXIS_DESCR
/end CHARACTERISTIC
/begin CHARACTERISTIC XS76 "" CURVE 0x278AC8 _REC_A1CUR_1_u2_u2_S2 15000 _CNV_R_R_Umr_1_zu_1_3_CM_S2 0 15000 FORMAT "%2.0"
 /begin AXIS_DESCR COM_AXIS W_DKKD _CNV_R_R_Umr_10_zu__9_CM_S2 17 0 120 AXIS_PTS_REF SSTSKL_RS_XS FORMAT "%3.1" /end AXIS_DESCR
/end CHARACTERISTIC
/begin CHARACTERISTIC XS78 "" CURVE 0x278F9A _REC_A1CUR_1_u2_u2_S2 15000 _CNV_R_R_Umr_1_zu_1_3_CM_S2 0 15000 FORMAT "%2.0"
 /begin AXIS_DESCR COM_AXIS W_DKKD _CNV_R_R_Umr_10_zu__9_CM_S2 13 0 120 AXIS_PTS_REF SSTSKL_HS_XS FORMAT "%3.1" /end AXIS_DESCR
/end CHARACTERISTIC
/begin CHARACTERISTIC XS87 "" CURVE 0x278FB4 _REC_A1CUR_1_u2_u2_S2 15000 _CNV_R_R_Umr_1_zu_1_3_CM_S2 0 15000 FORMAT "%2.0"
 /begin AXIS_DESCR COM_AXIS W_DKKD _CNV_R_R_Umr_10_zu__9_CM_S2 17 0 120 AXIS_PTS_REF SSTSKL_RS_XS FORMAT "%3.1" /end AXIS_DESCR
/end CHARACTERISTIC
/begin CHARACTERISTIC XTAB21S_ON_AB_HS_PROG "" CURVE 0x276BE4 _REC_A1CUR_30_u2_u1_S2 255 _CNV_R_R_Umr_1_zu_1_2_CM_S2 0 255
 /begin AXIS_DESCR FIX_AXIS Z_PROG_FFG _CNV_S_21_Enum_EPROG_40_CM_S2 21 0 20 FIX_AXIS_PAR_DIST 0 1 21 READ_ONLY /end AXIS_DESCR
/end CHARACTERISTIC
/begin CHARACTERISTIC XTAB3X3CN_AB_DELTANMOTHS_DECR "" MAP 0x272BE4 _REC_S7MAP_53_u2_u2_u2_S2 5000 _CNV_R_R_Umr_1_zu_1_3_CM_S2 0 5000 FORMAT "%2.0"
 /begin AXIS_DESCR STD_AXIS N_AB_DELTANMOTHS _CNV_R_R_Umr_1_zu_1_3_CM_S2 3 0 15000 FORMAT "%2.0" /end AXIS_DESCR
 /begin AXIS_DESCR STD_AXIS N_T _CNV_R_R_Umr_1_zu_1_3_CM_S2 3 0 15000 FORMAT "%2.0" /end AXIS_DESCR
/end CHARACTERISTIC
/begin CHARACTERISTIC XTAB5X9ON_AB_HS_A1_A2 "" MAP 0x276C32 _REC_S3MAP_54_u1_u2_u1_S2 1255 _CNV_R_R_Umr_1_zu_5_112_CM_S2 0 1255 FORMAT "%2.0"
 /begin AXIS_DESCR STD_AXIS W_DKKD _CNV_R_R_Umr_10_zu__9_CM_S2 5 0 120 FORMAT "%3.1" /end AXIS_DESCR
 /begin AXIS_DESCR FIX_AXIS Z_GANG_ZIEL _CNV_S_9_Enum_EGANG_30_CM_S2 9 0 8 FIX_AXIS_PAR_DIST 0 1 9 READ_ONLY /end AXIS_DESCR
/end CHARACTERISTIC
/begin CHARACTERISTIC XTAB5X9ON_AB_HS_A2_A3 "" MAP 0x276C6C _REC_S3MAP_54_u1_u2_u1_S2 1255 _CNV_R_R_Umr_1_zu_5_112_CM_S2 0 1255 FORMAT "%2.0"
 /begin AXIS_DESCR STD_AXIS W_DKKD _CNV_R_R_Umr_10_zu__9_CM_S2 5 0 120 FORMAT "%3.1" /end AXIS_DESCR
 /begin AXIS_DESCR FIX_AXIS Z_GANG_ZIEL _CNV_S_9_Enum_EGANG_30_CM_S2 9 0 8 FIX_AXIS_PAR_DIST 0 1 9 READ_ONLY /end AXIS_DESCR
/end CHARACTERISTIC
/begin CHARACTERISTIC XTAB5X9ON_AB_HS_A3_A4 "" MAP 0x276CA6 _REC_S3MAP_54_u1_u2_u1_S2 1255 _CNV_R_R_Umr_1_zu_5_112_CM_S2 0 1255 FORMAT "%2.0"
 /begin AXIS_DESCR STD_AXIS W_DKKD _CNV_R_R_Umr_10_zu__9_CM_S2 5 0 120 FORMAT "%3.1" /end AXIS_DESCR
 /begin AXIS_DESCR FIX_AXIS Z_GANG_ZIEL _CNV_S_9_Enum_EGANG_30_CM_S2 9 0 8 FIX_AXIS_PAR_DIST 0 1 9 READ_ONLY /end AXIS_DESCR
/end CHARACTERISTIC
/begin CHARACTERISTIC XTAB5X9ON_AB_HS_A4_A5 "" MAP 0x276CE0 _REC_S3MAP_54_u1_u2_u1_S2 1255 _CNV_R_R_Umr_1_zu_5_112_CM_S2 0 1255 FORMAT "%2.0"
 /begin AXIS_DESCR STD_AXIS W_DKKD _CNV_R_R_Umr_10_zu__9_CM_S2 5 0 120 FORMAT "%3.1" /end AXIS_DESCR
 /begin AXIS_DESCR FIX_AXIS Z_GANG_ZIEL _CNV_S_9_Enum_EGANG_30_CM_S2 9 0 8 FIX_AXIS_PAR_DIST 0 1 9 READ_ONLY /end AXIS_DESCR
/end CHARACTERISTIC
/begin CHARACTERISTIC XTAB5X9ON_AB_HS_OFF_A1 "" MAP 0x276D1A _REC_S3MAP_54_u1_u2_u1_S2 1255 _CNV_R_R_Umr_1_zu_5_112_CM_S2 0 1255 FORMAT "%2.0"
 /begin AXIS_DESCR STD_AXIS W_DKKD _CNV_R_R_Umr_10_zu__9_CM_S2 5 0 120 FORMAT "%3.1" /end AXIS_DESCR
 /begin AXIS_DESCR FIX_AXIS Z_GANG_ZIEL _CNV_S_9_Enum_EGANG_30_CM_S2 9 0 8 FIX_AXIS_PAR_DIST 0 1 9 READ_ONLY /end AXIS_DESCR
/end CHARACTERISTIC
/begin CHARACTERISTIC XTAB9N_AB_MAXRSTEMP "" CURVE 0x276C0E _REC_A1CUR_30_u2_u1_S2 20000 _CNV_R_R_Umr_1_zu_1_3_CM_S2 0 20000 FORMAT "%2.0"
 /begin AXIS_DESCR FIX_AXIS Z_GANG_ZIEL _CNV_S_9_Enum_EGANG_30_CM_S2 9 0 8 FIX_AXIS_PAR_DIST 0 1 9 READ_ONLY /end AXIS_DESCR
/end CHARACTERISTIC
/begin CHARACTERISTIC XTAB9ON_AB_HSWK "" CURVE 0x276C20 _REC_A1CUR_30_u2_u1_S2 1023 _CNV_R_R_Umr_1_zu_1_3_CM_S2 0 1023 FORMAT "%2.0"
 /begin AXIS_DESCR FIX_AXIS Z_GANG_ZIEL_SKL _CNV_S_9_Enum_EGANG_30_CM_S2 9 0 8 FIX_AXIS_PAR_DIST 0 1 9 READ_ONLY /end AXIS_DESCR
/end CHARACTERISTIC
/begin CHARACTERISTIC XTAB9X2SCHN_AB_MOTORNOTLAUF "" MAP 0x272C04 _REC_A1MAP_9_u2_u1_u1_S2 20000 _CNV_R_R_Umr_1_zu_1_3_CM_S2 0 20000 FORMAT "%2.0"
 /begin AXIS_DESCR FIX_AXIS Z_GANG_ZIEL _CNV_S_9_Enum_EGANG_30_CM_S2 9 0 8 FIX_AXIS_PAR_DIST 0 1 9 READ_ONLY /end AXIS_DESCR
 /begin AXIS_DESCR FIX_AXIS NO_INPUT_QUANTITY _CNV_S_2_Enum_ENOTL_110_CM_S2 2 0 1 FIX_AXIS_PAR_DIST 0 1 2 READ_ONLY /end AXIS_DESCR
/end CHARACTERISTIC
/begin CHARACTERISTIC XDGANG_MAX_SPA "" VALUE 0x27B5E8 _REC_S1VAL_1_u1_S2 6 _CNV_R_R_Umr_1_zu_1_2_CM_S2 1 7 FORMAT "%2.0" /end CHARACTERISTIC
/begin CHARACTERISTIC XHN_AB_HSRS "" VALUE 0x276D54 _REC_S1VAL_1_u2_S2 20000 _CNV_R_R_Umr_1_zu_1_3_CM_S2 0 20000 FORMAT "%2.0" /end CHARACTERISTIC
/begin CHARACTERISTIC XON_AB_DELTANMOTHS_RESET "" VALUE 0x276D56 _REC_S1VAL_1_u2_S2 10000 _CNV_R_R_Umr_1_zu_1_3_CM_S2 0 10000 FORMAT "%2.0" /end CHARACTERISTIC
/begin CHARACTERISTIC XSCHN_AB_SKLBEW_RS_MODWHYB "" VALUE 0x276D60 _REC_S1VAL_1_u2_S2 10000 _CNV_R_R_Umr_1_zu_1_3_CM_S2 0 10000 FORMAT "%2.0" /end CHARACTERISTIC
/begin CHARACTERISTIC XSCHN_T_HSWK "" VALUE 0x276D58 _REC_S1VAL_1_u2_S2 15000 _CNV_R_R_Umr_1_zu_1_3_CM_S2 0 15000 FORMAT "%2.0" /end CHARACTERISTIC
/begin CHARACTERISTIC XSCHTEMP_GETR_NABMAXRS "" VALUE 0x276D5A _REC_S1VAL_1_s2_S2 400 _CNV_R_R_Umr_1_zu_1_1_CM_S2 -200 200 FORMAT "%2.0" /end CHARACTERISTIC
/begin CHARACTERISTIC XSCHW_DKKD_NMOTHSVLSTEPTR "" VALUE 0x276D5C _REC_S1VAL_1_u2_S2 110 _CNV_R_R_Umr_10_zu__9_CM_S2 0 110 FORMAT "%3.1" /end CHARACTERISTIC
/begin CHARACTERISTIC XSCHW_DKKD_NMOTHSVOLLAST "" VALUE 0x276D5E _REC_S1VAL_1_u2_S2 110 _CNV_R_R_Umr_10_zu__9_CM_S2 0 110 FORMAT "%3.1" /end CHARACTERISTIC
/begin CHARACTERISTIC XS_SKLBEW_RS_MODWHYB "" VALUE 0x27B5EE _REC_S1VAL_1_u1_S2 1 _CNV_R_R_Umr_1_zu_1_2_CM_S2 0 1 /end CHARACTERISTIC
/begin CHARACTERISTIC XS_USE_DYNHSPV_HS "" VALUE 0x27B5E9 _REC_S1VAL_1_u1_S2 1 _CNV_S_2_Schalter_A_4_CM_S2 0 1 /end CHARACTERISTIC
/begin CHARACTERISTIC XS_USE_DYNHSPV_RS "" VALUE 0x27B5EA _REC_S1VAL_1_u1_S2 1 _CNV_S_2_Schalter_A_4_CM_S2 0 1 /end CHARACTERISTIC
/begin CHARACTERISTIC XS_USE_HSEARLIERVVT "" VALUE 0x27B5EB _REC_S1VAL_1_u1_S2 1 _CNV_R_R_Umr_1_zu_1_2_CM_S2 0 1 FORMAT "%2.0" /end CHARACTERISTIC
/begin CHARACTERISTIC XS_USE_HSWK "" VALUE 0x27B5EC _REC_S1VAL_1_u1_S2 1 _CNV_R_R_Umr_1_zu_1_2_CM_S2 0 1 FORMAT "%2.0" /end CHARACTERISTIC
/begin CHARACTERISTIC XS_USE_HS_WAEHREND_SCHALTUNG "" VALUE 0x27B5EF _REC_S1VAL_1_u1_S2 1 _CNV_R_R_Umr_1_zu_1_2_CM_S2 0 1 FORMAT "%2.0" /end CHARACTERISTIC
/begin CHARACTERISTIC XZ_USE_SKLKORSOURCE "" VALUE 0x27B5ED _REC_S1VAL_1_u1_S2 2 _CNV_S_3_Enum_ESKLK_113_CM_S2 0 2 /end CHARACTERISTIC
/begin CHARACTERISTIC XTAB13M_MOT_MAXSCHLEPP_HDC "" CURVE 0x276642 _REC_S7CUR_53_u2_u2_S2 1024 _CNV_R_R_Umr_1_zu_1_42_CM_S2 0 1024 FORMAT "%2.0"
 /begin AXIS_DESCR STD_AXIS N_MOT_NACHRS_HDC _CNV_R_R_Umr_1_zu_1_3_CM_S2 13 0 20000 FORMAT "%2.0" /end AXIS_DESCR
/end CHARACTERISTIC
/begin CHARACTERISTIC XTAB9FAKT_MRAD_HDC "" CURVE 0x27B598 _REC_A1CUR_30_u1_u1_S2 100 _CNV_R_R_Umr_1_zu_1_53_CM_S2 0 100 FORMAT "%2.0"
 /begin AXIS_DESCR FIX_AXIS Z_GANG_ZIEL _CNV_S_9_Enum_EGANG_30_CM_S2 9 0 8 FIX_AXIS_PAR_DIST 0 1 9 READ_ONLY /end AXIS_DESCR
/end CHARACTERISTIC
/begin CHARACTERISTIC XTAB9X2SCHN_MOT_HSHDC "" MAP 0x272868 _REC_A1MAP_9_u2_u1_u1_S2 20000 _CNV_R_R_Umr_1_zu_1_3_CM_S2 0 20000 FORMAT "%2.0"
 /begin AXIS_DESCR FIX_AXIS Z_GANG_ZIEL _CNV_S_9_Enum_EGANG_30_CM_S2 9 0 8 FIX_AXIS_PAR_DIST 0 1 9 READ_ONLY /end AXIS_DESCR
 /begin AXIS_DESCR FIX_AXIS S_HDC_BER _CNV_S_2_Enum_EHDC__114_CM_S2 2 0 1 FIX_AXIS_PAR_DIST 0 1 2 READ_ONLY /end AXIS_DESCR
/end CHARACTERISTIC
/begin CHARACTERISTIC XTAB9X2SCHN_MOT_RSHDC "" MAP 0x27288C _REC_A1MAP_9_u2_u1_u1_S2 20000 _CNV_R_R_Umr_1_zu_1_3_CM_S2 0 20000 FORMAT "%2.0"
 /begin AXIS_DESCR FIX_AXIS Z_GANG_ZIEL _CNV_S_9_Enum_EGANG_30_CM_S2 9 0 8 FIX_AXIS_PAR_DIST 0 1 9 READ_ONLY /end AXIS_DESCR
 /begin AXIS_DESCR FIX_AXIS S_HDC_BER _CNV_S_2_Enum_EHDC__114_CM_S2 2 0 1 FIX_AXIS_PAR_DIST 0 1 2 READ_ONLY /end AXIS_DESCR
/end CHARACTERISTIC
/begin CHARACTERISTIC XSCHM_RAD_HDCGH "" VALUE 0x276678 _REC_S1VAL_1_s2_S2 2000 _CNV_R_R_Umr_1_zu_1_42_CM_S2 -1000 1000 FORMAT "%2.0" /end CHARACTERISTIC
/begin CHARACTERISTIC XTAB15GANGMIN_HSURE_TYPE "" CURVE 0x27B4E7 _REC_A1CUR_30_u1_u2_S2 8 _CNV_S_9_Enum_EGANG_30_CM_S2 0 8
 /begin AXIS_DESCR FIX_AXIS NO_INPUT_QUANTITY _CNV_S_15_Enum_EHSUR_17_CM_S2 15 0 14 FIX_AXIS_PAR_DIST 0 1 15 READ_ONLY /end AXIS_DESCR
/end CHARACTERISTIC
/begin CHARACTERISTIC XTAB15SCHSCHLUPF_HSURE "" CURVE 0x27640A _REC_A1CUR_30_u2_u2_S2 65535 _CNV_R_R_Umr_1_zu_1_2_CM_S2 0 65535 FORMAT "%2.0"
 /begin AXIS_DESCR FIX_AXIS NO_INPUT_QUANTITY _CNV_S_15_Enum_EHSUR_17_CM_S2 15 0 14 FIX_AXIS_PAR_DIST 0 1 15 READ_ONLY /end AXIS_DESCR
/end CHARACTERISTIC
/begin CHARACTERISTIC XTAB15S_SOC_FAKT_HSURETYPE "" CURVE 0x27B4F6 _REC_A1CUR_30_u1_u2_S2 1 _CNV_R_R_Umr_1_zu_1_2_CM_S2 0 1 FORMAT "%2.0"
 /begin AXIS_DESCR FIX_AXIS NO_INPUT_QUANTITY _CNV_S_15_Enum_EHSUR_17_CM_S2 15 0 14 FIX_AXIS_PAR_DIST 0 1 15 READ_ONLY /end AXIS_DESCR
/end CHARACTERISTIC
/begin CHARACTERISTIC XTAB15X4SCHNMOT_HSURE_TYPE "" MAP 0x271748 _REC_A1MAP_9_u2_u2_u1_S2 20000 _CNV_R_R_Umr_1_zu_1_3_CM_S2 0 20000 FORMAT "%2.0"
 /begin AXIS_DESCR FIX_AXIS NO_INPUT_QUANTITY _CNV_S_15_Enum_EHSUR_17_CM_S2 15 0 14 FIX_AXIS_PAR_DIST 0 1 15 READ_ONLY /end AXIS_DESCR
 /begin AXIS_DESCR FIX_AXIS Z_AGSMOD_ECO_EFAHREN _CNV_S_4_Enum_EAGS__24_CM_S2 4 0 3 FIX_AXIS_PAR_DIST 0 1 4 READ_ONLY /end AXIS_DESCR
/end CHARACTERISTIC
/begin CHARACTERISTIC XTAB2S_USE_FP_HSSKL_HSURESLMUE "" CURVE 0x27A0F8 _REC_A1CUR_30_u1_u1_S2 1 _CNV_R_R_Umr_1_zu_1_2_CM_S2 0 1 FORMAT "%2.0"
 /begin AXIS_DESCR FIX_AXIS NO_INPUT_QUANTITY _CNV_S_2_Enum_EUSEH_117_CM_S2 2 0 1 FIX_AXIS_PAR_DIST 0 1 2 READ_ONLY /end AXIS_DESCR
/end CHARACTERISTIC
/begin CHARACTERISTIC XTAB3N_MOT_HSURESL "" CURVE 0x27A0FA _REC_A1CUR_30_u2_u1_S2 10000 _CNV_R_R_Umr_1_zu_1_3_CM_S2 0 10000 FORMAT "%2.0"
 /begin AXIS_DESCR FIX_AXIS NO_INPUT_QUANTITY _CNV_S_3_Enum_EHSUR_115_CM_S2 3 0 2 /begin FIX_AXIS_PAR_LIST 0 1 2 /end FIX_AXIS_PAR_LIST READ_ONLY /end AXIS_DESCR
/end CHARACTERISTIC
/begin CHARACTERISTIC XTAB3X2A_L_DECRSTART_HSURE_COS "" MAP 0x271600 _REC_S3MAP_54_s2_s2_u1_S2 40 _CNV_R_R_Umr_10_zu__46_CM_S2 -20 20 FORMAT "%3.1"
 /begin AXIS_DESCR STD_AXIS W_STEIGUNG_KORFILT _CNV_R_R_Umr_10_zu__9_CM_S2 3 -3276.8 3276.7 FORMAT "%3.1" /end AXIS_DESCR
 /begin AXIS_DESCR FIX_AXIS Z_AGS_MODBEDEL_HSU _CNV_S_2_Enum_EAGS_25_CM_S2 2 0 1 FIX_AXIS_PAR_DIST 0 1 2 READ_ONLY /end AXIS_DESCR
/end CHARACTERISTIC
/begin CHARACTERISTIC XTAB3X2C_HSUREINST_DECRVAL_LDM "" MAP 0x273A78 _REC_A1MAP_9_u2_u1_u1_S2 255 _CNV_R_R_Umr_1_zu_1_2_CM_S2 0 255 FORMAT "%2.0"
 /begin AXIS_DESCR FIX_AXIS Z_LDMBAB_HSURE_IDX _CNV_S_3_Enum_ELDMA_116_CM_S2 3 0 2 FIX_AXIS_PAR_DIST 0 1 3 READ_ONLY /end AXIS_DESCR
 /begin AXIS_DESCR FIX_AXIS Z_AGS_MODBEDEL_HSU _CNV_S_2_Enum_EAGS_25_CM_S2 2 0 1 FIX_AXIS_PAR_DIST 0 1 2 READ_ONLY /end AXIS_DESCR
/end CHARACTERISTIC
/begin CHARACTERISTIC XTAB3X2SCHGM_LDM_INIT_HSUREINST "" MAP 0x273A84 _REC_A1MAP_9_s2_u1_u1_S2 20000 _CNV_R_R_Umr_1_zu_1_77_CM_S2 -10000 10000 FORMAT "%2.0"
 /begin AXIS_DESCR FIX_AXIS Z_LDMBAB_HSURE_IDX _CNV_S_3_Enum_ELDMA_116_CM_S2 3 0 2 FIX_AXIS_PAR_DIST 0 1 3 READ_ONLY /end AXIS_DESCR
 /begin AXIS_DESCR FIX_AXIS Z_AGS_MODBEDEL_HSU _CNV_S_2_Enum_EAGS_25_CM_S2 2 0 1 FIX_AXIS_PAR_DIST 0 1 2 READ_ONLY /end AXIS_DESCR
/end CHARACTERISTIC
/begin CHARACTERISTIC XTAB3X2SCHGM_LDM_START_HSUREINST "" MAP 0x273A90 _REC_A1MAP_9_s2_u1_u1_S2 20000 _CNV_R_R_Umr_1_zu_1_126_CM_S2 -10000 10000 FORMAT "%2.0"
 /begin AXIS_DESCR FIX_AXIS Z_LDMBAB_HSURE_IDX _CNV_S_3_Enum_ELDMA_116_CM_S2 3 0 2 FIX_AXIS_PAR_DIST 0 1 3 READ_ONLY /end AXIS_DESCR
 /begin AXIS_DESCR FIX_AXIS Z_AGS_MODBEDEL_HSU _CNV_S_2_Enum_EAGS_25_CM_S2 2 0 1 FIX_AXIS_PAR_DIST 0 1 2 READ_ONLY /end AXIS_DESCR
/end CHARACTERISTIC
/begin CHARACTERISTIC XTAB3X3SMPL_SCHLUPFGEW_HSURE "" MAP 0x27643A _REC_A1MAP_9_u2_u1_u1_S2 65535 _CNV_R_R_Umr_1_zu_1_2_CM_S2 0 65535 FORMAT "%2.0"
 /begin AXIS_DESCR FIX_AXIS Z_SCHLUPF_ANTRIEB_RR _CNV_S_3_Enum_ESCHL_41_CM_S2 3 0 2 FIX_AXIS_PAR_DIST 0 1 3 READ_ONLY /end AXIS_DESCR
 /begin AXIS_DESCR FIX_AXIS Z_SCHLUPF_ANTRIEB_RL _CNV_S_3_Enum_ESCHL_41_CM_S2 3 0 2 FIX_AXIS_PAR_DIST 0 1 3 READ_ONLY /end AXIS_DESCR
/end CHARACTERISTIC
/begin CHARACTERISTIC XTAB3X5C_HSUKS_DECRVAL_IDX1 "" MAP 0x271800 _REC_S7MAP_53_u2_u2_s2_S2 255 _CNV_R_R_Umr_1_zu_1_2_CM_S2 0 255 FORMAT "%2.0"
 /begin AXIS_DESCR STD_AXIS N_MOT _CNV_R_R_Umr_1_zu_1_3_CM_S2 3 0 10000 FORMAT "%2.0" /end AXIS_DESCR
 /begin AXIS_DESCR STD_AXIS TEMP_KUP_A _CNV_R_R_Umr_1_zu_1_1_CM_S2 5 -40 500 FORMAT "%2.0" /end AXIS_DESCR
/end CHARACTERISTIC
/begin CHARACTERISTIC XTAB3X5C_HSUKS_DECRVAL_IDX2 "" MAP 0x271830 _REC_S7MAP_53_u2_u2_s2_S2 255 _CNV_R_R_Umr_1_zu_1_2_CM_S2 0 255 FORMAT "%2.0"
 /begin AXIS_DESCR STD_AXIS N_MOT _CNV_R_R_Umr_1_zu_1_3_CM_S2 3 0 10000 FORMAT "%2.0" /end AXIS_DESCR
 /begin AXIS_DESCR STD_AXIS TEMP_KUP_A _CNV_R_R_Umr_1_zu_1_1_CM_S2 5 -40 500 FORMAT "%2.0" /end AXIS_DESCR
/end CHARACTERISTIC
/begin CHARACTERISTIC XTAB3X5C_HSUKS_DECRVAL_IDX3 "" MAP 0x271860 _REC_S7MAP_53_u2_u2_s2_S2 255 _CNV_R_R_Umr_1_zu_1_2_CM_S2 0 255 FORMAT "%2.0"
 /begin AXIS_DESCR STD_AXIS N_MOT _CNV_R_R_Umr_1_zu_1_3_CM_S2 3 0 10000 FORMAT "%2.0" /end AXIS_DESCR
 /begin AXIS_DESCR STD_AXIS TEMP_KUP_A _CNV_R_R_Umr_1_zu_1_1_CM_S2 5 -40 500 FORMAT "%2.0" /end AXIS_DESCR
/end CHARACTERISTIC
/begin CHARACTERISTIC XTAB3X5C_HSUKS_DECRVAL_IDX4 "" MAP 0x271890 _REC_S7MAP_53_u2_u2_s2_S2 255 _CNV_R_R_Umr_1_zu_1_2_CM_S2 0 255 FORMAT "%2.0"
 /begin AXIS_DESCR STD_AXIS N_MOT _CNV_R_R_Umr_1_zu_1_3_CM_S2 3 0 10000 FORMAT "%2.0" /end AXIS_DESCR
 /begin AXIS_DESCR STD_AXIS TEMP_KUP_A _CNV_R_R_Umr_1_zu_1_1_CM_S2 5 -40 500 FORMAT "%2.0" /end AXIS_DESCR
/end CHARACTERISTIC
/begin CHARACTERISTIC XTAB3X6T_WAIT_HSURENL_D "" MAP 0x279F6C _REC_S3MAP_54_u1_u2_u1_S2 25.5 _CNV_R_R_Umr_10_zu__127_CM_S2 0 25.5 FORMAT "%3.1"
 /begin AXIS_DESCR STD_AXIS N_MOT _CNV_R_R_Umr_1_zu_1_3_CM_S2 3 0 20000 MONOTONY MON_INCREASE FORMAT "%2.0" /end AXIS_DESCR
 /begin AXIS_DESCR FIX_AXIS Z_DRIVELOGIC _CNV_S_6_Enum_EDL_11_CM_S2 6 1 6 FIX_AXIS_PAR_DIST 1 1 6 READ_ONLY /end AXIS_DESCR
/end CHARACTERISTIC
/begin CHARACTERISTIC XTAB3X6T_WAIT_HSURENL_S "" MAP 0x279F86 _REC_S3MAP_54_u1_u2_u1_S2 25.5 _CNV_R_R_Umr_10_zu__127_CM_S2 0 25.5 FORMAT "%3.1"
 /begin AXIS_DESCR STD_AXIS N_MOT _CNV_R_R_Umr_1_zu_1_3_CM_S2 3 0 20000 MONOTONY MON_INCREASE FORMAT "%2.0" /end AXIS_DESCR
 /begin AXIS_DESCR FIX_AXIS Z_DRIVELOGIC _CNV_S_6_Enum_EDL_11_CM_S2 6 1 6 FIX_AXIS_PAR_DIST 1 1 6 READ_ONLY /end AXIS_DESCR
/end CHARACTERISTIC
/begin CHARACTERISTIC XTAB4C_HSURENSC_DECRVAL "" CURVE 0x279FBE _REC_S7CUR_53_u2_s2_S2 255 _CNV_R_R_Umr_1_zu_1_2_CM_S2 0 255 FORMAT "%2.0"
 /begin AXIS_DESCR STD_AXIS DELTA_NT_HSSKL_NSC _CNV_R_R_Umr_1_zu_1_3_CM_S2 4 -32768 32767 FORMAT "%2.0" /end AXIS_DESCR
/end CHARACTERISTIC
/begin CHARACTERISTIC XTAB4DAQ_KURVE_HSURE "" CURVE 0x273BBC _REC_A1CUR_30_s2_u1_S2 100 _CNV_R_R_Umr_10_zu__45_CM_S2 0 100 FORMAT "%3.1"
 /begin AXIS_DESCR FIX_AXIS Z_MOD_KURVE_HSURE _CNV_S_4_Enum_EHSUR_121_CM_S2 4 0 3 FIX_AXIS_PAR_DIST 0 1 4 READ_ONLY /end AXIS_DESCR
/end CHARACTERISTIC
/begin CHARACTERISTIC XTAB4FAKT_AQ_HSUREKU "" CURVE 0x279EF0 _REC_S7CUR_53_u2_u2_S2 2 _CNV_R_R_Umr_100_zu_54_CM_S2 0 2 FORMAT "%4.2"
 /begin AXIS_DESCR STD_AXIS V_FZG _CNV_R_R_Umr_1_zu_1_8_CM_S2 4 0 400 FORMAT "%2.0" /end AXIS_DESCR
/end CHARACTERISTIC
/begin CHARACTERISTIC XTAB4ON_GEKURVESTEIG_HSURE_COS "" CURVE 0x2761FC _REC_S7CUR_53_s2_s2_S2 2000 _CNV_R_R_Umr_1_zu_1_3_CM_S2 -1000 1000 FORMAT "%2.0"
 /begin AXIS_DESCR STD_AXIS W_STEIGUNG_KORFILT _CNV_R_R_Umr_10_zu__9_CM_S2 4 -200 200 FORMAT "%3.1" /end AXIS_DESCR
/end CHARACTERISTIC
/begin CHARACTERISTIC XTAB4S_ENBL1_HSURE_COS "" CURVE 0x271614 _REC_A1CUR_30_u1_u1_S2 1 _CNV_R_R_Umr_1_zu_1_2_CM_S2 0 1 FORMAT "%2.0"
 /begin AXIS_DESCR FIX_AXIS NO_INPUT_QUANTITY _CNV_S_4_Enum_EADAS_13_CM_S2 4 0 3 FIX_AXIS_PAR_DIST 0 1 4 READ_ONLY /end AXIS_DESCR
/end CHARACTERISTIC
/begin CHARACTERISTIC XTAB4S_ENBL2_HSURE_COS "" CURVE 0x271618 _REC_A1CUR_30_u1_u1_S2 1 _CNV_R_R_Umr_1_zu_1_2_CM_S2 0 1 FORMAT "%2.0"
 /begin AXIS_DESCR FIX_AXIS NO_INPUT_QUANTITY _CNV_S_4_Enum_EADAS_13_CM_S2 4 0 3 FIX_AXIS_PAR_DIST 0 1 4 READ_ONLY /end AXIS_DESCR
/end CHARACTERISTIC
/begin CHARACTERISTIC XTAB4S_SOC_AGSMOD_HSURETYPE "" CURVE 0x2716FC _REC_A1CUR_30_u1_u1_S2 1 _CNV_R_R_Umr_1_zu_1_2_CM_S2 0 1 FORMAT "%2.0"
 /begin AXIS_DESCR FIX_AXIS Z_AGSMOD_ECO_EFAHREN _CNV_S_4_Enum_EAGS__24_CM_S2 4 0 3 FIX_AXIS_PAR_DIST 0 1 4 READ_ONLY /end AXIS_DESCR
/end CHARACTERISTIC
/begin CHARACTERISTIC XTAB4X2C_HSUREBRS_DECRVAL "" MAP 0x279D40 _REC_S3MAP_54_u2_u2_u1_S2 255 _CNV_R_R_Umr_1_zu_1_2_CM_S2 0 255 FORMAT "%2.0"
 /begin AXIS_DESCR STD_AXIS W_DKKD _CNV_R_R_Umr_10_zu__9_CM_S2 4 0 110 FORMAT "%3.1" /end AXIS_DESCR
 /begin AXIS_DESCR FIX_AXIS Z_AGS_MODBEDEL_HSU _CNV_S_2_Enum_EAGS_25_CM_S2 2 0 1 FIX_AXIS_PAR_DIST 0 1 2 READ_ONLY /end AXIS_DESCR
/end CHARACTERISTIC
/begin CHARACTERISTIC XTAB4X2C_HSUREFOF_DECRVAL "" MAP 0x279D60 _REC_S3MAP_54_u2_u2_u1_S2 255 _CNV_R_R_Umr_1_zu_1_2_CM_S2 0 255 FORMAT "%2.0"
 /begin AXIS_DESCR STD_AXIS W_DKKD _CNV_R_R_Umr_10_zu__9_CM_S2 4 0 110 FORMAT "%3.1" /end AXIS_DESCR
 /begin AXIS_DESCR FIX_AXIS Z_AGS_MODBEDEL_HSU _CNV_S_2_Enum_EAGS_25_CM_S2 2 0 1 FIX_AXIS_PAR_DIST 0 1 2 READ_ONLY /end AXIS_DESCR
/end CHARACTERISTIC
/begin CHARACTERISTIC XTAB4X2C_HSUREFPVORNEG_DECRVAL "" MAP 0x27A1A6 _REC_S3MAP_54_u2_u2_u1_S2 255 _CNV_R_R_Umr_1_zu_1_2_CM_S2 0 255 FORMAT "%2.0"
 /begin AXIS_DESCR STD_AXIS W_DKKD _CNV_R_R_Umr_10_zu__9_CM_S2 4 0 110 FORMAT "%3.1" /end AXIS_DESCR
 /begin AXIS_DESCR FIX_AXIS Z_AGS_MODBEDEL_HSU _CNV_S_2_Enum_EAGS_25_CM_S2 2 0 1 FIX_AXIS_PAR_DIST 0 1 2 READ_ONLY /end AXIS_DESCR
/end CHARACTERISTIC
/begin CHARACTERISTIC XTAB4X2C_HSUREFPVORPOS_DECRVAL "" MAP 0x27A1C0 _REC_S3MAP_54_u2_u2_u1_S2 255 _CNV_R_R_Umr_1_zu_1_2_CM_S2 0 255 FORMAT "%2.0"
 /begin AXIS_DESCR STD_AXIS W_DKKD _CNV_R_R_Umr_10_zu__9_CM_S2 4 0 110 FORMAT "%3.1" /end AXIS_DESCR
 /begin AXIS_DESCR FIX_AXIS Z_AGS_MODBEDEL_HSU _CNV_S_2_Enum_EAGS_25_CM_S2 2 0 1 FIX_AXIS_PAR_DIST 0 1 2 READ_ONLY /end AXIS_DESCR
/end CHARACTERISTIC
/begin CHARACTERISTIC XTAB4X2C_HSURENL_DECRVAL "" MAP 0x279FA0 _REC_S3MAP_54_u2_u2_u1_S2 255 _CNV_R_R_Umr_1_zu_1_2_CM_S2 0 255 FORMAT "%2.0"
 /begin AXIS_DESCR STD_AXIS W_DKKD _CNV_R_R_Umr_10_zu__9_CM_S2 4 0 110 FORMAT "%3.1" /end AXIS_DESCR
 /begin AXIS_DESCR FIX_AXIS Z_AGS_MODBEDEL_HSU _CNV_S_2_Enum_EAGS_25_CM_S2 2 0 1 FIX_AXIS_PAR_DIST 0 1 2 READ_ONLY /end AXIS_DESCR
/end CHARACTERISTIC
/begin CHARACTERISTIC XTAB4X2DVREL_SEGLIMNEG_HSUCOS "" MAP 0x27161C _REC_A1MAP_9_u2_u1_u1_S2 65535 _CNV_R_R_Umr_1_zu_1_53_CM_S2 0 65535 FORMAT "%2.0"
 /begin AXIS_DESCR FIX_AXIS NO_INPUT_QUANTITY _CNV_S_4_Enum_EADAS_13_CM_S2 4 0 3 FIX_AXIS_PAR_DIST 0 1 4 READ_ONLY /end AXIS_DESCR
 /begin AXIS_DESCR FIX_AXIS Z_AGS_MODBEDEL_HSU _CNV_S_2_Enum_EAGS_25_CM_S2 2 0 1 FIX_AXIS_PAR_DIST 0 1 2 READ_ONLY /end AXIS_DESCR
/end CHARACTERISTIC
/begin CHARACTERISTIC XTAB4X2DVREL_SEGLIMPOS_HSUCOS "" MAP 0x27162C _REC_A1MAP_9_u2_u1_u1_S2 65535 _CNV_R_R_Umr_1_zu_1_53_CM_S2 0 65535 FORMAT "%2.0"
 /begin AXIS_DESCR FIX_AXIS NO_INPUT_QUANTITY _CNV_S_4_Enum_EADAS_13_CM_S2 4 0 3 FIX_AXIS_PAR_DIST 0 1 4 READ_ONLY /end AXIS_DESCR
 /begin AXIS_DESCR FIX_AXIS Z_AGS_MODBEDEL_HSU _CNV_S_2_Enum_EAGS_25_CM_S2 2 0 1 FIX_AXIS_PAR_DIST 0 1 2 READ_ONLY /end AXIS_DESCR
/end CHARACTERISTIC
/begin CHARACTERISTIC XTAB4X2DVREL_SEGPRDNEG_HSUCOS "" MAP 0x27163C _REC_A1MAP_9_u2_u1_u1_S2 65535 _CNV_R_R_Umr_1_zu_1_53_CM_S2 0 65535 FORMAT "%2.0"
 /begin AXIS_DESCR FIX_AXIS NO_INPUT_QUANTITY _CNV_S_4_Enum_EADAS_13_CM_S2 4 0 3 FIX_AXIS_PAR_DIST 0 1 4 READ_ONLY /end AXIS_DESCR
 /begin AXIS_DESCR FIX_AXIS Z_AGS_MODBEDEL_HSU _CNV_S_2_Enum_EAGS_25_CM_S2 2 0 1 FIX_AXIS_PAR_DIST 0 1 2 READ_ONLY /end AXIS_DESCR
/end CHARACTERISTIC
/begin CHARACTERISTIC XTAB4X2DVREL_SEGPRDPOS_HSUCOS "" MAP 0x27164C _REC_A1MAP_9_u2_u1_u1_S2 65535 _CNV_R_R_Umr_1_zu_1_53_CM_S2 0 65535 FORMAT "%2.0"
 /begin AXIS_DESCR FIX_AXIS NO_INPUT_QUANTITY _CNV_S_4_Enum_EADAS_13_CM_S2 4 0 3 FIX_AXIS_PAR_DIST 0 1 4 READ_ONLY /end AXIS_DESCR
 /begin AXIS_DESCR FIX_AXIS Z_AGS_MODBEDEL_HSU _CNV_S_2_Enum_EAGS_25_CM_S2 2 0 1 FIX_AXIS_PAR_DIST 0 1 2 READ_ONLY /end AXIS_DESCR
/end CHARACTERISTIC
/begin CHARACTERISTIC XTAB4X2DVREL_SEG_HSUCOS "" MAP 0x27165C _REC_A1MAP_9_u2_u1_u1_S2 65535 _CNV_R_R_Umr_1_zu_1_53_CM_S2 0 65535 FORMAT "%2.0"
 /begin AXIS_DESCR FIX_AXIS Z_AGSMOD_ECO_EFAHREN _CNV_S_4_Enum_EAGS__24_CM_S2 4 0 3 FIX_AXIS_PAR_DIST 0 1 4 READ_ONLY /end AXIS_DESCR
 /begin AXIS_DESCR FIX_AXIS NO_INPUT_QUANTITY _CNV_S_2_Enum_EDV_R_124_CM_S2 2 0 1 /begin FIX_AXIS_PAR_LIST 0 1 /end FIX_AXIS_PAR_LIST READ_ONLY /end AXIS_DESCR
/end CHARACTERISTIC
/begin CHARACTERISTIC XTAB4X2ON_MOT_KREIS_HSURE_COS "" MAP 0x2763CC _REC_S7MAP_53_u2_u2_u2_S2 2500 _CNV_R_R_Umr_1_zu_1_3_CM_S2 0 2500 FORMAT "%2.0"
 /begin AXIS_DESCR STD_AXIS R_KREIS_MIN_DCODR _CNV_R_R_Umr_1_zu_1_123_CM_S2 4 0 65535 FORMAT "%2.0" /end AXIS_DESCR
 /begin AXIS_DESCR STD_AXIS NO_INPUT_QUANTITY _CNV_R_R_Umr_10_zu__46_CM_S2 2 0 6553.5 FORMAT "%3.1" /end AXIS_DESCR
/end CHARACTERISTIC
/begin CHARACTERISTIC XTAB4X2ON_MOT_KURVE_HSURE_COS "" MAP 0x2763EA _REC_S7MAP_53_u2_u2_u2_S2 2500 _CNV_R_R_Umr_1_zu_1_3_CM_S2 0 2500 FORMAT "%2.0"
 /begin AXIS_DESCR STD_AXIS R_KURVE_MIN_DCODR _CNV_R_R_Umr_1_zu_1_123_CM_S2 4 0 65535 FORMAT "%2.0" /end AXIS_DESCR
 /begin AXIS_DESCR STD_AXIS NO_INPUT_QUANTITY _CNV_R_R_Umr_10_zu__46_CM_S2 2 0 6553.5 FORMAT "%3.1" /end AXIS_DESCR
/end CHARACTERISTIC
/begin CHARACTERISTIC XTAB4X3C_HSUREADAPT_DECRVAL "" MAP 0x279C4C _REC_S3MAP_54_u2_s2_u1_S2 255 _CNV_R_R_Umr_1_zu_1_2_CM_S2 0 255 FORMAT "%2.0"
 /begin AXIS_DESCR STD_AXIS DELTA_NT_HSSKL _CNV_R_R_Umr_1_zu_1_3_CM_S2 4 -32768 32767 FORMAT "%2.0" /end AXIS_DESCR
 /begin AXIS_DESCR FIX_AXIS Z_ADAPT_REQ _CNV_S_3_Enum_EREQA_118_CM_S2 3 0 2 /begin FIX_AXIS_PAR_LIST 0 1 2 /end FIX_AXIS_PAR_LIST READ_ONLY /end AXIS_DESCR
/end CHARACTERISTIC
/begin CHARACTERISTIC XTAB4X6Z_IDX_FPVOR_HSURE "" MAP 0x273BC4 _REC_A1MAP_9_u1_u1_u1_S2 4 _CNV_S_5_Enum_EGWFP_128_CM_S2 0 4
 /begin AXIS_DESCR FIX_AXIS Z_PROG_MODE _CNV_S_4_Enum_EPROG_35_CM_S2 4 0 3 FIX_AXIS_PAR_DIST 0 1 4 READ_ONLY /end AXIS_DESCR
 /begin AXIS_DESCR FIX_AXIS Z_DRIVELOGIC _CNV_S_6_Enum_EDL_11_CM_S2 6 1 6 FIX_AXIS_PAR_DIST 1 1 6 READ_ONLY /end AXIS_DESCR
/end CHARACTERISTIC
/begin CHARACTERISTIC XTAB5C_HSURESL_DECRVAL "" CURVE 0x27A124 _REC_S7CUR_53_u2_u2_S2 255 _CNV_R_R_Umr_1_zu_1_2_CM_S2 0 255 FORMAT "%2.0"
 /begin AXIS_DESCR STD_AXIS N_MOT _CNV_R_R_Umr_1_zu_1_3_CM_S2 5 0 20000 FORMAT "%2.0" /end AXIS_DESCR
/end CHARACTERISTIC
/begin CHARACTERISTIC XTAB5GWFP_FPVORNEG_IDX1_HSURE "" CURVE 0x27A1DA _REC_S7CUR_53_s2_u2_S2 32768 _CNV_R_R_Umr_1_zu_1_7_CM_S2 -32768 0 FORMAT "%2.0"
 /begin AXIS_DESCR STD_AXIS N_MOT _CNV_R_R_Umr_1_zu_1_3_CM_S2 5 0 65535 FORMAT "%2.0" /end AXIS_DESCR
/end CHARACTERISTIC
/begin CHARACTERISTIC XTAB5GWFP_FPVORNEG_IDX2_HSURE "" CURVE 0x27A1F0 _REC_S7CUR_53_s2_u2_S2 32768 _CNV_R_R_Umr_1_zu_1_7_CM_S2 -32768 0 FORMAT "%2.0"
 /begin AXIS_DESCR STD_AXIS N_MOT _CNV_R_R_Umr_1_zu_1_3_CM_S2 5 0 65535 FORMAT "%2.0" /end AXIS_DESCR
/end CHARACTERISTIC
/begin CHARACTERISTIC XTAB5GWFP_FPVORNEG_IDX3_HSURE "" CURVE 0x27A206 _REC_S7CUR_53_s2_u2_S2 32768 _CNV_R_R_Umr_1_zu_1_7_CM_S2 -32768 0 FORMAT "%2.0"
 /begin AXIS_DESCR STD_AXIS N_MOT _CNV_R_R_Umr_1_zu_1_3_CM_S2 5 0 65535 FORMAT "%2.0" /end AXIS_DESCR
/end CHARACTERISTIC
/begin CHARACTERISTIC XTAB5GWFP_FPVORNEG_IDX4_HSURE "" CURVE 0x27A21C _REC_S7CUR_53_s2_u2_S2 32768 _CNV_R_R_Umr_1_zu_1_7_CM_S2 -32768 0 FORMAT "%2.0"
 /begin AXIS_DESCR STD_AXIS N_MOT _CNV_R_R_Umr_1_zu_1_3_CM_S2 5 0 65535 FORMAT "%2.0" /end AXIS_DESCR
/end CHARACTERISTIC
/begin CHARACTERISTIC XTAB5GWFP_FPVORNEG_IDX5_HSURE "" CURVE 0x27A232 _REC_S7CUR_53_s2_u2_S2 32768 _CNV_R_R_Umr_1_zu_1_7_CM_S2 -32768 0 FORMAT "%2.0"
 /begin AXIS_DESCR STD_AXIS N_MOT _CNV_R_R_Umr_1_zu_1_3_CM_S2 5 0 65535 FORMAT "%2.0" /end AXIS_DESCR
/end CHARACTERISTIC
/begin CHARACTERISTIC XTAB5GWFP_FPVORPOS_IDX1_HSURE "" CURVE 0x27A248 _REC_S7CUR_53_u2_u2_S2 30000 _CNV_R_R_Umr_1_zu_1_7_CM_S2 0 30000 FORMAT "%2.0" /begin AXIS_DESCR STD_AXIS N_MOT _CNV_R_R_Umr_1_zu_1_3_CM_S2 5 0 65000 /end AXIS_DESCR /end CHARACTERISTIC
/begin CHARACTERISTIC XTAB5GWFP_FPVORPOS_IDX2_HSURE "" CURVE 0x27A25E _REC_S7CUR_53_u2_u2_S2 30000 _CNV_R_R_Umr_1_zu_1_7_CM_S2 0 30000 FORMAT "%2.0" /begin AXIS_DESCR STD_AXIS N_MOT _CNV_R_R_Umr_1_zu_1_3_CM_S2 5 0 65000 /end AXIS_DESCR /end CHARACTERISTIC
/begin CHARACTERISTIC XTAB5GWFP_FPVORPOS_IDX3_HSURE "" CURVE 0x27A274 _REC_S7CUR_53_u2_u2_S2 30000 _CNV_R_R_Umr_1_zu_1_7_CM_S2 0 30000 FORMAT "%2.0" /begin AXIS_DESCR STD_AXIS N_MOT _CNV_R_R_Umr_1_zu_1_3_CM_S2 5 0 65000 /end AXIS_DESCR /end CHARACTERISTIC
/begin CHARACTERISTIC XTAB5GWFP_FPVORPOS_IDX4_HSURE "" CURVE 0x27A28A _REC_S7CUR_53_u2_u2_S2 30000 _CNV_R_R_Umr_1_zu_1_7_CM_S2 0 30000 FORMAT "%2.0" /begin AXIS_DESCR STD_AXIS N_MOT _CNV_R_R_Umr_1_zu_1_3_CM_S2 5 0 65000 /end AXIS_DESCR /end CHARACTERISTIC
/begin CHARACTERISTIC XTAB5GWFP_FPVORPOS_IDX5_HSURE "" CURVE 0x27A2A0 _REC_S7CUR_53_u2_u2_S2 30000 _CNV_R_R_Umr_1_zu_1_7_CM_S2 0 30000 FORMAT "%2.0" /begin AXIS_DESCR STD_AXIS N_MOT _CNV_R_R_Umr_1_zu_1_3_CM_S2 5 0 65000 /end AXIS_DESCR /end CHARACTERISTIC
/begin CHARACTERISTIC XTAB5SCHA_Q_HSUREKU_AAGS "" CURVE 0x279F02 _REC_S7CUR_53_s2_u2_S2 6553.5 _CNV_R_R_Umr_10_zu__46_CM_S2 -3276.8 3276.7 FORMAT "%3.1" /begin AXIS_DESCR STD_AXIS N_T _CNV_R_R_Umr_1_zu_1_3_CM_S2 5 0 65535 /end AXIS_DESCR /end CHARACTERISTIC
/begin CHARACTERISTIC XTAB5SCHA_Q_HSUREKU_LDMAAGS "" CURVE 0x279F18 _REC_S7CUR_53_s2_u2_S2 6553.5 _CNV_R_R_Umr_10_zu__46_CM_S2 -3276.8 3276.7 FORMAT "%3.1" /begin AXIS_DESCR STD_AXIS N_T _CNV_R_R_Umr_1_zu_1_3_CM_S2 5 0 65535 /end AXIS_DESCR /end CHARACTERISTIC
/begin CHARACTERISTIC XTAB5SCHA_Q_HSUREKU_LDMSAGS "" CURVE 0x279F2E _REC_S7CUR_53_s2_u2_S2 6553.5 _CNV_R_R_Umr_10_zu__46_CM_S2 -3276.8 3276.7 FORMAT "%3.1" /begin AXIS_DESCR STD_AXIS N_T _CNV_R_R_Umr_1_zu_1_3_CM_S2 5 0 65535 /end AXIS_DESCR /end CHARACTERISTIC
/begin CHARACTERISTIC XTAB5SCHA_Q_HSUREKU_SAGS "" CURVE 0x279F44 _REC_S7CUR_53_s2_u2_S2 6553.5 _CNV_R_R_Umr_10_zu__46_CM_S2 -3276.8 3276.7 FORMAT "%3.1" /begin AXIS_DESCR STD_AXIS N_T _CNV_R_R_Umr_1_zu_1_3_CM_S2 5 0 65535 /end AXIS_DESCR /end CHARACTERISTIC
/begin CHARACTERISTIC XTAB5SCHGWFP_FOFEINST_AAGS "" CURVE 0x279D7A _REC_S7CUR_53_s2_u2_S2 32768 _CNV_R_R_Umr_1_zu_1_7_CM_S2 -32768 0 FORMAT "%2.0"
 /begin AXIS_DESCR STD_AXIS N_MOT _CNV_R_R_Umr_1_zu_1_3_CM_S2 5 0 65535 FORMAT "%2.0" /end AXIS_DESCR
/end CHARACTERISTIC
/begin CHARACTERISTIC XTAB5SCHGWFP_FOFEINST_SAGS "" CURVE 0x279D90 _REC_S7CUR_53_s2_u2_S2 32768 _CNV_R_R_Umr_1_zu_1_7_CM_S2 -32768 0 FORMAT "%2.0"
 /begin AXIS_DESCR STD_AXIS N_MOT _CNV_R_R_Umr_1_zu_1_3_CM_S2 5 0 65535 FORMAT "%2.0" /end AXIS_DESCR
/end CHARACTERISTIC
/begin CHARACTERISTIC XTAB5S_PROG_MODE_HSUKS "" CURVE 0x27B50C _REC_A1CUR_30_u1_u1_S2 1 _CNV_R_R_Umr_1_zu_1_2_CM_S2 0 1 FORMAT "%2.0"
 /begin AXIS_DESCR FIX_AXIS NO_INPUT_QUANTITY _CNV_S_5_Enum_EPROG_122_CM_S2 5 0 4 FIX_AXIS_PAR_DIST 0 1 5 READ_ONLY /end AXIS_DESCR
/end CHARACTERISTIC
/begin CHARACTERISTIC XTAB5X5FAKT_SOC_HSURETYPE "" MAP 0x271700 _REC_S7MAP_53_u2_u2_s2_S2 1 _CNV_R_R_Umr_100_zu_54_CM_S2 0 1 FORMAT "%4.2"
 /begin AXIS_DESCR STD_AXIS Z_SOC _CNV_R_R_Umr_1_zu_1_53_CM_S2 5 0 100 FORMAT "%2.0" /end AXIS_DESCR
 /begin AXIS_DESCR STD_AXIS W_STEIGUNG_KORFILT _CNV_R_R_Umr_10_zu__9_CM_S2 5 -200 200 FORMAT "%3.1" /end AXIS_DESCR
/end CHARACTERISTIC
/begin CHARACTERISTIC XTAB5X5HSUREKU_DECRVAL_AAGS "" MAP 0x273A9C _REC_S7MAP_53_u2_u2_s2_S2 255 _CNV_R_R_Umr_1_zu_1_2_CM_S2 0 255 FORMAT "%2.0" /begin AXIS_DESCR STD_AXIS N_MOT _CNV_R_R_Umr_1_zu_1_3_CM_S2 5 0 65535 /end AXIS_DESCR /begin AXIS_DESCR STD_AXIS A_Q_KURVE _CNV_R_R_Umr_10_zu__46_CM_S2 5 0 3276.7 /end AXIS_DESCR /end CHARACTERISTIC
/begin CHARACTERISTIC XTAB5X5HSUREKU_DECRVAL_LDMAAGS "" MAP 0x273AE4 _REC_S7MAP_53_u2_u2_s2_S2 255 _CNV_R_R_Umr_1_zu_1_2_CM_S2 0 255 FORMAT "%2.0" /begin AXIS_DESCR STD_AXIS N_MOT _CNV_R_R_Umr_1_zu_1_3_CM_S2 5 0 65535 /end AXIS_DESCR /begin AXIS_DESCR STD_AXIS A_Q_KURVE _CNV_R_R_Umr_10_zu__46_CM_S2 5 0 3276.7 /end AXIS_DESCR /end CHARACTERISTIC
/begin CHARACTERISTIC XTAB5X5HSUREKU_DECRVAL_LDMSAGS "" MAP 0x273B2C _REC_S7MAP_53_u2_u2_s2_S2 255 _CNV_R_R_Umr_1_zu_1_2_CM_S2 0 255 FORMAT "%2.0" /begin AXIS_DESCR STD_AXIS N_MOT _CNV_R_R_Umr_1_zu_1_3_CM_S2 5 0 65535 /end AXIS_DESCR /begin AXIS_DESCR STD_AXIS A_Q_KURVE _CNV_R_R_Umr_10_zu__46_CM_S2 5 0 3276.7 /end AXIS_DESCR /end CHARACTERISTIC
/begin CHARACTERISTIC XTAB5X5HSUREKU_DECRVAL_SAGS "" MAP 0x273B74 _REC_S7MAP_53_u2_u2_s2_S2 255 _CNV_R_R_Umr_1_zu_1_2_CM_S2 0 255 FORMAT "%2.0" /begin AXIS_DESCR STD_AXIS N_MOT _CNV_R_R_Umr_1_zu_1_3_CM_S2 5 0 65535 /end AXIS_DESCR /begin AXIS_DESCR STD_AXIS A_Q_KURVE _CNV_R_R_Umr_10_zu__46_CM_S2 5 0 3276.7 /end AXIS_DESCR /end CHARACTERISTIC
/begin CHARACTERISTIC XTAB5X9C_DECRA_AAF_HSUCOS "" MAP 0x276232 _REC_S3MAP_54_u2_u2_u1_S2 255 _CNV_R_R_Umr_1_zu_1_2_CM_S2 0 255 FORMAT "%2.0"
 /begin AXIS_DESCR STD_AXIS N_MOT _CNV_R_R_Umr_1_zu_1_3_CM_S2 5 0 20000 FORMAT "%2.0" /end AXIS_DESCR
 /begin AXIS_DESCR FIX_AXIS Z_GANG_ZIEL_HSURE _CNV_S_9_Enum_EGANG_30_CM_S2 9 0 8 FIX_AXIS_PAR_DIST 0 1 9 READ_ONLY /end AXIS_DESCR
/end CHARACTERISTIC
/begin CHARACTERISTIC XTAB5X9C_DECRA_HSUCOS "" MAP 0x276298 _REC_S3MAP_54_u2_u2_u1_S2 255 _CNV_R_R_Umr_1_zu_1_2_CM_S2 0 255 FORMAT "%2.0"
 /begin AXIS_DESCR STD_AXIS N_MOT _CNV_R_R_Umr_1_zu_1_3_CM_S2 5 0 20000 FORMAT "%2.0" /end AXIS_DESCR
 /begin AXIS_DESCR FIX_AXIS Z_GANG_ZIEL_HSURE _CNV_S_9_Enum_EGANG_30_CM_S2 9 0 8 FIX_AXIS_PAR_DIST 0 1 9 READ_ONLY /end AXIS_DESCR
/end CHARACTERISTIC
/begin CHARACTERISTIC XTAB5X9C_DECRS_AAF_HSUCOS "" MAP 0x2762FE _REC_S3MAP_54_u2_u2_u1_S2 255 _CNV_R_R_Umr_1_zu_1_2_CM_S2 0 255 FORMAT "%2.0"
 /begin AXIS_DESCR STD_AXIS N_MOT _CNV_R_R_Umr_1_zu_1_3_CM_S2 5 0 20000 FORMAT "%2.0" /end AXIS_DESCR
 /begin AXIS_DESCR FIX_AXIS Z_GANG_ZIEL_HSURE _CNV_S_9_Enum_EGANG_30_CM_S2 9 0 8 FIX_AXIS_PAR_DIST 0 1 9 READ_ONLY /end AXIS_DESCR
/end CHARACTERISTIC
/begin CHARACTERISTIC XTAB5X9C_DECRS_HSUCOS "" MAP 0x276364 _REC_S3MAP_54_u2_u2_u1_S2 255 _CNV_R_R_Umr_1_zu_1_2_CM_S2 0 255 FORMAT "%2.0"
 /begin AXIS_DESCR STD_AXIS N_MOT _CNV_R_R_Umr_1_zu_1_3_CM_S2 5 0 20000 FORMAT "%2.0" /end AXIS_DESCR
 /begin AXIS_DESCR FIX_AXIS Z_GANG_ZIEL_HSURE _CNV_S_9_Enum_EGANG_30_CM_S2 9 0 8 FIX_AXIS_PAR_DIST 0 1 9 READ_ONLY /end AXIS_DESCR
/end CHARACTERISTIC
/begin CHARACTERISTIC XTAB5X9C_HSUREBAB_DECRVAL_AAGS "" MAP 0x279C72 _REC_S3MAP_54_u2_u2_u1_S2 255 _CNV_R_R_Umr_1_zu_1_2_CM_S2 0 255 FORMAT "%2.0"
 /begin AXIS_DESCR STD_AXIS N_MOT _CNV_R_R_Umr_1_zu_1_3_CM_S2 5 0 20000 FORMAT "%2.0" /end AXIS_DESCR
 /begin AXIS_DESCR FIX_AXIS Z_GANG_ZIEL_HSURE _CNV_S_9_Enum_EGANG_30_CM_S2 9 0 8 FIX_AXIS_PAR_DIST 0 1 9 READ_ONLY /end AXIS_DESCR
/end CHARACTERISTIC
/begin CHARACTERISTIC XTAB5X9C_HSUREBAB_DECRVAL_SAGS "" MAP 0x279CD8 _REC_S3MAP_54_u2_u2_u1_S2 255 _CNV_R_R_Umr_1_zu_1_2_CM_S2 0 255 FORMAT "%2.0"
 /begin AXIS_DESCR STD_AXIS N_MOT _CNV_R_R_Umr_1_zu_1_3_CM_S2 5 0 20000 FORMAT "%2.0" /end AXIS_DESCR
 /begin AXIS_DESCR FIX_AXIS Z_GANG_ZIEL_HSURE _CNV_S_9_Enum_EGANG_30_CM_S2 9 0 8 FIX_AXIS_PAR_DIST 0 1 9 READ_ONLY /end AXIS_DESCR
/end CHARACTERISTIC
/begin CHARACTERISTIC XTAB5X9C_HSUREHSDECR_NMOT_AAGS "" MAP 0x279DA8 _REC_S3MAP_54_u2_u2_u1_S2 255 _CNV_R_R_Umr_1_zu_1_2_CM_S2 0 255 FORMAT "%2.0"
 /begin AXIS_DESCR STD_AXIS N_MOTNACHHS_HSUREHS _CNV_R_R_Umr_1_zu_1_3_CM_S2 5 0 20000 FORMAT "%2.0" /end AXIS_DESCR
 /begin AXIS_DESCR FIX_AXIS Z_GANG_ZIEL_HSURE _CNV_S_9_Enum_EGANG_30_CM_S2 9 0 8 FIX_AXIS_PAR_DIST 0 1 9 READ_ONLY /end AXIS_DESCR
/end CHARACTERISTIC
/begin CHARACTERISTIC XTAB5X9C_HSUREHSDECR_NMOT_SAGS "" MAP 0x279E0E _REC_S3MAP_54_u2_u2_u1_S2 255 _CNV_R_R_Umr_1_zu_1_2_CM_S2 0 255 FORMAT "%2.0"
 /begin AXIS_DESCR STD_AXIS N_MOTNACHHS_HSUREHS _CNV_R_R_Umr_1_zu_1_3_CM_S2 5 0 20000 FORMAT "%2.0" /end AXIS_DESCR
 /begin AXIS_DESCR FIX_AXIS Z_GANG_ZIEL_HSURE _CNV_S_9_Enum_EGANG_30_CM_S2 9 0 8 FIX_AXIS_PAR_DIST 0 1 9 READ_ONLY /end AXIS_DESCR
/end CHARACTERISTIC
/begin CHARACTERISTIC XTAB5X9C_HSUREINSTDECR_NMOT "" MAP 0x279E76 _REC_S3MAP_54_u2_u2_u1_S2 20000 _CNV_R_R_Umr_1_zu_1_2_CM_S2 0 20000 FORMAT "%2.0"
 /begin AXIS_DESCR STD_AXIS N_MOT _CNV_R_R_Umr_1_zu_1_3_CM_S2 5 0 20000 FORMAT "%2.0" /end AXIS_DESCR
 /begin AXIS_DESCR FIX_AXIS Z_GANG_ZIEL _CNV_S_9_Enum_EGANG_30_CM_S2 9 0 8 FIX_AXIS_PAR_DIST 0 1 9 READ_ONLY /end AXIS_DESCR
/end CHARACTERISTIC
/begin CHARACTERISTIC XTAB5X9C_HSURERSDECR_NMOT_AAGS "" MAP 0x279FD0 _REC_S3MAP_54_u2_u2_u1_S2 255 _CNV_R_R_Umr_1_zu_1_2_CM_S2 0 255 FORMAT "%2.0"
 /begin AXIS_DESCR STD_AXIS N_MOT _CNV_R_R_Umr_1_zu_1_3_CM_S2 5 0 20000 FORMAT "%2.0" /end AXIS_DESCR
 /begin AXIS_DESCR FIX_AXIS Z_GANG_ZIEL_HSURE _CNV_S_9_Enum_EGANG_30_CM_S2 9 0 8 FIX_AXIS_PAR_DIST 0 1 9 READ_ONLY /end AXIS_DESCR
/end CHARACTERISTIC
/begin CHARACTERISTIC XTAB5X9C_HSURERSDECR_NMOT_SAGS "" MAP 0x27A036 _REC_S3MAP_54_u2_u2_u1_S2 255 _CNV_R_R_Umr_1_zu_1_2_CM_S2 0 255 FORMAT "%2.0"
 /begin AXIS_DESCR STD_AXIS N_MOT _CNV_R_R_Umr_1_zu_1_3_CM_S2 5 0 20000 FORMAT "%2.0" /end AXIS_DESCR
 /begin AXIS_DESCR FIX_AXIS Z_GANG_ZIEL_HSURE _CNV_S_9_Enum_EGANG_30_CM_S2 9 0 8 FIX_AXIS_PAR_DIST 0 1 9 READ_ONLY /end AXIS_DESCR
/end CHARACTERISTIC
/begin CHARACTERISTIC XTAB5X9SCHN_AB_HSURERS "" MAP 0x27A09C _REC_A1MAP_9_u2_u1_u1_S2 15000 _CNV_R_R_Umr_1_zu_1_2_CM_S2 0 15000 FORMAT "%2.0"
 /begin AXIS_DESCR FIX_AXIS Z_NABHSURERS_FFG _CNV_S_6_Enum_ENABH_108_CM_S2 5 0 5 FIX_AXIS_PAR_DIST 1 1 5 READ_ONLY /end AXIS_DESCR
 /begin AXIS_DESCR FIX_AXIS Z_GANG_ZIEL_HSURE _CNV_S_9_Enum_EGANG_30_CM_S2 9 0 8 FIX_AXIS_PAR_DIST 0 1 9 READ_ONLY /end AXIS_DESCR
/end CHARACTERISTIC
/begin CHARACTERISTIC XTAB7X2FAKT_HSURE_FWS "" MAP 0x273A4C _REC_S3MAP_54_u2_s2_u1_S2 200 _CNV_R_R_Umr_1_zu_1_53_CM_S2 0 200 FORMAT "%2.0"
 /begin AXIS_DESCR STD_AXIS DM_AB_FWSKOR_FILTFAST_BGH _CNV_R_R_Umr_1_zu_1_42_CM_S2 7 -32768 32767 /end AXIS_DESCR
 /begin AXIS_DESCR FIX_AXIS Z_AGS_MODBEDEL_HSU _CNV_S_2_Enum_EAGS_25_CM_S2 2 0 1 FIX_AXIS_PAR_DIST 0 1 2 READ_ONLY /end AXIS_DESCR
/end CHARACTERISTIC
/begin CHARACTERISTIC XTAB8X8S_BEDELWECHSEL_AUSHSU "" MAP 0x2717C0 _REC_A1MAP_8_u1_u1_u1_S2 2 _CNV_S_3_Enum_EHSUA_129_CM_S2 0 2
 /begin AXIS_DESCR FIX_AXIS Z_HSUBED _CNV_S_8_Enum_EHSUB_119_CM_S2 8 0 7 FIX_AXIS_PAR_DIST 0 1 8 READ_ONLY /end AXIS_DESCR
 /begin AXIS_DESCR FIX_AXIS Z_HSUBED _CNV_S_8_Enum_EHSUB_119_CM_S2 8 0 7 FIX_AXIS_PAR_DIST 0 1 8 READ_ONLY /end AXIS_DESCR
/end CHARACTERISTIC
/begin CHARACTERISTIC XTAB9FAKT_AQ_HSUREKU "" CURVE 0x279F5A _REC_A1CUR_30_u2_u1_S2 10 _CNV_R_R_Umr_100_zu_54_CM_S2 0 10 FORMAT "%4.2"
 /begin AXIS_DESCR FIX_AXIS Z_GANG_ZIEL_HSURE _CNV_S_9_Enum_EGANG_30_CM_S2 9 0 8 FIX_AXIS_PAR_DIST 0 1 9 READ_ONLY /end AXIS_DESCR
/end CHARACTERISTIC
/begin CHARACTERISTIC XTAB9N_AB_MAX_REINI_HSURESLREG "" CURVE 0x27A100 _REC_A1CUR_30_u2_u1_S2 20000 _CNV_R_R_Umr_1_zu_1_3_CM_S2 0 20000 FORMAT "%2.0"
 /begin AXIS_DESCR FIX_AXIS Z_GANG_ZIEL_HSURE _CNV_S_9_Enum_EGANG_30_CM_S2 9 0 8 FIX_AXIS_PAR_DIST 0 1 9 READ_ONLY /end AXIS_DESCR
/end CHARACTERISTIC
/begin CHARACTERISTIC XTAB9ON_AB_BRS_HSURE_COS "" CURVE 0x27620E _REC_A1CUR_30_u2_u1_S2 20000 _CNV_R_R_Umr_1_zu_1_3_CM_S2 0 20000 FORMAT "%2.0"
 /begin AXIS_DESCR FIX_AXIS Z_GANG_ZIEL_HSURE _CNV_S_9_Enum_EGANG_30_CM_S2 9 0 8 FIX_AXIS_PAR_DIST 0 1 9 READ_ONLY /end AXIS_DESCR
/end CHARACTERISTIC
/begin CHARACTERISTIC XTAB9ON_AB_DERS_HSURE_COS "" CURVE 0x276220 _REC_A1CUR_30_u2_u1_S2 20000 _CNV_R_R_Umr_1_zu_1_3_CM_S2 0 20000 FORMAT "%2.0"
 /begin AXIS_DESCR FIX_AXIS Z_GANG_ZIEL_HSURE _CNV_S_9_Enum_EGANG_30_CM_S2 9 0 8 FIX_AXIS_PAR_DIST 0 1 9 READ_ONLY /end AXIS_DESCR
/end CHARACTERISTIC
/begin CHARACTERISTIC XTAB9ON_AB_NL_HSURESLREG "" CURVE 0x27A112 _REC_A1CUR_30_u2_u1_S2 20000 _CNV_R_R_Umr_1_zu_1_3_CM_S2 0 20000 FORMAT "%2.0"
 /begin AXIS_DESCR FIX_AXIS Z_GANG_ZIEL_HSURE _CNV_S_9_Enum_EGANG_30_CM_S2 9 0 8 FIX_AXIS_PAR_DIST 0 1 9 READ_ONLY /end AXIS_DESCR
/end CHARACTERISTIC
/begin CHARACTERISTIC XTAB9SCHN_MOT_MAX_HSUKS "" CURVE 0x276456 _REC_A1CUR_30_u2_u1_S2 10000 _CNV_R_R_Umr_1_zu_1_3_CM_S2 0 10000 FORMAT "%2.0"
 /begin AXIS_DESCR FIX_AXIS Z_GANG_ZIEL _CNV_S_9_Enum_EGANG_30_CM_S2 9 0 8 FIX_AXIS_PAR_DIST 0 1 9 READ_ONLY /end AXIS_DESCR
/end CHARACTERISTIC
/begin CHARACTERISTIC XTAB9SCHW_DKKD_AUSHSU "" CURVE 0x276428 _REC_A1CUR_30_u2_u1_S2 110 _CNV_R_R_Umr_10_zu__9_CM_S2 0 110 FORMAT "%3.1"
 /begin AXIS_DESCR FIX_AXIS Z_GANG_ZIEL_HSURE _CNV_S_9_Enum_EGANG_30_CM_S2 9 0 8 FIX_AXIS_PAR_DIST 0 1 9 READ_ONLY /end AXIS_DESCR
/end CHARACTERISTIC
/begin CHARACTERISTIC XTAB9V_FZG_DECR_HSUREINST_HM "" CURVE 0x279EDC _REC_A1CUR_30_u2_u1_S2 400 _CNV_R_R_Umr_1_zu_1_8_CM_S2 0 400 FORMAT "%2.0"
 /begin AXIS_DESCR FIX_AXIS Z_GANG_ZIEL _CNV_S_9_Enum_EGANG_30_CM_S2 9 0 8 FIX_AXIS_PAR_DIST 0 1 9 READ_ONLY /end AXIS_DESCR
/end CHARACTERISTIC
/begin CHARACTERISTIC XTAB9X2SCHN_MOT_AAF_HSURE_COS "" MAP 0x27166C _REC_A1MAP_9_u2_u1_u1_S2 65535 _CNV_R_R_Umr_1_zu_1_3_CM_S2 0 65535 FORMAT "%2.0"
 /begin AXIS_DESCR FIX_AXIS Z_GANG_ZIEL_HSURE _CNV_S_9_Enum_EGANG_30_CM_S2 9 0 8 FIX_AXIS_PAR_DIST 0 1 9 READ_ONLY /end AXIS_DESCR
 /begin AXIS_DESCR FIX_AXIS Z_AGS_MODBEDEL_HSU _CNV_S_2_Enum_EAGS_25_CM_S2 2 0 1 FIX_AXIS_PAR_DIST 0 1 2 READ_ONLY /end AXIS_DESCR
/end CHARACTERISTIC
/begin CHARACTERISTIC XTAB9X2SCHN_MOT_KREIS_HSURE_COS "" MAP 0x271690 _REC_A1MAP_9_u2_u1_u1_S2 65535 _CNV_R_R_Umr_1_zu_1_3_CM_S2 0 65535 FORMAT "%2.0"
 /begin AXIS_DESCR FIX_AXIS Z_GANG_ZIEL_HSURE _CNV_S_9_Enum_EGANG_30_CM_S2 9 0 8 FIX_AXIS_PAR_DIST 0 1 9 READ_ONLY /end AXIS_DESCR
 /begin AXIS_DESCR FIX_AXIS Z_AGS_MODBEDEL_HSU _CNV_S_2_Enum_EAGS_25_CM_S2 2 0 1 FIX_AXIS_PAR_DIST 0 1 2 READ_ONLY /end AXIS_DESCR
/end CHARACTERISTIC
/begin CHARACTERISTIC XTAB9X2SCHN_MOT_KRZG_HSURE_COS "" MAP 0x2716B4 _REC_A1MAP_9_u2_u1_u1_S2 65535 _CNV_R_R_Umr_1_zu_1_3_CM_S2 0 65535 FORMAT "%2.0"
 /begin AXIS_DESCR FIX_AXIS Z_GANG_ZIEL_HSURE _CNV_S_9_Enum_EGANG_30_CM_S2 9 0 8 FIX_AXIS_PAR_DIST 0 1 9 READ_ONLY /end AXIS_DESCR
 /begin AXIS_DESCR FIX_AXIS Z_AGS_MODBEDEL_HSU _CNV_S_2_Enum_EAGS_25_CM_S2 2 0 1 FIX_AXIS_PAR_DIST 0 1 2 READ_ONLY /end AXIS_DESCR
/end CHARACTERISTIC
/begin CHARACTERISTIC XTAB9X2SCHN_MOT_KURVE_HSURE_COS "" MAP 0x2716D8 _REC_A1MAP_9_u2_u1_u1_S2 65535 _CNV_R_R_Umr_1_zu_1_3_CM_S2 0 65535 FORMAT "%2.0"
 /begin AXIS_DESCR FIX_AXIS Z_GANG_ZIEL_HSURE _CNV_S_9_Enum_EGANG_30_CM_S2 9 0 8 FIX_AXIS_PAR_DIST 0 1 9 READ_ONLY /end AXIS_DESCR
 /begin AXIS_DESCR FIX_AXIS Z_AGS_MODBEDEL_HSU _CNV_S_2_Enum_EAGS_25_CM_S2 2 0 1 FIX_AXIS_PAR_DIST 0 1 2 READ_ONLY /end AXIS_DESCR
/end CHARACTERISTIC
/begin CHARACTERISTIC XTAB9X3N_AB_MAX_HSURESL "" MAP 0x27A13A _REC_A1MAP_9_u2_u1_u1_S2 15000 _CNV_R_R_Umr_1_zu_1_2_CM_S2 0 15000 FORMAT "%2.0"
 /begin AXIS_DESCR FIX_AXIS Z_GANG_ZIEL_HSURE _CNV_S_9_Enum_EGANG_30_CM_S2 9 0 8 FIX_AXIS_PAR_DIST 0 1 9 READ_ONLY /end AXIS_DESCR
 /begin AXIS_DESCR FIX_AXIS NO_INPUT_QUANTITY _CNV_S_3_Enum_ENABH_120_CM_S2 3 0 2 FIX_AXIS_PAR_DIST 0 1 3 READ_ONLY /end AXIS_DESCR
/end CHARACTERISTIC
/begin CHARACTERISTIC XTAB9X3N_AB_MIN_NACHL_HSURESL "" MAP 0x27A170 _REC_A1MAP_9_u2_u1_u1_S2 15000 _CNV_R_R_Umr_1_zu_1_2_CM_S2 0 15000 FORMAT "%2.0"
 /begin AXIS_DESCR FIX_AXIS Z_GANG_ZIEL_HSURE _CNV_S_9_Enum_EGANG_30_CM_S2 9 0 8 FIX_AXIS_PAR_DIST 0 1 9 READ_ONLY /end AXIS_DESCR
 /begin AXIS_DESCR FIX_AXIS NO_INPUT_QUANTITY _CNV_S_3_Enum_ENABH_120_CM_S2 3 0 2 FIX_AXIS_PAR_DIST 0 1 3 READ_ONLY /end AXIS_DESCR
/end CHARACTERISTIC
/begin CHARACTERISTIC XTAB9X5_HSUKS_IDX "" MAP 0x27B511 _REC_A1MAP_9_u1_u1_u1_S2 4 _CNV_R_R_Umr_1_zu_1_2_CM_S2 0 4 FORMAT "%2.0"
 /begin AXIS_DESCR FIX_AXIS Z_GANG_ZIEL _CNV_S_9_Enum_EGANG_30_CM_S2 9 0 8 /begin FIX_AXIS_PAR_LIST 0 1 2 3 4 5 6 7 8 /end FIX_AXIS_PAR_LIST READ_ONLY /end AXIS_DESCR
 /begin AXIS_DESCR FIX_AXIS NO_INPUT_QUANTITY _CNV_S_5_Enum_EHSU__125_CM_S2 5 0 4 /begin FIX_AXIS_PAR_LIST 0 1 2 3 4 /end FIX_AXIS_PAR_LIST READ_ONLY /end AXIS_DESCR
/end CHARACTERISTIC
/begin CHARACTERISTIC XTAB9Z_GANG_HSURE_ADAPT "" CURVE 0x27B6E3 _REC_A1CUR_30_u1_u1_S2 1 _CNV_R_R_Umr_1_zu_1_2_CM_S2 0 1
 /begin AXIS_DESCR FIX_AXIS Z_GANG_ZIEL_HSURE _CNV_S_9_Enum_EGANG_30_CM_S2 9 0 8 FIX_AXIS_PAR_DIST 0 1 9 READ_ONLY /end AXIS_DESCR
/end CHARACTERISTIC
/begin CHARACTERISTIC XTAB9Z_GANG_HSURE_NSC "" CURVE 0x27B6F7 _REC_A1CUR_30_u1_u1_S2 1 _CNV_R_R_Umr_1_zu_1_2_CM_S2 0 1
 /begin AXIS_DESCR FIX_AXIS Z_GANG_ZIEL_HSURE _CNV_S_9_Enum_EGANG_30_CM_S2 9 0 8 FIX_AXIS_PAR_DIST 0 1 9 READ_ONLY /end AXIS_DESCR
/end CHARACTERISTIC
/begin CHARACTERISTIC XC_HSUREHS_DECRVALLDM "" VALUE 0x27B6F1 _REC_S1VAL_1_u1_S2 255 _CNV_R_R_Umr_1_zu_1_2_CM_S2 0 255 FORMAT "%2.0" /end CHARACTERISTIC
/begin CHARACTERISTIC XC_HSUREKUVOR_DECRVAL "" VALUE 0x27B6F5 _REC_S1VAL_1_u1_S2 255 _CNV_R_R_Umr_1_zu_1_2_CM_S2 0 255 FORMAT "%2.0" /end CHARACTERISTIC
/begin CHARACTERISTIC XC_HSURERS_DECRVALLDM "" VALUE 0x27B700 _REC_S1VAL_1_u1_S2 255 _CNV_R_R_Umr_1_zu_1_2_CM_S2 0 255 FORMAT "%2.0" /end CHARACTERISTIC
/begin CHARACTERISTIC XC_HSURE_INITVAL "" VALUE 0x27644C _REC_S1VAL_1_u2_S2 65535 _CNV_R_R_Umr_1_zu_1_2_CM_S2 0 65535 FORMAT "%2.0" /end CHARACTERISTIC
/begin CHARACTERISTIC XDGW_FP_HSURE_BRS "" VALUE 0x279D5A _REC_S1VAL_1_s2_S2 500 _CNV_R_R_Umr_1_zu_1_7_CM_S2 0 500 /end CHARACTERISTIC
/begin CHARACTERISTIC XFC_HSUREBAB_DECRVAL_DSPORT "" VALUE 0x27B6ED _REC_S1VAL_1_u1_S2 2.4 _CNV_R_R_Umr_100_zu_54_CM_S2 0.1 2.5 FORMAT "%4.2" /end CHARACTERISTIC
/begin CHARACTERISTIC XFC_HSUREBRS_DECRVAL_DSPORT "" VALUE 0x27B6F0 _REC_S1VAL_1_u1_S2 2.4 _CNV_R_R_Umr_100_zu_54_CM_S2 0.1 2.5 FORMAT "%4.2" /end CHARACTERISTIC
/begin CHARACTERISTIC XFC_HSURECOS_DECRVAL_DSPORT "" VALUE 0x27B4E4 _REC_S1VAL_1_u1_S2 2.4 _CNV_R_R_Umr_100_zu_54_CM_S2 0.1 2.5 FORMAT "%4.2" /end CHARACTERISTIC
/begin CHARACTERISTIC XFC_HSUREHS_DECRVAL_DSPORT "" VALUE 0x27B6F2 _REC_S1VAL_1_u1_S2 2.4 _CNV_R_R_Umr_100_zu_54_CM_S2 0.1 2.5 FORMAT "%4.2" /end CHARACTERISTIC
/begin CHARACTERISTIC XFC_HSUREKURVE_DECRVAL_DSPORT "" VALUE 0x27B6F4 _REC_S1VAL_1_u1_S2 2.4 _CNV_R_R_Umr_100_zu_54_CM_S2 0.1 2.5 FORMAT "%4.2" /end CHARACTERISTIC
/begin CHARACTERISTIC XFC_HSURENL_DECRVAL_DSPORT "" VALUE 0x27B6F6 _REC_S1VAL_1_u1_S2 2.4 _CNV_R_R_Umr_100_zu_54_CM_S2 0.1 2.5 FORMAT "%4.2" /end CHARACTERISTIC
/begin CHARACTERISTIC XFC_HSURERS_DECRVAL_DSPORT "" VALUE 0x27B701 _REC_S1VAL_1_u1_S2 2.4 _CNV_R_R_Umr_100_zu_54_CM_S2 0.1 2.5 FORMAT "%4.2" /end CHARACTERISTIC
/begin CHARACTERISTIC XFN_MOTDECRSTART_DSPORT_HSU_COS "" VALUE 0x27B4E5 _REC_S1VAL_1_u1_S2 2.5 _CNV_R_R_Umr_100_zu_54_CM_S2 0 2.5 FORMAT "%4.2" /end CHARACTERISTIC
/begin CHARACTERISTIC XON_GENEG_VRKURVE_HSURE_COS "" VALUE 0x276408 _REC_S1VAL_1_u2_S2 10000 _CNV_R_R_Umr_1_zu_1_3_CM_S2 0 10000 FORMAT "%2.0" /end CHARACTERISTIC
/begin CHARACTERISTIC XSCHDN_NT_HSSKL_ERSATZ_1 "" VALUE 0x279C6E _REC_S1VAL_1_s2_S2 2000 _CNV_R_R_Umr_1_zu_1_2_CM_S2 -1000 1000 FORMAT "%2.0" /end CHARACTERISTIC
/begin CHARACTERISTIC XSCHDN_NT_HSSKL_ERSATZ_2 "" VALUE 0x279C70 _REC_S1VAL_1_s2_S2 2000 _CNV_R_R_Umr_1_zu_1_2_CM_S2 -1000 1000 FORMAT "%2.0" /end CHARACTERISTIC
/begin CHARACTERISTIC XSCHGW_FP_HSURE_BRS "" VALUE 0x279D5C _REC_S1VAL_1_s2_S2 10000 _CNV_R_R_Umr_1_zu_1_7_CM_S2 0 10000 /end CHARACTERISTIC
/begin CHARACTERISTIC XSCHMASK_ADAS_HSURE_COS "" VALUE 0x27B4E6 _REC_S1VAL_1_u1_S2 255 _CNV_R_R_Umr_1_zu_1_2_CM_S2 0 255 FORMAT "%2.0" /end CHARACTERISTIC
/begin CHARACTERISTIC XSCHN_HSURE_ABLEGEN "" VALUE 0x279EEE _REC_S1VAL_1_s2_S2 10000 _CNV_R_R_Umr_1_zu_1_2_CM_S2 0 10000 FORMAT "%2.0" /end CHARACTERISTIC
/begin CHARACTERISTIC XSCHN_MOT_AUSHSURE "" VALUE 0x27644E _REC_S1VAL_1_u2_S2 20000 _CNV_R_R_Umr_1_zu_1_3_CM_S2 0 20000 FORMAT "%2.0" /end CHARACTERISTIC
/begin CHARACTERISTIC XSCHN_MOT_AUSHSURE_KS "" VALUE 0x276452 _REC_S1VAL_1_u2_S2 20000 _CNV_R_R_Umr_1_zu_1_3_CM_S2 0 20000 FORMAT "%2.0" /end CHARACTERISTIC
/begin CHARACTERISTIC XSCHN_MOT_HSURENL_BREMSE "" VALUE 0x279FBA _REC_S1VAL_1_u2_S2 10000 _CNV_R_R_Umr_1_zu_1_3_CM_S2 0 10000 FORMAT "%2.0" /end CHARACTERISTIC
/begin CHARACTERISTIC XSCHN_MOT_SERPKURVE_HSUREBAB "" VALUE 0x279D3E _REC_S1VAL_1_u2_S2 10000 _CNV_R_R_Umr_1_zu_1_3_CM_S2 0 10000 FORMAT "%2.0" /end CHARACTERISTIC
/begin CHARACTERISTIC XSCHWGWFP_MIN_HSUREHS "" VALUE 0x279E74 _REC_S1VAL_1_s2_S2 65535 _CNV_R_R_Umr_1_zu_1_7_CM_S2 -32768 32767 FORMAT "%2.0" /end CHARACTERISTIC
/begin CHARACTERISTIC XSCHWNL_HSUREFOF "" VALUE 0x279DA6 _REC_S1VAL_1_u2_S2 110 _CNV_R_R_Umr_10_zu__9_CM_S2 0 110 FORMAT "%3.1" /end CHARACTERISTIC
/begin CHARACTERISTIC XSCHWNL_HSURE_BRS "" VALUE 0x279D5E _REC_S1VAL_1_u2_S2 110 _CNV_R_R_Umr_10_zu__9_CM_S2 0 110 FORMAT "%3.1" /end CHARACTERISTIC
/begin CHARACTERISTIC XSCHW_DKKD_HSURENL "" VALUE 0x279FBC _REC_S1VAL_1_u2_S2 100 _CNV_R_R_Umr_10_zu__9_CM_S2 0 100 FORMAT "%3.1" /end CHARACTERISTIC
/begin CHARACTERISTIC XSCHW_DKKD_HSURERS "" VALUE 0x27A0F6 _REC_S1VAL_1_u2_S2 100 _CNV_R_R_Umr_10_zu__9_CM_S2 0 100 FORMAT "%3.1" /end CHARACTERISTIC
/begin CHARACTERISTIC XS_ERSATZW_DELTA_NT_HSSKL "" VALUE 0x27B6EC _REC_S1VAL_1_u1_S2 1 _CNV_R_R_Umr_1_zu_1_2_CM_S2 0 1 FORMAT "%2.0" /end CHARACTERISTIC
/begin CHARACTERISTIC XS_FT_MAXAAGS_DSPORT_HSURE "" VALUE 0x27B505 _REC_S1VAL_1_u1_S2 1 _CNV_R_R_Umr_1_zu_1_2_CM_S2 0 1 /end CHARACTERISTIC
/begin CHARACTERISTIC XS_HSURE_FZGSTEHT "" VALUE 0x27B506 _REC_S1VAL_1_u1_S2 1 _CNV_R_R_Umr_1_zu_1_2_CM_S2 0 1 FORMAT "%2.0" /end CHARACTERISTIC
/begin CHARACTERISTIC XS_HSURE_MODWHYB_RESET "" VALUE 0x27B50A _REC_S1VAL_1_u1_S2 1 _CNV_R_R_Umr_1_zu_1_2_CM_S2 0 1 /end CHARACTERISTIC
/begin CHARACTERISTIC XS_KURVE_HSUREBAB "" VALUE 0x27B6EE _REC_S1VAL_1_u1_S2 1 _CNV_S_2_Schalter_A_4_CM_S2 0 1 /end CHARACTERISTIC
/begin CHARACTERISTIC XS_RESET_HSURE_NSC "" VALUE 0x27B507 _REC_S1VAL_1_u1_S2 1 _CNV_S_2_Schalter_A_4_CM_S2 0 1 /end CHARACTERISTIC
/begin CHARACTERISTIC XS_SERP_HSUREBAB "" VALUE 0x27B6EF _REC_S1VAL_1_u1_S2 1 _CNV_S_2_Schalter_A_4_CM_S2 0 1 /end CHARACTERISTIC
/begin CHARACTERISTIC XS_USE_HSUREHS_SCHALTUNG "" VALUE 0x27B6F3 _REC_S1VAL_1_u1_S2 1 _CNV_S_2_Schalter_A_4_CM_S2 0 1 /end CHARACTERISTIC
/begin CHARACTERISTIC XS_USE_HSURERS_SCHALTUNG "" VALUE 0x27B702 _REC_S1VAL_1_u1_S2 1 _CNV_S_2_Schalter_A_4_CM_S2 0 1 /end CHARACTERISTIC
/begin CHARACTERISTIC XS_WDKKDPS_HSURE "" VALUE 0x27B508 _REC_S1VAL_1_u1_S2 1 _CNV_R_R_Umr_1_zu_1_2_CM_S2 0 1 FORMAT "%2.0" /end CHARACTERISTIC
/begin CHARACTERISTIC XTEMP_MAX_HSUKS "" VALUE 0x276468 _REC_S1VAL_1_u2_S2 500 _CNV_R_R_Umr_1_zu_1_1_CM_S2 0 500 FORMAT "%2.0" /end CHARACTERISTIC
/begin CHARACTERISTIC XTEMP_MIN_HSUKS "" VALUE 0x27646A _REC_S1VAL_1_u2_S2 500 _CNV_R_R_Umr_1_zu_1_1_CM_S2 0 500 FORMAT "%2.0" /end CHARACTERISTIC
/begin CHARACTERISTIC XT_HSURE_DECPERIOD "" VALUE 0x276450 _REC_S1VAL_1_u2_S2 65535 _CNV_R_R_Umr_1_zu_1_6_CM_S2 0 65535 FORMAT "%2.0" /end CHARACTERISTIC
/begin CHARACTERISTIC XT_HSURE_RESET_MODWHYB_NL "" VALUE 0x276454 _REC_S1VAL_1_u2_S2 2000 _CNV_R_R_Umr_1_zu_1_6_CM_S2 0 2000 FORMAT "%2.0" /end CHARACTERISTIC
/begin CHARACTERISTIC XW_KRZGSEG_HSURE_COS "" VALUE 0x2763CA _REC_S1VAL_1_u2_S2 180 _CNV_R_R_Umr_1_zu_1_138_CM_S2 0 180 FORMAT "%2.0" /end CHARACTERISTIC
/begin CHARACTERISTIC XZ_HSURESLSS "" VALUE 0x27B703 _REC_S1VAL_1_u1_S2 3 _CNV_R_R_Umr_1_zu_1_2_CM_S2 0 3 FORMAT "%2.0" /end CHARACTERISTIC
/begin CHARACTERISTIC XZ_HSURE_MODWHYB_N "" VALUE 0x27B50B _REC_S1VAL_1_u1_S2 2 _CNV_R_R_Umr_1_zu_1_2_CM_S2 0 2 FORMAT "%2.0" /end CHARACTERISTIC
/begin CHARACTERISTIC XZ_RESET_HSURE_KS "" VALUE 0x27B509 _REC_S1VAL_1_u1_S2 3 _CNV_R_R_Umr_1_zu_1_2_CM_S2 0 3 FORMAT "%2.0" /end CHARACTERISTIC
/begin CHARACTERISTIC XSCHDM_ABFWS_DELTA_RSUBGH "" VALUE 0x2764A0 _REC_S1VAL_1_s2_S2 250 _CNV_R_R_Umr_1_zu_1_42_CM_S2 0 250 FORMAT "%2.0" /end CHARACTERISTIC
/begin CHARACTERISTIC XSCHGW_FPFILT_RSUBGH "" VALUE 0x2764A2 _REC_S1VAL_1_s2_S2 2500 _CNV_R_R_Umr_1_zu_1_7_CM_S2 0 2500 FORMAT "%2.0" /end CHARACTERISTIC
/begin CHARACTERISTIC XSCHW_DKKD_DELTA_RSUBGH "" VALUE 0x2764A4 _REC_S1VAL_1_u2_S2 110 _CNV_R_R_Umr_10_zu__9_CM_S2 0 110 FORMAT "%3.1" /end CHARACTERISTIC
/begin CHARACTERISTIC XSCHW_DKKD_OBEN_RSUBGH "" VALUE 0x2764A6 _REC_S1VAL_1_u2_S2 110 _CNV_R_R_Umr_10_zu__9_CM_S2 0 110 FORMAT "%3.1" /end CHARACTERISTIC
/begin CHARACTERISTIC XSCHW_DKKD_UNTEN_RSUBGH "" VALUE 0x2764A8 _REC_S1VAL_1_u2_S2 110 _CNV_R_R_Umr_10_zu__9_CM_S2 0 110 FORMAT "%3.1" /end CHARACTERISTIC
/begin CHARACTERISTIC XSCHZ_GANG_MAX_RSUBGH "" VALUE 0x27B540 _REC_S1VAL_1_u1_S2 8 _CNV_S_9_Enum_EGANG_30_CM_S2 0 8 /end CHARACTERISTIC
/begin CHARACTERISTIC XSCHZ_PROGBGH_MIN_RSUBGH "" VALUE 0x27B541 _REC_S1VAL_1_u1_S2 5 _CNV_S_6_Enum_EBERG_61_CM_S2 0 5 /end CHARACTERISTIC
/begin CHARACTERISTIC XTAB6S_EFAHREN_ERK "" CURVE 0x276526 _REC_A1CUR_30_u1_u1_S2 255 _CNV_R_R_Umr_1_zu_1_2_CM_S2 0 255 FORMAT "%2.0"
 /begin AXIS_DESCR FIX_AXIS NO_INPUT_QUANTITY _CNV_R_R_Umr_1_zu_1_2_CM_S2 6 0 5 FIX_AXIS_PAR_DIST 0 1 6 READ_ONLY /end AXIS_DESCR
/end CHARACTERISTIC
/begin CHARACTERISTIC XTAB6X4Z_EFAHR_KL_ERK "" MAP 0x27198C _REC_A1MAP_9_u1_u1_u1_S2 3 _CNV_S_4_Enum_EEFAH_143_CM_S2 0 3
 /begin AXIS_DESCR FIX_AXIS Z_EFAHRKL _CNV_S_6_Enum_EEFAH_140_CM_S2 6 0 5 /begin FIX_AXIS_PAR_LIST 0 1 2 3 4 5 /end FIX_AXIS_PAR_LIST READ_ONLY /end AXIS_DESCR
 /begin AXIS_DESCR FIX_AXIS Z_SOC_MODE _CNV_S_4_Enum_ESOCM_142_CM_S2 4 0 3 /begin FIX_AXIS_PAR_LIST 0 1 2 3 /end FIX_AXIS_PAR_LIST READ_ONLY /end AXIS_DESCR
/end CHARACTERISTIC
/begin CHARACTERISTIC XTAB9S_HYBRID_HAS_IST_ERK "" CURVE 0x27B54D _REC_A1CUR_30_u1_u1_S2 1 _CNV_R_R_Umr_1_zu_1_2_CM_S2 0 1 FORMAT "%2.0"
 /begin AXIS_DESCR FIX_AXIS Z_HAS_IST _CNV_S_9_Enum_EHASS_141_CM_S2 9 0 8 FIX_AXIS_PAR_DIST 0 1 9 READ_ONLY /end AXIS_DESCR
/end CHARACTERISTIC
/begin CHARACTERISTIC XTAB9S_HYBRID_HAS_ZIEL_ERK "" CURVE 0x27B556 _REC_A1CUR_30_u1_u1_S2 1 _CNV_R_R_Umr_1_zu_1_2_CM_S2 0 1 FORMAT "%2.0"
 /begin AXIS_DESCR FIX_AXIS Z_HAS_ZIEL _CNV_S_9_Enum_EHASS_141_CM_S2 9 0 8 FIX_AXIS_PAR_DIST 0 1 9 READ_ONLY /end AXIS_DESCR
/end CHARACTERISTIC
/begin CHARACTERISTIC XS_S_EFAHREN_ERK "" VALUE 0x27B55F _REC_S1VAL_1_u1_S2 255 _CNV_R_R_Umr_1_zu_1_2_CM_S2 0 255 /end CHARACTERISTIC
/begin CHARACTERISTIC XS_TID_ZUSTART "" VALUE 0x27B560 _REC_S1VAL_1_u1_S2 1 _CNV_R_R_Umr_1_zu_1_2_CM_S2 0 1 FORMAT "%2.0" /end CHARACTERISTIC
/begin CHARACTERISTIC XS_USE_EFAHREN_ERK "" VALUE 0x27B561 _REC_S1VAL_1_u1_S2 255 _CNV_R_R_Umr_1_zu_1_2_CM_S2 0 255 /end CHARACTERISTIC
/begin CHARACTERISTIC XT_EFAHR_EMISSIONIERUNG "" VALUE 0x27652C _REC_S1VAL_1_u2_S2 10000 _CNV_R_R_Umr_1_zu_1_6_CM_S2 0 10000 FORMAT "%2.0" /end CHARACTERISTIC
/begin CHARACTERISTIC XZ_SOURCE_NOTLAUF_AEP "" VALUE 0x27B562 _REC_S1VAL_1_u1_S2 2 _CNV_S_3_Enum_ESIGN_84_CM_S2 0 2 /end CHARACTERISTIC
/begin CHARACTERISTIC XZ_SOURCE_NOTLAUF_EM_HIGH "" VALUE 0x27B563 _REC_S1VAL_1_u1_S2 2 _CNV_S_3_Enum_ESIGN_84_CM_S2 0 2 /end CHARACTERISTIC
/begin CHARACTERISTIC XZ_SOURCE_NOTLAUF_EM_LOW "" VALUE 0x27B564 _REC_S1VAL_1_u1_S2 2 _CNV_S_3_Enum_ESIGN_84_CM_S2 0 2 /end CHARACTERISTIC
/begin CHARACTERISTIC XTAB2C_AUSROLL_RS21 "" CURVE 0x271930 _REC_A1CUR_30_u2_u2_S2 65535 _CNV_R_R_Umr_1_zu_1_2_CM_S2 0 65535 FORMAT "%2.0"
 /begin AXIS_DESCR FIX_AXIS NO_INPUT_QUANTITY _CNV_S_2_Enum_EWL2_38_CM_S2 2 0 1 FIX_AXIS_PAR_DIST 0 1 2 READ_ONLY /end AXIS_DESCR
/end CHARACTERISTIC
/begin CHARACTERISTIC XTAB2V_FZG_STOPGO1 "" CURVE 0x271934 _REC_A1CUR_30_u2_u2_S2 400 _CNV_R_R_Umr_1_zu_1_8_CM_S2 0 400 FORMAT "%2.0"
 /begin AXIS_DESCR FIX_AXIS NO_INPUT_QUANTITY _CNV_S_2_Enum_EWL2_38_CM_S2 2 0 1 FIX_AXIS_PAR_DIST 0 1 2 READ_ONLY /end AXIS_DESCR
/end CHARACTERISTIC
/begin CHARACTERISTIC XTAB2V_FZG_STOPGO2 "" CURVE 0x271938 _REC_A1CUR_30_u2_u2_S2 400 _CNV_R_R_Umr_1_zu_1_8_CM_S2 0 400 FORMAT "%2.0"
 /begin AXIS_DESCR FIX_AXIS NO_INPUT_QUANTITY _CNV_S_2_Enum_EWL2_38_CM_S2 2 0 1 FIX_AXIS_PAR_DIST 0 1 2 READ_ONLY /end AXIS_DESCR
/end CHARACTERISTIC
/begin CHARACTERISTIC XTAB2W_DKKD_STOPGO1 "" CURVE 0x27193C _REC_A1CUR_30_u2_u2_S2 110 _CNV_R_R_Umr_10_zu__9_CM_S2 0 110 FORMAT "%3.1"
 /begin AXIS_DESCR FIX_AXIS NO_INPUT_QUANTITY _CNV_S_2_Enum_EWL2_38_CM_S2 2 0 1 FIX_AXIS_PAR_DIST 0 1 2 READ_ONLY /end AXIS_DESCR
/end CHARACTERISTIC
/begin CHARACTERISTIC XTAB2W_DKKD_STOPGO2 "" CURVE 0x271940 _REC_A1CUR_30_u2_u2_S2 110 _CNV_R_R_Umr_10_zu__9_CM_S2 0 110 FORMAT "%3.1"
 /begin AXIS_DESCR FIX_AXIS NO_INPUT_QUANTITY _CNV_S_2_Enum_EWL2_38_CM_S2 2 0 1 FIX_AXIS_PAR_DIST 0 1 2 READ_ONLY /end AXIS_DESCR
/end CHARACTERISTIC
/begin CHARACTERISTIC XTAB5X5FAKT_HEISSHOCH "" MAP 0x271944 _REC_S7MAP_53_u2_s2_u2_S2 250 _CNV_R_R_Umr_1_zu_1_53_CM_S2 0 250 FORMAT "%2.0"
 /begin AXIS_DESCR STD_AXIS TEMP_UMG _CNV_R_R_Umr_1_zu_1_1_CM_S2 5 -50 80 FORMAT "%2.0" /end AXIS_DESCR
 /begin AXIS_DESCR STD_AXIS P_LUFT _CNV_R_R_Umr_1_zu_1_0_CM_S2 5 598 1108 FORMAT "%2.0" /end AXIS_DESCR
/end CHARACTERISTIC
/begin CHARACTERISTIC XFAKT_HEISSHOCH_OBEN "" VALUE 0x2764AA _REC_S1VAL_1_u2_S2 250 _CNV_R_R_Umr_1_zu_1_53_CM_S2 0 250 FORMAT "%2.0" /end CHARACTERISTIC
/begin CHARACTERISTIC XFAKT_HEISSHOCH_UNTEN "" VALUE 0x2764AC _REC_S1VAL_1_u2_S2 250 _CNV_R_R_Umr_1_zu_1_53_CM_S2 0 250 FORMAT "%2.0" /end CHARACTERISTIC
/begin CHARACTERISTIC XHSCHP_LUFT_HEISSHOCH "" VALUE 0x2764AE _REC_S1VAL_1_u2_S2 150 _CNV_R_R_Umr_1_zu_1_0_CM_S2 0 150 FORMAT "%2.0" /end CHARACTERISTIC
/begin CHARACTERISTIC XHSCHTEMP_UMG_HEISSHOCH "" VALUE 0x2764B0 _REC_S1VAL_1_u2_S2 20 _CNV_R_R_Umr_1_zu_1_1_CM_S2 0 20 FORMAT "%2.0" /end CHARACTERISTIC
/begin CHARACTERISTIC XSCHGW_FP_STOPGO "" VALUE 0x2764B2 _REC_S1VAL_1_s2_S2 65535 _CNV_R_R_Umr_1_zu_1_7_CM_S2 -32768 32767 FORMAT "%2.0" /end CHARACTERISTIC
/begin CHARACTERISTIC XSCHP_LUFT_HEISSHOCH "" VALUE 0x2764B4 _REC_S1VAL_1_u2_S2 522 _CNV_R_R_Umr_1_zu_1_0_CM_S2 598 1120 FORMAT "%2.0" /end CHARACTERISTIC
/begin CHARACTERISTIC XSCHTEMP_GETR_STOPGOOBEN "" VALUE 0x2764B6 _REC_S1VAL_1_s2_S2 400 _CNV_R_R_Umr_1_zu_1_1_CM_S2 -200 200 FORMAT "%2.0" /end CHARACTERISTIC
/begin CHARACTERISTIC XSCHTEMP_GETR_STOPGOUNTEN "" VALUE 0x2764B8 _REC_S1VAL_1_s2_S2 400 _CNV_R_R_Umr_1_zu_1_1_CM_S2 -200 200 FORMAT "%2.0" /end CHARACTERISTIC
/begin CHARACTERISTIC XSCHTEMP_MOT_SGENBL "" VALUE 0x2764BA _REC_S1VAL_1_s2_S2 450 _CNV_R_R_Umr_1_zu_1_1_CM_S2 -50 400 FORMAT "%2.0" /end CHARACTERISTIC
/begin CHARACTERISTIC XSCHTEMP_UMG_HEISSHOCH "" VALUE 0x2764BC _REC_S1VAL_1_s2_S2 130 _CNV_R_R_Umr_1_zu_1_1_CM_S2 -50 80 FORMAT "%2.0" /end CHARACTERISTIC
/begin CHARACTERISTIC XSCHV_FZG_SGENBL "" VALUE 0x2764BE _REC_S1VAL_1_u2_S2 400 _CNV_R_R_Umr_1_zu_1_8_CM_S2 0 400 FORMAT "%2.0" /end CHARACTERISTIC
/begin CHARACTERISTIC XSCHW_DKKD_AUSROLL "" VALUE 0x2764C0 _REC_S1VAL_1_u2_S2 110 _CNV_R_R_Umr_10_zu__9_CM_S2 0 110 FORMAT "%3.1" /end CHARACTERISTIC
/begin CHARACTERISTIC XSCHW_DKKD_SGENBL "" VALUE 0x2764C2 _REC_S1VAL_1_u2_S2 110 _CNV_R_R_Umr_10_zu__9_CM_S2 0 110 FORMAT "%3.1" /end CHARACTERISTIC
/begin CHARACTERISTIC XSCHW_STEIGUNG_STOPGO "" VALUE 0x2764C4 _REC_S1VAL_1_s2_S2 400 _CNV_R_R_Umr_10_zu__9_CM_S2 -200 200 FORMAT "%3.1" /end CHARACTERISTIC
/begin CHARACTERISTIC XS_DSPORT_STOPGO "" VALUE 0x27B542 _REC_S1VAL_1_u1_S2 1 _CNV_R_R_Umr_1_zu_1_2_CM_S2 0 1 FORMAT "%2.0" /end CHARACTERISTIC
/begin CHARACTERISTIC XS_STOPGO_MSA "" VALUE 0x27B544 _REC_S1VAL_1_u1_S2 1 _CNV_S_2_Enum_ESTOP_145_CM_S2 0 1 /end CHARACTERISTIC
/begin CHARACTERISTIC XT_SG "" VALUE 0x2764C6 _REC_S1VAL_1_u2_S2 3600 _CNV_R_R_Umr_1_zu_1_146_CM_S2 0 3600 FORMAT "%2.0" /end CHARACTERISTIC
/begin CHARACTERISTIC XZ_HEISSHOCH_SOURCE "" VALUE 0x27B543 _REC_S1VAL_1_u1_S2 1 _CNV_S_2_Enum_EHEIS_147_CM_S2 0 1 /end CHARACTERISTIC
/begin CHARACTERISTIC XTAB2SCHA_QKURVE_KFMODAFB "" CURVE 0x2718C0 _REC_A1CUR_30_s2_u1_S2 6553.5 _CNV_R_R_Umr_10_zu__46_CM_S2 -3276.8 3276.7 FORMAT "%3.1"
 /begin AXIS_DESCR FIX_AXIS S_COD_MAB _CNV_R_R_Umr_1_zu_1_2_CM_S2 2 0 255 FIX_AXIS_PAR_DIST 0 1 2 READ_ONLY /end AXIS_DESCR
/end CHARACTERISTIC
/begin CHARACTERISTIC XTAB2SCHDA_QKURVE_KFMODAFB "" CURVE 0x2718C4 _REC_A1CUR_30_s2_u1_S2 6553.5 _CNV_R_R_Umr_10_zu__46_CM_S2 -3276.8 3276.7 FORMAT "%3.1"
 /begin AXIS_DESCR FIX_AXIS S_COD_MAB _CNV_R_R_Umr_1_zu_1_2_CM_S2 2 0 255 FIX_AXIS_PAR_DIST 0 1 2 READ_ONLY /end AXIS_DESCR
/end CHARACTERISTIC
/begin CHARACTERISTIC XTAB2SCHDM_ABFWS_KFMODAFB "" CURVE 0x2718C8 _REC_A1CUR_30_s2_u1_S2 20000 _CNV_R_R_Umr_1_zu_1_42_CM_S2 -10000 10000 FORMAT "%2.0"
 /begin AXIS_DESCR FIX_AXIS S_COD_MAB _CNV_R_R_Umr_1_zu_1_2_CM_S2 2 0 255 FIX_AXIS_PAR_DIST 0 1 2 READ_ONLY /end AXIS_DESCR
/end CHARACTERISTIC
/begin CHARACTERISTIC XTAB2SCHDM_ABFWS_MODAFB "" CURVE 0x2718CC _REC_A1CUR_30_s2_u1_S2 20000 _CNV_R_R_Umr_1_zu_1_42_CM_S2 -10000 10000 FORMAT "%2.0"
 /begin AXIS_DESCR FIX_AXIS S_COD_MAB _CNV_R_R_Umr_1_zu_1_2_CM_S2 2 0 255 FIX_AXIS_PAR_DIST 0 1 2 READ_ONLY /end AXIS_DESCR
/end CHARACTERISTIC
/begin CHARACTERISTIC XTAB2SCHTEMP_UMG_MODAFB "" CURVE 0x2718D0 _REC_A1CUR_30_s2_u1_S2 130 _CNV_R_R_Umr_1_zu_1_1_CM_S2 -50 80 FORMAT "%2.0"
 /begin AXIS_DESCR FIX_AXIS S_COD_MAB _CNV_R_R_Umr_1_zu_1_2_CM_S2 2 0 255 FIX_AXIS_PAR_DIST 0 1 2 READ_ONLY /end AXIS_DESCR
/end CHARACTERISTIC
/begin CHARACTERISTIC XTAB2SCHV_FZG_AUS1MODAFB "" CURVE 0x2718D4 _REC_A1CUR_30_u2_u1_S2 400 _CNV_R_R_Umr_1_zu_1_8_CM_S2 0 400 FORMAT "%2.0"
 /begin AXIS_DESCR FIX_AXIS S_COD_MAB _CNV_R_R_Umr_1_zu_1_2_CM_S2 2 0 255 FIX_AXIS_PAR_DIST 0 1 2 READ_ONLY /end AXIS_DESCR
/end CHARACTERISTIC
/begin CHARACTERISTIC XTAB2SCHV_FZG_AUS2MODAFB "" CURVE 0x2718D8 _REC_A1CUR_30_u2_u1_S2 400 _CNV_R_R_Umr_1_zu_1_8_CM_S2 0 400 FORMAT "%2.0"
 /begin AXIS_DESCR FIX_AXIS S_COD_MAB _CNV_R_R_Umr_1_zu_1_2_CM_S2 2 0 255 FIX_AXIS_PAR_DIST 0 1 2 READ_ONLY /end AXIS_DESCR
/end CHARACTERISTIC
/begin CHARACTERISTIC XTAB2SCHV_FZG_BETRBERAUSMODAFB "" CURVE 0x2718DC _REC_A1CUR_30_u2_u1_S2 400 _CNV_R_R_Umr_1_zu_1_8_CM_S2 0 400 FORMAT "%2.0"
 /begin AXIS_DESCR FIX_AXIS S_COD_MAB _CNV_R_R_Umr_1_zu_1_2_CM_S2 2 0 255 FIX_AXIS_PAR_DIST 0 1 2 READ_ONLY /end AXIS_DESCR
/end CHARACTERISTIC
/begin CHARACTERISTIC XTAB2SCHV_FZG_BETRBEREINMODAFB "" CURVE 0x2718E0 _REC_A1CUR_30_u2_u1_S2 400 _CNV_R_R_Umr_1_zu_1_8_CM_S2 0 400 FORMAT "%2.0"
 /begin AXIS_DESCR FIX_AXIS S_COD_MAB _CNV_R_R_Umr_1_zu_1_2_CM_S2 2 0 255 FIX_AXIS_PAR_DIST 0 1 2 READ_ONLY /end AXIS_DESCR
/end CHARACTERISTIC
/begin CHARACTERISTIC XTAB2SCHV_FZG_EIN1MODAFB "" CURVE 0x2718E4 _REC_A1CUR_30_u2_u1_S2 400 _CNV_R_R_Umr_1_zu_1_8_CM_S2 0 400 FORMAT "%2.0"
 /begin AXIS_DESCR FIX_AXIS S_COD_MAB _CNV_R_R_Umr_1_zu_1_2_CM_S2 2 0 255 FIX_AXIS_PAR_DIST 0 1 2 READ_ONLY /end AXIS_DESCR
/end CHARACTERISTIC
/begin CHARACTERISTIC XTAB2SCHV_FZG_EIN2MODAFB "" CURVE 0x2718E8 _REC_A1CUR_30_u2_u1_S2 400 _CNV_R_R_Umr_1_zu_1_8_CM_S2 0 400 FORMAT "%2.0"
 /begin AXIS_DESCR FIX_AXIS S_COD_MAB _CNV_R_R_Umr_1_zu_1_2_CM_S2 2 0 255 FIX_AXIS_PAR_DIST 0 1 2 READ_ONLY /end AXIS_DESCR
/end CHARACTERISTIC
/begin CHARACTERISTIC XTAB2SCHW_DKKD_AUSGWFP_MODAFB "" CURVE 0x2718EC _REC_A1CUR_30_u2_u1_S2 110 _CNV_R_R_Umr_10_zu__9_CM_S2 0 110 FORMAT "%3.1"
 /begin AXIS_DESCR FIX_AXIS S_COD_MAB _CNV_R_R_Umr_1_zu_1_2_CM_S2 2 0 255 FIX_AXIS_PAR_DIST 0 1 2 READ_ONLY /end AXIS_DESCR
/end CHARACTERISTIC
/begin CHARACTERISTIC XTAB2SCHW_DKKD_EINMODAFB "" CURVE 0x2718F0 _REC_A1CUR_30_u2_u1_S2 110 _CNV_R_R_Umr_10_zu__9_CM_S2 0 110 FORMAT "%3.1"
 /begin AXIS_DESCR FIX_AXIS S_COD_MAB _CNV_R_R_Umr_1_zu_1_2_CM_S2 2 0 255 FIX_AXIS_PAR_DIST 0 1 2 READ_ONLY /end AXIS_DESCR
/end CHARACTERISTIC
/begin CHARACTERISTIC XTAB2SCHW_DKKD_NLMODAFB "" CURVE 0x2718F4 _REC_A1CUR_30_u2_u1_S2 110 _CNV_R_R_Umr_10_zu__9_CM_S2 0 110 FORMAT "%3.1"
 /begin AXIS_DESCR FIX_AXIS S_COD_MAB _CNV_R_R_Umr_1_zu_1_2_CM_S2 2 0 255 FIX_AXIS_PAR_DIST 0 1 2 READ_ONLY /end AXIS_DESCR
/end CHARACTERISTIC
/begin CHARACTERISTIC XTAB2SCHW_LWVA_KFMODAFB "" CURVE 0x2718F8 _REC_A1CUR_30_u2_u1_S2 90 _CNV_R_R_Umr_10_zu__10_CM_S2 0 90 FORMAT "%3.1"
 /begin AXIS_DESCR FIX_AXIS S_COD_MAB _CNV_R_R_Umr_1_zu_1_2_CM_S2 2 0 255 FIX_AXIS_PAR_DIST 0 1 2 READ_ONLY /end AXIS_DESCR
/end CHARACTERISTIC
/begin CHARACTERISTIC XTAB2SCHW_LWVA_MODAFB "" CURVE 0x2718FC _REC_A1CUR_30_u2_u1_S2 90 _CNV_R_R_Umr_10_zu__10_CM_S2 0 90 FORMAT "%3.1"
 /begin AXIS_DESCR FIX_AXIS S_COD_MAB _CNV_R_R_Umr_1_zu_1_2_CM_S2 2 0 255 FIX_AXIS_PAR_DIST 0 1 2 READ_ONLY /end AXIS_DESCR
/end CHARACTERISTIC
/begin CHARACTERISTIC XTAB2SCHW_STEIGUNG_KFMODAFB "" CURVE 0x271900 _REC_A1CUR_30_s2_u1_S2 400 _CNV_R_R_Umr_10_zu__9_CM_S2 -200 200 FORMAT "%3.1"
 /begin AXIS_DESCR FIX_AXIS S_COD_MAB _CNV_R_R_Umr_1_zu_1_2_CM_S2 2 0 255 FIX_AXIS_PAR_DIST 0 1 2 READ_ONLY /end AXIS_DESCR
/end CHARACTERISTIC
/begin CHARACTERISTIC XTAB2SCHW_STEIGUNG_MODAFB "" CURVE 0x271904 _REC_A1CUR_30_s2_u1_S2 400 _CNV_R_R_Umr_10_zu__9_CM_S2 -200 200 FORMAT "%3.1"
 /begin AXIS_DESCR FIX_AXIS S_COD_MAB _CNV_R_R_Umr_1_zu_1_2_CM_S2 2 0 255 FIX_AXIS_PAR_DIST 0 1 2 READ_ONLY /end AXIS_DESCR
/end CHARACTERISTIC
/begin CHARACTERISTIC XTAB2S_USE_MAB_S_B_STILLSTAND "" CURVE 0x27646C _REC_A1CUR_30_u1_u1_S2 1 _CNV_R_R_Umr_1_zu_1_2_CM_S2 0 1 FORMAT "%2.0"
 /begin AXIS_DESCR FIX_AXIS S_COD_MAB _CNV_R_R_Umr_1_zu_1_2_CM_S2 2 0 255 FIX_AXIS_PAR_DIST 0 1 2 READ_ONLY /end AXIS_DESCR
/end CHARACTERISTIC
/begin CHARACTERISTIC XTAB2T_BESCHL_MODAFB "" CURVE 0x271908 _REC_A1CUR_30_u4_u1_S2 36000 _CNV_R_R_Umr_10_zu__127_CM_S2 0 36000 FORMAT "%3.1"
 /begin AXIS_DESCR FIX_AXIS S_COD_MAB _CNV_R_R_Umr_1_zu_1_2_CM_S2 2 0 255 FIX_AXIS_PAR_DIST 0 1 2 READ_ONLY /end AXIS_DESCR
/end CHARACTERISTIC
/begin CHARACTERISTIC XTAB2T_BETRBEREINMODAFB "" CURVE 0x271910 _REC_A1CUR_30_u4_u1_S2 36000 _CNV_R_R_Umr_10_zu__127_CM_S2 0 36000 FORMAT "%3.1"
 /begin AXIS_DESCR FIX_AXIS S_COD_MAB _CNV_R_R_Umr_1_zu_1_2_CM_S2 2 0 255 FIX_AXIS_PAR_DIST 0 1 2 READ_ONLY /end AXIS_DESCR
/end CHARACTERISTIC
/begin CHARACTERISTIC XTAB2T_KFINIT_MODAFB "" CURVE 0x271918 _REC_A1CUR_30_u4_u1_S2 36000 _CNV_R_R_Umr_10_zu__127_CM_S2 0 36000 FORMAT "%3.1"
 /begin AXIS_DESCR FIX_AXIS S_COD_MAB _CNV_R_R_Umr_1_zu_1_2_CM_S2 2 0 255 FIX_AXIS_PAR_DIST 0 1 2 READ_ONLY /end AXIS_DESCR
/end CHARACTERISTIC
/begin CHARACTERISTIC XTAB2T_KF_MODAFB "" CURVE 0x271920 _REC_A1CUR_30_u4_u1_S2 36000 _CNV_R_R_Umr_10_zu__127_CM_S2 0 36000 FORMAT "%3.1"
 /begin AXIS_DESCR FIX_AXIS S_COD_MAB _CNV_R_R_Umr_1_zu_1_2_CM_S2 2 0 255 FIX_AXIS_PAR_DIST 0 1 2 READ_ONLY /end AXIS_DESCR
/end CHARACTERISTIC
/begin CHARACTERISTIC XTAB2X6FWS_FILTGEW_MODAFB "" MAP 0x27646E _REC_S3MAP_54_s2_s2_u1_S2 10000 _CNV_R_R_Umr_1_zu_1_2_CM_S2 0 10000 FORMAT "%2.0"
 /begin AXIS_DESCR STD_AXIS DM_AB_FWSDELTA _CNV_R_R_Umr_1_zu_1_42_CM_S2 6 -32768 32767 FORMAT "%2.0" /end AXIS_DESCR
 /begin AXIS_DESCR FIX_AXIS NO_INPUT_QUANTITY _CNV_S_2_Enum_EGEW__16_CM_S2 2 0 1 /begin FIX_AXIS_PAR_LIST 0 1 /end FIX_AXIS_PAR_LIST READ_ONLY /end AXIS_DESCR
/end CHARACTERISTIC
/begin CHARACTERISTIC XTAB2X9T_RS_MAB "" MAP 0x273D4C _REC_A1MAP_9_u4_u1_u1_S2 2048 _CNV_R_R_Umr_1_zu_1_6_CM_S2 0 2048 FORMAT "%2.0"
 /begin AXIS_DESCR FIX_AXIS S_COD_MAB _CNV_R_R_Umr_1_zu_1_2_CM_S2 2 0 255 FIX_AXIS_PAR_DIST 0 1 2 READ_ONLY /end AXIS_DESCR
 /begin AXIS_DESCR FIX_AXIS Z_GANG_ZIEL _CNV_S_9_Enum_EGANG_30_CM_S2 9 0 8 FIX_AXIS_PAR_DIST 0 1 9 READ_ONLY /end AXIS_DESCR
/end CHARACTERISTIC
/begin CHARACTERISTIC XTAB2Z_GANG_MIN_MAB "" CURVE 0x27A428 _REC_A1CUR_30_u1_u1_S2 8 _CNV_S_9_Enum_EGANG_30_CM_S2 0 8
 /begin AXIS_DESCR FIX_AXIS S_COD_MAB _CNV_R_R_Umr_1_zu_1_2_CM_S2 2 0 255 FIX_AXIS_PAR_DIST 0 1 2 READ_ONLY /end AXIS_DESCR
/end CHARACTERISTIC
/begin CHARACTERISTIC XTAB2Z_GANG_RSSEQ_MAB "" CURVE 0x27A42A _REC_A1CUR_30_u1_u1_S2 8 _CNV_S_9_Enum_EGANG_30_CM_S2 0 8
 /begin AXIS_DESCR FIX_AXIS S_COD_MAB _CNV_R_R_Umr_1_zu_1_2_CM_S2 2 0 255 FIX_AXIS_PAR_DIST 0 1 2 READ_ONLY /end AXIS_DESCR
/end CHARACTERISTIC
/begin CHARACTERISTIC XTAB8S_BEDEL_MODAFB "" CURVE 0x271928 _REC_A1CUR_30_u1_u1_S2 1 _CNV_R_R_Umr_1_zu_1_2_CM_S2 0 1 FORMAT "%2.0"
 /begin AXIS_DESCR FIX_AXIS Z_POS _CNV_S_8_Enum_EPOS_33_CM_S2 8 0 7 FIX_AXIS_PAR_DIST 0 1 8 READ_ONLY /end AXIS_DESCR
/end CHARACTERISTIC
/begin CHARACTERISTIC XSCHP_LUFT_MODAFB "" VALUE 0x276494 _REC_S1VAL_1_u2_S2 522 _CNV_R_R_Umr_1_zu_1_0_CM_S2 598 1120 FORMAT "%2.0" /end CHARACTERISTIC
/begin CHARACTERISTIC XSCHV_FZG_AUS_MODAFB_CHN "" VALUE 0x276496 _REC_S1VAL_1_u2_S2 400 _CNV_R_R_Umr_1_zu_1_8_CM_S2 0 400 FORMAT "%2.0" /end CHARACTERISTIC
/begin CHARACTERISTIC XSCHV_FZG_EIN_MODAFB_CHN "" VALUE 0x276498 _REC_S1VAL_1_u2_S2 400 _CNV_R_R_Umr_1_zu_1_8_CM_S2 0 400 FORMAT "%2.0" /end CHARACTERISTIC
/begin CHARACTERISTIC XSCHW_DKKD_AUSMODAFB "" VALUE 0x27649A _REC_S1VAL_1_u2_S2 120 _CNV_R_R_Umr_10_zu__9_CM_S2 0 120 FORMAT "%3.1" /end CHARACTERISTIC
/begin CHARACTERISTIC XS_MAB_USE_TAB_VFZG "" VALUE 0x27B53E _REC_S1VAL_1_u1_S2 1 _CNV_R_R_Umr_1_zu_1_2_CM_S2 0 1 FORMAT "%2.0" /end CHARACTERISTIC
/begin CHARACTERISTIC XTAB2FAKTGN_SR_DYNDZM_1 "" CURVE 0x2710FC _REC_A1CUR_30_u2_u1_S2 500 _CNV_R_R_Umr_1_zu_1_53_CM_S2 0 500 FORMAT "%2.0"
 /begin AXIS_DESCR FIX_AXIS NO_INPUT_QUANTITY _CNV_S_2_Enum_EERSM_158_CM_S2 2 0 1 FIX_AXIS_PAR_DIST 0 1 2 READ_ONLY /end AXIS_DESCR
/end CHARACTERISTIC
/begin CHARACTERISTIC XTAB2FAKTGN_SR_DYNDZM_2 "" CURVE 0x271100 _REC_A1CUR_30_u2_u1_S2 500 _CNV_R_R_Umr_1_zu_1_53_CM_S2 0 500 FORMAT "%2.0"
 /begin AXIS_DESCR FIX_AXIS NO_INPUT_QUANTITY _CNV_S_2_Enum_EERSM_158_CM_S2 2 0 1 FIX_AXIS_PAR_DIST 0 1 2 READ_ONLY /end AXIS_DESCR
/end CHARACTERISTIC
/begin CHARACTERISTIC XTAB2FAKTGN_SR_DYNDZM_3 "" CURVE 0x271104 _REC_A1CUR_30_u2_u1_S2 500 _CNV_R_R_Umr_1_zu_1_53_CM_S2 0 500 FORMAT "%2.0"
 /begin AXIS_DESCR FIX_AXIS NO_INPUT_QUANTITY _CNV_S_2_Enum_EERSM_158_CM_S2 2 0 1 FIX_AXIS_PAR_DIST 0 1 2 READ_ONLY /end AXIS_DESCR
/end CHARACTERISTIC
/begin CHARACTERISTIC XTAB2FAKTGN_SR_DYNDZM_4 "" CURVE 0x271108 _REC_A1CUR_30_u2_u1_S2 500 _CNV_R_R_Umr_1_zu_1_53_CM_S2 0 500 FORMAT "%2.0"
 /begin AXIS_DESCR FIX_AXIS NO_INPUT_QUANTITY _CNV_S_2_Enum_EERSM_158_CM_S2 2 0 1 FIX_AXIS_PAR_DIST 0 1 2 READ_ONLY /end AXIS_DESCR
/end CHARACTERISTIC
/begin CHARACTERISTIC XTAB2FAKTGN_SR_DYNDZM_5 "" CURVE 0x27110C _REC_A1CUR_30_u2_u1_S2 500 _CNV_R_R_Umr_1_zu_1_53_CM_S2 0 500 FORMAT "%2.0"
 /begin AXIS_DESCR FIX_AXIS NO_INPUT_QUANTITY _CNV_S_2_Enum_EERSM_158_CM_S2 2 0 1 FIX_AXIS_PAR_DIST 0 1 2 READ_ONLY /end AXIS_DESCR
/end CHARACTERISTIC
/begin CHARACTERISTIC XTAB2FAKTWARTE_SR_DYNDZM_1 "" CURVE 0x271110 _REC_A1CUR_30_u2_u1_S2 500 _CNV_R_R_Umr_1_zu_1_53_CM_S2 0 500 FORMAT "%2.0"
 /begin AXIS_DESCR FIX_AXIS NO_INPUT_QUANTITY _CNV_S_2_Enum_EERSM_158_CM_S2 2 0 1 FIX_AXIS_PAR_DIST 0 1 2 READ_ONLY /end AXIS_DESCR
/end CHARACTERISTIC
/begin CHARACTERISTIC XTAB2FAKTWARTE_SR_DYNDZM_2 "" CURVE 0x271114 _REC_A1CUR_30_u2_u1_S2 500 _CNV_R_R_Umr_1_zu_1_53_CM_S2 0 500 FORMAT "%2.0"
 /begin AXIS_DESCR FIX_AXIS NO_INPUT_QUANTITY _CNV_S_2_Enum_EERSM_158_CM_S2 2 0 1 FIX_AXIS_PAR_DIST 0 1 2 READ_ONLY /end AXIS_DESCR
/end CHARACTERISTIC
/begin CHARACTERISTIC XTAB2FAKTWARTE_SR_DYNDZM_3 "" CURVE 0x271118 _REC_A1CUR_30_u2_u1_S2 500 _CNV_R_R_Umr_1_zu_1_53_CM_S2 0 500 FORMAT "%2.0"
 /begin AXIS_DESCR FIX_AXIS NO_INPUT_QUANTITY _CNV_S_2_Enum_EERSM_158_CM_S2 2 0 1 FIX_AXIS_PAR_DIST 0 1 2 READ_ONLY /end AXIS_DESCR
/end CHARACTERISTIC
/begin CHARACTERISTIC XTAB2FAKTWARTE_SR_DYNDZM_4 "" CURVE 0x27111C _REC_A1CUR_30_u2_u1_S2 500 _CNV_R_R_Umr_1_zu_1_53_CM_S2 0 500 FORMAT "%2.0"
 /begin AXIS_DESCR FIX_AXIS NO_INPUT_QUANTITY _CNV_S_2_Enum_EERSM_158_CM_S2 2 0 1 FIX_AXIS_PAR_DIST 0 1 2 READ_ONLY /end AXIS_DESCR
/end CHARACTERISTIC
/begin CHARACTERISTIC XTAB2FAKTWARTE_SR_DYNDZM_5 "" CURVE 0x271120 _REC_A1CUR_30_u2_u1_S2 500 _CNV_R_R_Umr_1_zu_1_53_CM_S2 0 500 FORMAT "%2.0"
 /begin AXIS_DESCR FIX_AXIS NO_INPUT_QUANTITY _CNV_S_2_Enum_EERSM_158_CM_S2 2 0 1 FIX_AXIS_PAR_DIST 0 1 2 READ_ONLY /end AXIS_DESCR
/end CHARACTERISTIC
/begin CHARACTERISTIC XTAB2FILT_PT1_DYNDZM_0 "" CURVE 0x2758EC _REC_A1CUR_30_u1_u1_S2 200 _CNV_R_R_Umr_1_zu_1_2_CM_S2 0 200 FORMAT "%2.0"
 /begin AXIS_DESCR FIX_AXIS NO_INPUT_QUANTITY _CNV_S_2_Enum_EPT1__21_CM_S2 2 0 1 /begin FIX_AXIS_PAR_LIST 0 1 /end FIX_AXIS_PAR_LIST READ_ONLY /end AXIS_DESCR
/end CHARACTERISTIC
/begin CHARACTERISTIC XTAB2FILT_PT1_DYNDZM_1 "" CURVE 0x2758EE _REC_A1CUR_30_u1_u1_S2 200 _CNV_R_R_Umr_1_zu_1_2_CM_S2 0 200 FORMAT "%2.0"
 /begin AXIS_DESCR FIX_AXIS NO_INPUT_QUANTITY _CNV_S_2_Enum_EPT1__21_CM_S2 2 0 1 /begin FIX_AXIS_PAR_LIST 0 1 /end FIX_AXIS_PAR_LIST READ_ONLY /end AXIS_DESCR
/end CHARACTERISTIC
/begin CHARACTERISTIC XTAB2FILT_PT1_DYNDZM_2 "" CURVE 0x2758F0 _REC_A1CUR_30_u1_u1_S2 200 _CNV_R_R_Umr_1_zu_1_2_CM_S2 0 200 FORMAT "%2.0"
 /begin AXIS_DESCR FIX_AXIS NO_INPUT_QUANTITY _CNV_S_2_Enum_EPT1__21_CM_S2 2 0 1 /begin FIX_AXIS_PAR_LIST 0 1 /end FIX_AXIS_PAR_LIST READ_ONLY /end AXIS_DESCR
/end CHARACTERISTIC
/begin CHARACTERISTIC XTAB2FILT_PT1_DYNDZM_3 "" CURVE 0x2758F2 _REC_A1CUR_30_u1_u1_S2 200 _CNV_R_R_Umr_1_zu_1_2_CM_S2 0 200 FORMAT "%2.0"
 /begin AXIS_DESCR FIX_AXIS NO_INPUT_QUANTITY _CNV_S_2_Enum_EPT1__21_CM_S2 2 0 1 /begin FIX_AXIS_PAR_LIST 0 1 /end FIX_AXIS_PAR_LIST READ_ONLY /end AXIS_DESCR
/end CHARACTERISTIC
/begin CHARACTERISTIC XTAB2FILT_REK_DYNDZM_0 "" CURVE 0x2758F4 _REC_A1CUR_30_u1_u1_S2 200 _CNV_R_R_Umr_1_zu_1_2_CM_S2 0 200 FORMAT "%2.0"
 /begin AXIS_DESCR FIX_AXIS NO_INPUT_QUANTITY _CNV_S_2_Enum_EGEW__16_CM_S2 2 0 1 /begin FIX_AXIS_PAR_LIST 0 1 /end FIX_AXIS_PAR_LIST READ_ONLY /end AXIS_DESCR
/end CHARACTERISTIC
/begin CHARACTERISTIC XTAB2FILT_REK_DYNDZM_1 "" CURVE 0x2758F6 _REC_A1CUR_30_u1_u1_S2 200 _CNV_R_R_Umr_1_zu_1_2_CM_S2 0 200 FORMAT "%2.0"
 /begin AXIS_DESCR FIX_AXIS NO_INPUT_QUANTITY _CNV_S_2_Enum_EGEW__16_CM_S2 2 0 1 /begin FIX_AXIS_PAR_LIST 0 1 /end FIX_AXIS_PAR_LIST READ_ONLY /end AXIS_DESCR
/end CHARACTERISTIC
/begin CHARACTERISTIC XTAB2FILT_REK_DYNDZM_2 "" CURVE 0x2758F8 _REC_A1CUR_30_u1_u1_S2 200 _CNV_R_R_Umr_1_zu_1_2_CM_S2 0 200 FORMAT "%2.0"
 /begin AXIS_DESCR FIX_AXIS NO_INPUT_QUANTITY _CNV_S_2_Enum_EGEW__16_CM_S2 2 0 1 /begin FIX_AXIS_PAR_LIST 0 1 /end FIX_AXIS_PAR_LIST READ_ONLY /end AXIS_DESCR
/end CHARACTERISTIC
/begin CHARACTERISTIC XTAB2FILT_REK_DYNDZM_3 "" CURVE 0x2758FA _REC_A1CUR_30_u1_u1_S2 200 _CNV_R_R_Umr_1_zu_1_2_CM_S2 0 200 FORMAT "%2.0"
 /begin AXIS_DESCR FIX_AXIS NO_INPUT_QUANTITY _CNV_S_2_Enum_EGEW__16_CM_S2 2 0 1 /begin FIX_AXIS_PAR_LIST 0 1 /end FIX_AXIS_PAR_LIST READ_ONLY /end AXIS_DESCR
/end CHARACTERISTIC
/begin CHARACTERISTIC XTAB2GN_DYNDZM_QS3 "" CURVE 0x271124 _REC_A1CUR_30_u2_u1_S2 500 _CNV_R_R_Umr_1_zu_1_2_CM_S2 0 500
 /begin AXIS_DESCR FIX_AXIS Z_GANG_IST _CNV_S_9_Enum_EGANG_30_CM_S2 2 0 8 FIX_AXIS_PAR_DIST 0 1 2 READ_ONLY /end AXIS_DESCR
/end CHARACTERISTIC
/begin CHARACTERISTIC XTAB2N_SIMULATE_DYNDZM "" CURVE 0x271128 _REC_A1CUR_30_u2_u1_S2 20000 _CNV_R_R_Umr_1_zu_1_3_CM_S2 0 20000 FORMAT "%2.0"
 /begin AXIS_DESCR FIX_AXIS NO_INPUT_QUANTITY _CNV_S_2_Enum_ESIMU_160_CM_S2 2 0 1 FIX_AXIS_PAR_DIST 0 1 2 READ_ONLY /end AXIS_DESCR
/end CHARACTERISTIC
/begin CHARACTERISTIC XTAB2N_ZIEL_EFAHREN_DYNDZM "" CURVE 0x27114C _REC_A1CUR_30_u2_u1_S2 20000 _CNV_R_R_Umr_1_zu_1_3_CM_S2 0 20000 FORMAT "%2.0"
 /begin AXIS_DESCR FIX_AXIS NO_INPUT_QUANTITY _CNV_R_R_Umr_1_zu_1_2_CM_S2 2 0 255 FIX_AXIS_PAR_DIST 0 1 2 READ_ONLY /end AXIS_DESCR
/end CHARACTERISTIC
/begin CHARACTERISTIC XTAB2T_ENTPR_ENBL_DYNDZM "" CURVE 0x27112C _REC_A1CUR_30_u2_u1_S2 1000 _CNV_R_R_Umr_1_zu_1_6_CM_S2 0 1000 FORMAT "%2.0"
 /begin AXIS_DESCR FIX_AXIS NO_INPUT_QUANTITY _CNV_S_3_Enum_EENTP_157_CM_S2 2 0 2 FIX_AXIS_PAR_DIST 0 1 2 READ_ONLY /end AXIS_DESCR
/end CHARACTERISTIC
/begin CHARACTERISTIC XTAB2T_WARTE_DYNDZM_QS3 "" CURVE 0x271130 _REC_A1CUR_30_s2_u1_S2 2000 _CNV_R_R_Umr_1_zu_1_2_CM_S2 0 2000
 /begin AXIS_DESCR FIX_AXIS Z_GANG_IST _CNV_S_9_Enum_EGANG_30_CM_S2 2 0 8 FIX_AXIS_PAR_DIST 0 1 2 READ_ONLY /end AXIS_DESCR
/end CHARACTERISTIC
/begin CHARACTERISTIC XTAB2X6Z_FOLGESCHALTUNG_DYNDZM "" MAP 0x271158 _REC_A1MAP_9_u1_u1_u1_S2 3 _CNV_R_R_Umr_1_zu_1_2_CM_S2 0 3 FORMAT "%2.0"
 /begin AXIS_DESCR FIX_AXIS NO_INPUT_QUANTITY _CNV_S_2_Enum_EFOLG_159_CM_S2 2 0 1 /begin FIX_AXIS_PAR_LIST 0 1 /end FIX_AXIS_PAR_LIST READ_ONLY /end AXIS_DESCR
 /begin AXIS_DESCR FIX_AXIS Z_SCHALTUNGSTYP _CNV_S_6_Enum_ESCHA_152_CM_S2 6 0 5 FIX_AXIS_PAR_DIST 0 1 6 READ_ONLY /end AXIS_DESCR
/end CHARACTERISTIC
/begin CHARACTERISTIC XTAB4FAKT_GN_TEMP_DYNDZM "" CURVE 0x2760AA _REC_S7CUR_53_u2_s2_S2 500 _CNV_R_R_Umr_1_zu_1_53_CM_S2 0 500 FORMAT "%2.0"
 /begin AXIS_DESCR STD_AXIS TEMP_GETR _CNV_R_R_Umr_1_zu_1_1_CM_S2 4 -200 200 FORMAT "%2.0" /end AXIS_DESCR
/end CHARACTERISTIC
/begin CHARACTERISTIC XTAB4FAKT_WARTE_TEMP_DYNDZM "" CURVE 0x2760BC _REC_S7CUR_53_u2_s2_S2 500 _CNV_R_R_Umr_1_zu_1_53_CM_S2 0 500 FORMAT "%2.0"
 /begin AXIS_DESCR STD_AXIS TEMP_GETR _CNV_R_R_Umr_1_zu_1_1_CM_S2 4 -200 200 FORMAT "%2.0" /end AXIS_DESCR
/end CHARACTERISTIC
/begin CHARACTERISTIC XTAB4GN_DYNDZM_EFAHREN "" CURVE 0x271150 _REC_A1CUR_30_u2_u1_S2 200 _CNV_R_R_Umr_1_zu_1_3_CM_S2 0 200 FORMAT "%2.0"
 /begin AXIS_DESCR FIX_AXIS NO_INPUT_QUANTITY _CNV_R_R_Umr_1_zu_1_2_CM_S2 4 0 255 FIX_AXIS_PAR_DIST 0 1 4 READ_ONLY /end AXIS_DESCR
/end CHARACTERISTIC
/begin CHARACTERISTIC XTAB4GN_DYNDZM_SEGELN_AUS "" CURVE 0x2760CE _REC_S7CUR_53_s2_u2_S2 200 _CNV_R_R_Umr_1_zu_1_3_CM_S2 0 200 FORMAT "%2.0"
 /begin AXIS_DESCR STD_AXIS W_DKKD _CNV_R_R_Umr_10_zu__9_CM_S2 4 0 110 FORMAT "%3.1" /end AXIS_DESCR
/end CHARACTERISTIC
/begin CHARACTERISTIC XTAB4X3FAKT_GN_M_MOT_DYNDZM "" MAP 0x27120C _REC_S7MAP_53_s2_s2_u2_S2 500 _CNV_R_R_Umr_1_zu_1_53_CM_S2 0 500 FORMAT "%2.0"
 /begin AXIS_DESCR STD_AXIS M_MOT_DMEE _CNV_R_R_Umr_1_zu_1_42_CM_S2 4 -32768 32767 FORMAT "%2.0" /end AXIS_DESCR
 /begin AXIS_DESCR STD_AXIS N_VM _CNV_R_R_Umr_1_zu_1_3_CM_S2 3 0 65535 FORMAT "%2.0" /end AXIS_DESCR
/end CHARACTERISTIC
/begin CHARACTERISTIC XTAB4X3FAKT_WARTE_M_MOT_DYNDZM "" MAP 0x271234 _REC_S7MAP_53_u2_s2_u2_S2 500 _CNV_R_R_Umr_1_zu_1_53_CM_S2 0 500 FORMAT "%2.0"
 /begin AXIS_DESCR STD_AXIS M_MOT_DMEE _CNV_R_R_Umr_1_zu_1_42_CM_S2 4 -32768 32767 FORMAT "%2.0" /end AXIS_DESCR
 /begin AXIS_DESCR STD_AXIS N_VM _CNV_R_R_Umr_1_zu_1_3_CM_S2 3 0 65535 FORMAT "%2.0" /end AXIS_DESCR
/end CHARACTERISTIC
/begin CHARACTERISTIC XTAB6FAKT_GN_MANUELL_DYNDZM "" CURVE 0x271134 _REC_A1CUR_30_s2_u1_S2 500 _CNV_R_R_Umr_1_zu_1_53_CM_S2 0 500 FORMAT "%2.0"
 /begin AXIS_DESCR FIX_AXIS Z_SCHALTUNGSTYP _CNV_S_6_Enum_ESCHA_152_CM_S2 6 0 5 FIX_AXIS_PAR_DIST 0 1 6 READ_ONLY /end AXIS_DESCR
/end CHARACTERISTIC
/begin CHARACTERISTIC XTAB6FAKT_WARTE_MANUELL_DYNDZM "" CURVE 0x271140 _REC_A1CUR_30_s2_u1_S2 500 _CNV_R_R_Umr_1_zu_1_53_CM_S2 0 500 FORMAT "%2.0"
 /begin AXIS_DESCR FIX_AXIS Z_SCHALTUNGSTYP _CNV_S_6_Enum_ESCHA_152_CM_S2 6 0 5 FIX_AXIS_PAR_DIST 0 1 6 READ_ONLY /end AXIS_DESCR
/end CHARACTERISTIC
/begin CHARACTERISTIC XTAB6X3FAKT_GN_SCHALT_DYNDZM "" MAP 0x271164 _REC_A1MAP_9_s2_u1_u1_S2 500 _CNV_R_R_Umr_1_zu_1_53_CM_S2 0 500 FORMAT "%2.0"
 /begin AXIS_DESCR FIX_AXIS Z_SCHALTUNGSTYP _CNV_S_6_Enum_ESCHA_152_CM_S2 6 0 5 FIX_AXIS_PAR_DIST 0 1 6 READ_ONLY /end AXIS_DESCR
 /begin AXIS_DESCR FIX_AXIS Z_SCHALTDYN _CNV_S_7_Enum_ESDYN_151_CM_S2 3 0 6 /begin FIX_AXIS_PAR_LIST 0 1 2 /end FIX_AXIS_PAR_LIST READ_ONLY /end AXIS_DESCR
/end CHARACTERISTIC
/begin CHARACTERISTIC XTAB6X3FAKT_WARTESCHALT_DYNDZM "" MAP 0x271188 _REC_A1MAP_9_s2_u1_u1_S2 500 _CNV_R_R_Umr_1_zu_1_53_CM_S2 0 500 FORMAT "%2.0"
 /begin AXIS_DESCR FIX_AXIS Z_SCHALTUNGSTYP _CNV_S_6_Enum_ESCHA_152_CM_S2 6 0 5 FIX_AXIS_PAR_DIST 0 1 6 READ_ONLY /end AXIS_DESCR
 /begin AXIS_DESCR FIX_AXIS Z_SCHALTDYN _CNV_S_7_Enum_ESDYN_151_CM_S2 3 0 6 /begin FIX_AXIS_PAR_LIST 0 1 2 /end FIX_AXIS_PAR_LIST READ_ONLY /end AXIS_DESCR
/end CHARACTERISTIC
/begin CHARACTERISTIC XTAB6X4SCHM_BR_MOD_DYNDZM "" MAP 0x2711AC _REC_A1MAP_9_s2_u1_u1_S2 10000 _CNV_R_R_Umr_1_zu_1_42_CM_S2 -10000 0 FORMAT "%2.0"
 /begin AXIS_DESCR FIX_AXIS Z_SCHALTUNGSTYP _CNV_S_6_Enum_ESCHA_152_CM_S2 6 0 5 FIX_AXIS_PAR_DIST 0 1 6 READ_ONLY /end AXIS_DESCR
 /begin AXIS_DESCR FIX_AXIS Z_SCHALTDYN _CNV_S_7_Enum_ESDYN_151_CM_S2 4 0 6 /begin FIX_AXIS_PAR_LIST 0 1 2 3 /end FIX_AXIS_PAR_LIST READ_ONLY /end AXIS_DESCR
/end CHARACTERISTIC
/begin CHARACTERISTIC XTAB6X4SCHN_AB_MOD_DYNDZM "" MAP 0x2711DC _REC_A1MAP_9_s2_u1_u1_S2 10000 _CNV_R_R_Umr_1_zu_1_3_CM_S2 0 10000 FORMAT "%2.0"
 /begin AXIS_DESCR FIX_AXIS Z_SCHALTUNGSTYP _CNV_S_6_Enum_ESCHA_152_CM_S2 6 0 5 FIX_AXIS_PAR_DIST 0 1 6 READ_ONLY /end AXIS_DESCR
 /begin AXIS_DESCR FIX_AXIS Z_SCHALTDYN _CNV_S_7_Enum_ESDYN_151_CM_S2 4 0 6 /begin FIX_AXIS_PAR_LIST 0 1 2 3 /end FIX_AXIS_PAR_LIST READ_ONLY /end AXIS_DESCR
/end CHARACTERISTIC
/begin CHARACTERISTIC XTAB9X2FILT_DYNDZM_IDX "" MAP 0x275900 _REC_A1MAP_9_u1_u1_u1_S2 3 _CNV_R_R_Umr_1_zu_1_2_CM_S2 0 3 FORMAT "%2.0"
 /begin AXIS_DESCR FIX_AXIS Z_GANG_ZIEL_AGS _CNV_S_9_Enum_EGANG_30_CM_S2 9 0 8 FIX_AXIS_PAR_DIST 0 1 9 READ_ONLY /end AXIS_DESCR
 /begin AXIS_DESCR FIX_AXIS S_GN_DYNDZM _CNV_R_R_Umr_1_zu_1_2_CM_S2 2 0 255 /begin FIX_AXIS_PAR_LIST 0 1 /end FIX_AXIS_PAR_LIST READ_ONLY /end AXIS_DESCR
/end CHARACTERISTIC
/begin CHARACTERISTIC XTAB9X3FAKTGN_SR_DYNDZM_IDX "" MAP 0x27AF53 _REC_A1MAP_9_u1_u1_u1_S2 5 _CNV_S_6_Enum_EIDX__162_CM_S2 0 5
 /begin AXIS_DESCR FIX_AXIS Z_GANG_IST _CNV_S_9_Enum_EGANG_30_CM_S2 9 0 8 FIX_AXIS_PAR_DIST 0 1 9 READ_ONLY /end AXIS_DESCR
 /begin AXIS_DESCR FIX_AXIS NO_INPUT_QUANTITY _CNV_S_3_Enum_ESCHU_161_CM_S2 3 0 2 FIX_AXIS_PAR_DIST 0 1 3 READ_ONLY /end AXIS_DESCR
/end CHARACTERISTIC
/begin CHARACTERISTIC XTAB9X3FAKTWARTE_SR_DYNDZM_IDX "" MAP 0x27AF6E _REC_A1MAP_9_u1_u1_u1_S2 5 _CNV_S_6_Enum_EIDX__162_CM_S2 0 5
 /begin AXIS_DESCR FIX_AXIS Z_GANG_IST _CNV_S_9_Enum_EGANG_30_CM_S2 9 0 8 FIX_AXIS_PAR_DIST 0 1 9 READ_ONLY /end AXIS_DESCR
 /begin AXIS_DESCR FIX_AXIS NO_INPUT_QUANTITY _CNV_S_3_Enum_ESCHU_161_CM_S2 3 0 2 FIX_AXIS_PAR_DIST 0 1 3 READ_ONLY /end AXIS_DESCR
/end CHARACTERISTIC
/begin CHARACTERISTIC XTAB9X9GN_DYNDZM_QS0 "" MAP 0x275912 _REC_A1MAP_9_u2_u1_u1_S2 500 _CNV_R_R_Umr_1_zu_1_2_CM_S2 0 500
 /begin AXIS_DESCR FIX_AXIS Z_GANG_ZIEL_DYNDZM _CNV_S_9_Enum_EGANG_30_CM_S2 9 0 8 FIX_AXIS_PAR_DIST 0 1 9 READ_ONLY /end AXIS_DESCR
 /begin AXIS_DESCR FIX_AXIS Z_GANG_IST _CNV_S_9_Enum_EGANG_30_CM_S2 9 0 8 FIX_AXIS_PAR_DIST 0 1 9 READ_ONLY /end AXIS_DESCR
/end CHARACTERISTIC
/begin CHARACTERISTIC XTAB9X9GN_DYNDZM_QS0_SSG "" MAP 0x2759B4 _REC_A1MAP_9_u2_u1_u1_S2 500 _CNV_R_R_Umr_1_zu_1_2_CM_S2 0 500
 /begin AXIS_DESCR FIX_AXIS Z_GANG_ZIEL_DYNDZM _CNV_S_9_Enum_EGANG_30_CM_S2 9 0 8 FIX_AXIS_PAR_DIST 0 1 9 READ_ONLY /end AXIS_DESCR
 /begin AXIS_DESCR FIX_AXIS Z_GANG_IST _CNV_S_9_Enum_EGANG_30_CM_S2 9 0 8 FIX_AXIS_PAR_DIST 0 1 9 READ_ONLY /end AXIS_DESCR
/end CHARACTERISTIC
/begin CHARACTERISTIC XTAB9X9GN_DYNDZM_QS1 "" MAP 0x275A56 _REC_A1MAP_9_u2_u1_u1_S2 500 _CNV_R_R_Umr_1_zu_1_2_CM_S2 0 500
 /begin AXIS_DESCR FIX_AXIS Z_GANG_ZIEL_DYNDZM _CNV_S_9_Enum_EGANG_30_CM_S2 9 0 8 FIX_AXIS_PAR_DIST 0 1 9 READ_ONLY /end AXIS_DESCR
 /begin AXIS_DESCR FIX_AXIS Z_GANG_IST _CNV_S_9_Enum_EGANG_30_CM_S2 9 0 8 FIX_AXIS_PAR_DIST 0 1 9 READ_ONLY /end AXIS_DESCR
/end CHARACTERISTIC
/begin CHARACTERISTIC XTAB9X9GN_DYNDZM_QS1_SSG "" MAP 0x275AF8 _REC_A1MAP_9_u2_u1_u1_S2 500 _CNV_R_R_Umr_1_zu_1_2_CM_S2 0 500
 /begin AXIS_DESCR FIX_AXIS Z_GANG_ZIEL_DYNDZM _CNV_S_9_Enum_EGANG_30_CM_S2 9 0 8 FIX_AXIS_PAR_DIST 0 1 9 READ_ONLY /end AXIS_DESCR
 /begin AXIS_DESCR FIX_AXIS Z_GANG_IST _CNV_S_9_Enum_EGANG_30_CM_S2 9 0 8 FIX_AXIS_PAR_DIST 0 1 9 READ_ONLY /end AXIS_DESCR
/end CHARACTERISTIC
/begin CHARACTERISTIC XTAB9X9GN_DYNDZM_QS2 "" MAP 0x275B9A _REC_A1MAP_9_u2_u1_u1_S2 500 _CNV_R_R_Umr_1_zu_1_2_CM_S2 0 500
 /begin AXIS_DESCR FIX_AXIS Z_GANG_ZIEL_DYNDZM _CNV_S_9_Enum_EGANG_30_CM_S2 9 0 8 FIX_AXIS_PAR_DIST 0 1 9 READ_ONLY /end AXIS_DESCR
 /begin AXIS_DESCR FIX_AXIS Z_GANG_IST _CNV_S_9_Enum_EGANG_30_CM_S2 9 0 8 FIX_AXIS_PAR_DIST 0 1 9 READ_ONLY /end AXIS_DESCR
/end CHARACTERISTIC
/begin CHARACTERISTIC XTAB9X9GN_DYNDZM_QS2_SSG "" MAP 0x275C3C _REC_A1MAP_9_u2_u1_u1_S2 500 _CNV_R_R_Umr_1_zu_1_2_CM_S2 0 500
 /begin AXIS_DESCR FIX_AXIS Z_GANG_ZIEL_DYNDZM _CNV_S_9_Enum_EGANG_30_CM_S2 9 0 8 FIX_AXIS_PAR_DIST 0 1 9 READ_ONLY /end AXIS_DESCR
 /begin AXIS_DESCR FIX_AXIS Z_GANG_IST _CNV_S_9_Enum_EGANG_30_CM_S2 9 0 8 FIX_AXIS_PAR_DIST 0 1 9 READ_ONLY /end AXIS_DESCR
/end CHARACTERISTIC
/begin CHARACTERISTIC XTAB9X9T_WARTE_DYNDZM_QS0 "" MAP 0x275CDE _REC_A1MAP_9_s2_u1_u1_S2 2000 _CNV_R_R_Umr_1_zu_1_2_CM_S2 0 2000
 /begin AXIS_DESCR FIX_AXIS Z_GANG_ZIEL_DYNDZM _CNV_S_9_Enum_EGANG_30_CM_S2 9 0 8 FIX_AXIS_PAR_DIST 0 1 9 READ_ONLY /end AXIS_DESCR
 /begin AXIS_DESCR FIX_AXIS Z_GANG_IST _CNV_S_9_Enum_EGANG_30_CM_S2 9 0 8 FIX_AXIS_PAR_DIST 0 1 9 READ_ONLY /end AXIS_DESCR
/end CHARACTERISTIC
/begin CHARACTERISTIC XTAB9X9T_WARTE_DYNDZM_QS0_SSG "" MAP 0x275D80 _REC_A1MAP_9_s2_u1_u1_S2 2000 _CNV_R_R_Umr_1_zu_1_2_CM_S2 0 2000
 /begin AXIS_DESCR FIX_AXIS Z_GANG_ZIEL_DYNDZM _CNV_S_9_Enum_EGANG_30_CM_S2 9 0 8 FIX_AXIS_PAR_DIST 0 1 9 READ_ONLY /end AXIS_DESCR
 /begin AXIS_DESCR FIX_AXIS Z_GANG_IST _CNV_S_9_Enum_EGANG_30_CM_S2 9 0 8 FIX_AXIS_PAR_DIST 0 1 9 READ_ONLY /end AXIS_DESCR
/end CHARACTERISTIC
/begin CHARACTERISTIC XTAB9X9T_WARTE_DYNDZM_QS1 "" MAP 0x275E22 _REC_A1MAP_9_s2_u1_u1_S2 2000 _CNV_R_R_Umr_1_zu_1_2_CM_S2 0 2000
 /begin AXIS_DESCR FIX_AXIS Z_GANG_ZIEL_DYNDZM _CNV_S_9_Enum_EGANG_30_CM_S2 9 0 8 FIX_AXIS_PAR_DIST 0 1 9 READ_ONLY /end AXIS_DESCR
 /begin AXIS_DESCR FIX_AXIS Z_GANG_IST _CNV_S_9_Enum_EGANG_30_CM_S2 9 0 8 FIX_AXIS_PAR_DIST 0 1 9 READ_ONLY /end AXIS_DESCR
/end CHARACTERISTIC
/begin CHARACTERISTIC XTAB9X9T_WARTE_DYNDZM_QS1_SSG "" MAP 0x275EC4 _REC_A1MAP_9_s2_u1_u1_S2 2000 _CNV_R_R_Umr_1_zu_1_2_CM_S2 0 2000
 /begin AXIS_DESCR FIX_AXIS Z_GANG_ZIEL_DYNDZM _CNV_S_9_Enum_EGANG_30_CM_S2 9 0 8 FIX_AXIS_PAR_DIST 0 1 9 READ_ONLY /end AXIS_DESCR
 /begin AXIS_DESCR FIX_AXIS Z_GANG_IST _CNV_S_9_Enum_EGANG_30_CM_S2 9 0 8 FIX_AXIS_PAR_DIST 0 1 9 READ_ONLY /end AXIS_DESCR
/end CHARACTERISTIC
/begin CHARACTERISTIC XTAB9X9T_WARTE_DYNDZM_QS2 "" MAP 0x275F66 _REC_A1MAP_9_s2_u1_u1_S2 2000 _CNV_R_R_Umr_1_zu_1_2_CM_S2 0 2000
 /begin AXIS_DESCR FIX_AXIS Z_GANG_ZIEL_DYNDZM _CNV_S_9_Enum_EGANG_30_CM_S2 9 0 8 FIX_AXIS_PAR_DIST 0 1 9 READ_ONLY /end AXIS_DESCR
 /begin AXIS_DESCR FIX_AXIS Z_GANG_IST _CNV_S_9_Enum_EGANG_30_CM_S2 9 0 8 FIX_AXIS_PAR_DIST 0 1 9 READ_ONLY /end AXIS_DESCR
/end CHARACTERISTIC
/begin CHARACTERISTIC XTAB9X9T_WARTE_DYNDZM_QS2_SSG "" MAP 0x276008 _REC_A1MAP_9_s2_u1_u1_S2 2000 _CNV_R_R_Umr_1_zu_1_2_CM_S2 0 2000
 /begin AXIS_DESCR FIX_AXIS Z_GANG_ZIEL_DYNDZM _CNV_S_9_Enum_EGANG_30_CM_S2 9 0 8 FIX_AXIS_PAR_DIST 0 1 9 READ_ONLY /end AXIS_DESCR
 /begin AXIS_DESCR FIX_AXIS Z_GANG_IST _CNV_S_9_Enum_EGANG_30_CM_S2 9 0 8 FIX_AXIS_PAR_DIST 0 1 9 READ_ONLY /end AXIS_DESCR
/end CHARACTERISTIC
/begin CHARACTERISTIC XGN_DYNDZM_MOD "" VALUE 0x2760E0 _REC_S1VAL_1_u2_S2 500 _CNV_R_R_Umr_1_zu_1_3_CM_S2 0 500 FORMAT "%2.0" /end CHARACTERISTIC
/begin CHARACTERISTIC XGN_DYNDZM_MSA "" VALUE 0x2760E2 _REC_S1VAL_1_u2_S2 500 _CNV_R_R_Umr_1_zu_1_3_CM_S2 0 500 FORMAT "%2.0" /end CHARACTERISTIC
/begin CHARACTERISTIC XGN_DYNDZM_SEGELN_EIN "" VALUE 0x2760E4 _REC_S1VAL_1_u2_S2 500 _CNV_R_R_Umr_1_zu_1_3_CM_S2 0 500 FORMAT "%2.0" /end CHARACTERISTIC
/begin CHARACTERISTIC XGN_DYNDZM_SEGELN_UEBERGANG "" VALUE 0x2760E6 _REC_S1VAL_1_u2_S2 500 _CNV_R_R_Umr_1_zu_1_3_CM_S2 0 500 FORMAT "%2.0" /end CHARACTERISTIC
/begin CHARACTERISTIC XGN_DYNDZM_UEBERGANG_KRIECHEN "" VALUE 0x2760E8 _REC_S1VAL_1_u2_S2 500 _CNV_R_R_Umr_1_zu_1_3_CM_S2 0 500 FORMAT "%2.0" /end CHARACTERISTIC
/begin CHARACTERISTIC XGN_SIMULATE_DYNDZM "" VALUE 0x2760EA _REC_S1VAL_1_u2_S2 10000 _CNV_R_R_Umr_1_zu_1_177_CM_S2 0 10000 FORMAT "%2.0" /end CHARACTERISTIC
/begin CHARACTERISTIC XON_MOT_MIN_DYNDZM "" VALUE 0x2760EC _REC_S1VAL_1_u2_S2 1500 _CNV_R_R_Umr_1_zu_1_3_CM_S2 0 1500 FORMAT "%2.0" /end CHARACTERISTIC
/begin CHARACTERISTIC XSCHDN_ABBRUCH_T_WARTE_DYNDZM "" VALUE 0x2760EE _REC_S1VAL_1_s2_S2 2000 _CNV_R_R_Umr_1_zu_1_3_CM_S2 0 2000 FORMAT "%2.0" /end CHARACTERISTIC
/begin CHARACTERISTIC XSCHN_AB_AUS_DYNDZM "" VALUE 0x2760F0 _REC_S1VAL_1_u2_S2 10000 _CNV_R_R_Umr_1_zu_1_3_CM_S2 0 10000 FORMAT "%2.0" /end CHARACTERISTIC
/begin CHARACTERISTIC XSCHN_AB_EIN_DYNDZM "" VALUE 0x2760F2 _REC_S1VAL_1_u2_S2 10000 _CNV_R_R_Umr_1_zu_1_3_CM_S2 0 10000 FORMAT "%2.0" /end CHARACTERISTIC
/begin CHARACTERISTIC XSCHN_AB_SOLLLL_DYNDZM "" VALUE 0x2760F4 _REC_S1VAL_1_u2_S2 10000 _CNV_R_R_Umr_1_zu_1_3_CM_S2 0 10000 FORMAT "%2.0" /end CHARACTERISTIC
/begin CHARACTERISTIC XSCHN_MOT_MAX_DYNDZM "" VALUE 0x2760F6 _REC_S1VAL_1_u2_S2 10000 _CNV_R_R_Umr_1_zu_1_3_CM_S2 0 10000 FORMAT "%2.0" /end CHARACTERISTIC
/begin CHARACTERISTIC XSCHN_VM_AUS_EFAHREN_DYNDZM "" VALUE 0x2758FC _REC_S1VAL_1_u2_S2 1500 _CNV_R_R_Umr_1_zu_1_3_CM_S2 0 1500 FORMAT "%2.0" /end CHARACTERISTIC
/begin CHARACTERISTIC XSCHN_VM_EIN_EFAHREN_DYNDZM "" VALUE 0x2758FE _REC_S1VAL_1_u2_S2 1500 _CNV_R_R_Umr_1_zu_1_3_CM_S2 0 1500 FORMAT "%2.0" /end CHARACTERISTIC
/begin CHARACTERISTIC XSCHTEMP_GETR_DYNDZM "" VALUE 0x2760F8 _REC_S1VAL_1_s2_S2 400 _CNV_R_R_Umr_1_zu_1_1_CM_S2 -200 200 FORMAT "%2.0" /end CHARACTERISTIC
/begin CHARACTERISTIC XSCHT_ANGLEICH_DYNDZM "" VALUE 0x2760FA _REC_S1VAL_1_u2_S2 2000 _CNV_R_R_Umr_1_zu_1_6_CM_S2 0 2000 FORMAT "%2.0" /end CHARACTERISTIC
/begin CHARACTERISTIC XSCHT_FREEZE_DYNDZM "" VALUE 0x2760FC _REC_S1VAL_1_u2_S2 65000 _CNV_R_R_Umr_1_zu_1_6_CM_S2 0 65000 FORMAT "%2.0" /end CHARACTERISTIC
/begin CHARACTERISTIC XSCHW_DKKD_SEGELN_DYNDZM "" VALUE 0x2760FE _REC_S1VAL_1_u2_S2 110 _CNV_R_R_Umr_10_zu__9_CM_S2 0 110 FORMAT "%3.1" /end CHARACTERISTIC
/begin CHARACTERISTIC XSCHW_DKKD_SOLLLL_DYNDZM "" VALUE 0x276100 _REC_S1VAL_1_u2_S2 110 _CNV_R_R_Umr_10_zu__9_CM_S2 0 110 FORMAT "%3.1" /end CHARACTERISTIC
/begin CHARACTERISTIC XS_GNNEUBER_AENDERUNG_DYNDZM "" VALUE 0x27AF89 _REC_S1VAL_1_u1_S2 1 _CNV_R_R_Umr_1_zu_1_2_CM_S2 0 1 /end CHARACTERISTIC
/begin CHARACTERISTIC XS_INIT_N_DYNDZM "" VALUE 0x27AF8A _REC_S1VAL_1_u1_S2 1 _CNV_R_R_Umr_1_zu_1_2_CM_S2 0 1 /end CHARACTERISTIC
/begin CHARACTERISTIC XS_K0_EFAHREN_DYNDZM "" VALUE 0x27AF52 _REC_S1VAL_1_u1_S2 1 _CNV_R_R_Umr_1_zu_1_2_CM_S2 0 1 /end CHARACTERISTIC
/begin CHARACTERISTIC XS_MMOTDMEEFILT_DYNDZM "" VALUE 0x27AF8B _REC_S1VAL_1_u1_S2 1 _CNV_R_R_Umr_1_zu_1_2_CM_S2 0 1 /end CHARACTERISTIC
/begin CHARACTERISTIC XS_ND_DYNDZM "" VALUE 0x27AF8C _REC_S1VAL_1_u1_S2 1 _CNV_R_R_Umr_1_zu_1_2_CM_S2 0 1 /end CHARACTERISTIC
/begin CHARACTERISTIC XS_SIMULATE_DYNDZM "" VALUE 0x27AF8D _REC_S1VAL_1_u1_S2 1 _CNV_R_R_Umr_1_zu_1_2_CM_S2 0 1 /end CHARACTERISTIC
/begin CHARACTERISTIC XS_USE_DYNDZM "" VALUE 0x27AF8E _REC_S1VAL_1_u1_S2 1 _CNV_R_R_Umr_1_zu_1_2_CM_S2 0 1 /end CHARACTERISTIC
/begin CHARACTERISTIC XS_USE_PT1FILT_DYNDZM "" VALUE 0x27AF8F _REC_S1VAL_1_u1_S2 1 _CNV_R_R_Umr_1_zu_1_2_CM_S2 0 1 /end CHARACTERISTIC
/begin CHARACTERISTIC XS_USE_VORWAHL_DYNDZM "" VALUE 0x27AF90 _REC_S1VAL_1_u1_S2 1 _CNV_R_R_Umr_1_zu_1_2_CM_S2 0 1 /end CHARACTERISTIC
/begin CHARACTERISTIC XT_FOLGESCHALTUNG_DYNDZM "" VALUE 0x276102 _REC_S1VAL_1_u2_S2 10000 _CNV_R_R_Umr_1_zu_1_6_CM_S2 0 10000 FORMAT "%2.0" /end CHARACTERISTIC
/begin CHARACTERISTIC XT_ND_DYNDZM "" VALUE 0x276104 _REC_S1VAL_1_u2_S2 10000 _CNV_R_R_Umr_1_zu_1_6_CM_S2 0 10000 FORMAT "%2.0" /end CHARACTERISTIC
/begin CHARACTERISTIC XT_SEGELN_FOLGE_DYNDZM "" VALUE 0x276106 _REC_S1VAL_1_u2_S2 10000 _CNV_R_R_Umr_1_zu_1_6_CM_S2 0 10000 FORMAT "%2.0" /end CHARACTERISTIC
/begin CHARACTERISTIC XT_WARTE_SEGELN_DYNDZM "" VALUE 0x276108 _REC_S1VAL_1_u2_S2 1000 _CNV_R_R_Umr_1_zu_1_6_CM_S2 0 1000 FORMAT "%2.0" /end CHARACTERISTIC
/begin CHARACTERISTIC XT_WARTE_SIMULATE_DYNDZM "" VALUE 0x27610A _REC_S1VAL_1_u2_S2 10000 _CNV_R_R_Umr_1_zu_1_6_CM_S2 0 10000 FORMAT "%2.0" /end CHARACTERISTIC
/begin CHARACTERISTIC XZ_AENDERUNGSSCHALTUNG_DYNDZM "" VALUE 0x27AF91 _REC_S1VAL_1_u1_S2 2 _CNV_R_R_Umr_1_zu_1_2_CM_S2 0 2 /end CHARACTERISTIC
/begin CHARACTERISTIC XZ_GN_SR_NEUBER_DYNDZM "" VALUE 0x27AF92 _REC_S1VAL_1_u1_S2 3 _CNV_R_R_Umr_1_zu_1_2_CM_S2 0 3 /end CHARACTERISTIC
/begin CHARACTERISTIC XTAB2T_PADDLE_VERL_STEP "" CURVE 0x2719A8 _REC_A1CUR_30_u4_u1_S2 2.14748E+009 _CNV_R_R_Umr_1_zu_1_6_CM_S2 0 2147483647 FORMAT "%2.0"
 /begin AXIS_DESCR FIX_AXIS NO_INPUT_QUANTITY _CNV_S_2_Enum_EVERL_179_CM_S2 2 0 1 MONOTONY MON_INCREASE /begin FIX_AXIS_PAR_LIST 0 1 /end FIX_AXIS_PAR_LIST READ_ONLY /end AXIS_DESCR
/end CHARACTERISTIC
/begin CHARACTERISTIC XTAB2X9_RELATION_N_VAHA_DOWN "" MAP 0x2755B4 _REC_A1MAP_9_u1_u1_u1_S2 2 _CNV_R_R_Umr_100_zu_54_CM_S2 0 2 FORMAT "%4.2"
 /begin AXIS_DESCR FIX_AXIS NO_INPUT_QUANTITY _CNV_R_R_Umr_1_zu_1_2_CM_S2 2 0 255 /begin FIX_AXIS_PAR_LIST 0 1 /end FIX_AXIS_PAR_LIST READ_ONLY /end AXIS_DESCR
 /begin AXIS_DESCR FIX_AXIS Z_GANG_ZIEL_SSTEP _CNV_S_9_Enum_EGANG_30_CM_S2 9 0 8 FIX_AXIS_PAR_DIST 0 1 9 READ_ONLY /end AXIS_DESCR
/end CHARACTERISTIC
/begin CHARACTERISTIC XTAB2X9_RELATION_N_VAHA_UP "" MAP 0x2755C6 _REC_A1MAP_9_u1_u1_u1_S2 2 _CNV_R_R_Umr_100_zu_54_CM_S2 0 2 FORMAT "%4.2"
 /begin AXIS_DESCR FIX_AXIS NO_INPUT_QUANTITY _CNV_R_R_Umr_1_zu_1_2_CM_S2 2 0 255 /begin FIX_AXIS_PAR_LIST 0 1 /end FIX_AXIS_PAR_LIST READ_ONLY /end AXIS_DESCR
 /begin AXIS_DESCR FIX_AXIS Z_GANG_ZIEL_SSTEP _CNV_S_9_Enum_EGANG_30_CM_S2 9 0 8 FIX_AXIS_PAR_DIST 0 1 9 READ_ONLY /end AXIS_DESCR
/end CHARACTERISTIC
/begin CHARACTERISTIC XTAB2_DSC_TASTER_ZHSAUS "" CURVE 0x275644 _REC_A1CUR_30_u1_u1_S2 2 _CNV_S_3_Enum_EDSC__182_CM_S2 0 2
 /begin AXIS_DESCR FIX_AXIS NO_INPUT_QUANTITY _CNV_R_R_Umr_1_zu_1_2_CM_S2 2 0 255 /begin FIX_AXIS_PAR_LIST 0 1 /end FIX_AXIS_PAR_LIST READ_ONLY /end AXIS_DESCR
/end CHARACTERISTIC
/begin CHARACTERISTIC XTAB3X9ON_AB_RSSTPR_HOTDUE "" MAP 0x2755D8 _REC_A1MAP_9_s2_u1_u1_S2 10000 _CNV_R_R_Umr_1_zu_1_3_CM_S2 -1000 9000 FORMAT "%2.0"
 /begin AXIS_DESCR FIX_AXIS Z_HOTDUE _CNV_S_3_Enum_EHOTD_180_CM_S2 3 0 2 FIX_AXIS_PAR_DIST 0 1 3 READ_ONLY /end AXIS_DESCR
 /begin AXIS_DESCR FIX_AXIS Z_GANG_ZIEL_SSTEP _CNV_S_9_Enum_EGANG_30_CM_S2 9 0 8 FIX_AXIS_PAR_DIST 0 1 9 READ_ONLY /end AXIS_DESCR
/end CHARACTERISTIC
/begin CHARACTERISTIC XTAB5X9N_TIPPRS_NOT_STPTRsport "" MAP 0x27567C _REC_S3MAP_54_u2_s2_u1_S2 9000 _CNV_R_R_Umr_1_zu_1_3_CM_S2 0 9000 FORMAT "%2.0"
 /begin AXIS_DESCR STD_AXIS G2W_AB_FILT _CNV_R_R_Umr_10_zu__181_CM_S2 5 -3276.8 3276.7 FORMAT "%3.1" /end AXIS_DESCR
 /begin AXIS_DESCR FIX_AXIS Z_GANG_TIPP_SPORT _CNV_S_9_Enum_EGANG_30_CM_S2 9 0 8 FIX_AXIS_PAR_DIST 0 1 9 READ_ONLY /end AXIS_DESCR
/end CHARACTERISTIC
/begin CHARACTERISTIC XTAB5X9ON_AB_RSSTPR "" MAP 0x2756E2 _REC_S3MAP_54_s2_s2_u1_S2 6000 _CNV_R_R_Umr_1_zu_1_3_CM_S2 -1000 5000 FORMAT "%2.0"
 /begin AXIS_DESCR STD_AXIS G2W_AB_FILT _CNV_R_R_Umr_10_zu__181_CM_S2 5 -3276.8 3276.7 FORMAT "%3.1" /end AXIS_DESCR
 /begin AXIS_DESCR FIX_AXIS Z_GANG_ZIEL_SSTEP _CNV_S_9_Enum_EGANG_30_CM_S2 9 0 8 FIX_AXIS_PAR_DIST 0 1 9 READ_ONLY /end AXIS_DESCR
/end CHARACTERISTIC
/begin CHARACTERISTIC XTAB6X3_ZHSKDRS_VERBOT_STEPS "" MAP 0x27560E _REC_A1MAP_9_u1_u1_u1_S2 1 _CNV_R_R_Umr_1_zu_1_2_CM_S2 0 1 FORMAT "%2.0"
 /begin AXIS_DESCR FIX_AXIS Z_DRIVELOGIC _CNV_S_6_Enum_EDL_11_CM_S2 6 1 6 FIX_AXIS_PAR_DIST 1 1 6 READ_ONLY /end AXIS_DESCR
 /begin AXIS_DESCR FIX_AXIS Z_DSC _CNV_S_3_Enum_EDSCS_28_CM_S2 3 0 2 FIX_AXIS_PAR_DIST 0 1 3 READ_ONLY /end AXIS_DESCR
/end CHARACTERISTIC
/begin CHARACTERISTIC XTAB6X3_ZHSKDRS_VERBOT_STEPS_CS "" MAP 0x275620 _REC_A1MAP_9_u1_u1_u1_S2 1 _CNV_R_R_Umr_1_zu_1_2_CM_S2 0 1 FORMAT "%2.0"
 /begin AXIS_DESCR FIX_AXIS Z_DRIVELOGIC _CNV_S_6_Enum_EDL_11_CM_S2 6 1 6 FIX_AXIS_PAR_DIST 1 1 6 READ_ONLY /end AXIS_DESCR
 /begin AXIS_DESCR FIX_AXIS Z_DSC _CNV_S_3_Enum_EDSCS_28_CM_S2 3 0 2 FIX_AXIS_PAR_DIST 0 1 3 READ_ONLY /end AXIS_DESCR
/end CHARACTERISTIC
/begin CHARACTERISTIC XTAB9N_MAX_RENNSTART "" CURVE 0x275646 _REC_A1CUR_30_u2_u1_S2 20000 _CNV_R_R_Umr_1_zu_1_3_CM_S2 0 20000 FORMAT "%2.0"
 /begin AXIS_DESCR FIX_AXIS Z_GANG_IST _CNV_S_9_Enum_EGANG_30_CM_S2 9 0 8 FIX_AXIS_PAR_DIST 0 1 9 READ_ONLY /end AXIS_DESCR
/end CHARACTERISTIC
/begin CHARACTERISTIC XTAB9ON_TIPPHS_NOT_STEPS "" CURVE 0x275658 _REC_A1CUR_30_s2_u1_S2 4000 _CNV_R_R_Umr_1_zu_1_3_CM_S2 -2000 2000 FORMAT "%2.0"
 /begin AXIS_DESCR FIX_AXIS Z_GANG_TIPP_SPORT _CNV_S_9_Enum_EGANG_30_CM_S2 9 0 8 FIX_AXIS_PAR_DIST 0 1 9 READ_ONLY /end AXIS_DESCR
/end CHARACTERISTIC
/begin CHARACTERISTIC XTAB9ON_TIPPHS_NOT_STEPSDUE "" CURVE 0x27566A _REC_A1CUR_30_s2_u1_S2 8000 _CNV_R_R_Umr_1_zu_1_3_CM_S2 -2000 6000 FORMAT "%2.0"
 /begin AXIS_DESCR FIX_AXIS Z_GANG_TIPP_SPORT _CNV_S_9_Enum_EGANG_30_CM_S2 9 0 8 FIX_AXIS_PAR_DIST 0 1 9 READ_ONLY /end AXIS_DESCR
/end CHARACTERISTIC
/begin CHARACTERISTIC XTAB9X2Z_GANG_ZRS "" MAP 0x275632 _REC_A1MAP_9_u1_u1_u1_S2 8 _CNV_S_9_Enum_EGANG_30_CM_S2 0 8
 /begin AXIS_DESCR FIX_AXIS Z_GANG_ZIEL_SSTEP _CNV_S_9_Enum_EGANG_30_CM_S2 9 0 8 FIX_AXIS_PAR_DIST 0 1 9 READ_ONLY /end AXIS_DESCR
 /begin AXIS_DESCR FIX_AXIS S_ZRS_MOD_STEPS _CNV_S_2_Schalter_A_4_CM_S2 2 0 1 /begin FIX_AXIS_PAR_LIST 0 1 /end FIX_AXIS_PAR_LIST READ_ONLY /end AXIS_DESCR
/end CHARACTERISTIC
/begin CHARACTERISTIC XTAB9Z_GANG_KDRS_STEPS "" CURVE 0x275748 _REC_S7CUR_53_u2_u2_S2 8 _CNV_S_9_Enum_EGANG_30_CM_S2 0 8
 /begin AXIS_DESCR STD_AXIS N_AB _CNV_R_R_Umr_1_zu_1_3_CM_S2 9 0 20000 FORMAT "%2.0" /end AXIS_DESCR
/end CHARACTERISTIC
/begin CHARACTERISTIC XTAB9Z_GANG_VFZG "" CURVE 0x27576E _REC_S7CUR_53_u2_u2_S2 8 _CNV_S_9_Enum_EGANG_30_CM_S2 0 8
 /begin AXIS_DESCR STD_AXIS V_FZG _CNV_R_R_Umr_1_zu_1_8_CM_S2 9 0 400 FORMAT "%2.0" /end AXIS_DESCR
/end CHARACTERISTIC
/begin CHARACTERISTIC XC_GANGMAX_SP_STAND "" VALUE 0x27AEC8 _REC_S1VAL_1_u1_S2 8 _CNV_S_9_Enum_EGANG_30_CM_S2 0 8 /end CHARACTERISTIC
/begin CHARACTERISTIC XC_NABMAX_SP_STAND_OBEN "" VALUE 0x275794 _REC_S1VAL_1_u2_S2 2000 _CNV_R_R_Umr_1_zu_1_3_CM_S2 0 2000 FORMAT "%2.0" /end CHARACTERISTIC
/begin CHARACTERISTIC XC_NABMAX_SP_STAND_UNTEN "" VALUE 0x275796 _REC_S1VAL_1_u2_S2 2000 _CNV_R_R_Umr_1_zu_1_3_CM_S2 0 2000 FORMAT "%2.0" /end CHARACTERISTIC
/begin CHARACTERISTIC XDT_ENTPR_PADDLE_FLANKW_STEP "" VALUE 0x27B565 _REC_S1VAL_1_u1_S2 255 _CNV_R_R_Umr_1_zu_1_6_CM_S2 0 255 FORMAT "%2.0" /end CHARACTERISTIC
/begin CHARACTERISTIC XGANG_ANZAHL_TIPP "" VALUE 0x27AEC9 _REC_S1VAL_1_u1_S2 255 _CNV_R_R_Umr_1_zu_1_2_CM_S2 0 255 /end CHARACTERISTIC
/begin CHARACTERISTIC XHW_STEIGUNG_STEPS "" VALUE 0x275798 _REC_S1VAL_1_u2_S2 200 _CNV_R_R_Umr_10_zu__9_CM_S2 0 200 FORMAT "%3.1" /end CHARACTERISTIC
/begin CHARACTERISTIC XN_MOT_SOLLLL_STEPTR "" VALUE 0x27579A _REC_S1VAL_1_u2_S2 3000 _CNV_P_2_A_I_184_CM_S2 0 3000 FORMAT "%2.0" /end CHARACTERISTIC
/begin CHARACTERISTIC XSCHG2W_AB_ZRS_STEP "" VALUE 0x27579C _REC_S1VAL_1_s2_S2 3000 _CNV_R_R_Umr_10_zu__181_CM_S2 -3000 0 FORMAT "%3.1" /end CHARACTERISTIC
/begin CHARACTERISTIC XSCHW_DKKD_STEPSNULLAST "" VALUE 0x27579E _REC_S1VAL_1_u2_S2 110 _CNV_R_R_Umr_10_zu__9_CM_S2 0 110 FORMAT "%3.1" /end CHARACTERISTIC
/begin CHARACTERISTIC XSCHW_STEIGUNG_STEPS "" VALUE 0x2757A0 _REC_S1VAL_1_s2_S2 400 _CNV_R_R_Umr_10_zu__9_CM_S2 -200 200 FORMAT "%3.1" /end CHARACTERISTIC
/begin CHARACTERISTIC XSCH_HOTMODE_SCHALTVERBOT "" VALUE 0x27AECA _REC_S1VAL_1_u1_S2 3 _CNV_R_R_Umr_1_zu_1_2_CM_S2 0 3 FORMAT "%2.0" /end CHARACTERISTIC
/begin CHARACTERISTIC XSCH_HOTMODE_STEPS "" VALUE 0x27AECB _REC_S1VAL_1_u1_S2 3 _CNV_R_R_Umr_1_zu_1_2_CM_S2 0 3 FORMAT "%2.0" /end CHARACTERISTIC
/begin CHARACTERISTIC XSCH_HOTMODE_STEPSZRS1 "" VALUE 0x27AECC _REC_S1VAL_1_u1_S2 3 _CNV_R_R_Umr_1_zu_1_2_CM_S2 0 3 FORMAT "%2.0" /end CHARACTERISTIC
/begin CHARACTERISTIC XS_ECO_PADDLE_VERL_STEP "" VALUE 0x27B566 _REC_S1VAL_1_u1_S2 1 _CNV_S_2_Schalter_A_4_CM_S2 0 1 /end CHARACTERISTIC
/begin CHARACTERISTIC XS_FDS_ZRS_STAND_STEPS "" VALUE 0x27AECD _REC_S1VAL_1_u1_S2 1 _CNV_S_2_Schalter_A_4_CM_S2 0 1 /end CHARACTERISTIC
/begin CHARACTERISTIC XS_GANGREF_VERL_STEP "" VALUE 0x27B567 _REC_S1VAL_1_u1_S2 1 _CNV_R_R_Umr_1_zu_1_2_CM_S2 0 1 FORMAT "%2.0" /end CHARACTERISTIC
/begin CHARACTERISTIC XS_GANG_PRUEF_VERL_STEP "" VALUE 0x27B568 _REC_S1VAL_1_u1_S2 1 _CNV_S_2_Schalter_A_4_CM_S2 0 1 /end CHARACTERISTIC
/begin CHARACTERISTIC XS_HS1TIPPLUS_EINSTIEG_STEPS "" VALUE 0x27AECE _REC_S1VAL_1_u1_S2 1 _CNV_R_R_Umr_1_zu_1_2_CM_S2 0 1 FORMAT "%2.0" /end CHARACTERISTIC
/begin CHARACTERISTIC XS_KDRS_STAND_STEPS "" VALUE 0x27AECF _REC_S1VAL_1_u1_S2 1 _CNV_S_2_Schalter_A_4_CM_S2 0 1 /end CHARACTERISTIC
/begin CHARACTERISTIC XS_KDRS_STEPS "" VALUE 0x27AED0 _REC_S1VAL_1_u1_S2 1 _CNV_S_2_Schalter_A_4_CM_S2 0 1 /end CHARACTERISTIC
/begin CHARACTERISTIC XS_KDRS_TIPMINUSAKTIV_SSTEP "" VALUE 0x27AED1 _REC_S1VAL_1_u1_S2 1 _CNV_R_R_Umr_1_zu_1_2_CM_S2 0 1 FORMAT "%2.0" /end CHARACTERISTIC
/begin CHARACTERISTIC XS_KDTippRS_AKTIV "" VALUE 0x27AED2 _REC_S1VAL_1_u1_S2 1 _CNV_S_2_Schalter_A_4_CM_S2 0 1 /end CHARACTERISTIC
/begin CHARACTERISTIC XS_MINUSPADDLE_DRS_STEPS "" VALUE 0x27AED3 _REC_S1VAL_1_u1_S2 1 _CNV_R_R_Umr_1_zu_1_2_CM_S2 0 1 FORMAT "%2.0" /end CHARACTERISTIC
/begin CHARACTERISTIC XS_MINUSPADDLE_DRS_TID "" VALUE 0x27AED4 _REC_S1VAL_1_u1_S2 1 _CNV_R_R_Umr_1_zu_1_2_CM_S2 0 1 FORMAT "%2.0" /end CHARACTERISTIC
/begin CHARACTERISTIC XS_SCHALTUNG_VERL_STEP "" VALUE 0x27B569 _REC_S1VAL_1_u1_S2 1 _CNV_S_2_Schalter_A_4_CM_S2 0 1 /end CHARACTERISTIC
/begin CHARACTERISTIC XS_SOURCE_NMOTSOLLLL_STEPTR "" VALUE 0x27AED5 _REC_S1VAL_1_u1_S2 1 _CNV_R_R_Umr_1_zu_1_2_CM_S2 0 1 /end CHARACTERISTIC
/begin CHARACTERISTIC XS_TIPPEN_VERL_STEP "" VALUE 0x27B56A _REC_S1VAL_1_u1_S2 1 _CNV_S_2_Schalter_A_4_CM_S2 0 1 /end CHARACTERISTIC
/begin CHARACTERISTIC XS_TIPP_VORWAHL_MINUS "" VALUE 0x27AED6 _REC_S1VAL_1_u1_S2 1 _CNV_S_2_Schalter_A_4_CM_S2 0 1 /end CHARACTERISTIC
/begin CHARACTERISTIC XS_TIPP_VORWAHL_PLUS "" VALUE 0x27AED7 _REC_S1VAL_1_u1_S2 1 _CNV_S_2_Schalter_A_4_CM_S2 0 1 /end CHARACTERISTIC
/begin CHARACTERISTIC XS_TIPP_VORWAHL_STAND "" VALUE 0x27AED8 _REC_S1VAL_1_u1_S2 1 _CNV_S_2_Schalter_A_4_CM_S2 0 1 /end CHARACTERISTIC
/begin CHARACTERISTIC XS_USE_ANHSTEPSZRS1 "" VALUE 0x27AED9 _REC_S1VAL_1_u1_S2 1 _CNV_S_2_Schalter_A_4_CM_S2 0 1 /end CHARACTERISTIC
/begin CHARACTERISTIC XS_USE_CODGETRTYP_KDTippRS "" VALUE 0x27AEDA _REC_S1VAL_1_u1_S2 1 _CNV_S_2_Schalter_A_4_CM_S2 0 1 /end CHARACTERISTIC
/begin CHARACTERISTIC XS_USE_DMFS_TIPP "" VALUE 0x27AEDB _REC_S1VAL_1_u1_S2 1 _CNV_S_2_Schalter_A_4_CM_S2 0 1 /end CHARACTERISTIC
/begin CHARACTERISTIC XS_USE_GANG_STAND_STEPS "" VALUE 0x27AEDC _REC_S1VAL_1_u1_S2 1 _CNV_S_2_Schalter_A_4_CM_S2 0 1 /end CHARACTERISTIC
/begin CHARACTERISTIC XS_USE_INIT_SSTEP_GLEICHSINNIG "" VALUE 0x27AEDD _REC_S1VAL_1_u1_S2 1 _CNV_R_R_Umr_1_zu_1_2_CM_S2 0 1 FORMAT "%2.0" /end CHARACTERISTIC
/begin CHARACTERISTIC XS_USE_RENNSTARTGANG2 "" VALUE 0x27AEDE _REC_S1VAL_1_u1_S2 1 _CNV_S_2_Schalter_A_4_CM_S2 0 1 /end CHARACTERISTIC
/begin CHARACTERISTIC XS_USE_SCHLUPFNACHLAUFZWEI_SSTEP "" VALUE 0x27AEDF _REC_S1VAL_1_u1_S2 1 _CNV_R_R_Umr_1_zu_1_2_CM_S2 0 1 FORMAT "%2.0" /end CHARACTERISTIC
/begin CHARACTERISTIC XS_VORWAHL_MDSSCHUB_SSTEP "" VALUE 0x27AEE0 _REC_S1VAL_1_u1_S2 1 _CNV_R_R_Umr_1_zu_1_2_CM_S2 0 1 FORMAT "%2.0" /end CHARACTERISTIC
/begin CHARACTERISTIC XS_ZHS_VERBOT_STEPS "" VALUE 0x27AEE1 _REC_S1VAL_1_u1_S2 1 _CNV_S_2_Schalter_A_4_CM_S2 0 1 /end CHARACTERISTIC
/begin CHARACTERISTIC XS_ZWANGHSRS_VORWAHL "" VALUE 0x27AEE2 _REC_S1VAL_1_u1_S2 1 _CNV_R_R_Umr_1_zu_1_2_CM_S2 0 1 FORMAT "%2.0" /end CHARACTERISTIC
/begin CHARACTERISTIC XT_GANG_ZIEL_STPTRsport "" VALUE 0x270E40 _REC_S1VAL_1_u4_S2 2.14748E+009 _CNV_R_R_Umr_1_zu_1_6_CM_S2 0 2147483647 FORMAT "%2.0" /end CHARACTERISTIC
/begin CHARACTERISTIC XT_MINUSPADDLE_DRS_STEPS "" VALUE 0x2757A2 _REC_S1VAL_1_u2_S2 3000 _CNV_R_R_Umr_1_zu_1_183_CM_S2 0 3000 FORMAT "%2.0" /end CHARACTERISTIC
/begin CHARACTERISTIC XT_SPEICHER_TIPP_MINUS "" VALUE 0x2757A4 _REC_S1VAL_1_u2_S2 10000 _CNV_R_R_Umr_1_zu_1_6_CM_S2 0 10000 FORMAT "%2.0" /end CHARACTERISTIC
/begin CHARACTERISTIC XT_TIPP_STEPS "" VALUE 0x270E44 _REC_S1VAL_1_u4_S2 2.14748E+009 _CNV_R_R_Umr_1_zu_1_6_CM_S2 0 2147483647 FORMAT "%2.0" /end CHARACTERISTIC
/begin CHARACTERISTIC XT_VORWAHL "" VALUE 0x2757A6 _REC_S1VAL_1_u2_S2 65512 _CNV_R_R_Umr_1_zu_1_6_CM_S2 0 65512 FORMAT "%2.0" /end CHARACTERISTIC
/begin CHARACTERISTIC XT_ZWANG_HSRS_STPTRsport "" VALUE 0x270E48 _REC_S1VAL_1_u4_S2 2.14748E+009 _CNV_R_R_Umr_1_zu_1_6_CM_S2 0 2147483647 FORMAT "%2.0" /end CHARACTERISTIC
/begin CHARACTERISTIC XV_FZG_PADDLEMINUS_VERL_STEP "" VALUE 0x276532 _REC_S1VAL_1_u2_S2 400 _CNV_R_R_Umr_1_zu_1_8_CM_S2 0 400 FORMAT "%2.0" /end CHARACTERISTIC
/begin CHARACTERISTIC XZ_GANG_PADDLEMINUS_VERL_STEP "" VALUE 0x27B56B _REC_S1VAL_1_u1_S2 8 _CNV_S_9_Enum_EGANG_30_CM_S2 0 8 /end CHARACTERISTIC
/begin CHARACTERISTIC XZ_PADDLE_VERL_STEP "" VALUE 0x27B56C _REC_S1VAL_1_u1_S2 3 _CNV_S_4_Enum_TIDAU_185_CM_S2 0 3 /end CHARACTERISTIC
/begin CHARACTERISTIC XZ_TIPZUL_ZWANGSHSRS_SSTEP "" VALUE 0x27AEE3 _REC_S1VAL_1_u1_S2 2 _CNV_R_R_Umr_1_zu_1_2_CM_S2 0 2 FORMAT "%2.0" /end CHARACTERISTIC
/begin CHARACTERISTIC XTAB150X2NAVI_COUNTRY_CODE_ENBL "" MAP 0x270E90 _REC_A1MAP_9_u2_u1_u1_S2 65535 _CNV_R_R_Umr_1_zu_1_2_CM_S2 0 65535 FORMAT "%2.0"
 /begin AXIS_DESCR FIX_AXIS NO_INPUT_QUANTITY _CNV_R_R_Umr_1_zu_1_2_CM_S2 150 0 255
  /begin FIX_AXIS_PAR_LIST 0 1 2 3 4 5 6 7 8 9 10 11 12 13 14 15 16 17 18 19 20 21 22 23 24 25 26 27 28 29 30 31 32 33 34 35 36 37 38 39 40 41 42 43 44 45 46 47 48 49 50 51 52 53 54 55 56 57 58 59 60 61 62 63 64 65 66 67 68 69 70 71 72 73 74 75 76 77 78 79 80 81 82 83 84 85 86 87 88 89 90 91 92 93 94 95 96 97 98 99 100 101 102 103 104 105 106 107 108 109 110 111 112 113 114 115 116 117 118 119 120 121 122 123 124 125 126 127 128 129 130 131 132 133 134 135 136 137 138 139 140 141 142 143 144 145 146 147 148 149 /end FIX_AXIS_PAR_LIST
  FORMAT "%2.0" READ_ONLY /end AXIS_DESCR
 /begin AXIS_DESCR FIX_AXIS NO_INPUT_QUANTITY _CNV_R_R_Umr_1_zu_1_2_CM_S2 2 0 255 /begin FIX_AXIS_PAR_LIST 0 1 /end FIX_AXIS_PAR_LIST FORMAT "%2.0" READ_ONLY /end AXIS_DESCR
/end CHARACTERISTIC
/begin CHARACTERISTIC XTAB2ODL_KRZG_BLINKEN_COS "" CURVE 0x26F250 _REC_A1CUR_30_u2_u1_S2 500 _CNV_R_R_Umr_1_zu_1_123_CM_S2 0 500 FORMAT "%2.0"
 /begin AXIS_DESCR FIX_AXIS S_AUTOBAHN_DCODR _CNV_R_R_Umr_1_zu_1_2_CM_S2 2 0 255 /begin FIX_AXIS_PAR_LIST 0 1 /end FIX_AXIS_PAR_LIST FORMAT "%2.0" READ_ONLY /end AXIS_DESCR
/end CHARACTERISTIC
/begin CHARACTERISTIC XTAB2ODL_NEG_KRZG_DCODR "" CURVE 0x2758CE _REC_S7CUR_53_u2_u2_S2 65535 _CNV_R_R_Umr_1_zu_1_123_CM_S2 0 65535 FORMAT "%2.0"
 /begin AXIS_DESCR STD_AXIS V_FZG _CNV_R_R_Umr_1_zu_1_8_CM_S2 2 0 65535 FORMAT "%2.0" /end AXIS_DESCR
/end CHARACTERISTIC
/begin CHARACTERISTIC XTAB2R_MINERK_KURVE_DCODR "" CURVE 0x2710E8 _REC_A1CUR_30_s2_u1_S2 65535 _CNV_R_R_Umr_1_zu_1_123_CM_S2 -32768 32767 FORMAT "%2.0"
 /begin AXIS_DESCR FIX_AXIS Z_AGS_MODBEDEL _CNV_S_2_Enum_EAGS_25_CM_S2 2 0 1 FIX_AXIS_PAR_DIST 0 1 2 READ_ONLY /end AXIS_DESCR
/end CHARACTERISTIC
/begin CHARACTERISTIC XTAB2R_MINERW_KURVE_DCODR "" CURVE 0x2710EC _REC_A1CUR_30_s2_u1_S2 65535 _CNV_R_R_Umr_1_zu_1_123_CM_S2 -32768 32767 FORMAT "%2.0"
 /begin AXIS_DESCR FIX_AXIS Z_AGS_MODBEDEL _CNV_S_2_Enum_EAGS_25_CM_S2 2 0 1 FIX_AXIS_PAR_DIST 0 1 2 READ_ONLY /end AXIS_DESCR
/end CHARACTERISTIC
/begin CHARACTERISTIC XTAB2X2T_BLINKEN_COS "" MAP 0x274E04 _REC_S3MAP_54_u2_u2_u1_S2 65535 _CNV_R_R_Umr_1_zu_1_6_CM_S2 0 65535 FORMAT "%2.0"
 /begin AXIS_DESCR STD_AXIS V_FZG _CNV_R_R_Umr_1_zu_1_8_CM_S2 2 0 65535 FORMAT "%2.0" /end AXIS_DESCR
 /begin AXIS_DESCR FIX_AXIS S_AUTOBAHN_DCODR _CNV_R_R_Umr_1_zu_1_2_CM_S2 2 0 255 /begin FIX_AXIS_PAR_LIST 0 1 /end FIX_AXIS_PAR_LIST FORMAT "%2.0" READ_ONLY /end AXIS_DESCR
/end CHARACTERISTIC
/begin CHARACTERISTIC XTAB3A_LMAX_DL_KREIS_COS "" CURVE 0x275804 _REC_S7CUR_53_u2_u2_S2 24.9 _CNV_R_R_Umr_10_zu__46_CM_S2 0.1 25 FORMAT "%3.1"
 /begin AXIS_DESCR STD_AXIS DL_KREIS_DCODR _CNV_R_R_Umr_1_zu_1_123_CM_S2 3 0 65535 FORMAT "%2.0" /end AXIS_DESCR
/end CHARACTERISTIC
/begin CHARACTERISTIC XTAB3A_LMAX_DL_KRZG_COS "" CURVE 0x275812 _REC_S7CUR_53_u2_u2_S2 24.9 _CNV_R_R_Umr_10_zu__46_CM_S2 0.1 25 FORMAT "%3.1"
 /begin AXIS_DESCR STD_AXIS DL_KRZG_ANF_DCODR _CNV_R_R_Umr_1_zu_1_123_CM_S2 3 0 65535 FORMAT "%2.0" /end AXIS_DESCR
/end CHARACTERISTIC
/begin CHARACTERISTIC XTAB3A_LMAX_DL_KURVE_COS "" CURVE 0x275820 _REC_S7CUR_53_u2_u2_S2 24.9 _CNV_R_R_Umr_10_zu__46_CM_S2 0.1 25 FORMAT "%3.1"
 /begin AXIS_DESCR STD_AXIS DL_KURVE_ANF_DCODR _CNV_R_R_Umr_1_zu_1_123_CM_S2 3 0 65535 FORMAT "%2.0" /end AXIS_DESCR
/end CHARACTERISTIC
/begin CHARACTERISTIC XTAB3A_QMAX_KREIS_COS "" CURVE 0x27582E _REC_S7CUR_53_u2_u2_S2 25 _CNV_R_R_Umr_10_zu__46_CM_S2 0 25 FORMAT "%3.1"
 /begin AXIS_DESCR STD_AXIS R_KREIS_MIN_DCODR _CNV_R_R_Umr_1_zu_1_123_CM_S2 3 0 65535 FORMAT "%2.0" /end AXIS_DESCR
/end CHARACTERISTIC
/begin CHARACTERISTIC XTAB3A_QMAX_KURVE_COS "" CURVE 0x27583C _REC_S7CUR_53_u2_u2_S2 25 _CNV_R_R_Umr_10_zu__46_CM_S2 0 25 FORMAT "%3.1"
 /begin AXIS_DESCR STD_AXIS R_KURVE_MIN_DCODR _CNV_R_R_Umr_1_zu_1_123_CM_S2 3 0 65535 FORMAT "%2.0" /end AXIS_DESCR
/end CHARACTERISTIC
/begin CHARACTERISTIC XTAB3DL_AAF_ANF_DCODR_ERK "" CURVE 0x274E26 _REC_S7CUR_53_u2_u2_S2 65535 _CNV_R_R_Umr_1_zu_1_123_CM_S2 0 65535 FORMAT "%2.0"
 /begin AXIS_DESCR STD_AXIS V_FZG _CNV_R_R_Umr_1_zu_1_8_CM_S2 3 0 400 FORMAT "%2.0" /end AXIS_DESCR
/end CHARACTERISTIC
/begin CHARACTERISTIC XTAB3DL_KREIS_DCODR_ERK "" CURVE 0x274E34 _REC_S7CUR_53_u2_u2_S2 65535 _CNV_R_R_Umr_1_zu_1_123_CM_S2 0 65535 FORMAT "%2.0"
 /begin AXIS_DESCR STD_AXIS V_FZG _CNV_R_R_Umr_1_zu_1_8_CM_S2 3 0 400 FORMAT "%2.0" /end AXIS_DESCR
/end CHARACTERISTIC
/begin CHARACTERISTIC XTAB3DL_KRZG_ANF_DCODR_ERK "" CURVE 0x274E42 _REC_S7CUR_53_u2_u2_S2 1000 _CNV_R_R_Umr_1_zu_1_123_CM_S2 0 1000 FORMAT "%2.0"
 /begin AXIS_DESCR STD_AXIS V_FZG _CNV_R_R_Umr_1_zu_1_8_CM_S2 3 0 400 FORMAT "%2.0" /end AXIS_DESCR
/end CHARACTERISTIC
/begin CHARACTERISTIC XTAB3DL_KURVE_ANF_DCODR_ERK "" CURVE 0x274E50 _REC_S7CUR_53_u2_u2_S2 65535 _CNV_R_R_Umr_1_zu_1_123_CM_S2 0 65535 FORMAT "%2.0"
 /begin AXIS_DESCR STD_AXIS V_FZG _CNV_R_R_Umr_1_zu_1_8_CM_S2 3 0 400 FORMAT "%2.0" /end AXIS_DESCR
/end CHARACTERISTIC
/begin CHARACTERISTIC XTAB3SCHA_L_BLINKEN_COS "" CURVE 0x274E12 _REC_S7CUR_53_s2_u2_S2 6553.5 _CNV_R_R_Umr_10_zu__46_CM_S2 -3276.8 3276.7 FORMAT "%3.1"
 /begin AXIS_DESCR STD_AXIS DL_KRZG_ANF_DCODR _CNV_R_R_Umr_1_zu_1_123_CM_S2 3 0 65535 FORMAT "%2.0" /end AXIS_DESCR
/end CHARACTERISTIC
/begin CHARACTERISTIC XTAB3T_AAF_DOWNGRADE_COS "" CURVE 0x275886 _REC_S7CUR_53_s2_s2_S2 32767 _CNV_R_R_Umr_1_zu_1_6_CM_S2 0 32767 FORMAT "%2.0"
 /begin AXIS_DESCR STD_AXIS DV_SEGLIM_FZG_COS _CNV_R_R_Umr_1_zu_1_8_CM_S2 3 -250 250 FORMAT "%2.0" /end AXIS_DESCR
/end CHARACTERISTIC
/begin CHARACTERISTIC XTAB3T_DLPLS_COS "" CURVE 0x2758BE _REC_S7CUR_53_u2_u2_S2 65535 _CNV_R_R_Umr_1_zu_1_6_CM_S2 0 65535 FORMAT "%2.0"
 /begin AXIS_DESCR STD_AXIS V_FZG _CNV_R_R_Umr_1_zu_1_8_CM_S2 3 0 65535 FORMAT "%2.0" /end AXIS_DESCR
/end CHARACTERISTIC
/begin CHARACTERISTIC XTAB3T_KREIS_DOWNGRADE_COS "" CURVE 0x275894 _REC_S7CUR_53_s2_s2_S2 32767 _CNV_R_R_Umr_1_zu_1_6_CM_S2 0 32767 FORMAT "%2.0"
 /begin AXIS_DESCR STD_AXIS DV_SEGLIM_FZG_COS _CNV_R_R_Umr_1_zu_1_8_CM_S2 3 -250 250 FORMAT "%2.0" /end AXIS_DESCR
/end CHARACTERISTIC
/begin CHARACTERISTIC XTAB3T_KRZG_DOWNGRADE_COS "" CURVE 0x2758A2 _REC_S7CUR_53_s2_s2_S2 32767 _CNV_R_R_Umr_1_zu_1_6_CM_S2 0 32767 FORMAT "%2.0"
 /begin AXIS_DESCR STD_AXIS DV_SEGLIM_FZG_COS _CNV_R_R_Umr_1_zu_1_8_CM_S2 3 -250 250 FORMAT "%2.0" /end AXIS_DESCR
/end CHARACTERISTIC
/begin CHARACTERISTIC XTAB3T_KURVE_DOWNGRADE_COS "" CURVE 0x2758B0 _REC_S7CUR_53_s2_s2_S2 32767 _CNV_R_R_Umr_1_zu_1_6_CM_S2 0 32767 FORMAT "%2.0"
 /begin AXIS_DESCR STD_AXIS DV_SEGLIM_FZG_COS _CNV_R_R_Umr_1_zu_1_8_CM_S2 3 -250 250 FORMAT "%2.0" /end AXIS_DESCR
/end CHARACTERISTIC
/begin CHARACTERISTIC XTAB4X2R_KURVE_MIN_DCODR_ERK "" MAP 0x274E5E _REC_S3MAP_54_u2_u2_u1_S2 65535 _CNV_R_R_Umr_1_zu_1_123_CM_S2 0 65535 FORMAT "%2.0"
 /begin AXIS_DESCR STD_AXIS V_FZG _CNV_R_R_Umr_1_zu_1_8_CM_S2 4 0 400 FORMAT "%2.0" /end AXIS_DESCR
 /begin AXIS_DESCR FIX_AXIS Z_AGS_MODBEDEL _CNV_S_2_Enum_EAGS_25_CM_S2 2 0 1 FIX_AXIS_PAR_DIST 0 1 2 READ_ONLY /end AXIS_DESCR
/end CHARACTERISTIC
/begin CHARACTERISTIC XTAB4X4PRIO_ERK_COS "" MAP 0x270E80 _REC_A1MAP_8_u1_u1_u1_S2 1 _CNV_R_R_Umr_1_zu_1_2_CM_S2 0 1 FORMAT "%2.0"
 /begin AXIS_DESCR FIX_AXIS NO_INPUT_QUANTITY _CNV_S_4_Enum_EPRIO_188_CM_S2 4 0 3 /begin FIX_AXIS_PAR_LIST 0 1 2 3 /end FIX_AXIS_PAR_LIST READ_ONLY /end AXIS_DESCR
 /begin AXIS_DESCR FIX_AXIS NO_INPUT_QUANTITY _CNV_S_4_Enum_EPRIO_188_CM_S2 4 0 3 /begin FIX_AXIS_PAR_LIST 0 1 2 3 /end FIX_AXIS_PAR_LIST READ_ONLY /end AXIS_DESCR
/end CHARACTERISTIC
/begin CHARACTERISTIC XTAB5V_PRD_KRZG_COS "" CURVE 0x27584A _REC_S7CUR_53_u2_u2_S2 255 _CNV_R_R_Umr_10_zu__190_CM_S2 0 255 FORMAT "%3.1"
 /begin AXIS_DESCR STD_AXIS W_KRZGSEG_ADAS_COS _CNV_R_R_Umr_1_zu_1_138_CM_S2 5 0 180 FORMAT "%2.0" /end AXIS_DESCR
/end CHARACTERISTIC
/begin CHARACTERISTIC XTAB5X3DL_KRZG_BLINKEN_COS "" MAP 0x26F254 _REC_S7MAP_53_u2_u2_u2_S2 65535 _CNV_R_R_Umr_1_zu_1_123_CM_S2 0 65535 FORMAT "%2.0"
 /begin AXIS_DESCR STD_AXIS V_FZG_COG _CNV_R_R_Umr_64_zu__44_CM_S2 5 0 250 FORMAT "%4.2" /end AXIS_DESCR
 /begin AXIS_DESCR STD_AXIS W_KRZGSEG_ADAS_COS _CNV_R_R_Umr_1_zu_1_138_CM_S2 3 0 180 FORMAT "%2.0" /end AXIS_DESCR
/end CHARACTERISTIC
/begin CHARACTERISTIC XTAB9V_PRD_NAEHERUNG_COS "" CURVE 0x275860 _REC_S7CUR_53_u2_u2_S2 6553.5 _CNV_R_R_Umr_10_zu__191_CM_S2 0 6553.5 FORMAT "%3.1"
 /begin AXIS_DESCR STD_AXIS V_PRD_KREIS_COS_RADIKANT _CNV_R_R_Umr_100_zu_189_CM_S2 9 0 655.35 FORMAT "%4.2" /end AXIS_DESCR
/end CHARACTERISTIC
/begin CHARACTERISTIC XC_ERR_DLPLS_COS "" VALUE 0x27AF44 _REC_S1VAL_1_u1_S2 255 _CNV_R_R_Umr_1_zu_1_2_CM_S2 0 255 FORMAT "%2.0" /end CHARACTERISTIC
/begin CHARACTERISTIC XDL_ERR_AAF_SIMULATE "" VALUE 0x2758D8 _REC_S1VAL_1_u2_S2 65535 _CNV_R_R_Umr_1_zu_1_123_CM_S2 0 65535 FORMAT "%2.0" /end CHARACTERISTIC
/begin CHARACTERISTIC XDL_ERR_KREIS_SIMULATE "" VALUE 0x2758DA _REC_S1VAL_1_u2_S2 65535 _CNV_R_R_Umr_1_zu_1_123_CM_S2 0 65535 FORMAT "%2.0" /end CHARACTERISTIC
/begin CHARACTERISTIC XDL_ERR_KRZG_SIMULATE "" VALUE 0x2758DC _REC_S1VAL_1_u2_S2 65535 _CNV_R_R_Umr_1_zu_1_123_CM_S2 0 65535 FORMAT "%2.0" /end CHARACTERISTIC
/begin CHARACTERISTIC XDL_ERR_KURVE_MIN_RAD_SIMULATE "" VALUE 0x2710F0 _REC_S1VAL_1_u4_S2 4.29497E+009 _CNV_R_R_Umr_1_zu_1_123_CM_S2 0 4294967295 FORMAT "%2.0" /end CHARACTERISTIC
/begin CHARACTERISTIC XDL_ERR_KURVE_SIMULATE "" VALUE 0x2758DE _REC_S1VAL_1_u2_S2 65535 _CNV_R_R_Umr_1_zu_1_123_CM_S2 0 65535 FORMAT "%2.0" /end CHARACTERISTIC
/begin CHARACTERISTIC XDL_TOPO_DLALMAXMAPP_COS "" VALUE 0x27AF3B _REC_S1VAL_1_u1_S2 255 _CNV_R_R_Umr_1_zu_1_123_CM_S2 0 255 FORMAT "%2.0" /end CHARACTERISTIC
/begin CHARACTERISTIC XDW_TKRZG_DCODR "" VALUE 0x27AF45 _REC_S1VAL_1_u1_S2 255 _CNV_R_R_Umr_1_zu_1_138_CM_S2 0 255 FORMAT "%2.0" /end CHARACTERISTIC
/begin CHARACTERISTIC XMAX_ALTERNATE_DISTANCE_DCODR "" VALUE 0x2710F8 _REC_S1VAL_1_u4_S2 4.29497E+009 _CNV_R_R_Umr_1_zu_1_123_CM_S2 0 4294967295 FORMAT "%2.0" /end CHARACTERISTIC
/begin CHARACTERISTIC XMAX_ALTERNATE_UNIQUENESS_DCODR "" VALUE 0x27AF4E _REC_S1VAL_1_u1_S2 255 _CNV_R_R_Umr_1_zu_1_53_CM_S2 0 255 FORMAT "%2.0" /end CHARACTERISTIC
/begin CHARACTERISTIC XMAX_VIRT_SEGMENT_LENGTH_DCODR "" VALUE 0x27AF46 _REC_S1VAL_1_u1_S2 255 _CNV_R_R_Umr_1_zu_1_2_CM_S2 0 255 FORMAT "%2.0" /end CHARACTERISTIC
/begin CHARACTERISTIC XNAVI_COUNTRY_CODE_SIMULATE "" VALUE 0x2757BA _REC_S1VAL_1_u2_S2 65535 _CNV_R_R_Umr_1_zu_1_2_CM_S2 0 65535 FORMAT "%2.0" /end CHARACTERISTIC
/begin CHARACTERISTIC XR_MAX_KREIS_DCODR "" VALUE 0x27AC60 _REC_S1VAL_1_u1_S2 255 _CNV_R_R_Umr_1_zu_1_123_CM_S2 0 255 FORMAT "%2.0" /end CHARACTERISTIC
/begin CHARACTERISTIC XSCHDL_VIRT_KURVE_LEN_DCODR "" VALUE 0x2710F4 _REC_S1VAL_1_u4_S2 4.29497E+009 _CNV_R_R_Umr_1_zu_1_123_CM_S2 0 4294967295 FORMAT "%2.0" /end CHARACTERISTIC
/begin CHARACTERISTIC XSCHM_BR_FREEZE_VFZGDLPRD_COS "" VALUE 0x274E78 _REC_S1VAL_1_s2_S2 65535 _CNV_R_R_Umr_1_zu_1_42_CM_S2 -32768 32767 FORMAT "%2.0" /end CHARACTERISTIC
/begin CHARACTERISTIC XSCHSMPLMIN_SEGPROB_KRZG_COS "" VALUE 0x27AC69 _REC_S1VAL_1_u1_S2 255 _CNV_R_R_Umr_1_zu_1_53_CM_S2 0 255 FORMAT "%2.0" /end CHARACTERISTIC
/begin CHARACTERISTIC XSCHSMPL_GEFAELLE_MINERK_DCODR "" VALUE 0x2758E0 _REC_S1VAL_1_u2_S2 65535 _CNV_R_R_Umr_1_zu_1_53_CM_S2 0 65535 FORMAT "%2.0" /end CHARACTERISTIC
/begin CHARACTERISTIC XSCHSMPL_GEFAELLE_MINERW_DCODR "" VALUE 0x2758E2 _REC_S1VAL_1_u2_S2 65535 _CNV_R_R_Umr_1_zu_1_53_CM_S2 0 65535 FORMAT "%2.0" /end CHARACTERISTIC
/begin CHARACTERISTIC XSCHSMPL_SEGPROB100_KRZG_COS "" VALUE 0x27AC6A _REC_S1VAL_1_u1_S2 255 _CNV_R_R_Umr_1_zu_1_53_CM_S2 0 255 FORMAT "%2.0" /end CHARACTERISTIC
/begin CHARACTERISTIC XSCHSMPL_STEIGUNG_MINERK_DCODR "" VALUE 0x2758E4 _REC_S1VAL_1_u2_S2 65535 _CNV_R_R_Umr_1_zu_1_53_CM_S2 0 65535 FORMAT "%2.0" /end CHARACTERISTIC
/begin CHARACTERISTIC XSCHSMPL_STEIGUNG_MINERW_DCODR "" VALUE 0x2758E6 _REC_S1VAL_1_u2_S2 65535 _CNV_R_R_Umr_1_zu_1_53_CM_S2 0 65535 FORMAT "%2.0" /end CHARACTERISTIC
/begin CHARACTERISTIC XSCHW_MIN_CDA_SEG_DCODR "" VALUE 0x2758E8 _REC_S1VAL_1_u2_S2 65535 _CNV_R_R_Umr_1_zu_1_138_CM_S2 0 65535 FORMAT "%2.0" /end CHARACTERISTIC
/begin CHARACTERISTIC XSCHW_VIRT_KURVE_ERK_DCODR "" VALUE 0x2758EA _REC_S1VAL_1_u2_S2 65535 _CNV_R_R_Umr_1_zu_1_138_CM_S2 0 65535 FORMAT "%2.0" /end CHARACTERISTIC
/begin CHARACTERISTIC XSCH_MPP_BRS_COS "" VALUE 0x274E20 _REC_S1VAL_1_u2_S2 255 _CNV_R_R_Umr_1_zu_1_53_CM_S2 0 255 FORMAT "%2.0" /end CHARACTERISTIC
/begin CHARACTERISTIC XSCH_MPP_DERS_COS "" VALUE 0x274E22 _REC_S1VAL_1_u2_S2 255 _CNV_R_R_Umr_1_zu_1_53_CM_S2 0 255 FORMAT "%2.0" /end CHARACTERISTIC
/begin CHARACTERISTIC XSCH_MPP_HSURE_COS "" VALUE 0x274E24 _REC_S1VAL_1_u2_S2 255 _CNV_R_R_Umr_1_zu_1_53_CM_S2 0 255 FORMAT "%2.0" /end CHARACTERISTIC
/begin CHARACTERISTIC XSMPL_MINLR_TKRZG_COS "" VALUE 0x27AC6B _REC_S1VAL_1_u1_S2 255 _CNV_R_R_Umr_1_zu_1_53_CM_S2 0 255 FORMAT "%2.0" /end CHARACTERISTIC
/begin CHARACTERISTIC XST_MTCH_QUAL_ADAS "" VALUE 0x27AF3E _REC_S1VAL_1_u1_S2 100 _CNV_R_R_Umr_1_zu_1_53_CM_S2 0 100 FORMAT "%2.0" /end CHARACTERISTIC
/begin CHARACTERISTIC XST_MTCH_UNIQ_PO_ADAS "" VALUE 0x27AF3F _REC_S1VAL_1_u1_S2 100 _CNV_R_R_Umr_1_zu_1_53_CM_S2 0 100 FORMAT "%2.0" /end CHARACTERISTIC
/begin CHARACTERISTIC XST_VRS_HW1_NAVI_ADAS "" VALUE 0x27AF40 _REC_S1VAL_1_u1_S2 29 _CNV_R_R_Umr_1_zu_1_2_CM_S2 0 29 FORMAT "%2.0" /end CHARACTERISTIC
/begin CHARACTERISTIC XST_VRS_HW2_NAVI_ADAS "" VALUE 0x27AF41 _REC_S1VAL_1_u1_S2 29 _CNV_R_R_Umr_1_zu_1_2_CM_S2 0 29 FORMAT "%2.0" /end CHARACTERISTIC
/begin CHARACTERISTIC XST_VRS_MAP_NAVI_ADAS "" VALUE 0x27AF42 _REC_S1VAL_1_u1_S2 29 _CNV_R_R_Umr_1_zu_1_2_CM_S2 0 29 FORMAT "%2.0" /end CHARACTERISTIC
/begin CHARACTERISTIC XST_VRS_PRTL_NAVI_ADAS "" VALUE 0x27AF43 _REC_S1VAL_1_u1_S2 253 _CNV_R_R_Umr_1_zu_1_2_CM_S2 0 253 FORMAT "%2.0" /end CHARACTERISTIC
/begin CHARACTERISTIC XS_ADAS_ANFRESYNC_TEST "" VALUE 0x27AF05 _REC_S1VAL_1_u1_S2 1 _CNV_S_2_Schalter_A_4_CM_S2 0 1 /end CHARACTERISTIC
/begin CHARACTERISTIC XS_ADAS_COMPLIANT_BRS_COS "" VALUE 0x27AC61 _REC_S1VAL_1_u1_S2 1 _CNV_S_2_Schalter_A_4_CM_S2 0 1 /end CHARACTERISTIC
/begin CHARACTERISTIC XS_ADAS_COMPLIANT_DERS_COS "" VALUE 0x27AC62 _REC_S1VAL_1_u1_S2 1 _CNV_S_2_Schalter_A_4_CM_S2 0 1 /end CHARACTERISTIC
/begin CHARACTERISTIC XS_ADAS_COMPLIANT_HSURE_COS "" VALUE 0x27AC63 _REC_S1VAL_1_u1_S2 1 _CNV_S_2_Schalter_A_4_CM_S2 0 1 /end CHARACTERISTIC
/begin CHARACTERISTIC XS_ADAS_FEHLERBEHANDLUNG "" VALUE 0x27AF1F _REC_S1VAL_1_u1_S2 1 _CNV_R_R_Umr_1_zu_1_2_CM_S2 0 1 FORMAT "%2.0" /end CHARACTERISTIC
/begin CHARACTERISTIC XS_ADAS_IDX_V2 "" VALUE 0x27AF4F _REC_S1VAL_1_u1_S2 1 _CNV_R_R_Umr_1_zu_1_2_CM_S2 0 1 FORMAT "%2.0" /end CHARACTERISTIC
/begin CHARACTERISTIC XS_ADAS_RADIUS_V2 "" VALUE 0x27AF50 _REC_S1VAL_1_u1_S2 1 _CNV_R_R_Umr_1_zu_1_2_CM_S2 0 1 FORMAT "%2.0" /end CHARACTERISTIC
/begin CHARACTERISTIC XS_ADAS_RECERR_KOOPVERBOT_COS "" VALUE 0x27AF51 _REC_S1VAL_1_u1_S2 1 _CNV_S_2_Schalter_A_4_CM_S2 0 1 /end CHARACTERISTIC
/begin CHARACTERISTIC XS_ADAS_UMRECHNUNG "" VALUE 0x27AF20 _REC_S1VAL_1_u1_S2 1 _CNV_R_R_Umr_1_zu_1_2_CM_S2 0 1 FORMAT "%2.0" /end CHARACTERISTIC
/begin CHARACTERISTIC XS_BER_KURVEVR_DCODR "" VALUE 0x27AF47 _REC_S1VAL_1_u1_S2 1 _CNV_S_2_Schalter_A_4_CM_S2 0 1 /end CHARACTERISTIC
/begin CHARACTERISTIC XS_BLINKEN_AUTOBAHN_COS "" VALUE 0x27AC64 _REC_S1VAL_1_u1_S2 1 _CNV_R_R_Umr_1_zu_1_2_CM_S2 0 1 FORMAT "%2.0" /end CHARACTERISTIC
/begin CHARACTERISTIC XS_DL_ERR_AAF_SIMULATE "" VALUE 0x27AF48 _REC_S1VAL_1_u1_S2 1 _CNV_S_2_Schalter_A_4_CM_S2 0 1 /end CHARACTERISTIC
/begin CHARACTERISTIC XS_DL_ERR_KREIS_SIMULATE "" VALUE 0x27AF49 _REC_S1VAL_1_u1_S2 1 _CNV_S_2_Schalter_A_4_CM_S2 0 1 /end CHARACTERISTIC
/begin CHARACTERISTIC XS_DL_ERR_KRZG_SIMULATE "" VALUE 0x27AF4A _REC_S1VAL_1_u1_S2 1 _CNV_S_2_Schalter_A_4_CM_S2 0 1 /end CHARACTERISTIC
/begin CHARACTERISTIC XS_DL_ERR_KURVE_SIMULATE "" VALUE 0x27AF4B _REC_S1VAL_1_u1_S2 1 _CNV_S_2_Schalter_A_4_CM_S2 0 1 /end CHARACTERISTIC
/begin CHARACTERISTIC XS_FREEZE_VFZG_DLPRD_COS "" VALUE 0x27AC67 _REC_S1VAL_1_u1_S2 1 _CNV_S_2_Schalter_A_4_CM_S2 0 1 /end CHARACTERISTIC
/begin CHARACTERISTIC XS_SEGPROB100_KRZG_COS "" VALUE 0x27AC6C _REC_S1VAL_1_u1_S2 1 _CNV_R_R_Umr_1_zu_1_2_CM_S2 0 1 FORMAT "%2.0" /end CHARACTERISTIC
/begin CHARACTERISTIC XS_USE_ADAS "" VALUE 0x27AF21 _REC_S1VAL_1_u1_S2 1 _CNV_S_2_Schalter_A_4_CM_S2 0 1 /end CHARACTERISTIC
/begin CHARACTERISTIC XS_USE_KURVEVR_DCODR "" VALUE 0x27AF4C _REC_S1VAL_1_u1_S2 1 _CNV_S_2_Schalter_A_4_CM_S2 0 1 /end CHARACTERISTIC
/begin CHARACTERISTIC XS_USE_PRIO_COS "" VALUE 0x27AF3D _REC_S1VAL_1_u1_S2 1 _CNV_S_2_Schalter_A_4_CM_S2 0 1 /end CHARACTERISTIC
/begin CHARACTERISTIC XS_USE_TKRZG_COS "" VALUE 0x27AC65 _REC_S1VAL_1_u1_S2 1 _CNV_S_2_Schalter_A_4_CM_S2 0 1 /end CHARACTERISTIC
/begin CHARACTERISTIC XV_FZG_DLALMAXMAPP_COS "" VALUE 0x27AF3C _REC_S1VAL_1_u1_S2 255 _CNV_R_R_Umr_1_zu_1_8_CM_S2 0 255 FORMAT "%2.0" /end CHARACTERISTIC
/begin CHARACTERISTIC XV_FZG_DLPLS_COS "" VALUE 0x2758CC _REC_S1VAL_1_u2_S2 400 _CNV_R_R_Umr_1_zu_1_8_CM_S2 0 400 FORMAT "%2.0" /end CHARACTERISTIC
/begin CHARACTERISTIC XW_MINLR_TKRZG_COS "" VALUE 0x27AC66 _REC_S1VAL_1_u1_S2 255 _CNV_R_R_Umr_1_zu_1_138_CM_S2 0 255 FORMAT "%2.0" /end CHARACTERISTIC
/begin CHARACTERISTIC XW_TKRZG_COS "" VALUE 0x27AC68 _REC_S1VAL_1_u1_S2 255 _CNV_R_R_Umr_1_zu_1_138_CM_S2 0 255 FORMAT "%2.0" /end CHARACTERISTIC
/begin CHARACTERISTIC XW_TKRZG_ERK_MAX_DCODR "" VALUE 0x27AF4D _REC_S1VAL_1_u1_S2 255 _CNV_R_R_Umr_1_zu_1_2_CM_S2 0 255 FORMAT "%2.0" /end CHARACTERISTIC
/begin CHARACTERISTIC XZ_NAVI_COUNTRY_CODE_SOURCE "" VALUE 0x27AF1E _REC_S1VAL_1_u1_S2 1 _CNV_S_2_Enum_ENAVI_197_CM_S2 0 1 /end CHARACTERISTIC
/begin CHARACTERISTIC XTAB5X7Z_GANGANZEIGE "" MAP 0x27AC6D _REC_A1MAP_9_u1_u1_u1_S2 5 _CNV_S_6_Enum_EANZE_208_CM_S2 0 5
 /begin AXIS_DESCR FIX_AXIS Z_DRIVE_PROG_FFG _CNV_S_5_Enum_ZDRIV_27_CM_S2 5 0 4 /begin FIX_AXIS_PAR_LIST 0 1 2 3 4 /end FIX_AXIS_PAR_LIST READ_ONLY /end AXIS_DESCR
 /begin AXIS_DESCR FIX_AXIS Z_DRIVEDYN_IDX _CNV_S_7_Enum_EDRIV_207_CM_S2 7 0 6 FIX_AXIS_PAR_DIST 0 1 7 READ_ONLY /end AXIS_DESCR
/end CHARACTERISTIC
/begin CHARACTERISTIC XTAB5X7Z_GANGANZEIGE_SSG "" MAP 0x27AC90 _REC_A1MAP_9_u1_u1_u1_S2 5 _CNV_S_6_Enum_EANZE_208_CM_S2 0 5
 /begin AXIS_DESCR FIX_AXIS Z_DRIVE_PROG_FFG _CNV_S_5_Enum_ZDRIV_27_CM_S2 5 0 4 /begin FIX_AXIS_PAR_LIST 0 1 2 3 4 /end FIX_AXIS_PAR_LIST READ_ONLY /end AXIS_DESCR
 /begin AXIS_DESCR FIX_AXIS Z_DRIVEDYN_IDX _CNV_S_7_Enum_EDRIV_207_CM_S2 7 0 6 FIX_AXIS_PAR_DIST 0 1 7 READ_ONLY /end AXIS_DESCR
/end CHARACTERISTIC
/begin CHARACTERISTIC XTAB6SCH_N_RATIO_ANZEIGE "" CURVE 0x26F284 _REC_A1CUR_30_s2_u1_S2 20 _CNV_R_R_Umr_100_zu_54_CM_S2 -10 10 FORMAT "%4.2"
 /begin AXIS_DESCR FIX_AXIS Z_SCHALTUNGSTYP _CNV_S_6_Enum_ESCHA_152_CM_S2 6 0 5 FIX_AXIS_PAR_DIST 0 1 6 READ_ONLY /end AXIS_DESCR
/end CHARACTERISTIC
/begin CHARACTERISTIC XTAB6X2Z_GANGANZEIGE "" MAP 0x26F290 _REC_A1MAP_9_u1_u1_u1_S2 5 _CNV_S_6_Enum_EANZE_208_CM_S2 0 5
 /begin AXIS_DESCR FIX_AXIS Z_ANZGANGART _CNV_S_6_Enum_EANZG_205_CM_S2 6 0 5 FIX_AXIS_PAR_DIST 0 1 6 READ_ONLY /end AXIS_DESCR
 /begin AXIS_DESCR FIX_AXIS S_COD_GETRTYP _CNV_S_2_Enum_ECOD__23_CM_S2 2 0 1 FIX_AXIS_PAR_DIST 0 1 2 READ_ONLY /end AXIS_DESCR
/end CHARACTERISTIC
/begin CHARACTERISTIC XTAB6Z_MODUSANZEIGE "" CURVE 0x274E7A _REC_A1CUR_30_u1_u1_S2 3 _CNV_S_4_Enum_EKOMB_93_CM_S2 0 3
 /begin AXIS_DESCR FIX_AXIS Z_ANZGANGART _CNV_S_6_Enum_EANZG_205_CM_S2 6 0 5 FIX_AXIS_PAR_DIST 0 1 6 READ_ONLY /end AXIS_DESCR
/end CHARACTERISTIC
/begin CHARACTERISTIC XTAB7Z_DRIVEDYN_MODE "" CURVE 0x27ACB3 _REC_A1CUR_30_u1_u1_S2 3 _CNV_S_4_Enum_EPROG_35_CM_S2 0 3
 /begin AXIS_DESCR FIX_AXIS Z_DRIVEDYN_IDX _CNV_S_7_Enum_EDRIV_207_CM_S2 7 0 6 /begin FIX_AXIS_PAR_LIST 0 1 2 3 4 5 6 /end FIX_AXIS_PAR_LIST READ_ONLY /end AXIS_DESCR
/end CHARACTERISTIC
/begin CHARACTERISTIC XTAB9Z_GANGWHL_AZG "" CURVE 0x27ACBB _REC_A1CUR_30_u1_u1_S2 255 _CNV_R_R_Umr_1_zu_1_2_CM_S2 0 255 FORMAT "%2.0"
 /begin AXIS_DESCR FIX_AXIS Z_GANG_IST _CNV_S_9_Enum_EGANG_30_CM_S2 9 0 8 FIX_AXIS_PAR_DIST 0 1 9 READ_ONLY /end AXIS_DESCR
/end CHARACTERISTIC
/begin CHARACTERISTIC XF_NMOT_ANZEIGE_BAND "" VALUE 0x274E80 _REC_S1VAL_1_u2_S2 1 _CNV_R_R_Umr_1000_z_57_CM_S2 0 1 FORMAT "%5.3" /end CHARACTERISTIC
/begin CHARACTERISTIC XS_ANZGANGART "" VALUE 0x27ACC4 _REC_S1VAL_1_u1_S2 1 _CNV_R_R_Umr_1_zu_1_2_CM_S2 0 1 FORMAT "%2.0" /end CHARACTERISTIC
/begin CHARACTERISTIC XS_GANGANZEIGE_DRIVEPROG_FES "" VALUE 0x27ACBA _REC_S1VAL_1_u1_S2 1 _CNV_R_R_Umr_1_zu_1_2_CM_S2 0 1 FORMAT "%2.0" /end CHARACTERISTIC
/begin CHARACTERISTIC XS_USE_N_DYNDZM_ANZEIGE "" VALUE 0x27ACC5 _REC_S1VAL_1_u1_S2 1 _CNV_S_2_Schalter_A_4_CM_S2 0 1 /end CHARACTERISTIC
/begin CHARACTERISTIC XS_USE_Z_GANG_IST_ANZEIGE_FREEZE "" VALUE 0x27ACC6 _REC_S1VAL_1_u1_S2 1 _CNV_S_2_Schalter_A_4_CM_S2 0 1 /end CHARACTERISTIC
/begin CHARACTERISTIC XS_USE_Z_GANG_ZIEL_ANZEIGE_FREEZ "" VALUE 0x27ACC7 _REC_S1VAL_1_u1_S2 1 _CNV_S_2_Schalter_A_4_CM_S2 0 1 /end CHARACTERISTIC
/begin CHARACTERISTIC XT_KEINGANG_ANZ_NACHL "" VALUE 0x274E82 _REC_S1VAL_1_u2_S2 65535 _CNV_R_R_Umr_1_zu_1_6_CM_S2 0 65535 FORMAT "%2.0" /end CHARACTERISTIC
/begin CHARACTERISTIC XTAB3HN_MOT_MDSSCHUB_RSHS "" CURVE 0x276B26 _REC_A1CUR_30_u2_u1_S2 1000 _CNV_R_R_Umr_1_zu_1_3_CM_S2 0 1000 FORMAT "%2.0"
 /begin AXIS_DESCR FIX_AXIS Z_WK_ZIEL _CNV_S_3_Enum_EWK_153_CM_S2 3 0 2 FIX_AXIS_PAR_DIST 0 1 3 READ_ONLY /end AXIS_DESCR
/end CHARACTERISTIC
/begin CHARACTERISTIC XTAB3X2Z_DSC_ABREGLER_SCHLUPF "" MAP 0x276B36 _REC_A1MAP_9_u1_u1_u1_S2 2 _CNV_R_R_Umr_1_zu_1_2_CM_S2 0 2 FORMAT "%2.0"
 /begin AXIS_DESCR FIX_AXIS Z_DSC _CNV_S_3_Enum_EDSCS_28_CM_S2 3 0 2 FIX_AXIS_PAR_DIST 0 1 3 READ_ONLY /end AXIS_DESCR
 /begin AXIS_DESCR FIX_AXIS NO_INPUT_QUANTITY _CNV_S_2_Enum_EXCFK_209_CM_S2 2 0 1 /begin FIX_AXIS_PAR_LIST 0 1 /end FIX_AXIS_PAR_LIST READ_ONLY /end AXIS_DESCR
/end CHARACTERISTIC
/begin CHARACTERISTIC XTAB4C_ABREGLER_DECRVAL "" CURVE 0x276B3C _REC_S7CUR_53_u2_u2_S2 65535 _CNV_R_R_Umr_1_zu_1_2_CM_S2 0 65535 FORMAT "%2.0"
 /begin AXIS_DESCR STD_AXIS N_MOT_HSVIRT _CNV_R_R_Umr_1_zu_1_3_CM_S2 4 0 10000 FORMAT "%2.0" /end AXIS_DESCR
/end CHARACTERISTIC
/begin CHARACTERISTIC XTAB5X9F_NMOTBEGR "" MAP 0x276B78 _REC_S3MAP_54_u2_s2_u1_S2 2 _CNV_R_R_Umr_100_zu_210_CM_S2 0 2 FORMAT "%4.2"
 /begin AXIS_DESCR STD_AXIS G2W_AB_FILT _CNV_R_R_Umr_10_zu__181_CM_S2 5 -3276.8 3276.7 FORMAT "%3.1" /end AXIS_DESCR
 /begin AXIS_DESCR FIX_AXIS Z_GANG_ZIEL _CNV_S_9_Enum_EGANG_30_CM_S2 9 0 8 FIX_AXIS_PAR_DIST 0 1 9 READ_ONLY /end AXIS_DESCR
/end CHARACTERISTIC
/begin CHARACTERISTIC XTAB9ON_AB_ABREGLER_SCHLUPF "" CURVE 0x276B4E _REC_A1CUR_30_u2_u1_S2 32000 _CNV_R_R_Umr_1_zu_1_2_CM_S2 0 32000 FORMAT "%2.0"
 /begin AXIS_DESCR FIX_AXIS Z_GANG_ZIEL _CNV_S_9_Enum_EGANG_30_CM_S2 9 0 8 FIX_AXIS_PAR_DIST 0 1 9 READ_ONLY /end AXIS_DESCR
/end CHARACTERISTIC
/begin CHARACTERISTIC XTAB9SCHN_MOT_MIN_ABREGEL_ZHS "" CURVE 0x276B60 _REC_A1CUR_30_u2_u1_S2 7000 _CNV_R_R_Umr_1_zu_1_3_CM_S2 0 7000 FORMAT "%2.0"
 /begin AXIS_DESCR FIX_AXIS Z_GANG_IST _CNV_S_9_Enum_EGANG_30_CM_S2 9 0 8 FIX_AXIS_PAR_DIST 0 1 9 READ_ONLY /end AXIS_DESCR
/end CHARACTERISTIC
/begin CHARACTERISTIC XTAB9_RELATION_N_VAHA_DOWN "" CURVE 0x27B5CF _REC_A1CUR_30_u1_u1_S2 2 _CNV_R_R_Umr_100_zu_54_CM_S2 0 2 FORMAT "%4.2"
 /begin AXIS_DESCR FIX_AXIS Z_GANG_ZIEL _CNV_S_9_Enum_EGANG_30_CM_S2 9 0 8 FIX_AXIS_PAR_DIST 0 1 9 READ_ONLY /end AXIS_DESCR
/end CHARACTERISTIC
/begin CHARACTERISTIC XTAB9_RELATION_N_VAHA_UP "" CURVE 0x27B5D8 _REC_A1CUR_30_u1_u1_S2 2 _CNV_R_R_Umr_100_zu_54_CM_S2 0 2 FORMAT "%4.2"
 /begin AXIS_DESCR FIX_AXIS Z_GANG_ZIEL _CNV_S_9_Enum_EGANG_30_CM_S2 9 0 8 FIX_AXIS_PAR_DIST 0 1 9 READ_ONLY /end AXIS_DESCR
/end CHARACTERISTIC
/begin CHARACTERISTIC XC_ABREGLERINIT "" VALUE 0x276B72 _REC_S1VAL_1_u2_S2 65535 _CNV_R_R_Umr_1_zu_1_2_CM_S2 0 65535 FORMAT "%2.0" /end CHARACTERISTIC
/begin CHARACTERISTIC XFAKT_SCHLUPF_MDS "" VALUE 0x27B5E4 _REC_S1VAL_1_u1_S2 1 _CNV_R_R_Umr_1_zu_1_2_CM_S2 0 1 FORMAT "%2.0" /end CHARACTERISTIC
/begin CHARACTERISTIC XF_NMOTABREGEL_DUENE_MDS "" VALUE 0x27B5E5 _REC_S1VAL_1_u1_S2 15 _CNV_R_R_Umr_1_zu_1_53_CM_S2 100 115 FORMAT "%2.0" /end CHARACTERISTIC
/begin CHARACTERISTIC XF_NMOTABREGEL_ZHSVERBOT_MDS "" VALUE 0x27B5E6 _REC_S1VAL_1_u1_S2 15 _CNV_R_R_Umr_1_zu_1_53_CM_S2 100 115 FORMAT "%2.0" /end CHARACTERISTIC
/begin CHARACTERISTIC XHN_AB_ABREGLER_SCHLUPF "" VALUE 0x276B74 _REC_S1VAL_1_u2_S2 1000 _CNV_R_R_Umr_1_zu_1_2_CM_S2 0 1000 FORMAT "%2.0" /end CHARACTERISTIC
/begin CHARACTERISTIC XON_SCHLUPF_MDS "" VALUE 0x276BDE _REC_S1VAL_1_u2_S2 3000 _CNV_R_R_Umr_1_zu_1_3_CM_S2 0 3000 FORMAT "%2.0" /end CHARACTERISTIC
/begin CHARACTERISTIC XSCHN_MOT_MDSMAXHS "" VALUE 0x276BE0 _REC_S1VAL_1_u2_S2 20000 _CNV_R_R_Umr_1_zu_1_3_CM_S2 0 20000 FORMAT "%2.0" /end CHARACTERISTIC
/begin CHARACTERISTIC XSCHN_MOT_MDSSCHUB_AUS "" VALUE 0x276B2C _REC_S1VAL_1_u2_S2 10000 _CNV_R_R_Umr_1_zu_1_3_CM_S2 0 10000 FORMAT "%2.0" /end CHARACTERISTIC
/begin CHARACTERISTIC XSCHN_MOT_MDSSCHUB_EIN "" VALUE 0x276B2E _REC_S1VAL_1_u2_S2 10000 _CNV_R_R_Umr_1_zu_1_3_CM_S2 0 10000 FORMAT "%2.0" /end CHARACTERISTIC
/begin CHARACTERISTIC XSCHN_T_MDSMAXRS "" VALUE 0x276BE2 _REC_S1VAL_1_u2_S2 20000 _CNV_R_R_Umr_1_zu_1_3_CM_S2 0 20000 FORMAT "%2.0" /end CHARACTERISTIC
/begin CHARACTERISTIC XSCHW_DKKD_MDSSCHUB "" VALUE 0x276B30 _REC_S1VAL_1_u2_S2 110 _CNV_R_R_Umr_10_zu__9_CM_S2 0 110 FORMAT "%3.1" /end CHARACTERISTIC
/begin CHARACTERISTIC XS_ABREGLER_ABBRUCH_HS "" VALUE 0x27B5E1 _REC_S1VAL_1_u1_S2 1 _CNV_S_2_Schalter_A_4_CM_S2 0 1 /end CHARACTERISTIC
/begin CHARACTERISTIC XS_ERR_DSC_ABREGLER_SCHLUPF "" VALUE 0x27B5E2 _REC_S1VAL_1_u1_S2 1 _CNV_R_R_Umr_1_zu_1_2_CM_S2 0 1 FORMAT "%2.0" /end CHARACTERISTIC
/begin CHARACTERISTIC XS_USE_ABREGLER_SCHLUPF "" VALUE 0x27B5E3 _REC_S1VAL_1_u1_S2 1 _CNV_S_2_Schalter_A_4_CM_S2 0 1 /end CHARACTERISTIC
/begin CHARACTERISTIC XS_USE_MDSRSDYN "" VALUE 0x27B5E7 _REC_S1VAL_1_u1_S2 1 _CNV_S_2_Schalter_A_4_CM_S2 0 1 /end CHARACTERISTIC
/begin CHARACTERISTIC XT_ABREGLER_DECPERIOD "" VALUE 0x276B76 _REC_S1VAL_1_u2_S2 65535 _CNV_R_R_Umr_1_zu_1_6_CM_S2 0 65535 FORMAT "%2.0" /end CHARACTERISTIC
/begin CHARACTERISTIC XT_MDSSCHUB "" VALUE 0x276B32 _REC_S1VAL_1_u2_S2 1000 _CNV_R_R_Umr_1_zu_1_146_CM_S2 0 1000 FORMAT "%2.0" /end CHARACTERISTIC
/begin CHARACTERISTIC XT_MDSSCHUB_REGEN "" VALUE 0x276B34 _REC_S1VAL_1_u2_S2 1000 _CNV_R_R_Umr_1_zu_1_146_CM_S2 0 1000 FORMAT "%2.0" /end CHARACTERISTIC
/begin CHARACTERISTIC XTAB15S_DYNAMIK_GLBENBL "" CURVE 0x27ACC8 _REC_A1CUR_30_u1_u2_S2 1 _CNV_R_R_Umr_1_zu_1_2_CM_S2 0 1 FORMAT "%2.0"
 /begin AXIS_DESCR FIX_AXIS NO_INPUT_QUANTITY _CNV_S_15_Enum_EDYNA_215_CM_S2 15 0 14 FIX_AXIS_PAR_DIST 0 1 15 READ_ONLY /end AXIS_DESCR
/end CHARACTERISTIC
/begin CHARACTERISTIC XTAB25X15Z_DYNAMIK_FIND "" MAP 0x27ACD7 _REC_A1MAP_8_u1_u2_u1_S2 1 _CNV_R_R_Umr_1_zu_1_2_CM_S2 0 1 FORMAT "%2.0"
 /begin AXIS_DESCR FIX_AXIS NO_INPUT_QUANTITY _CNV_S_15_Enum_EDYNA_215_CM_S2 15 0 14 FIX_AXIS_PAR_DIST 0 1 15 READ_ONLY /end AXIS_DESCR
 /begin AXIS_DESCR FIX_AXIS Z_DYNAMIK_YIDX _CNV_R_R_Umr_1_zu_1_2_CM_S2 25 0 24 FIX_AXIS_PAR_DIST 0 1 25 READ_ONLY /end AXIS_DESCR
/end CHARACTERISTIC
/begin CHARACTERISTIC XTAB25Z_DYNAMIK_IDXGRBDYN "" CURVE 0x27AE4E _REC_A1CUR_30_u1_u1_S2 15 _CNV_S_16_Enum_EIDXG_225_CM_S2 0 15
 /begin AXIS_DESCR FIX_AXIS Z_DYNAMIK_YIDX _CNV_R_R_Umr_1_zu_1_2_CM_S2 25 0 24 FIX_AXIS_PAR_DIST 0 1 25 READ_ONLY /end AXIS_DESCR
/end CHARACTERISTIC
/begin CHARACTERISTIC XTAB27X43Z_SDYN_FIND "" MAP 0x27B04B _REC_A1MAP_8_u1_u1_u1_S2 6 _CNV_R_R_Umr_1_zu_1_2_CM_S2 0 6 FORMAT "%2.0"
 /begin AXIS_DESCR FIX_AXIS Z_QSHIFT_XIDX _CNV_S_43_Enum_EQSHI_219_CM_S2 43 0 42 FIX_AXIS_PAR_DIST 0 1 43 READ_ONLY /end AXIS_DESCR
 /begin AXIS_DESCR FIX_AXIS Z_QSHIFT_YIDX _CNV_R_R_Umr_1_zu_1_2_CM_S2 27 0 26 FIX_AXIS_PAR_DIST 0 1 27 FORMAT "%2.0" READ_ONLY /end AXIS_DESCR
/end CHARACTERISTIC
/begin CHARACTERISTIC XTAB2SCHTEMP_SDYNTEMP_GETR "" CURVE 0x271368 _REC_A1CUR_30_s2_u1_S2 240 _CNV_R_R_Umr_1_zu_1_1_CM_S2 -40 200 FORMAT "%2.0"
 /begin AXIS_DESCR FIX_AXIS NO_INPUT_QUANTITY _CNV_S_2_Enum_ESCHT_212_CM_S2 2 0 1 /begin FIX_AXIS_PAR_LIST 0 1 /end FIX_AXIS_PAR_LIST READ_ONLY /end AXIS_DESCR
/end CHARACTERISTIC
/begin CHARACTERISTIC XTAB2SCHTEMP_SDYNTEMP_KUP_A "" CURVE 0x271370 _REC_A1CUR_30_u2_u1_S2 250 _CNV_R_R_Umr_1_zu_1_1_CM_S2 100 350 FORMAT "%2.0"
 /begin AXIS_DESCR FIX_AXIS NO_INPUT_QUANTITY _CNV_S_2_Enum_ESCHT_212_CM_S2 2 0 1 /begin FIX_AXIS_PAR_LIST 0 1 /end FIX_AXIS_PAR_LIST READ_ONLY /end AXIS_DESCR
/end CHARACTERISTIC
/begin CHARACTERISTIC XTAB2SCHW_DKKD_SDYNGWFP "" CURVE 0x27136C _REC_A1CUR_30_u2_u2_S2 110 _CNV_R_R_Umr_10_zu__9_CM_S2 0 110 FORMAT "%3.1"
 /begin AXIS_DESCR FIX_AXIS NO_INPUT_QUANTITY _CNV_S_5_Enum_EGWDK_216_CM_S2 2 0 4 FIX_AXIS_PAR_DIST 0 1 2 READ_ONLY /end AXIS_DESCR
/end CHARACTERISTIC
/begin CHARACTERISTIC XTAB2X2SCHA_Q_KURVE_SDYN "" MAP 0x271374 _REC_A1MAP_9_u2_u1_u1_S2 50 _CNV_R_R_Umr_10_zu__46_CM_S2 0 50 FORMAT "%3.1"
 /begin AXIS_DESCR FIX_AXIS NO_INPUT_QUANTITY _CNV_S_2_Enum_ESCHT_212_CM_S2 2 0 1 /begin FIX_AXIS_PAR_LIST 0 1 /end FIX_AXIS_PAR_LIST READ_ONLY /end AXIS_DESCR
 /begin AXIS_DESCR FIX_AXIS S_ALLRAD _CNV_R_R_Umr_1_zu_1_2_CM_S2 2 0 255 /begin FIX_AXIS_PAR_LIST 0 1 /end FIX_AXIS_PAR_LIST FORMAT "%2.0" READ_ONLY /end AXIS_DESCR
/end CHARACTERISTIC
/begin CHARACTERISTIC XTAB2X2SCHGW_FP_SDYNGWFP "" MAP 0x27137C _REC_A1MAP_9_s2_u2_u2_S2 65535 _CNV_R_R_Umr_1_zu_1_7_CM_S2 -32768 32767 FORMAT "%2.0"
 /begin AXIS_DESCR FIX_AXIS NO_INPUT_QUANTITY _CNV_S_5_Enum_EGWDK_216_CM_S2 2 0 4 FIX_AXIS_PAR_DIST 0 1 2 READ_ONLY /end AXIS_DESCR
 /begin AXIS_DESCR FIX_AXIS NO_INPUT_QUANTITY _CNV_S_2_Enum_ESCHG_222_CM_S2 2 0 1 FIX_AXIS_PAR_DIST 0 1 2 READ_ONLY /end AXIS_DESCR
/end CHARACTERISTIC
/begin CHARACTERISTIC XTAB3X3SCHW_DKKD_SDYNWDKKD "" MAP 0x27614C _REC_A1MAP_9_u2_u2_u2_S2 110 _CNV_R_R_Umr_10_zu__9_CM_S2 0 110 FORMAT "%3.1"
 /begin AXIS_DESCR FIX_AXIS NO_INPUT_QUANTITY _CNV_S_3_Enum_EWDKK_218_CM_S2 3 0 2 FIX_AXIS_PAR_DIST 0 1 3 READ_ONLY /end AXIS_DESCR
 /begin AXIS_DESCR FIX_AXIS NO_INPUT_QUANTITY _CNV_S_3_Enum_ESCHW_220_CM_S2 3 0 2 FIX_AXIS_PAR_DIST 0 1 3 READ_ONLY /end AXIS_DESCR
/end CHARACTERISTIC
/begin CHARACTERISTIC XTAB3X9SCHN_MOT_QS_DOWNGRADE "" MAP 0x274E92 _REC_A1MAP_9_u2_u1_u2_S2 8160 _CNV_R_R_Umr_1_zu_1_3_CM_S2 0 8160 FORMAT "%2.0"
 /begin AXIS_DESCR FIX_AXIS Z_GANG_IST _CNV_S_9_Enum_EGANG_30_CM_S2 9 0 8 FIX_AXIS_PAR_DIST 0 1 9 READ_ONLY /end AXIS_DESCR
 /begin AXIS_DESCR FIX_AXIS NO_INPUT_QUANTITY _CNV_S_3_Enum_EQS_D_221_CM_S2 3 0 2 FIX_AXIS_PAR_DIST 0 1 3 READ_ONLY /end AXIS_DESCR
/end CHARACTERISTIC
/begin CHARACTERISTIC XTAB4T_QSHIFTMFRS_ACTIVE "" CURVE 0x27615E _REC_S7CUR_53_u2_s2_S2 65535 _CNV_R_R_Umr_1_zu_1_6_CM_S2 0 65535 FORMAT "%2.0"
 /begin AXIS_DESCR STD_AXIS TEMP_GETR _CNV_R_R_Umr_1_zu_1_1_CM_S2 4 -200 200 FORMAT "%2.0" /end AXIS_DESCR
/end CHARACTERISTIC
/begin CHARACTERISTIC XTAB6X2SCHTEMP_GETR_QSMAX "" MAP 0x271384 _REC_A1MAP_9_s2_u2_u2_S2 400 _CNV_R_R_Umr_1_zu_1_1_CM_S2 -200 200 FORMAT "%2.0"
 /begin AXIS_DESCR FIX_AXIS NO_INPUT_QUANTITY _CNV_S_6_Enum_EQS_T_213_CM_S2 6 0 5 FIX_AXIS_PAR_DIST 0 1 6 READ_ONLY /end AXIS_DESCR
 /begin AXIS_DESCR FIX_AXIS NO_INPUT_QUANTITY _CNV_S_2_Enum_HSRS_214_CM_S2 2 0 1 /begin FIX_AXIS_PAR_LIST 0 1 /end FIX_AXIS_PAR_LIST READ_ONLY /end AXIS_DESCR
/end CHARACTERISTIC
/begin CHARACTERISTIC XTAB6X4Z_KF_FP_0 "" MAP 0x26F29C _REC_A1MAP_9_u1_u1_u1_S2 2 _CNV_R_R_Umr_1_zu_1_2_CM_S2 0 2 FORMAT "%2.0"
 /begin AXIS_DESCR FIX_AXIS Z_DRIVELOGIC _CNV_S_6_Enum_EDL_11_CM_S2 6 1 6 FIX_AXIS_PAR_DIST 1 1 6 READ_ONLY /end AXIS_DESCR
 /begin AXIS_DESCR FIX_AXIS Z_PROG_MODE _CNV_S_4_Enum_EPROG_35_CM_S2 4 0 3 FIX_AXIS_PAR_DIST 0 1 4 READ_ONLY /end AXIS_DESCR
/end CHARACTERISTIC
/begin AXIS_PTS SSTSKL_HS_SA4 "" 0x272DB0 W_DKKD _REC_A2AXS_31_u2_S2 120 _CNV_R_R_Umr_10_zu__9_CM_S2 13 0 120 FORMAT "%3.1" /end AXIS_PTS
/begin AXIS_PTS SSTSKL_HS_SO1 "" 0x272DCC W_DKKD _REC_A2AXS_31_u2_S2 120 _CNV_R_R_Umr_10_zu__9_CM_S2 13 0 120 FORMAT "%3.1" /end AXIS_PTS
/begin AXIS_PTS SSTSKL_HS_SO2 "" 0x272DE8 W_DKKD _REC_A2AXS_31_u2_S2 120 _CNV_R_R_Umr_10_zu__9_CM_S2 13 0 120 FORMAT "%3.1" /end AXIS_PTS
/begin AXIS_PTS SSTSKL_HS_WL1 "" 0x272E04 W_DKKD _REC_A2AXS_31_u2_S2 120 _CNV_R_R_Umr_10_zu__9_CM_S2 13 0 120 FORMAT "%3.1" /end AXIS_PTS
/begin AXIS_PTS SSTSKL_HS_WL2 "" 0x272E20 W_DKKD _REC_A2AXS_31_u2_S2 120 _CNV_R_R_Umr_10_zu__9_CM_S2 13 0 120 FORMAT "%3.1" /end AXIS_PTS
/begin AXIS_PTS SSTSKL_HS_XE "" 0x272E3C W_DKKD _REC_A2AXS_31_u2_S2 120 _CNV_R_R_Umr_10_zu__9_CM_S2 13 0 120 FORMAT "%3.1" /end AXIS_PTS
/begin AXIS_PTS SSTSKL_HS_XS "" 0x272E58 W_DKKD _REC_A2AXS_31_u2_S2 120 _CNV_R_R_Umr_10_zu__9_CM_S2 13 0 120 FORMAT "%3.1" /end AXIS_PTS
/begin AXIS_PTS SSTSKL_RS_SA4 "" 0x27306C W_DKKD _REC_A2AXS_31_u2_S2 120 _CNV_R_R_Umr_10_zu__9_CM_S2 17 0 120 FORMAT "%3.1" /end AXIS_PTS
/begin AXIS_PTS SSTSKL_RS_SO1 "" 0x273090 W_DKKD _REC_A2AXS_31_u2_S2 120 _CNV_R_R_Umr_10_zu__9_CM_S2 17 0 120 FORMAT "%3.1" /end AXIS_PTS
/begin AXIS_PTS SSTSKL_RS_SO2 "" 0x2730B4 W_DKKD _REC_A2AXS_31_u2_S2 120 _CNV_R_R_Umr_10_zu__9_CM_S2 17 0 120 FORMAT "%3.1" /end AXIS_PTS
/begin AXIS_PTS SSTSKL_RS_WL1 "" 0x2730D8 W_DKKD _REC_A2AXS_31_u2_S2 120 _CNV_R_R_Umr_10_zu__9_CM_S2 17 0 120 FORMAT "%3.1" /end AXIS_PTS
/begin AXIS_PTS SSTSKL_RS_WL2 "" 0x2730FC W_DKKD _REC_A2AXS_31_u2_S2 120 _CNV_R_R_Umr_10_zu__9_CM_S2 17 0 120 FORMAT "%3.1" /end AXIS_PTS
/begin AXIS_PTS SSTSKL_RS_XE "" 0x273120 W_DKKD _REC_A2AXS_31_u2_S2 120 _CNV_R_R_Umr_10_zu__9_CM_S2 17 0 120 FORMAT "%3.1" /end AXIS_PTS
/begin AXIS_PTS SSTSKL_RS_XS "" 0x273144 W_DKKD _REC_A2AXS_31_u2_S2 120 _CNV_R_R_Umr_10_zu__9_CM_S2 17 0 120 FORMAT "%3.1" /end AXIS_PTS
/begin COMPU_METHOD _CNV_R_R_Umr_1_zu_1_0_CM_S2 "" RAT_FUNC "%6.3" "hPa" COEFFS 0 1 0 0 0 1 /end COMPU_METHOD
/begin COMPU_METHOD _CNV_R_R_Umr_1_zu_1_1_CM_S2 "" RAT_FUNC "%6.3" "°C" COEFFS 0 1 0 0 0 1 /end COMPU_METHOD
/begin COMPU_METHOD _CNV_R_R_Umr_1_zu_1_2_CM_S2 "" RAT_FUNC "%6.3" "" COEFFS 0 1 0 0 0 1 /end COMPU_METHOD
/begin COMPU_METHOD _CNV_R_R_Umr_1_zu_1_3_CM_S2 "" RAT_FUNC "%6.3" "U/min" COEFFS 0 1 0 0 0 1 /end COMPU_METHOD
/begin COMPU_METHOD _CNV_S_2_Schalter_A_4_CM_S2 "Schalter: 0 = AUS, 1 = EIN" TAB_VERB "%6.3" "" COMPU_TAB_REF _CNV_S_2_Schalter_A_4_S2 /end COMPU_METHOD
/begin COMPU_METHOD _CNV_R_R_Umr_1_zu_1_6_CM_S2 "" RAT_FUNC "%6.3" "ms" COEFFS 0 1 0 0 0 1 /end COMPU_METHOD
/begin COMPU_METHOD _CNV_R_R_Umr_1_zu_1_7_CM_S2 "" RAT_FUNC "%6.3" "%/s" COEFFS 0 1 0 0 0 1 /end COMPU_METHOD
/begin COMPU_METHOD _CNV_R_R_Umr_1_zu_1_8_CM_S2 "" RAT_FUNC "%6.3" "km/h" COEFFS 0 1 0 0 0 1 /end COMPU_METHOD
/begin COMPU_METHOD _CNV_R_R_Umr_10_zu__9_CM_S2 "" RAT_FUNC "%6.3" "%" COEFFS 0 10 0 0 0 1 /end COMPU_METHOD
/begin COMPU_METHOD _CNV_R_R_Umr_10_zu__10_CM_S2 "" RAT_FUNC "%6.3" "°" COEFFS 0 10 0 0 0 1 /end COMPU_METHOD
/begin COMPU_METHOD _CNV_S_6_Enum_EDL_11_CM_S2 "" TAB_VERB "%6.3" "" COMPU_TAB_REF _CNV_S_6_Enum_EDL_11_S2 /end COMPU_METHOD
/begin COMPU_METHOD _CNV_S_4_Enum_EADAS_13_CM_S2 "" TAB_VERB "%6.3" "" COMPU_TAB_REF _CNV_S_4_Enum_EADAS_13_S2 /end COMPU_METHOD
/begin COMPU_METHOD _CNV_S_2_Enum_EGEW__16_CM_S2 "" TAB_VERB "%6.3" "" COMPU_TAB_REF _CNV_S_2_Enum_EGEW__16_S2 /end COMPU_METHOD
/begin COMPU_METHOD _CNV_S_15_Enum_EHSUR_17_CM_S2 "" TAB_VERB "%6.3" "" COMPU_TAB_REF _CNV_S_15_Enum_EHSUR_17_S2 /end COMPU_METHOD
/begin COMPU_METHOD _CNV_S_2_Enum_EPT1__21_CM_S2 "" TAB_VERB "%6.3" "" COMPU_TAB_REF _CNV_S_2_Enum_EPT1__21_S2 /end COMPU_METHOD
/begin COMPU_METHOD _CNV_S_2_Enum_ECOD__23_CM_S2 "" TAB_VERB "%6.3" "" COMPU_TAB_REF _CNV_S_2_Enum_ECOD__23_S2 /end COMPU_METHOD
/begin COMPU_METHOD _CNV_S_4_Enum_EAGS__24_CM_S2 "" TAB_VERB "%6.3" "" COMPU_TAB_REF _CNV_S_4_Enum_EAGS__24_S2 /end COMPU_METHOD
/begin COMPU_METHOD _CNV_S_2_Enum_EAGS_25_CM_S2 "" TAB_VERB "%6.3" "" COMPU_TAB_REF _CNV_S_2_Enum_EAGS_25_S2 /end COMPU_METHOD
/begin COMPU_METHOD _CNV_S_5_Enum_ZDRIV_27_CM_S2 "" TAB_VERB "%6.3" "" COMPU_TAB_REF _CNV_S_5_Enum_ZDRIV_27_S2 /end COMPU_METHOD
/begin COMPU_METHOD _CNV_S_3_Enum_EDSCS_28_CM_S2 "" TAB_VERB "%6.3" "" COMPU_TAB_REF _CNV_S_3_Enum_EDSCS_28_S2 /end COMPU_METHOD
/begin COMPU_METHOD _CNV_S_9_Enum_EGANG_30_CM_S2 "" TAB_VERB "%6.3" "" COMPU_TAB_REF _CNV_S_9_Enum_EGANG_30_S2 /end COMPU_METHOD
/begin COMPU_METHOD _CNV_S_8_Enum_EPOS_33_CM_S2 "" TAB_VERB "%6.3" "" COMPU_TAB_REF _CNV_S_8_Enum_EPOS_33_S2 /end COMPU_METHOD
/begin COMPU_METHOD _CNV_S_4_Enum_EPROG_35_CM_S2 "" TAB_VERB "%6.3" "" COMPU_TAB_REF _CNV_S_4_Enum_EPROG_35_S2 /end COMPU_METHOD
/begin COMPU_METHOD _CNV_S_2_Enum_EWL2_38_CM_S2 "" TAB_VERB "%6.3" "" COMPU_TAB_REF _CNV_S_2_Enum_EWL2_38_S2 /end COMPU_METHOD
/begin COMPU_METHOD _CNV_S_21_Enum_EPROG_40_CM_S2 "" TAB_VERB "%6.3" "" COMPU_TAB_REF _CNV_S_21_Enum_EPROG_40_S2 /end COMPU_METHOD
/begin COMPU_METHOD _CNV_S_3_Enum_ESCHL_41_CM_S2 "" TAB_VERB "%6.3" "" COMPU_TAB_REF _CNV_S_3_Enum_ESCHL_41_S2 /end COMPU_METHOD
/begin COMPU_METHOD _CNV_R_R_Umr_1_zu_1_42_CM_S2 "" RAT_FUNC "%6.3" "Nm" COEFFS 0 1 0 0 0 1 /end COMPU_METHOD
/begin COMPU_METHOD _CNV_R_R_Umr_64_zu__44_CM_S2 "" RAT_FUNC "%6.3" "km/h" COEFFS 0 64 0 0 0 1 /end COMPU_METHOD
/begin COMPU_METHOD _CNV_R_R_Umr_10_zu__45_CM_S2 "" RAT_FUNC "%6.3" "" COEFFS 0 10 0 0 0 1 /end COMPU_METHOD
/begin COMPU_METHOD _CNV_R_R_Umr_10_zu__46_CM_S2 "" RAT_FUNC "%6.3" "m/s*s" COEFFS 0 10 0 0 0 1 /end COMPU_METHOD
/begin COMPU_METHOD _CNV_R_R_Umr_1_zu_1_53_CM_S2 "" RAT_FUNC "%6.3" "%" COEFFS 0 1 0 0 0 1 /end COMPU_METHOD
/begin COMPU_METHOD _CNV_R_R_Umr_100_zu_54_CM_S2 "" RAT_FUNC "%6.3" "" COEFFS 0 100 0 0 0 1 /end COMPU_METHOD
/begin COMPU_METHOD _CNV_R_R_Umr_1000_z_57_CM_S2 "" RAT_FUNC "%6.3" "" COEFFS 0 1000 0 0 0 1 /end COMPU_METHOD
/begin COMPU_METHOD _CNV_S_6_Enum_EBERG_61_CM_S2 "" TAB_VERB "%6.3" "" COMPU_TAB_REF _CNV_S_6_Enum_EBERG_61_S2 /end COMPU_METHOD
/begin COMPU_METHOD _CNV_R_R_Umr_1_zu_1_77_CM_S2 "" RAT_FUNC "%6.3" "Nm/s" COEFFS 0 1 0 0 0 10 /end COMPU_METHOD
/begin COMPU_METHOD _CNV_S_3_Enum_ESIGN_84_CM_S2 "" TAB_VERB "%6.3" "" COMPU_TAB_REF _CNV_S_3_Enum_ESIGN_84_S2 /end COMPU_METHOD
/begin COMPU_METHOD _CNV_S_4_Enum_EKOMB_93_CM_S2 "" TAB_VERB "%6.3" "" COMPU_TAB_REF _CNV_S_4_Enum_EKOMB_93_S2 /end COMPU_METHOD
/begin COMPU_METHOD _CNV_S_6_Enum_ENABH_108_CM_S2 "" TAB_VERB "%6.3" "" COMPU_TAB_REF _CNV_S_6_Enum_ENABH_108_S2 /end COMPU_METHOD
/begin COMPU_METHOD _CNV_S_2_Enum_ENOTL_110_CM_S2 "" TAB_VERB "%6.3" "" COMPU_TAB_REF _CNV_S_2_Enum_ENOTL_110_S2 /end COMPU_METHOD
/begin COMPU_METHOD _CNV_R_R_Umr_1_zu_5_112_CM_S2 "" RAT_FUNC "%6.3" "U/min" COEFFS 0 1 0 0 0 5 /end COMPU_METHOD
/begin COMPU_METHOD _CNV_S_3_Enum_ESKLK_113_CM_S2 "" TAB_VERB "%6.3" "" COMPU_TAB_REF _CNV_S_3_Enum_ESKLK_113_S2 /end COMPU_METHOD
/begin COMPU_METHOD _CNV_S_2_Enum_EHDC__114_CM_S2 "" TAB_VERB "%6.3" "" COMPU_TAB_REF _CNV_S_2_Enum_EHDC__114_S2 /end COMPU_METHOD
/begin COMPU_METHOD _CNV_S_3_Enum_EHSUR_115_CM_S2 "" TAB_VERB "%6.3" "" COMPU_TAB_REF _CNV_S_3_Enum_EHSUR_115_S2 /end COMPU_METHOD
/begin COMPU_METHOD _CNV_S_3_Enum_ELDMA_116_CM_S2 "" TAB_VERB "%6.3" "" COMPU_TAB_REF _CNV_S_3_Enum_ELDMA_116_S2 /end COMPU_METHOD
/begin COMPU_METHOD _CNV_S_2_Enum_EUSEH_117_CM_S2 "" TAB_VERB "%6.3" "" COMPU_TAB_REF _CNV_S_2_Enum_EUSEH_117_S2 /end COMPU_METHOD
/begin COMPU_METHOD _CNV_S_3_Enum_EREQA_118_CM_S2 "" TAB_VERB "%6.3" "" COMPU_TAB_REF _CNV_S_3_Enum_EREQA_118_S2 /end COMPU_METHOD
/begin COMPU_METHOD _CNV_S_8_Enum_EHSUB_119_CM_S2 "" TAB_VERB "%6.3" "" COMPU_TAB_REF _CNV_S_8_Enum_EHSUB_119_S2 /end COMPU_METHOD
/begin COMPU_METHOD _CNV_S_3_Enum_ENABH_120_CM_S2 "" TAB_VERB "%6.3" "" COMPU_TAB_REF _CNV_S_3_Enum_ENABH_120_S2 /end COMPU_METHOD
/begin COMPU_METHOD _CNV_S_4_Enum_EHSUR_121_CM_S2 "" TAB_VERB "%6.3" "" COMPU_TAB_REF _CNV_S_4_Enum_EHSUR_121_S2 /end COMPU_METHOD
/begin COMPU_METHOD _CNV_S_5_Enum_EPROG_122_CM_S2 "" TAB_VERB "%6.3" "" COMPU_TAB_REF _CNV_S_5_Enum_EPROG_122_S2 /end COMPU_METHOD
/begin COMPU_METHOD _CNV_R_R_Umr_1_zu_1_123_CM_S2 "" RAT_FUNC "%6.3" "m" COEFFS 0 1 0 0 0 1 /end COMPU_METHOD
/begin COMPU_METHOD _CNV_S_2_Enum_EDV_R_124_CM_S2 "" TAB_VERB "%6.3" "" COMPU_TAB_REF _CNV_S_2_Enum_EDV_R_124_S2 /end COMPU_METHOD
/begin COMPU_METHOD _CNV_S_5_Enum_EHSU__125_CM_S2 "" TAB_VERB "%6.3" "" COMPU_TAB_REF _CNV_S_5_Enum_EHSU__125_S2 /end COMPU_METHOD
/begin COMPU_METHOD _CNV_R_R_Umr_1_zu_1_126_CM_S2 "" RAT_FUNC "%6.3" "" COEFFS 0 1 0 0 0 10 /end COMPU_METHOD
/begin COMPU_METHOD _CNV_R_R_Umr_10_zu__127_CM_S2 "" RAT_FUNC "%6.3" "s" COEFFS 0 10 0 0 0 1 /end COMPU_METHOD
/begin COMPU_METHOD _CNV_S_5_Enum_EGWFP_128_CM_S2 "" TAB_VERB "%6.3" "" COMPU_TAB_REF _CNV_S_5_Enum_EGWFP_128_S2 /end COMPU_METHOD
/begin COMPU_METHOD _CNV_S_3_Enum_EHSUA_129_CM_S2 "" TAB_VERB "%6.3" "" COMPU_TAB_REF _CNV_S_3_Enum_EHSUA_129_S2 /end COMPU_METHOD
/begin COMPU_METHOD _CNV_R_R_Umr_1_zu_1_138_CM_S2 "" RAT_FUNC "%6.3" "°" COEFFS 0 1 0 0 0 1 /end COMPU_METHOD
/begin COMPU_METHOD _CNV_S_6_Enum_EEFAH_140_CM_S2 "" TAB_VERB "%6.3" "" COMPU_TAB_REF _CNV_S_6_Enum_EEFAH_140_S2 /end COMPU_METHOD
/begin COMPU_METHOD _CNV_S_9_Enum_EHASS_141_CM_S2 "" TAB_VERB "%6.3" "" COMPU_TAB_REF _CNV_S_9_Enum_EHASS_141_S2 /end COMPU_METHOD
/begin COMPU_METHOD _CNV_S_4_Enum_ESOCM_142_CM_S2 "Status SOC MODE" TAB_VERB "%6.3" "" COMPU_TAB_REF _CNV_S_4_Enum_ESOCM_142_S2 /end COMPU_METHOD
/begin COMPU_METHOD _CNV_S_4_Enum_EEFAH_143_CM_S2 "" TAB_VERB "%6.3" "" COMPU_TAB_REF _CNV_S_4_Enum_EEFAH_143_S2 /end COMPU_METHOD
/begin COMPU_METHOD _CNV_S_2_Enum_ESTOP_145_CM_S2 "" TAB_VERB "%6.3" "" COMPU_TAB_REF _CNV_S_2_Enum_ESTOP_145_S2 /end COMPU_METHOD
/begin COMPU_METHOD _CNV_R_R_Umr_1_zu_1_146_CM_S2 "" RAT_FUNC "%6.3" "s" COEFFS 0 1 0 0 0 1 /end COMPU_METHOD
/begin COMPU_METHOD _CNV_S_2_Enum_EHEIS_147_CM_S2 "" TAB_VERB "%6.3" "" COMPU_TAB_REF _CNV_S_2_Enum_EHEIS_147_S2 /end COMPU_METHOD
/begin COMPU_METHOD _CNV_S_7_Enum_ESDYN_151_CM_S2 "" TAB_VERB "%6.3" "" COMPU_TAB_REF _CNV_S_7_Enum_ESDYN_151_S2 /end COMPU_METHOD
/begin COMPU_METHOD _CNV_S_6_Enum_ESCHA_152_CM_S2 "" TAB_VERB "%6.3" "" COMPU_TAB_REF _CNV_S_6_Enum_ESCHA_152_S2 /end COMPU_METHOD
/begin COMPU_METHOD _CNV_S_3_Enum_EWK_153_CM_S2 "" TAB_VERB "%6.3" "" COMPU_TAB_REF _CNV_S_3_Enum_EWK_153_S2 /end COMPU_METHOD
/begin COMPU_METHOD _CNV_S_3_Enum_EENTP_157_CM_S2 "" TAB_VERB "%6.3" "" COMPU_TAB_REF _CNV_S_3_Enum_EENTP_157_S2 /end COMPU_METHOD
/begin COMPU_METHOD _CNV_S_2_Enum_EERSM_158_CM_S2 "" TAB_VERB "%6.3" "" COMPU_TAB_REF _CNV_S_2_Enum_EERSM_158_S2 /end COMPU_METHOD
/begin COMPU_METHOD _CNV_S_2_Enum_EFOLG_159_CM_S2 "" TAB_VERB "%6.3" "" COMPU_TAB_REF _CNV_S_2_Enum_EFOLG_159_S2 /end COMPU_METHOD
/begin COMPU_METHOD _CNV_S_2_Enum_ESIMU_160_CM_S2 "" TAB_VERB "%6.3" "" COMPU_TAB_REF _CNV_S_2_Enum_ESIMU_160_S2 /end COMPU_METHOD
/begin COMPU_METHOD _CNV_S_3_Enum_ESCHU_161_CM_S2 "" TAB_VERB "%6.3" "" COMPU_TAB_REF _CNV_S_3_Enum_ESCHU_161_S2 /end COMPU_METHOD
/begin COMPU_METHOD _CNV_S_6_Enum_EIDX__162_CM_S2 "" TAB_VERB "%6.3" "" COMPU_TAB_REF _CNV_S_6_Enum_EIDX__162_S2 /end COMPU_METHOD
/begin COMPU_METHOD _CNV_R_R_Umr_1_zu_1_177_CM_S2 "" RAT_FUNC "%6.3" "U/(min*ms)" COEFFS 0 1 0 0 0 1 /end COMPU_METHOD
/begin COMPU_METHOD _CNV_S_2_Enum_EVERL_179_CM_S2 "" TAB_VERB "%6.3" "" COMPU_TAB_REF _CNV_S_2_Enum_EVERL_179_S2 /end COMPU_METHOD
/begin COMPU_METHOD _CNV_S_3_Enum_EHOTD_180_CM_S2 "" TAB_VERB "%6.3" "" COMPU_TAB_REF _CNV_S_3_Enum_EHOTD_180_S2 /end COMPU_METHOD
/begin COMPU_METHOD _CNV_R_R_Umr_10_zu__181_CM_S2 "" RAT_FUNC "%6.3" "1/s²" COEFFS 0 10 0 0 0 1 /end COMPU_METHOD
/begin COMPU_METHOD _CNV_S_3_Enum_EDSC__182_CM_S2 "" TAB_VERB "%6.3" "" COMPU_TAB_REF _CNV_S_3_Enum_EDSC__182_S2 /end COMPU_METHOD
/begin COMPU_METHOD _CNV_R_R_Umr_1_zu_1_183_CM_S2 "" RAT_FUNC "%6.3" "m/s" COEFFS 0 1 0 0 0 1 /end COMPU_METHOD
/begin COMPU_METHOD _CNV_P_2_A_I_184_CM_S2 "" TAB_INTP "%6.3" "U/min" COMPU_TAB_REF _CNV_P_2_A_I_184_S2 /end COMPU_METHOD
/begin COMPU_METHOD _CNV_S_4_Enum_TIDAU_185_CM_S2 "" TAB_VERB "%6.3" "" COMPU_TAB_REF _CNV_S_4_Enum_TIDAU_185_S2 /end COMPU_METHOD
/begin COMPU_METHOD _CNV_S_4_Enum_EPRIO_188_CM_S2 "" TAB_VERB "%6.3" "" COMPU_TAB_REF _CNV_S_4_Enum_EPRIO_188_S2 /end COMPU_METHOD
/begin COMPU_METHOD _CNV_R_R_Umr_100_zu_189_CM_S2 "" RAT_FUNC "%6.3" "m*m/s*s" COEFFS 0 100 0 0 0 1 /end COMPU_METHOD
/begin COMPU_METHOD _CNV_R_R_Umr_10_zu__190_CM_S2 "" RAT_FUNC "%6.3" "km/h" COEFFS 0 10 0 0 0 1 /end COMPU_METHOD
/begin COMPU_METHOD _CNV_R_R_Umr_10_zu__191_CM_S2 "" RAT_FUNC "%6.3" "m/s" COEFFS 0 10 0 0 0 1 /end COMPU_METHOD
/begin COMPU_METHOD _CNV_S_2_Enum_ENAVI_197_CM_S2 "" TAB_VERB "%6.3" "" COMPU_TAB_REF _CNV_S_2_Enum_ENAVI_197_S2 /end COMPU_METHOD
/begin COMPU_METHOD _CNV_S_6_Enum_EANZG_205_CM_S2 "" TAB_VERB "%6.3" "" COMPU_TAB_REF _CNV_S_6_Enum_EANZG_205_S2 /end COMPU_METHOD
/begin COMPU_METHOD _CNV_S_7_Enum_EDRIV_207_CM_S2 "" TAB_VERB "%6.3" "" COMPU_TAB_REF _CNV_S_7_Enum_EDRIV_207_S2 /end COMPU_METHOD
/begin COMPU_METHOD _CNV_S_6_Enum_EANZE_208_CM_S2 "" TAB_VERB "%6.3" "" COMPU_TAB_REF _CNV_S_6_Enum_EANZE_208_S2 /end COMPU_METHOD
/begin COMPU_METHOD _CNV_S_2_Enum_EXCFK_209_CM_S2 "" TAB_VERB "%6.3" "" COMPU_TAB_REF _CNV_S_2_Enum_EXCFK_209_S2 /end COMPU_METHOD
/begin COMPU_METHOD _CNV_R_R_Umr_100_zu_210_CM_S2 "" RAT_FUNC "%6.3" "U/min" COEFFS 0 100 0 0 0 1 /end COMPU_METHOD
/begin COMPU_METHOD _CNV_S_2_Enum_ESCHT_212_CM_S2 "" TAB_VERB "%6.3" "" COMPU_TAB_REF _CNV_S_2_Enum_ESCHT_212_S2 /end COMPU_METHOD
/begin COMPU_METHOD _CNV_S_6_Enum_EQS_T_213_CM_S2 "" TAB_VERB "%6.3" "" COMPU_TAB_REF _CNV_S_6_Enum_EQS_T_213_S2 /end COMPU_METHOD
/begin COMPU_METHOD _CNV_S_2_Enum_HSRS_214_CM_S2 "" TAB_VERB "%6.3" "" COMPU_TAB_REF _CNV_S_2_Enum_HSRS_214_S2 /end COMPU_METHOD
/begin COMPU_METHOD _CNV_S_15_Enum_EDYNA_215_CM_S2 "" TAB_VERB "%6.3" "" COMPU_TAB_REF _CNV_S_15_Enum_EDYNA_215_S2 /end COMPU_METHOD
/begin COMPU_METHOD _CNV_S_5_Enum_EGWDK_216_CM_S2 "" TAB_VERB "%6.3" "" COMPU_TAB_REF _CNV_S_5_Enum_EGWDK_216_S2 /end COMPU_METHOD
/begin COMPU_METHOD _CNV_S_3_Enum_EWDKK_218_CM_S2 "" TAB_VERB "%6.3" "" COMPU_TAB_REF _CNV_S_3_Enum_EWDKK_218_S2 /end COMPU_METHOD
/begin COMPU_METHOD _CNV_S_43_Enum_EQSHI_219_CM_S2 "" TAB_VERB "%6.3" "" COMPU_TAB_REF _CNV_S_43_Enum_EQSHI_219_S2 /end COMPU_METHOD
/begin COMPU_METHOD _CNV_S_3_Enum_ESCHW_220_CM_S2 "" TAB_VERB "%6.3" "" COMPU_TAB_REF _CNV_S_3_Enum_ESCHW_220_S2 /end COMPU_METHOD
/begin COMPU_METHOD _CNV_S_3_Enum_EQS_D_221_CM_S2 "" TAB_VERB "%6.3" "" COMPU_TAB_REF _CNV_S_3_Enum_EQS_D_221_S2 /end COMPU_METHOD
/begin COMPU_METHOD _CNV_S_2_Enum_ESCHG_222_CM_S2 "" TAB_VERB "%6.3" "" COMPU_TAB_REF _CNV_S_2_Enum_ESCHG_222_S2 /end COMPU_METHOD
/begin COMPU_METHOD _CNV_S_16_Enum_EIDXG_225_CM_S2 "" TAB_VERB "%6.3" "" COMPU_TAB_REF _CNV_S_16_Enum_EIDXG_225_S2 /end COMPU_METHOD
/begin COMPU_METHOD SAB_T_1H_S2_S3 "int = ((phys * 1) / 1) - (0) h" RAT_FUNC "%2.0" "h" COEFFS 0 1 -0 0 0 1 /end COMPU_METHOD
/begin COMPU_METHOD SAB_T_1S_S2_S3 "int = ((phys * 1) / 1) - (0) sec" RAT_FUNC "%2.0" "sec" COEFFS 0 1 -0 0 0 1 /end COMPU_METHOD
/begin COMPU_METHOD SAB_5T_S_S2_S3 "int = ((phys * 1) / 5) - (0) s" RAT_FUNC "%2.0" "s" COEFFS 0 1 -0 0 0 5 /end COMPU_METHOD
/begin COMPU_METHOD SAB_R_OHM1000_S2_S3 "int = ((phys * 1000) / 1) - (0) Ohm" RAT_FUNC "%5.3" "Ohm" COEFFS 0 1000 -0 0 0 1 /end COMPU_METHOD
/begin COMPU_METHOD SAB_L_MHENRY10_S2_S3 "int = ((phys * 10) / 1) - (0) Henry" RAT_FUNC "%5.3" "Henry" COEFFS 0 10 -0 0 0 1 /end COMPU_METHOD
/begin COMPU_METHOD SAB_U_20MILLIVOLT_S2_S3 "int = ((phys * 1) / 20) - (0) Volt" RAT_FUNC "%3.1" "Volt" COEFFS 0 1 -0 0 0 20 /end COMPU_METHOD
/begin COMPU_METHOD SAB_U_1VOLT400_S2_S3 "int = ((phys * 400) / 1) - (0) Volt" RAT_FUNC "%5.3" "Volt" COEFFS 0 400 -0 0 0 1 /end COMPU_METHOD
/begin COMPU_METHOD SAB_U_1VOLT8000_S2_S3 "int = ((phys * 8000) / 1) - (0) V" RAT_FUNC "%7.5" "V" COEFFS 0 8000 -0 0 0 1 /end COMPU_METHOD
/begin COMPU_METHOD SAB_U_VOLT1000000_S2_S3 "int = ((phys * 1.0E6) / 1) - (0) V" RAT_FUNC "%8.6" "V" COEFFS 0 1000000 -0 0 0 1 /end COMPU_METHOD
/begin COMPU_METHOD SAB_U_8VOLT100_S2_S3 "int = ((phys * 100) / 8) - (0) V" RAT_FUNC "%5.3" "V" COEFFS 0 100 -0 0 0 8 /end COMPU_METHOD
/begin COMPU_METHOD SAB_U_5VOLT100_S2_S3 "int = ((phys * 100) / 5) - (0) V" RAT_FUNC "%5.3" "V" COEFFS 0 100 -0 0 0 5 /end COMPU_METHOD
/begin COMPU_METHOD SAB_U_812VOLT10000_S2_S3 "int = ((phys * 10000) / 812) - (0) V" RAT_FUNC "%7.5" "V" COEFFS 0 10000 -0 0 0 812 /end COMPU_METHOD
/begin COMPU_METHOD SAB_U_VOLT40_S2_S3 "int = ((phys * 40) / 1) - (0) Volt" RAT_FUNC "%5.3" "Volt" COEFFS 0 40 -0 0 0 1 /end COMPU_METHOD
/begin COMPU_METHOD SAB_U_VOLT4_S2_S3 "int = ((phys * 4) / 1) - (0) Volt" RAT_FUNC "%5.3" "Volt" COEFFS 0 4 -0 0 0 1 /end COMPU_METHOD
/begin COMPU_METHOD SAB_U_VOLT50_S2_S3 "int = ((phys * 50) / 1) - (0) Volt" RAT_FUNC "%5.3" "Volt" COEFFS 0 50 -0 0 0 1 /end COMPU_METHOD
/begin COMPU_METHOD SAB_VOLT20_M5_S2_S3 "int = ((phys * 20) / 1) - (100) Volt" RAT_FUNC "%5.3" "Volt" COEFFS 0 20 -100 0 0 1 /end COMPU_METHOD
/begin COMPU_METHOD SAB_M_37NM100_M12124_S2_S3 "int = ((phys * 100) / 37) - (-32768) Nm" RAT_FUNC "%5.3" "Nm" COEFFS 0 100 1212416 0 0 37 /end COMPU_METHOD
/begin COMPU_METHOD SAB_M_592NM100_M12124_S2_S3 "int = ((phys * 100) / 592) - (-2048) Nm" RAT_FUNC "%5.3" "Nm" COEFFS 0 100 1212416 0 0 592 /end COMPU_METHOD
/begin COMPU_METHOD SAB_M_NM2_M2046_S2_S3 "int = ((phys * 2) / 1) - (-2046) Nm" RAT_FUNC "%5.3" "Nm" COEFFS 0 2 2046 0 0 1 /end COMPU_METHOD
/begin COMPU_METHOD SAB_M_5NM10_M1023_S2_S3 "int = ((phys * 2) / 1) - (-2046) Nm" RAT_FUNC "%5.3" "Nm" COEFFS 0 2 2046 0 0 1 /end COMPU_METHOD
/begin COMPU_METHOD SAB_M_NM2_10235M10_S2_S3 "int = ((phys * 2) / 1) - (-2047) Nm" RAT_FUNC "%5.3" "Nm" COEFFS 0 2 2047 0 0 1 /end COMPU_METHOD
/begin COMPU_METHOD SAB_M_NM4_M511_S2_S3 "int = ((phys * 4) / 1) - (-2044) Nm" RAT_FUNC "%5.3" "Nm" COEFFS 0 4 2044 0 0 1 /end COMPU_METHOD
/begin COMPU_METHOD SAB_M_NM2_M_S2_S3 "int = ((phys * 2) / 1) - (0) Nm" RAT_FUNC "%5.3" "Nm" COEFFS 0 2 -0 0 0 1 /end COMPU_METHOD
/begin COMPU_METHOD SAB_M_NM_M1021_S2_S3 "int = ((phys * 1) / 1) - (-1021) Nm" RAT_FUNC "%2.0" "Nm" COEFFS 0 1 1021 0 0 1 /end COMPU_METHOD
/begin COMPU_METHOD SAB_M_NM_M1023_S2_S3 "int = ((phys * 1) / 1) - (-1023) Nm" RAT_FUNC "%2.0" "Nm" COEFFS 0 1 1023 0 0 1 /end COMPU_METHOD
/begin COMPU_METHOD SAB_M_NM2_M800_S2_S3 "int = ((phys * 2) / 1) - (-800) Nm" RAT_FUNC "%5.3" "Nm" COEFFS 0 2 800 0 0 1 /end COMPU_METHOD
/begin COMPU_METHOD SAB_0125PROZENT_S2_S3 "int = ((phys * 1000) / 125) - (0) %" RAT_FUNC "%5.3" "%" COEFFS 0 1000 -0 0 0 125 /end COMPU_METHOD
/begin COMPU_METHOD SAB_0781PROZENT_S2_S3 "int = ((phys * 1000) / 781) - (0) %" RAT_FUNC "%5.3" "%" COEFFS 0 1000 -0 0 0 781 /end COMPU_METHOD
/begin COMPU_METHOD SAB_100PROZENT125_M127_S2_S3 "int = ((phys * 125) / 100) - (-127) %" RAT_FUNC "%5.3" "%" COEFFS 0 125 12700 0 0 100 /end COMPU_METHOD
/begin COMPU_METHOD SAB_0400PROZENT_S2_S3 "int = ((phys * 1000) / 400) - (0) %" RAT_FUNC "%5.3" "%" COEFFS 0 1000 -0 0 0 400 /end COMPU_METHOD
/begin COMPU_METHOD SAB_100PROZENT255_S2_S3 "int = ((phys * 255) / 100) - (0) %" RAT_FUNC "%5.3" "%" COEFFS 0 255 -0 0 0 100 /end COMPU_METHOD
/begin COMPU_METHOD SAB_100PROZENT200_S2_S3 "int = ((phys * 200) / 100) - (0) %" RAT_FUNC "%5.3" "%" COEFFS 0 200 -0 0 0 100 /end COMPU_METHOD
/begin COMPU_METHOD SAB_125PROZENT1000_S2_S3 "int = ((phys * 1000) / 125) - (0) %" RAT_FUNC "%5.3" "%" COEFFS 0 1000 -0 0 0 125 /end COMPU_METHOD
/begin COMPU_METHOD SAB_392157PROZENT1000000_S2_S3 "int = ((phys * 1.0E6) / 392157) - (0) %" RAT_FUNC "%5.3" "%" COEFFS 0 1000000 -0 0 0 392157 /end COMPU_METHOD
/begin COMPU_METHOD SAB_100PROZENT2048_6201M1000_S2_S3 "int = ((phys * 2048) / 100) - (-127) %" RAT_FUNC "%5.3" "%" COEFFS 0 2048 12700 0 0 100 /end COMPU_METHOD
/begin COMPU_METHOD SAB_PROZENT100_S2_S3 "int = ((phys * 100) / 1) - (0) %" RAT_FUNC "%5.3" "%" COEFFS 0 100 -0 0 0 1 /end COMPU_METHOD
/begin COMPU_METHOD SAB_PROZENT50_S2_S3 "int = ((phys * 50) / 1) - (0) %" RAT_FUNC "%5.3" "%" COEFFS 0 50 -0 0 0 1 /end COMPU_METHOD
/begin COMPU_METHOD SAB_PROZENT10_M100_S2_S3 "int = ((phys * 10) / 1) - (-1000) %" RAT_FUNC "%3.1" "%" COEFFS 0 10 1000 0 0 1 /end COMPU_METHOD
/begin COMPU_METHOD SAB_PROZENT10_M1000_S2_S3 "int = ((phys * 10) / 1) - (-1000) %" RAT_FUNC "%5.3" "%" COEFFS 0 10 1000 0 0 1 /end COMPU_METHOD
/begin COMPU_METHOD SAB_PROZENT10_M3000_S2_S3 "int = ((phys * 10) / 1) - (-3000) %" RAT_FUNC "%5.3" "%" COEFFS 0 10 3000 0 0 1 /end COMPU_METHOD
/begin COMPU_METHOD SAB_I_MA1_S2_S3 "int = ((phys * 1) / 1) - (0) mA" RAT_FUNC "%2.0" "mA" COEFFS 0 1 -0 0 0 1 /end COMPU_METHOD
/begin COMPU_METHOD SAB_I_MA_S2_S3 "int = ((phys * 1) / 1) - (0) mA" RAT_FUNC "%2.0" "mA" COEFFS 0 1 -0 0 0 1 /end COMPU_METHOD
/begin COMPU_METHOD SAB_I_10MA_S2_S3 "int = ((phys * 1) / 10) - (0) mA" RAT_FUNC "%5.3" "mA" COEFFS 0 1 -0 0 0 10 /end COMPU_METHOD
/begin COMPU_METHOD SAB_I_4MA_S2_S3 "int = ((phys * 1) / 4) - (0) mA" RAT_FUNC "%5.3" "mA" COEFFS 0 1 -0 0 0 4 /end COMPU_METHOD
/begin COMPU_METHOD SAB_I_MA10_M1000_S2_S3 "int = ((phys * 10) / 1) - (-10000) mA" RAT_FUNC "%5.3" "mA" COEFFS 0 10 10000 0 0 1 /end COMPU_METHOD
/begin COMPU_METHOD SAB_I_200MA_S2_S3 "int = ((phys * 1) / 200) - (0) mA" RAT_FUNC "%5.3" "mA" COEFFS 0 1 -0 0 0 200 /end COMPU_METHOD
/begin COMPU_METHOD SAB_FRQ_HZ_S2_S3 "int = ((phys * 1) / 1) - (0) Hz" RAT_FUNC "%2.0" "Hz" COEFFS 0 1 -0 0 0 1 /end COMPU_METHOD
/begin COMPU_METHOD SAB_KG_32KG_S2_S3 "int = ((phys * 1) / 32) - (0) kg" RAT_FUNC "%5.3" "kg" COEFFS 0 1 -0 0 0 32 /end COMPU_METHOD
/begin COMPU_METHOD SAB_KG_100KG_S2_S3 "int = ((phys * 1) / 100) - (0) kg" RAT_FUNC "%5.3" "kg" COEFFS 0 1 -0 0 0 100 /end COMPU_METHOD
/begin COMPU_METHOD SAB_M_2KG_S2_S3 "int = ((phys * 1) / 2) - (0) kg" RAT_FUNC "%5.3" "kg" COEFFS 0 1 -0 0 0 2 /end COMPU_METHOD
/begin COMPU_METHOD SAB_M_32KG_S2_S3 "int = ((phys * 1) / 32) - (0) kg" RAT_FUNC "%2.0" "kg" COEFFS 0 1 -0 0 0 32 /end COMPU_METHOD
/begin COMPU_METHOD SAB_M_100KG_S2_S3 "int = ((phys * 1) / 100) - (0) kg" RAT_FUNC "%5.3" "kg" COEFFS 0 1 -0 0 0 100 /end COMPU_METHOD
/begin COMPU_METHOD SAB_M_200KG_P500_S2_S3 "int = ((phys * 10) / 2000) - (25) kg" RAT_FUNC "%2.0" "kg" COEFFS 0 10 -50000 0 0 2000 /end COMPU_METHOD
/begin COMPU_METHOD SAB_KG_200KG_P500_S2_S3 "int = ((phys * 10) / 2000) - (25) kg" RAT_FUNC "%2.0" "kg" COEFFS 0 10 -50000 0 0 2000 /end COMPU_METHOD
/begin COMPU_METHOD SAB_PHI_4375GRAD100000_S2_S3 "int = ((phys * 100000) / 4375) - (0) grad" RAT_FUNC "%5.3" "grad" COEFFS 0 100000 -0 0 0 4375 /end COMPU_METHOD
/begin COMPU_METHOD SAB_A_MPSS_S2_S3 "int = ((phys * 1) / 1) - (0) m/s^2" RAT_FUNC "%2.0" "m/s^2" COEFFS 0 1 -0 0 0 1 /end COMPU_METHOD
/begin COMPU_METHOD SAB_A_MPSS128_S2_S3 "int = ((phys * 128) / 1) - (0) m/s^2" RAT_FUNC "%5.3" "m/s^2" COEFFS 0 128 -0 0 0 1 /end COMPU_METHOD
/begin COMPU_METHOD SAB_A_24MPSS1000_398M100_S2_S3 "int = ((phys * 1000) / 24) - (-166) m/s^2" RAT_FUNC "%5.3" "m/s^2" COEFFS 0 1000 3984 0 0 24 /end COMPU_METHOD
/begin COMPU_METHOD SAB_A_24MPSS1000_M166_S2_S3 "int = ((phys * 1000) / 24) - (-166) m/s^2" RAT_FUNC "%5.3" "m/s^2" COEFFS 0 1000 3984 0 0 24 /end COMPU_METHOD
/begin COMPU_METHOD SAB_PROZENT200_S2_S3 "int = ((phys * 200) / 1) - (0) %" RAT_FUNC "%5.3" "%" COEFFS 0 200 -0 0 0 1 /end COMPU_METHOD
/begin COMPU_METHOD SAB_MG_NMS_S2_S3 "int = ((phys * 1) / 1) - (0) Nm/s" RAT_FUNC "%2.0" "Nm/s" COEFFS 0 1 -0 0 0 1 /end COMPU_METHOD
/begin COMPU_METHOD SAB_MG_50NMS_M6325_S2_S3 "int = ((phys * 1) / 50) - (-126.5) Nm/s" RAT_FUNC "%5.3" "Nm/s" COEFFS 0 1 6325 0 0 50 /end COMPU_METHOD
/begin COMPU_METHOD SAB_P_2685MMHG1000_914P10_S2_S3 "int = ((phys * 1000) / 2685) - (33.8919925512104) mmHg" RAT_FUNC "%5.3" "mmHg" COEFFS 0 1000 -91000 0 0 2685 /end COMPU_METHOD
/begin COMPU_METHOD SAB_K250_S2_S3 "int = ((phys * 250) / 1) - (0) none" RAT_FUNC "%5.3" "none" COEFFS 0 250 -0 0 0 1 /end COMPU_METHOD
/begin COMPU_METHOD SAB_L_KM100_S2_S3 "int = ((phys * 100) / 1) - (0) km" RAT_FUNC "%5.3" "km" COEFFS 0 100 -0 0 0 1 /end COMPU_METHOD
/begin COMPU_METHOD SAB_P_36MBAR10_P300_S2_S3 "int = ((phys * 10) / 36) - (83.3333333333333) mbar" RAT_FUNC "%5.3" "mbar" COEFFS 0 10 -3000 0 0 36 /end COMPU_METHOD
/begin COMPU_METHOD SAB_C_3CEL_M40_S2_S3 "int = ((phys * 1) / 3) - (-13.3333333333333) Grad Celsius" RAT_FUNC "%5.3" "Grad Celsius" COEFFS 0 1 40 0 0 3 /end COMPU_METHOD
/begin COMPU_METHOD SAB_C_3CEL4_S2_S3 "int = ((phys * 4) / 3) - (0) Grad Celsius" RAT_FUNC "%5.3" "Grad Celsius" COEFFS 0 4 -0 0 0 3 /end COMPU_METHOD
/begin COMPU_METHOD SAB_P_BAR4_S2_S3 "int = ((phys * 4) / 1) - (0) bar" RAT_FUNC "%5.3" "bar" COEFFS 0 4 -0 0 0 1 /end COMPU_METHOD
/begin COMPU_METHOD SAB_49PROZENT125_S2_S3 "int = ((phys * 125) / 49) - (0) %" RAT_FUNC "%5.3" "%" COEFFS 0 125 -0 0 0 49 /end COMPU_METHOD
/begin COMPU_METHOD SAB_V_5KMH10_S2_S3 "int = ((phys * 10) / 5) - (0) km/h" RAT_FUNC "%5.3" "km/h" COEFFS 0 10 -0 0 0 5 /end COMPU_METHOD
/begin COMPU_METHOD SAB_A_2MPSS100_4096M100_S2_S3 "int = ((phys * 100) / 2) - (-2048) m/s^2" RAT_FUNC "%5.3" "m/s^2" COEFFS 0 100 4096 0 0 2 /end COMPU_METHOD
/begin COMPU_METHOD SAB_A_2MPSS100_256M100_S2_S3 "int = ((phys * 100) / 2) - (-128) m/s^2" RAT_FUNC "%5.3" "m/s^2" COEFFS 0 100 256 0 0 2 /end COMPU_METHOD
/begin COMPU_METHOD SAB_MG_50NMS_M6350_S2_S3 "int = ((phys * 1) / 50) - (-127) Nm/s" RAT_FUNC "%5.3" "Nm/s" COEFFS 0 1 6350 0 0 50 /end COMPU_METHOD
/begin COMPU_METHOD SAB_MG_50NMS_M2000_S2_S3 "int = ((phys * 1) / 50) - (-40) Nm/s" RAT_FUNC "%5.3" "Nm/s" COEFFS 0 1 2000 0 0 50 /end COMPU_METHOD
/begin COMPU_METHOD SAB_MG_50NMS_S2_S3 "int = ((phys * 1) / 50) - (0) Nm/s" RAT_FUNC "%5.3" "Nm/s" COEFFS 0 1 -0 0 0 50 /end COMPU_METHOD
/begin COMPU_METHOD SAB_I_I10000_S2_S3 "int = ((phys * 10000) / 1) - (0) none" RAT_FUNC "%7.5" "none" COEFFS 0 10000 -0 0 0 1 /end COMPU_METHOD
/begin COMPU_METHOD SAB_MG_25NMS_S2_S3 "int = ((phys * 1) / 25) - (0) Nm/s" RAT_FUNC "%5.3" "Nm/s" COEFFS 0 1 -0 0 0 25 /end COMPU_METHOD
/begin COMPU_METHOD SAB_MG_M25NMS_S2_S3 "int = ((phys * 1) / -25) - (0) Nm/s" RAT_FUNC "%5.3" "Nm/s" COEFFS 0 1 0 0 0 -25 /end COMPU_METHOD
/begin COMPU_METHOD SAB_N_16RPM_S2_S3 "int = ((phys * 1) / 16) - (0) U/min" RAT_FUNC "%5.3" "U/min" COEFFS 0 1 -0 0 0 16 /end COMPU_METHOD
/begin COMPU_METHOD SAB_PROZENT_PROZENT_M30_S2_S3 "int = ((phys * 1) / 1) - (-30) Unit_PerCent" RAT_FUNC "%2.0" "Unit_PerCent" COEFFS 0 1 30 0 0 1 /end COMPU_METHOD
/begin COMPU_TAB _CNV_P_2_A_I_184_S2 "" TAB_INTP 2 0 0 65535 65535 /end COMPU_TAB
/begin COMPU_VTAB _CNV_S_2_Schalter_A_4_S2 "Schalter: 0 = AUS, 1 = EIN" TAB_VERB 2 0 "AUS" 1 "EIN" /end COMPU_VTAB
/begin COMPU_VTAB _CNV_S_6_Enum_EDL_11_S2 "" TAB_VERB 6 1 "DL_1" 2 "DL_2" 3 "DL_3" 4 "DL_4" 5 "DL_5" 6 "DL_6" /end COMPU_VTAB
/begin COMPU_VTAB _CNV_S_4_Enum_EADAS_13_S2 "" TAB_VERB 4 0 "ADAS_KURVE" 1 "ADAS_KREIS" 2 "ADAS_KRZG" 3 "ADAS_AAF" /end COMPU_VTAB
/begin COMPU_VTAB _CNV_S_2_Enum_EGEW__16_S2 "" TAB_VERB 2 0 "IN_GEW" 1 "OUT_GEW" /end COMPU_VTAB
/begin COMPU_VTAB _CNV_S_15_Enum_EHSUR_17_S2 "" TAB_VERB 15 0 "HSURE_VOR" 1 "HSURE_FOF" 2 "HSURE_INSTAT" 3 "HSURE_BRS" 4 "HSURE_NL" 5 "HSURE_BAB" 6 "HSURE_KUVORHALT" 7 "HSURE_KU" 8 "HSURE_RS" 9 "HSURE_HS" 10 "HSURE_ADAPT" 11 "HSURE_NABNEGATIV" 12 "HSURE_SCHLUPF" 13 "HSURE_COS" 14 "HSURE_NSC" /end COMPU_VTAB
/begin COMPU_VTAB _CNV_S_2_Enum_EPT1__21_S2 "" TAB_VERB 2 0 "PT1_VERST" 1 "PT1_TRAEG" /end COMPU_VTAB
/begin COMPU_VTAB _CNV_S_2_Enum_ECOD__23_S2 "" TAB_VERB 2 0 "KEIN_SPORTSCHALTER" 1 "SPORTSCHALTER" /end COMPU_VTAB
/begin COMPU_VTAB _CNV_S_4_Enum_EAGS__24_S2 "" TAB_VERB 4 0 "A_AGS" 1 "S_AGS" 2 "ECO" 3 "E_FAHREN" /end COMPU_VTAB
/begin COMPU_VTAB _CNV_S_2_Enum_EAGS_25_S2 "" TAB_VERB 2 0 "A_AGS" 1 "S_AGS" /end COMPU_VTAB
/begin COMPU_VTAB _CNV_S_5_Enum_ZDRIV_27_S2 "" TAB_VERB 5 0 "D_DRIVE" 1 "S_DRIVE" 2 "M_DRIVE" 3 "TID_DRIVE" 4 "LMODE_DRIVE" /end COMPU_VTAB
/begin COMPU_VTAB _CNV_S_3_Enum_EDSCS_28_S2 "" TAB_VERB 3 0 "DSC_ACTIVE" 1 "DSC_PASSIVE" 2 "DTC_ACTIVE" /end COMPU_VTAB
/begin COMPU_VTAB _CNV_S_9_Enum_EGANG_30_S2 "" TAB_VERB 9 0 "GANG_1" 1 "GANG_2" 2 "GANG_3" 3 "GANG_4" 4 "GANG_5" 5 "GANG_6" 6 "GANG_7" 7 "GANG_8" 8 "GANG_9" /end COMPU_VTAB
/begin COMPU_VTAB _CNV_S_8_Enum_EPOS_33_S2 "" TAB_VERB 8 0 "POS_1" 1 "POS_2" 2 "POS_3" 3 "POS_4" 4 "POS_D" 5 "POS_N" 6 "POS_R" 7 "POS_P" /end COMPU_VTAB
/begin COMPU_VTAB _CNV_S_4_Enum_EPROG_35_S2 "" TAB_VERB 4 0 "NORMAL_MODE" 1 "SPORT_MODE" 2 "STEPTRONIC_MODE" 3 "L_MODE" /end COMPU_VTAB
/begin COMPU_VTAB _CNV_S_2_Enum_EWL2_38_S2 "" TAB_VERB 2 0 "WL2_nichtaktiv" 1 "WL2_aktiv" /end COMPU_VTAB
/begin COMPU_VTAB _CNV_S_21_Enum_EPROG_40_S2 "" TAB_VERB 21 0 "EXTREME_ECONOMY_PROG" 1 "ECONOMY_PROG" 2 "SPORT_PROG" 3 "EXTREME_SPORT_PROG" 4 "A1_PROG" 5 "A2_PROG" 6 "A3_PROG" 7 "A4_PROG" 8 "A5_PROG" 9 "SA1_PROG" 10 "SA2_PROG" 11 "SA3_PROG" 12 "SA4_PROG" 13 "WL1_PROG" 14 "WL2_PROG" 15 "ECO_PROG" 16 "ECOA1_PROG" 17 "ECOA2_PROG" 18 "ECOWL2_PROG" 19 "SO1_PROG" 20 "SO2_PROG" /end COMPU_VTAB
/begin COMPU_VTAB _CNV_S_3_Enum_ESCHL_41_S2 "" TAB_VERB 3 0 "HAFT_REIBUNG" 1 "ZUG_SCHLUPF" 2 "SCHUB_SCHLUPF" /end COMPU_VTAB
/begin COMPU_VTAB _CNV_S_6_Enum_EBERG_61_S2 "" TAB_VERB 6 0 "BERGANH_OFF" 1 "BERGANH_A1" 2 "BERGANH_A2" 3 "BERGANH_A3" 4 "BERGANH_A4" 5 "BERGANH_A5" /end COMPU_VTAB
/begin COMPU_VTAB _CNV_S_3_Enum_ESIGN_84_S2 "" TAB_VERB 3 0 "SIGNAL_AUS" 1 "SIGNAL_EIN" 2 "SIGNAL_UEBERNAHME" /end COMPU_VTAB
/begin COMPU_VTAB _CNV_S_4_Enum_EKOMB_93_S2 "" TAB_VERB 4 0 "DARK_KOMBI" 1 "SPORT_KOMBI" 2 "STEPTRONIC_KOMBI" 3 "L_KOMBI" /end COMPU_VTAB
/begin COMPU_VTAB _CNV_S_6_Enum_ENABH_108_S2 "" TAB_VERB 6 0 "KEINE_HSURERS" 1 "NABHSURERS_NULLDECRVL_1" 2 "NABHSURERS_NULLDECRVL_2" 3 "NABHSURERS_NULLDECRVL_3" 4 "NABHSURERS_NULLDECRVL_4" 5 "NABHSURERS_NULLDECRVL_5" /end COMPU_VTAB
/begin COMPU_VTAB _CNV_S_2_Enum_ENOTL_110_S2 "" TAB_VERB 2 0 "MOTOR_NOTLAUF_1" 1 "MOTOR_NOTLAUF_2" /end COMPU_VTAB
/begin COMPU_VTAB _CNV_S_3_Enum_ESKLK_113_S2 "" TAB_VERB 3 0 "MAX_SCHWELLE" 1 "MAX_ENTFAELLT" 2 "MAX_HSEARLIERLATER" /end COMPU_VTAB
/begin COMPU_VTAB _CNV_S_2_Enum_EHDC__114_S2 "" TAB_VERB 2 0 "N_MOT_SCHALTEN" 1 "N_MOT_GANGHALTEN" /end COMPU_VTAB
/begin COMPU_VTAB _CNV_S_3_Enum_EHSUR_115_S2 "" TAB_VERB 3 0 "REGERK" 1 "MUELOWSS" 2 "MUELOW" /end COMPU_VTAB
/begin COMPU_VTAB _CNV_S_3_Enum_ELDMA_116_S2 "" TAB_VERB 3 0 "LDM_ZUG" 1 "LDM_SCHUB_BAB_INAKTIV" 2 "LDM_SCHUB_BAB_AKTIV" /end COMPU_VTAB
/begin COMPU_VTAB _CNV_S_2_Enum_EUSEH_117_S2 "" TAB_VERB 2 0 "Min" 1 "Max" /end COMPU_VTAB
/begin COMPU_VTAB _CNV_S_3_Enum_EREQA_118_S2 "" TAB_VERB 3 0 "NO_REQUEST" 1 "REQUEST_PRIO_LOW" 2 "REQUEST_PRIO_HIGH" /end COMPU_VTAB
/begin COMPU_VTAB _CNV_S_8_Enum_EHSUB_119_S2 "" TAB_VERB 8 0 "HSUBEDAUS_D" 1 "HSUBEDAUS_D_FDC" 2 "HSUBEDAUS_S" 3 "HSUBEDAUS_S_FDC" 4 "HSUBEDAUS_STEP" 5 "HSUBEDAUS_STEP_FDC" 6 "HSUBEDAUS_TID" 7 "HSUBEDAUS_TID_FDC" /end COMPU_VTAB
/begin COMPU_VTAB _CNV_S_3_Enum_ENABH_120_S2 "" TAB_VERB 3 0 "HSURESLREG" 1 "HSURESLMUE" 2 "HSURESLSS" /end COMPU_VTAB
/begin COMPU_VTAB _CNV_S_4_Enum_EHSUR_121_S2 "" TAB_VERB 4 0 "HSURE_KUVOR_A_AGS" 1 "HSURE_KUVOR_S_AGS" 2 "HSURE_KUVOR_LDMAAGS" 3 "HSURE_KUVOR_LDMSAGS" /end COMPU_VTAB
/begin COMPU_VTAB _CNV_S_5_Enum_EPROG_122_S2 "" TAB_VERB 5 0 "NORMAL_MODE" 1 "SPORT_MODE" 2 "STEPTRONIC_MODE" 3 "L_MODE" 4 "TIP_in_D" /end COMPU_VTAB
/begin COMPU_VTAB _CNV_S_2_Enum_EDV_R_124_S2 "" TAB_VERB 2 0 "DVREL_SEGLIM_FZG_COS" 1 "DVREL_SEGPRD_FZG_COS" /end COMPU_VTAB
/begin COMPU_VTAB _CNV_S_5_Enum_EHSU__125_S2 "" TAB_VERB 5 0 "KUP_A" 1 "KUP_B" 2 "KUP_C" 3 "KUP_D" 4 "KUP_E" /end COMPU_VTAB
/begin COMPU_VTAB _CNV_S_5_Enum_EGWFP_128_S2 "" TAB_VERB 5 0 "GWFP_IDX1" 1 "GWFP_IDX2" 2 "GWFP_IDX3" 3 "GWFP_IDX4" 4 "GWFP_IDX5" /end COMPU_VTAB
/begin COMPU_VTAB _CNV_S_3_Enum_EHSUA_129_S2 "" TAB_VERB 3 0 "KEEP_HSU" 1 "OUT_HSU_ONLY" 2 "OUT_HSU_PLUS_BUFF" /end COMPU_VTAB
/begin COMPU_VTAB _CNV_S_6_Enum_EEFAH_140_S2 "" TAB_VERB 6 0 "KEIN_E_FAHREN" 1 "MSA_KENNLINIE" 2 "HOCHEFFIZIENZ_KL" 3 "EFFIZIENZ_KL" 4 "KUNDENWERTE_KL" 5 "EDRIVE_KL" /end COMPU_VTAB
/begin COMPU_VTAB _CNV_S_9_Enum_EHASS_141_S2 "" TAB_VERB 9 0 "INIT_INAKTIV" 1 "ANGEKOPPELT" 2 "ENTKOPPELT" 3 "E_FAHREN" 4 "STOP" 5 "LADEN" 6 "ENTKOPPELT_VM_EIN" 7 "E_FAHREN_VM_EIN" 8 "HYBRIDFAHREN" /end COMPU_VTAB
/begin COMPU_VTAB _CNV_S_4_Enum_ESOCM_142_S2 "Status SOC MODE" TAB_VERB 4 0 "Depleting" 1 "Sustaining" 2 "Hold" 3 "Failure" /end COMPU_VTAB
/begin COMPU_VTAB _CNV_S_4_Enum_EEFAH_143_S2 "" TAB_VERB 4 0 "EFAHREN_1_ERK" 1 "EFAHREN_2_ERK" 2 "EFAHREN_3_ERK" 3 "EFAHREN_4_ERK" /end COMPU_VTAB
/begin COMPU_VTAB _CNV_S_2_Enum_ESTOP_145_S2 "" TAB_VERB 2 0 "Deaktivierung_Stop_Go_bei_aktivem_MSA" 1 "Stop_Go_bei_aktivem_MSA_moeglich" /end COMPU_VTAB
/begin COMPU_VTAB _CNV_S_2_Enum_EHEIS_147_S2 "" TAB_VERB 2 0 "Kennfeld" 1 "Druck_oder_Temperatur" /end COMPU_VTAB
/begin COMPU_VTAB _CNV_S_7_Enum_ESDYN_151_S2 "" TAB_VERB 7 0 "KOMFORT_SDYN" 1 "QS1_SDYN" 2 "QS2_SDYN" 3 "QS3_SDYN" 4 "QS4_SDYN" 5 "QS5_SDYN" 6 "QS6_SDYN" /end COMPU_VTAB
/begin COMPU_VTAB _CNV_S_6_Enum_ESCHA_152_S2 "" TAB_VERB 6 0 "ZUG_HOCH" 1 "ZUG_RUECK" 2 "SCHUB_HOCH" 3 "SCHUB_RUECK" 4 "SCHUB_RUECK_POSME" 5 "SCHUB_RUECK_OFFEN" /end COMPU_VTAB
/begin COMPU_VTAB _CNV_S_3_Enum_EWK_153_S2 "" TAB_VERB 3 0 "OFFEN" 1 "GEREGELT" 2 "ZU" /end COMPU_VTAB
/begin COMPU_VTAB _CNV_S_3_Enum_EENTP_157_S2 "" TAB_VERB 3 0 "Aktivierung: steigende Flanke S_DYNDZM_FFG" 1 "Deaktivierung: fallende Flanke S_DYNDZM_FFG" 2 "Verzoegerung bei Aktivierung" /end COMPU_VTAB
/begin COMPU_VTAB _CNV_S_2_Enum_EERSM_158_S2 "" TAB_VERB 2 0 "ERS" 1 "MRS" /end COMPU_VTAB
/begin COMPU_VTAB _CNV_S_2_Enum_EFOLG_159_S2 "" TAB_VERB 2 0 "RS" 1 "HS" /end COMPU_VTAB
/begin COMPU_VTAB _CNV_S_2_Enum_ESIMU_160_S2 "" TAB_VERB 2 0 "VON" 1 "BIS" /end COMPU_VTAB
/begin COMPU_VTAB _CNV_S_3_Enum_ESCHU_161_S2 "" TAB_VERB 3 0 "SCHUB_RUECK" 1 "SCHUB_RUECK_POSME" 2 "SCHUB_RUECK_OFFEN" /end COMPU_VTAB
/begin COMPU_VTAB _CNV_S_6_Enum_EIDX__162_S2 "" TAB_VERB 6 0 "IDX_0" 1 "IDX_1" 2 "IDX_2" 3 "IDX_3" 4 "IDX_4" 5 "IDX_5" /end COMPU_VTAB
/begin COMPU_VTAB _CNV_S_2_Enum_EVERL_179_S2 "" TAB_VERB 2 0 "TiD" 1 "TiS" /end COMPU_VTAB
/begin COMPU_VTAB _CNV_S_3_Enum_EHOTD_180_S2 "" TAB_VERB 3 0 "DUE" 1 "DUE_RSZVERBOT" 2 "HOTMODE" /end COMPU_VTAB
/begin COMPU_VTAB _CNV_S_3_Enum_EDSC__182_S2 "" TAB_VERB 3 0 "SPORTSTEP_DSC_PASSIVE" 1 "SPORTSTEP_DSC_PASSIVE_OR_DTC_ACTIVE" 2 "SPORTSTEP_NEVER" DEFAULT_VALUE "0" /end COMPU_VTAB
/begin COMPU_VTAB _CNV_S_4_Enum_TIDAU_185_S2 "" TAB_VERB 4 0 "KEIN Ausstieg via Paddle (default)" 1 "Zeitabh. Ausstieg nach Langdruck Paddle+" 2 "Zeitunabh. Ausstieg bei Paddel- ueber Paddle+" 3 "Ausstieg ueber Option [1] oder [2]" /end COMPU_VTAB
/begin COMPU_VTAB _CNV_S_4_Enum_EPRIO_188_S2 "" TAB_VERB 4 0 "KREIS" 1 "Kurve" 2 "AAF" 3 "KRZG" /end COMPU_VTAB
/begin COMPU_VTAB _CNV_S_2_Enum_ENAVI_197_S2 "" TAB_VERB 2 0 "SIGNAL_UEBERNAHME" 1 "SIGNAL_SIMULATE" /end COMPU_VTAB
/begin COMPU_VTAB _CNV_S_6_Enum_EANZG_205_S2 "" TAB_VERB 6 0 "GANGART_AUTOMAT" 1 "GANGART_MANUELL" 2 "GANGART_SPORT" 3 "GANGART_FAS" 4 "GANGART_ZKA" 5 "GANGART_LMODE" /end COMPU_VTAB
/begin COMPU_VTAB _CNV_S_7_Enum_EDRIV_207_S2 "" TAB_VERB 7 0 "DRIVEDYN_BASIS" 1 "DRIVEDYN_KOMFORT" 2 "DRIVEDYN_TRAKTION" 3 "DRIVEDYN_SPORT" 4 "DRIVEDYN_SPORT_PLUS" 5 "DRIVEDYN_RACE" 6 "DRIVEDYN_ECO" /end COMPU_VTAB
/begin COMPU_VTAB _CNV_S_6_Enum_EANZE_208_S2 "" TAB_VERB 6 0 "MANUELLGANG_ANZ" 1 "ISTGANG_ANZ" 2 "ZIELGANG_ANZ" 3 "AUTOMATGANG_ANZ" 4 "LMODEGANG_ANZ" 5 "KEINGANG_ANZ" /end COMPU_VTAB
/begin COMPU_VTAB _CNV_S_2_Enum_EXCFK_209_S2 "" TAB_VERB 2 0 "AUTOMAT" 1 "MANUELL" /end COMPU_VTAB
/begin COMPU_VTAB _CNV_S_2_Enum_ESCHT_212_S2 "" TAB_VERB 2 0 "Ueberschreiten" 1 "Unterschreiten" /end COMPU_VTAB
/begin COMPU_VTAB _CNV_S_6_Enum_EQS_T_213_S2 "" TAB_VERB 6 0 "QS1_MIN" 1 "QS1_MAX" 2 "QS2_MIN" 3 "QS2_MAX" 4 "QS3_MIN" 5 "QS3_MAX" /end COMPU_VTAB
/begin COMPU_VTAB _CNV_S_2_Enum_HSRS_214_S2 "" TAB_VERB 2 0 "HS" 1 "RS" /end COMPU_VTAB
/begin COMPU_VTAB _CNV_S_15_Enum_EDYNA_215_S2 "" TAB_VERB 15 0 "HS_KOMFORT" 1 "HS_QS1" 2 "HS_QS2" 3 "HS_QS3" 4 "RS_KOMFORT" 5 "RS_PME_KOMFORT" 6 "RS_PME_QS1" 7 "RS_PME_QS2" 8 "DMRS_PME_QS1" 9 "DMRS_PME_QS2" 10 "FPKF_KOMFORT" 11 "FPKF_ECO" 12 "FPKF_SPORT" 13 "WKANBIND_KOMFORT" 14 "WKANBIND_DIREKT" /end COMPU_VTAB
/begin COMPU_VTAB _CNV_S_5_Enum_EGWDK_216_S2 "" TAB_VERB 5 0 "GWDKKD1_QS" 1 "GWDKKD2_QS" 2 "GWDKKD3_QS" 3 "GWDKKD4_QS" 4 "GWDKKD5_QS" /end COMPU_VTAB
/begin COMPU_VTAB _CNV_S_3_Enum_EWDKK_218_S2 "" TAB_VERB 3 0 "WDKKD1_QS" 1 "WDKKD2_QS" 2 "WDKKD3_QS" /end COMPU_VTAB
/begin COMPU_VTAB _CNV_S_43_Enum_EQSHI_219_S2 "" TAB_VERB 43 0 "ZWANGSCH_STEP" 1 "FT_BR_E" 2 "FT_BR_S" 3 "FT_BR_XS" 4 "GWDKKD1" 5 "GWDKKD2" 6 "MFRS" 7 "MFHS" 8 "WDKKD1" 9 "WDKKD2" 10 "WDKKD3" 11 "NULLAST" 12 "DSC_DTC" 13 "DSC_AUS" 14 "S_QS3_SOLL" 15 "ANH" 16 "ASC" 17 "A_Q_KURVE" 18 "TEMP_GETR" 19 "TEMP_KUP_A" 20 "WL2" 21 "ECO" 22 "COD_GETRTYP" 23 "EXCFKT1" 24 "EXCFKT2" 25 "EXCFKT3" 26 "EXCFKT4" 27 "EXCFKT5" 28 "EXCFKT6" 29 "EXCFKT7" 30 "EXCFKT8" 31 "HOCHSCH" 32 "RUECKSCH" 33 "ISTGANG_1" 34 "ISTGANG_2" 35 "ISTGANG_3" 36 "ISTGANG_4" 37 "ISTGANG_5" 38 "ISTGANG_6" 39 "ISTGANG_7" 40 "ISTGANG_8" 41 "ISTGANG_9" 42 "DYNAMIK" /end COMPU_VTAB
/begin COMPU_VTAB _CNV_S_3_Enum_ESCHW_220_S2 "" TAB_VERB 3 0 "SCH_HS" 1 "SCH_RS" 2 "H_HSRS" /end COMPU_VTAB
/begin COMPU_VTAB _CNV_S_3_Enum_EQS_D_221_S2 "" TAB_VERB 3 0 "QS1_DOWN_QS0" 1 "QS2_DOWN_QS1" 2 "QS2_DOWN_QS0" /end COMPU_VTAB
/begin COMPU_VTAB _CNV_S_2_Enum_ESCHG_222_S2 "" TAB_VERB 2 0 "SCH_ACTIVE" 1 "SCH_WAIT" /end COMPU_VTAB
/begin COMPU_VTAB _CNV_S_16_Enum_EIDXG_225_S2 "" TAB_VERB 16 0 "Index_0" 1 "Index_1" 2 "Index_2" 3 "Index_3" 4 "Index_4" 5 "Index_5" 6 "Index_6" 7 "Index_7" 8 "Index_8" 9 "Index_9" 10 "Index_10" 11 "Index_11" 12 "Index_12" 13 "Index_13" 14 "Index_14" 15 "SIGNAL_UNGUELTIG" DEFAULT_VALUE "0" /end COMPU_VTAB
/begin RECORD_LAYOUT _REC_S7CUR_53_s2_u2_S2 FNC_VALUES 3 SWORD COLUMN_DIR DIRECT AXIS_PTS_X 2 UWORD INDEX_INCR DIRECT NO_AXIS_PTS_X 1 UBYTE /end RECORD_LAYOUT
/begin RECORD_LAYOUT _REC_S1VAL_1_s2_S2 FNC_VALUES 1 SWORD COLUMN_DIR DIRECT /end RECORD_LAYOUT
/begin RECORD_LAYOUT _REC_S1VAL_1_u2_S2 FNC_VALUES 1 UWORD COLUMN_DIR DIRECT /end RECORD_LAYOUT
/begin RECORD_LAYOUT _REC_S1VAL_1_u1_S2 FNC_VALUES 1 UBYTE COLUMN_DIR DIRECT /end RECORD_LAYOUT
/begin RECORD_LAYOUT _REC_S1VAL_1_u4_S2 FNC_VALUES 1 ULONG COLUMN_DIR DIRECT /end RECORD_LAYOUT
/begin RECORD_LAYOUT _REC_S7CUR_53_u2_s2_S2 FNC_VALUES 3 UWORD COLUMN_DIR DIRECT AXIS_PTS_X 2 SWORD INDEX_INCR DIRECT NO_AXIS_PTS_X 1 UBYTE /end RECORD_LAYOUT
/begin RECORD_LAYOUT _REC_S7MAP_53_u2_s2_u2_S2 FNC_VALUES 5 UWORD COLUMN_DIR DIRECT AXIS_PTS_X 3 SWORD INDEX_INCR DIRECT AXIS_PTS_Y 4 UWORD INDEX_INCR DIRECT NO_AXIS_PTS_X 1 UBYTE NO_AXIS_PTS_Y 2 UBYTE /end RECORD_LAYOUT
/begin RECORD_LAYOUT _REC_A1MAP_9_u2_u1_u1_S2 FNC_VALUES 1 UWORD COLUMN_DIR DIRECT /end RECORD_LAYOUT
/begin RECORD_LAYOUT _REC_S7CUR_53_s2_s2_S2 FNC_VALUES 3 SWORD COLUMN_DIR DIRECT AXIS_PTS_X 2 SWORD INDEX_INCR DIRECT NO_AXIS_PTS_X 1 UBYTE /end RECORD_LAYOUT
/begin RECORD_LAYOUT _REC_A1CUR_30_u1_u1_S2 FNC_VALUES 1 UBYTE COLUMN_DIR DIRECT /end RECORD_LAYOUT
/begin RECORD_LAYOUT _REC_S7MAP_53_s2_s2_u2_S2 FNC_VALUES 5 SWORD COLUMN_DIR DIRECT AXIS_PTS_X 3 SWORD INDEX_INCR DIRECT AXIS_PTS_Y 4 UWORD INDEX_INCR DIRECT NO_AXIS_PTS_X 1 UBYTE NO_AXIS_PTS_Y 2 UBYTE /end RECORD_LAYOUT
/begin RECORD_LAYOUT _REC_A1CUR_30_u4_u1_S2 FNC_VALUES 1 ULONG COLUMN_DIR DIRECT /end RECORD_LAYOUT
/begin RECORD_LAYOUT _REC_S7CUR_53_u2_u2_S2 FNC_VALUES 3 UWORD COLUMN_DIR DIRECT AXIS_PTS_X 2 UWORD INDEX_INCR DIRECT NO_AXIS_PTS_X 1 UBYTE /end RECORD_LAYOUT
/begin RECORD_LAYOUT _REC_S3MAP_54_u2_s2_u1_S2 FNC_VALUES 3 UWORD ROW_DIR DIRECT AXIS_PTS_X 2 SWORD INDEX_INCR DIRECT NO_AXIS_PTS_X 1 UBYTE /end RECORD_LAYOUT
/begin RECORD_LAYOUT _REC_A1MAP_9_s2_u1_u1_S2 FNC_VALUES 1 SWORD COLUMN_DIR DIRECT /end RECORD_LAYOUT
/begin RECORD_LAYOUT _REC_A1CUR_30_u2_u1_S2 FNC_VALUES 1 UWORD COLUMN_DIR DIRECT /end RECORD_LAYOUT
/begin RECORD_LAYOUT _REC_A1MAP_9_u1_u1_u1_S2 FNC_VALUES 1 UBYTE COLUMN_DIR DIRECT /end RECORD_LAYOUT
/begin RECORD_LAYOUT _REC_A1CUR_30_s2_u1_S2 FNC_VALUES 1 SWORD COLUMN_DIR DIRECT /end RECORD_LAYOUT
/begin RECORD_LAYOUT _REC_A1CUR_1_u2_u2_S2 FNC_VALUES 1 UWORD COLUMN_DIR DIRECT /end RECORD_LAYOUT
/begin RECORD_LAYOUT _REC_S3MAP_54_s2_s2_u1_S2 FNC_VALUES 3 SWORD ROW_DIR DIRECT AXIS_PTS_X 2 SWORD INDEX_INCR DIRECT NO_AXIS_PTS_X 1 UBYTE /end RECORD_LAYOUT
/begin RECORD_LAYOUT _REC_A1MAP_8_u1_u2_u1_S2 FNC_VALUES 1 UBYTE ROW_DIR DIRECT /end RECORD_LAYOUT
/begin RECORD_LAYOUT _REC_A1CUR_30_u1_u2_S2 FNC_VALUES 1 UBYTE COLUMN_DIR DIRECT /end RECORD_LAYOUT
/begin RECORD_LAYOUT _REC_S7MAP_53_u2_u2_u2_S2 FNC_VALUES 5 UWORD COLUMN_DIR DIRECT AXIS_PTS_X 3 UWORD INDEX_INCR DIRECT AXIS_PTS_Y 4 UWORD INDEX_INCR DIRECT NO_AXIS_PTS_X 1 UBYTE NO_AXIS_PTS_Y 2 UBYTE /end RECORD_LAYOUT
/begin RECORD_LAYOUT _REC_A2AXS_31_u2_S2 AXIS_PTS_X 2 UWORD INDEX_INCR DIRECT NO_AXIS_PTS_X 1 UWORD /end RECORD_LAYOUT
/begin RECORD_LAYOUT _REC_S3MAP_54_u1_u2_u1_S2 FNC_VALUES 3 UBYTE ROW_DIR DIRECT AXIS_PTS_X 2 UWORD INDEX_INCR DIRECT NO_AXIS_PTS_X 1 UBYTE /end RECORD_LAYOUT
/begin RECORD_LAYOUT _REC_A1CUR_30_u2_u2_S2 FNC_VALUES 1 UWORD COLUMN_DIR DIRECT /end RECORD_LAYOUT
/begin RECORD_LAYOUT _REC_A1MAP_9_u2_u2_u1_S2 FNC_VALUES 1 UWORD COLUMN_DIR DIRECT /end RECORD_LAYOUT
/begin RECORD_LAYOUT _REC_S7MAP_53_u2_u2_s2_S2 FNC_VALUES 5 UWORD COLUMN_DIR DIRECT AXIS_PTS_X 3 UWORD INDEX_INCR DIRECT AXIS_PTS_Y 4 SWORD INDEX_INCR DIRECT NO_AXIS_PTS_X 1 UBYTE NO_AXIS_PTS_Y 2 UBYTE /end RECORD_LAYOUT
/begin RECORD_LAYOUT _REC_S3MAP_54_u2_u2_u1_S2 FNC_VALUES 3 UWORD ROW_DIR DIRECT AXIS_PTS_X 2 UWORD INDEX_INCR DIRECT NO_AXIS_PTS_X 1 UBYTE /end RECORD_LAYOUT
/begin RECORD_LAYOUT _REC_A1MAP_8_u1_u1_u1_S2 FNC_VALUES 1 UBYTE ROW_DIR DIRECT /end RECORD_LAYOUT
/begin RECORD_LAYOUT _REC_A1MAP_9_u4_u1_u1_S2 FNC_VALUES 1 ULONG COLUMN_DIR DIRECT /end RECORD_LAYOUT
/begin RECORD_LAYOUT _REC_A1MAP_9_s2_u2_u2_S2 FNC_VALUES 1 SWORD COLUMN_DIR DIRECT /end RECORD_LAYOUT
/begin RECORD_LAYOUT _REC_A1MAP_9_u2_u2_u2_S2 FNC_VALUES 1 UWORD COLUMN_DIR DIRECT /end RECORD_LAYOUT
/begin RECORD_LAYOUT _REC_A1MAP_9_u2_u1_u2_S2 FNC_VALUES 1 UWORD COLUMN_DIR DIRECT /end RECORD_LAYOUT
/end MODULE
/end PROJECT
