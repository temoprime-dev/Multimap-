ASAP2_VERSION 1 51
/begin PROJECT _929_929 "Gen2_BMW_System_Supplier_Lib"
/begin HEADER "" VERSION "C_03_03" PROJECT_NO _929_929 /end HEADER
/begin MODULE DIM ""
/begin MOD_COMMON "" BYTE_ORDER MSB_FIRST ALIGNMENT_BYTE 1 ALIGNMENT_WORD 2 ALIGNMENT_LONG 4 ALIGNMENT_FLOAT32_IEEE 4 /end MOD_COMMON
/begin MEASUREMENT iAzsSollgangMoeglich.sollgang_moeglich "Gibt einen Gang moeglichst nahe am Sollgang an, in den das Getriebe ueber mehrere Schaltungen hinweg derzeit geschalten werden koennte" SBYTE Conv.cAzsSollgangMoeglich._.sollgang_moeglich_S6_S3 1 100 -1 8 DISPLAY_IDENTIFIER sollgang_moeglich.iAzsSollgangMoeglich ECU_ADDRESS 0xFFF8A394 /end MEASUREMENT
/begin MEASUREMENT iAzsVorgabeGang.gang_schleppstart "der vorgabegang der Schleppstart-Fkt." SBYTE Conv.cAzsVorgabeGang._.gang_schleppstart_S6_S3 1 100 -1 8 DISPLAY_IDENTIFIER gang_schleppstart.iAzsVorgabeGang ECU_ADDRESS 0xFFF8A395 /end MEASUREMENT
/begin MEASUREMENT iAzsVorgabeGang.vorgabegang "Vorgabegang - sammelt alle Ganganforderungen (ohne Gang R)" SBYTE Conv.cAzsVorgabeGang._.vorgabegang_S6_S3 1 100 -1 8 DISPLAY_IDENTIFIER vorgabegang.iAzsVorgabeGang ECU_ADDRESS 0xFFF8A396 /end MEASUREMENT
/begin MEASUREMENT iAzsVorgabeGang.f_abbruch_vorb_angefordert "Abbruch einer Vorbereitung wegen Schleppstart" UBYTE Conv.cAzsVorgabeGang._.f_abbruch_vorb_angefordert_S6_S3 1 100 0 1 BIT_MASK 0x1 DISPLAY_IDENTIFIER f_abbruch_vorb_angefordert.iAzsVorgabeGang ECU_ADDRESS 0xFFF8A397 /end MEASUREMENT
/begin MEASUREMENT iAzsVorgabeGang.f_schleppstart_erkannt "Aktive Anforderung einer Schaltungsverhinderung/-abbruch durch Schleppstartfkt." UBYTE Conv.cAzsVorgabeGang._.f_schleppstart_erkannt_S6_S3 1 100 0 1 BIT_MASK 0x1 DISPLAY_IDENTIFIER f_schleppstart_erkannt.iAzsVorgabeGang ECU_ADDRESS 0xFFF8A398 /end MEASUREMENT
/begin MEASUREMENT iAzsVorgabeGang.z_abbruch_rsrs "Vorgabe um RS durch RS abzubrechen" UBYTE Conv.cAzsVorgabeGang._.z_abbruch_rsrs_S6_S3 1 100 0 2 DISPLAY_IDENTIFIER z_abbruch_rsrs.iAzsVorgabeGang ECU_ADDRESS 0xFFF8A399 /end MEASUREMENT
/begin MEASUREMENT iAzsZielgangSoll.zielgang_soll "Zielgang-Soll" SBYTE Conv.cAzsZielgangSoll._.zielgang_soll_S6_S3 1 100 -1 8 DISPLAY_IDENTIFIER zielgang_soll.iAzsZielgangSoll ECU_ADDRESS 0xFFF8A39F /end MEASUREMENT
/begin MEASUREMENT iAzsZielgang.f_schalt_abbruch_invers "Abbruch der laufenden Schaltung wegen inverser Anforderung wurde von SAS erlaubt" UBYTE Conv.cAzsZielgang._.f_schalt_abbruch_invers_S6_S3 1 100 0 1 BIT_MASK 0x1 DISPLAY_IDENTIFIER f_schalt_abbruch_invers.iAzsZielgang ECU_ADDRESS 0xFFF8A254 /end MEASUREMENT
/begin MEASUREMENT iAzsZielgang.zielgang "zielgang ist ein zum istgang schaltbarer Gang" SBYTE Conv.cAzsZielgang._.zielgang_S6_S3 1 100 -1 8 DISPLAY_IDENTIFIER zielgang.iAzsZielgang ECU_ADDRESS 0xFFF8A255 /end MEASUREMENT
/begin MEASUREMENT iAzsZielgangSas.schaltung "TRUE waehrend laufender Schaltung" UBYTE Conv.cAzsZielgangSas._.schaltung_S6_S3 1 100 0 1 BIT_MASK 0x1 DISPLAY_IDENTIFIER schaltung.iAzsZielgangSas ECU_ADDRESS 0xFFF8A39A /end MEASUREMENT
/begin MEASUREMENT iAzsZielgangSas.schaltart "Laufende Schaltung ist HS, RS oder keine Schaltung" UBYTE Conv.cAzsZielgangSas._.schaltart_S6_S3 1 100 0 2 DISPLAY_IDENTIFIER schaltart.iAzsZielgangSas ECU_ADDRESS 0xFFF8A39B /end MEASUREMENT
/begin MEASUREMENT iAzsZielgangSas.schaltinfo "Laufende Schaltung ist EHS, MHS, MRS, MRS oder keine Schaltung" UBYTE Conv.cAzsZielgangSas._.schaltinfo_S6_S3 1 100 0 4 DISPLAY_IDENTIFIER schaltinfo.iAzsZielgangSas ECU_ADDRESS 0xFFF8A39C /end MEASUREMENT
/begin MEASUREMENT iAzsZielgangSas.zielgang_sas "Zielgang-Sas: wenn ungleich Istgang laeuft gerade eine Schaltung" SBYTE Conv.cAzsZielgangSas._.zielgang_sas_S6_S3 1 100 -1 8 DISPLAY_IDENTIFIER zielgang_sas.iAzsZielgangSas ECU_ADDRESS 0xFFF8A39D /end MEASUREMENT
/begin MEASUREMENT iAzsZielgangSas.zielgang_sas_komp "Zielgang-Sas-Komplement: Bitinvertiertes Signal zu zielgang_sas" SBYTE Conv.cAzsZielgangSas._.zielgang_sas_komp_S6_S3 1 100 -9 0 DISPLAY_IDENTIFIER zielgang_sas_komp.iAzsZielgangSas ECU_ADDRESS 0xFFF8A39E /end MEASUREMENT
/begin MEASUREMENT iAzsIstgang.istgang "Ist-Gang" SBYTE Conv.cAzsIstGang._.istgang_S6_S3 1 100 -1 8 DISPLAY_IDENTIFIER istgang.iAzsIstgang ECU_ADDRESS 0xFFF8ED2C /end MEASUREMENT
/begin MEASUREMENT iAzsIstgang.f_saf_abbruch_invers "Anforderung einer inversen und Abbruch der laufenden Schaltung" UBYTE Conv.cAzsIstGang._.f_saf_abbruch_invers_S6_S3 1 100 0 1 BIT_MASK 0x1 DISPLAY_IDENTIFIER f_saf_abbruch_invers.iAzsIstgang ECU_ADDRESS 0xFFF8ED2D /end MEASUREMENT
/begin MEASUREMENT iAzsIstgang.f_saf_folgeschaltung "Folge-Schaltung (bereits freigegeben)" UBYTE Conv.cAzsIstGang._.f_saf_folgeschaltung_S6_S3 1 100 0 1 BIT_MASK 0x1 DISPLAY_IDENTIFIER f_saf_folgeschaltung.iAzsIstgang ECU_ADDRESS 0xFFF8ED2E /end MEASUREMENT
/begin MEASUREMENT iAzsIstgang.f_saf_freigegeben "Schaltungsanforderung ist freigegeben" UBYTE Conv.cAzsIstGang._.f_saf_freigegeben_S6_S3 1 100 0 1 BIT_MASK 0x1 DISPLAY_IDENTIFIER f_saf_freigegeben.iAzsIstgang ECU_ADDRESS 0xFFF8ED2F /end MEASUREMENT
/begin MEASUREMENT iAzsKupMassnahmenKoord.iSchaltungVerz.cSchaltung._.manuell "Speichert ob es sich bei der aktuellen Schaltung um eine Manuelle o. nicht handelt" UBYTE Conv.cSchaltung._.manuell_S6_S3 1 100 1 255 DISPLAY_IDENTIFIER manuell._.cSchaltung.iSchaltungVerz.iAzsKupMassnahmenKoord ECU_ADDRESS 0xFFF8C858 /end MEASUREMENT
/begin MEASUREMENT iAzsKupMassnahmenKoord.iSchaltungVerz.cSchaltung._.temp_schwelle_k_zu "Temperaturschwelle auf die aktuell geschaut wird" UWORD UMR_GRADC__1_1_0_S6_S3 1 100 0 65535 DISPLAY_IDENTIFIER temp_schwelle_k_zu._.cSchaltung.iSchaltungVerz.iAzsKupMassnahmenKoord ECU_ADDRESS 0xFFF8C85A /end MEASUREMENT
/begin MEASUREMENT iAzsKupMassnahmenKoord.iSchaltungVerz.cSchaltung._.temp_schwelle_k_ab "Temperaturschwelle auf die aktuell geschaut wird" UWORD UMR_GRADC__1_1_0_S6_S3 1 100 0 65535 DISPLAY_IDENTIFIER temp_schwelle_k_ab._.cSchaltung.iSchaltungVerz.iAzsKupMassnahmenKoord ECU_ADDRESS 0xFFF8C85C /end MEASUREMENT
/begin MEASUREMENT iAzsKupMassnahmenKoord.iSchaltungVerz.cSchaltung._.temp_schwelle_hys_k_zu "Temparaturschwelle - Hysterese" UWORD UMR_GRADC__1_1_0_S6_S3 1 100 0 65535 DISPLAY_IDENTIFIER temp_schwelle_hys_k_zu._.cSchaltung.iSchaltungVerz.iAzsKupMassnahmenKoord ECU_ADDRESS 0xFFF8C85E /end MEASUREMENT
/begin MEASUREMENT iAzsKupMassnahmenKoord.iSchaltungVerz.cSchaltung._.temp_schwelle_hys_k_ab "Temparaturschwelle - Hysterese" UWORD UMR_GRADC__1_1_0_S6_S3 1 100 0 65535 DISPLAY_IDENTIFIER temp_schwelle_hys_k_ab._.cSchaltung.iSchaltungVerz.iAzsKupMassnahmenKoord ECU_ADDRESS 0xFFF8C860 /end MEASUREMENT
/begin MEASUREMENT iAzsKupMassnahmenKoord.iSchaltungVerz.cSchaltung._.k_ab_temp "Temperatur der abschaltenden Kupplung" SWORD UMR_GRADC__1_1_0_S6_S3 1 100 -40 500 DISPLAY_IDENTIFIER k_ab_temp._.cSchaltung.iSchaltungVerz.iAzsKupMassnahmenKoord ECU_ADDRESS 0xFFF8C862 /end MEASUREMENT
/begin MEASUREMENT iAzsKupMassnahmenKoord.iSchaltungVerz.cSchaltung._.k_zu_temp "Temperatur der zuschaltenden Kupplung" SWORD UMR_GRADC__1_1_0_S6_S3 1 100 -40 500 DISPLAY_IDENTIFIER k_zu_temp._.cSchaltung.iSchaltungVerz.iAzsKupMassnahmenKoord ECU_ADDRESS 0xFFF8C864 /end MEASUREMENT
/begin MEASUREMENT iAzsKupMassnahmenKoord.iSchaltungVerz.cSchaltung._.kup_mass "Kupplung deren Temp. zu der Massnahme geführt hat. Falls bei einer Rückschaltung beide Kup.-Temp. über der Grenze liegen, dann wird die größte zurückgeliefert." UBYTE Conv.cSchaltung._.kup_mass_S6_S3 1 100 0 5 DISPLAY_IDENTIFIER kup_mass._.cSchaltung.iSchaltungVerz.iAzsKupMassnahmenKoord ECU_ADDRESS 0xFFF8C866 /end MEASUREMENT
/begin MEASUREMENT iAzsKupMassnahmenKoord.iSchaltungVerz.cSchaltung._.k_ab "Kupplung deren Temp. zu der Massnahme geführt hat. Falls bei einer Rückschaltung beide Kup.-Temp. über der Grenze liegen, dann wird die größte zurückgeliefert." UBYTE Conv.cSchaltung._.k_ab_S6_S3 1 100 0 5 DISPLAY_IDENTIFIER k_ab._.cSchaltung.iSchaltungVerz.iAzsKupMassnahmenKoord ECU_ADDRESS 0xFFF8C867 /end MEASUREMENT
/begin MEASUREMENT iAzsKupMassnahmenKoord.iSchaltungVerz.cSchaltung._.k_zu "Kupplung deren Temp. zu der Massnahme geführt hat. Falls bei einer Rückschaltung beide Kup.-Temp. über der Grenze liegen, dann wird die größte zurückgeliefert." UBYTE Conv.cSchaltung._.k_zu_S6_S3 1 100 0 5 DISPLAY_IDENTIFIER k_zu._.cSchaltung.iSchaltungVerz.iAzsKupMassnahmenKoord ECU_ADDRESS 0xFFF8C868 /end MEASUREMENT
/begin MEASUREMENT iAzsKupMassnahmenKoord.iSchaltungVerz.cSchaltung._.schaltart "Schaltart der aktuellen Schaltung" UBYTE Conv.cSchaltung._.schaltart_S6_S3 1 100 0 2 DISPLAY_IDENTIFIER schaltart._.cSchaltung.iSchaltungVerz.iAzsKupMassnahmenKoord ECU_ADDRESS 0xFFF8C869 /end MEASUREMENT
/begin MEASUREMENT iAzsKupMassnahmenKoord.iSchaltungVerz.cSchaltung._.istgang "current gear" SBYTE Conv.cSchaltung._.istgang_S6_S3 1 100 0 2 DISPLAY_IDENTIFIER istgang._.cSchaltung.iSchaltungVerz.iAzsKupMassnahmenKoord ECU_ADDRESS 0xFFF8C86A /end MEASUREMENT
/begin MEASUREMENT iAzsKupMassnahmenKoord.iSchaltungVerz.cSchaltung._.zielgang_sas "target gear (sas)" SBYTE Conv.cSchaltung._.zielgang_sas_S6_S3 1 100 0 2 DISPLAY_IDENTIFIER zielgang_sas._.cSchaltung.iSchaltungVerz.iAzsKupMassnahmenKoord ECU_ADDRESS 0xFFF8C86B /end MEASUREMENT
/begin MEASUREMENT iAzsKupMassnahmenKoord.iSchaltungVerz.iVerzZeit.time "Zeit des Timers" UWORD UMR_SEC__1_100_0_S6_S3 1 100 0 655.35 DISPLAY_IDENTIFIER iVerzZeit.iSchaltungVerz.iAzsKupMassnahmenKoord ECU_ADDRESS 0xFFF8C876 /end MEASUREMENT
/begin MEASUREMENT iAzsKupMassnahmenKoord.iSchaltungVerz.sollgang "Sollgang-Gang" SBYTE Conv.cSchaltungMitVerzoegerung._.sollgang_S6_S3 1 100 -1 8 DISPLAY_IDENTIFIER sollgang.iSchaltungVerz.iAzsKupMassnahmenKoord ECU_ADDRESS 0xFFF8C870 /end MEASUREMENT
/begin MEASUREMENT iAzsKupMassnahmenKoord.iSchaltungVerz.k_a_schalt_verh "Die K_A hat eine Schaltungsverhinderung ausgelöst." UBYTE Conv.cSchaltungMitVerzoegerung._.k_a_schalt_verh_S6_S3 1 100 0 1 BIT_MASK 0x1 DISPLAY_IDENTIFIER k_a_schalt_verh.iSchaltungVerz.iAzsKupMassnahmenKoord ECU_ADDRESS 0xFFF8C871 /end MEASUREMENT
/begin MEASUREMENT iAzsKupMassnahmenKoord.iSchaltungVerz.k_b_schalt_verh "Die K_B hat eine Schaltungsverhinderung ausgelöst." UBYTE Conv.cSchaltungMitVerzoegerung._.k_b_schalt_verh_S6_S3 1 100 0 1 BIT_MASK 0x1 DISPLAY_IDENTIFIER k_b_schalt_verh.iSchaltungVerz.iAzsKupMassnahmenKoord ECU_ADDRESS 0xFFF8C872 /end MEASUREMENT
/begin MEASUREMENT iAzsKupMassnahmenKoord.iSchaltungVerz.k_c_schalt_verh "Die K_C hat eine Schaltungsverhinderung ausgelöst." UBYTE Conv.cSchaltungMitVerzoegerung._.k_c_schalt_verh_S6_S3 1 100 0 1 BIT_MASK 0x1 DISPLAY_IDENTIFIER k_c_schalt_verh.iSchaltungVerz.iAzsKupMassnahmenKoord ECU_ADDRESS 0xFFF8C873 /end MEASUREMENT
/begin MEASUREMENT iAzsKupMassnahmenKoord.iSchaltungVerz.k_d_schalt_verh "Die K_D hat eine Schaltungsverhinderung ausgelöst." UBYTE Conv.cSchaltungMitVerzoegerung._.k_d_schalt_verh_S6_S3 1 100 0 1 BIT_MASK 0x1 DISPLAY_IDENTIFIER k_d_schalt_verh.iSchaltungVerz.iAzsKupMassnahmenKoord ECU_ADDRESS 0xFFF8C874 /end MEASUREMENT
/begin MEASUREMENT iAzsKupMassnahmenKoord.iSchaltungVerz.k_e_schalt_verh "Die K_E hat eine Schaltungsverhinderung ausgelöst." UBYTE Conv.cSchaltungMitVerzoegerung._.k_e_schalt_verh_S6_S3 1 100 0 1 BIT_MASK 0x1 DISPLAY_IDENTIFIER k_e_schalt_verh.iSchaltungVerz.iAzsKupMassnahmenKoord ECU_ADDRESS 0xFFF8C875 /end MEASUREMENT
/begin MEASUREMENT iAzsKupMassnahmenKoord.iSchaltungTrans.manuell "Speichert ob es sich bei der aktuellen Schaltung um eine Manuelle o. nicht handelt" UBYTE Conv.cSchaltung._.manuell_S6_S3 1 100 1 255 DISPLAY_IDENTIFIER manuell.iSchaltungTrans.iAzsKupMassnahmenKoord ECU_ADDRESS 0xFFF8C878 /end MEASUREMENT
/begin MEASUREMENT iAzsKupMassnahmenKoord.iSchaltungTrans.temp_schwelle_k_zu "Temperaturschwelle auf die aktuell geschaut wird" UWORD UMR_GRADC__1_1_0_S6_S3 1 100 0 65535 DISPLAY_IDENTIFIER temp_schwelle_k_zu.iSchaltungTrans.iAzsKupMassnahmenKoord ECU_ADDRESS 0xFFF8C87A /end MEASUREMENT
/begin MEASUREMENT iAzsKupMassnahmenKoord.iSchaltungTrans.temp_schwelle_k_ab "Temperaturschwelle auf die aktuell geschaut wird" UWORD UMR_GRADC__1_1_0_S6_S3 1 100 0 65535 DISPLAY_IDENTIFIER temp_schwelle_k_ab.iSchaltungTrans.iAzsKupMassnahmenKoord ECU_ADDRESS 0xFFF8C87C /end MEASUREMENT
/begin MEASUREMENT iAzsKupMassnahmenKoord.iSchaltungTrans.temp_schwelle_hys_k_zu "Temparaturschwelle - Hysterese" UWORD UMR_GRADC__1_1_0_S6_S3 1 100 0 65535 DISPLAY_IDENTIFIER temp_schwelle_hys_k_zu.iSchaltungTrans.iAzsKupMassnahmenKoord ECU_ADDRESS 0xFFF8C87E /end MEASUREMENT
/begin MEASUREMENT iAzsKupMassnahmenKoord.iSchaltungTrans.temp_schwelle_hys_k_ab "Temparaturschwelle - Hysterese" UWORD UMR_GRADC__1_1_0_S6_S3 1 100 0 65535 DISPLAY_IDENTIFIER temp_schwelle_hys_k_ab.iSchaltungTrans.iAzsKupMassnahmenKoord ECU_ADDRESS 0xFFF8C880 /end MEASUREMENT
/begin MEASUREMENT iAzsKupMassnahmenKoord.iSchaltungTrans.k_ab_temp "Temperatur der abschaltenden Kupplung" SWORD UMR_GRADC__1_1_0_S6_S3 1 100 -40 500 DISPLAY_IDENTIFIER k_ab_temp.iSchaltungTrans.iAzsKupMassnahmenKoord ECU_ADDRESS 0xFFF8C882 /end MEASUREMENT
/begin MEASUREMENT iAzsKupMassnahmenKoord.iSchaltungTrans.k_zu_temp "Temperatur der zuschaltenden Kupplung" SWORD UMR_GRADC__1_1_0_S6_S3 1 100 -40 500 DISPLAY_IDENTIFIER k_zu_temp.iSchaltungTrans.iAzsKupMassnahmenKoord ECU_ADDRESS 0xFFF8C884 /end MEASUREMENT
/begin MEASUREMENT iAzsKupMassnahmenKoord.iSchaltungTrans.kup_mass "Kupplung deren Temp. zu der Massnahme geführt hat. Falls bei einer Rückschaltung beide Kup.-Temp. über der Grenze liegen, dann wird die größte zurückgeliefert." UBYTE Conv.cSchaltung._.kup_mass_S6_S3 1 100 0 5 DISPLAY_IDENTIFIER kup_mass.iSchaltungTrans.iAzsKupMassnahmenKoord ECU_ADDRESS 0xFFF8C886 /end MEASUREMENT
/begin MEASUREMENT iAzsKupMassnahmenKoord.iSchaltungTrans.k_ab "Kupplung deren Temp. zu der Massnahme geführt hat. Falls bei einer Rückschaltung beide Kup.-Temp. über der Grenze liegen, dann wird die größte zurückgeliefert." UBYTE Conv.cSchaltung._.k_ab_S6_S3 1 100 0 5 DISPLAY_IDENTIFIER k_ab.iSchaltungTrans.iAzsKupMassnahmenKoord ECU_ADDRESS 0xFFF8C887 /end MEASUREMENT
/begin MEASUREMENT iAzsKupMassnahmenKoord.iSchaltungTrans.k_zu "Kupplung deren Temp. zu der Massnahme geführt hat. Falls bei einer Rückschaltung beide Kup.-Temp. über der Grenze liegen, dann wird die größte zurückgeliefert." UBYTE Conv.cSchaltung._.k_zu_S6_S3 1 100 0 5 DISPLAY_IDENTIFIER k_zu.iSchaltungTrans.iAzsKupMassnahmenKoord ECU_ADDRESS 0xFFF8C888 /end MEASUREMENT
/begin MEASUREMENT iAzsKupMassnahmenKoord.iSchaltungTrans.schaltart "Schaltart der aktuellen Schaltung" UBYTE Conv.cSchaltung._.schaltart_S6_S3 1 100 0 2 DISPLAY_IDENTIFIER schaltart.iSchaltungTrans.iAzsKupMassnahmenKoord ECU_ADDRESS 0xFFF8C889 /end MEASUREMENT
/begin MEASUREMENT iAzsKupMassnahmenKoord.iSchaltungTrans.istgang "current gear" SBYTE Conv.cSchaltung._.istgang_S6_S3 1 100 0 2 DISPLAY_IDENTIFIER istgang.iSchaltungTrans.iAzsKupMassnahmenKoord ECU_ADDRESS 0xFFF8C88A /end MEASUREMENT
/begin MEASUREMENT iAzsKupMassnahmenKoord.iSchaltungTrans.zielgang_sas "target gear (sas)" SBYTE Conv.cSchaltung._.zielgang_sas_S6_S3 1 100 0 2 DISPLAY_IDENTIFIER zielgang_sas.iSchaltungTrans.iAzsKupMassnahmenKoord ECU_ADDRESS 0xFFF8C88B /end MEASUREMENT
/begin MEASUREMENT iAzsKupMassnahmenKoord.reduzierung_m_mot_max "Reduzierung des max. Motormoments auf Grund eines überhitzten Schaltelements." UBYTE Conv.cAzsKupMassnahmenKoord._.reduzierung_m_mot_max_S6_S3 1 100 0 3 DISPLAY_IDENTIFIER reduzierung_m_mot_max.iAzsKupMassnahmenKoord ECU_ADDRESS 0xFFF8C850 /end MEASUREMENT
/begin MEASUREMENT iAzsKupMassnahmenKoord.beeinfl_spont_index "Beeinflussung des Spontanitätsindex auf Grund eines überhitzten Schaltelements." UBYTE Conv.cAzsKupMassnahmenKoord._.beeinfl_spont_index_S6_S3 1 100 0 3 DISPLAY_IDENTIFIER beeinfl_spont_index.iAzsKupMassnahmenKoord ECU_ADDRESS 0xFFF8C851 /end MEASUREMENT
/begin MEASUREMENT iAzsKupMassnahmenKoord.zustand_schaltungsverh "Gibt an ob die aktuelle Schaltung verhindert werden soll." UBYTE Conv.cAzsKupMassnahmenKoord._.zustand_schaltungsverh_S6_S3 1 100 0 2 DISPLAY_IDENTIFIER zustand_schaltungsverh.iAzsKupMassnahmenKoord ECU_ADDRESS 0xFFF8C852 /end MEASUREMENT
/begin MEASUREMENT iAzsKupMassnahmenKoord.versch_schalt_verh "In der Messgröße wird gespeichert ob eine verschachtelte Schaltung verhindert wird." UBYTE Conv.cAzsKupMassnahmenKoord._.versch_schalt_verh_S6_S3 1 100 0 1 BIT_MASK 0x1 DISPLAY_IDENTIFIER versch_schalt_verh.iAzsKupMassnahmenKoord ECU_ADDRESS 0xFFF8C853 /end MEASUREMENT
/begin MEASUREMENT iAzsKupMassnahmenKoord.kup_mass_global "Ueberhizte Kupplung" UBYTE Conv.cAzsKupMassnahmenKoord._.kup_mass_global_S6_S3 1 100 0 5 DISPLAY_IDENTIFIER kup_mass_global.iAzsKupMassnahmenKoord ECU_ADDRESS 0xFFF8C854 /end MEASUREMENT
/begin MEASUREMENT iAzsKupMassnahmenKoord.c_kup_mass_global "Kupplungtemperatur" UWORD UMR___1_1_0_S6_S3 1 100 0 500 DISPLAY_IDENTIFIER c_kup_mass_global.iAzsKupMassnahmenKoord ECU_ADDRESS 0xFFF8C856 /end MEASUREMENT
/begin MEASUREMENT iBihMomenHsHss.iTimerGesamtHssStartRampe3.timer "Der aktuelle Timerwert" UWORD UMR_MSEC__10_1_0_S6_S3 1 100 0 655350 DISPLAY_IDENTIFIER iTimerGesamtHssStartRampe3.iBihMomenHsHss ECU_ADDRESS 0xFFF8C930 /end MEASUREMENT
/begin MEASUREMENT iBihMomenHsHss.iTimerGesamtHssPhase.timer "Der aktuelle Timerwert" UWORD UMR_MSEC__10_1_0_S6_S3 1 100 0 655350 DISPLAY_IDENTIFIER iTimerGesamtHssPhase.iBihMomenHsHss ECU_ADDRESS 0xFFF8C932 /end MEASUREMENT
/begin MEASUREMENT iBihMomenHsHss.z_mmotmax_hss "Zustand mmot_max- Begrenzungwaehrend einer Hochschaltung" UBYTE Conv.cBihMomenHsHss._.z_mmotmax_hss_S6_S3 1 100 0 4 DISPLAY_IDENTIFIER z_mmotmax_hss.iBihMomenHsHss ECU_ADDRESS 0xFFF8C90C /end MEASUREMENT
/begin MEASUREMENT iBihMomenHsHss.m_motmax_hss "maximal zulaessiges Getr.moment waehrend einer Hochschaltung" SWORD UMR_NM__1_1_0_S6_S3 1 100 -400 1640 DISPLAY_IDENTIFIER m_motmax_hss.iBihMomenHsHss ECU_ADDRESS 0xFFF8C90E /end MEASUREMENT
/begin MEASUREMENT iBihMomenHsHss.me_sas_hss "waehrend der Begrenzung die interne me_sas Werte" SWORD UMR_NM__1_1_0_S6_S3 1 100 -400 1640 DISPLAY_IDENTIFIER me_sas_hss.iBihMomenHsHss ECU_ADDRESS 0xFFF8C910 /end MEASUREMENT
/begin MEASUREMENT iBihMomenHsHss.m_mot_hss "waehrend der Begrenzung die interne m_mot Werte" SWORD UMR_NM__1_1_0_S6_S3 1 100 -400 1640 DISPLAY_IDENTIFIER m_mot_hss.iBihMomenHsHss ECU_ADDRESS 0xFFF8C912 /end MEASUREMENT
/begin MEASUREMENT iBihMomenHsHss.hss_momotmaxndhss "Sicherheitsmomentenoffset bei Ruecknahme Sonderfunktion, HSS" UWORD UMR_NM__1_1_0_S6_S3 1 100 0 65535 DISPLAY_IDENTIFIER hss_momotmaxndhss.iBihMomenHsHss ECU_ADDRESS 0xFFF8C914 /end MEASUREMENT
/begin MEASUREMENT iBihMomenHsHss.hss_tvsyncghss "Start der Sonderfunktion mit Zeit vor/ nach Synchron" UWORD UMR_MSEC__10_1_0_S6_S3 1 100 0 655350 DISPLAY_IDENTIFIER hss_tvsyncghss.iBihMomenHsHss ECU_ADDRESS 0xFFF8C916 /end MEASUREMENT
/begin MEASUREMENT iBihMomenHsHss.hss_m_motmaxhss_hys "Motmax Hysterese" UWORD UMR_NM__1_1_0_S6_S3 1 100 0 65535 DISPLAY_IDENTIFIER hss_m_motmaxhss_hys.iBihMomenHsHss ECU_ADDRESS 0xFFF8C918 /end MEASUREMENT
/begin MEASUREMENT iBihMomenHsHss.zielgang_hss "Zielgang" SBYTE Conv.cBihMomenHsHss._.zielgang_hss_S6_S3 1 100 -1 8 DISPLAY_IDENTIFIER zielgang_hss.iBihMomenHsHss ECU_ADDRESS 0xFFF8C91A /end MEASUREMENT
/begin MEASUREMENT iBihMomenHsHss.istgang_hss "Istgang" SBYTE Conv.cBihMomenHsHss._.istgang_hss_S6_S3 1 100 -1 8 DISPLAY_IDENTIFIER istgang_hss.iBihMomenHsHss ECU_ADDRESS 0xFFF8C91B /end MEASUREMENT
/begin MEASUREMENT iBihNeigungssignal.steigung_hang_filter "-" SWORD UMR___1_1_0_S6_S3 1 100 -32768 32767 DISPLAY_IDENTIFIER steigung_hang_filter.iBihNeigungssignal ECU_ADDRESS 0xFFF8C93C /end MEASUREMENT
/begin MEASUREMENT iBihNeigungssignal.timer_neigung "Timer Neigung" UBYTE UMR_MSEC__10_1_0_S6_S3 1 100 0 2550 DISPLAY_IDENTIFIER timer_neigung.iBihNeigungssignal ECU_ADDRESS 0xFFF8C93E /end MEASUREMENT
/begin MEASUREMENT iBihMeRedAbs.me_red_abs "ausgegebene Motormoment als Absolutmoment" SWORD UMR_NM__1_1_0_S6_S3 1 100 -2000 2000 DISPLAY_IDENTIFIER me_red_abs.iBihMeRedAbs ECU_ADDRESS 0xFFF8A0AE /end MEASUREMENT
/begin MEASUREMENT iBihMeRedAbs.me_red_abs_komp "ausgegebene Motormoment als Absolutmoment" SWORD UMR_NM__1_1_0_S6_S3 1 100 -2001 1999 DISPLAY_IDENTIFIER me_red_abs_komp.iBihMeRedAbs ECU_ADDRESS 0xFFF8A0B0 /end MEASUREMENT
/begin MEASUREMENT iBihMeRedAbs.me_red_status "Status von me_red_abs" UBYTE Conv.cBihMeRedAbs._.me_red_status_S6_S3 1 100 0 3 DISPLAY_IDENTIFIER me_red_status.iBihMeRedAbs ECU_ADDRESS 0xFFF8A0B2 /end MEASUREMENT
/begin MEASUREMENT iBihMeRedAbs.me_red_status_komp "Status von me_red_abs" UBYTE Conv.cBihMeRedAbs._.me_red_status_komp_S6_S3 1 100 0 255 DISPLAY_IDENTIFIER me_red_status_komp.iBihMeRedAbs ECU_ADDRESS 0xFFF8A0B3 /end MEASUREMENT
/begin MEASUREMENT iBihHotmode.c_maxhotmode "Max(Getriebetemperatur,Chiptemperatur)" UBYTE UMR_GRADC__1_1_M40_S6_S3 1 100 -40 215 DISPLAY_IDENTIFIER c_maxhotmode.iBihHotmode ECU_ADDRESS 0xFFF8A3A1 /end MEASUREMENT
/begin MEASUREMENT iBihMobef.me_abs "Angefordertes Motormoment als Absolutmoment gesamt" SWORD UMR_NM__1_1_0_S6_S3 1 100 -2000 2000 DISPLAY_IDENTIFIER me_abs.iBihMobef ECU_ADDRESS 0xFFF8C8B8 /end MEASUREMENT
/begin MEASUREMENT iBihMobef.me_diff "ausgegebenes Momentenveränderung als Differenz zu m_mot in Nm" SWORD UMR_NM__1_1_0_S6_S3 1 100 -2000 2000 DISPLAY_IDENTIFIER me_diff.iBihMobef ECU_ADDRESS 0xFFF8C8BA /end MEASUREMENT
/begin MEASUREMENT iBihMobef.timer_notlaufsprung "Timer Getriebeschutz Notlaufsprung" UBYTE UMR_MSEC__10_1_0_S6_S3 1 100 0 2550 DISPLAY_IDENTIFIER timer_notlaufsprung.iBihMobef ECU_ADDRESS 0xFFF8C8BC /end MEASUREMENT
/begin MEASUREMENT iBihMobef.flag_schlupf_psyseff "Schlupferkennung fuer Effizienzsystemdruck aktiv/nicht aktiv" UBYTE Conv.cBihMobef._.flag_schlupf_psyseff_S6_S3 1 100 0 1 BIT_MASK 0x1 DISPLAY_IDENTIFIER flag_schlupf_psyseff.iBihMobef ECU_ADDRESS 0xFFF8C8BD /end MEASUREMENT
/begin MEASUREMENT iBihMobef.nd_synmmotmax "nd_syn fuer gefuehrter Getriebeschutz" SWORD UMR_U_MIN_1_1_0_S6_S3 1 100 -8160 8160 DISPLAY_IDENTIFIER nd_synmmotmax.iBihMobef ECU_ADDRESS 0xFFF8C8BE /end MEASUREMENT
/begin MEASUREMENT iBihMobef.timer_ra_m_motmax "Timer Rampe Berechnung m_motmax" UBYTE UMR_MSEC__10_1_0_S6_S3 1 100 0 2550 DISPLAY_IDENTIFIER timer_ra_m_motmax.iBihMobef ECU_ADDRESS 0xFFF8C8C0 /end MEASUREMENT
/begin MEASUREMENT iBihMobef.m_motmax_getr_neu "maximal zulaessiges Getr.moment ohne Sicherheit neuer Wert" SWORD UMR_NM__1_1_0_S6_S3 1 100 0 1640 DISPLAY_IDENTIFIER m_motmax_getr_neu.iBihMobef ECU_ADDRESS 0xFFF8C8C2 /end MEASUREMENT
/begin MEASUREMENT iBihMobef.m_motmax_getr_alt "maximal zulaessiges Getr.moment ohne Sicherheit alter Wert" SWORD UMR_NM__1_1_0_S6_S3 1 100 0 1640 DISPLAY_IDENTIFIER m_motmax_getr_alt.iBihMobef ECU_ADDRESS 0xFFF8C8C4 /end MEASUREMENT
/begin MEASUREMENT iBihMobef.m_motmax_getr "maximal zulaessiges Getr.moment ohne Sicherheit aktueller Wert" SWORD UMR_NM__1_1_0_S6_S3 1 100 0 1640 DISPLAY_IDENTIFIER m_motmax_getr.iBihMobef ECU_ADDRESS 0xFFF8C8C6 /end MEASUREMENT
/begin MEASUREMENT iBihMobef.funk_ge_mmotmax "Aktives KF fuer Momentanbestimmung bei aktivem GE" SWORD Conv.cBihMobef._.funk_ge_mmotmax_S6_S3 1 100 0 6 DISPLAY_IDENTIFIER funk_ge_mmotmax.iBihMobef ECU_ADDRESS 0xFFF8C8C8 /end MEASUREMENT
/begin MEASUREMENT iBihMobef.timer_vstall "Timer Rampe verzoegerung Schutzfunktion Antiebsstrang" UBYTE UMR_MSEC__10_1_0_S6_S3 1 100 0 2550 DISPLAY_IDENTIFIER timer_vstall.iBihMobef ECU_ADDRESS 0xFFF8C8CA /end MEASUREMENT
/begin MEASUREMENT iBihMobef.z_m_motmax_kor_strang "Zustand gef. Getriebeschutz bei Stallspeed Antriebsstranschutz" UBYTE Conv.cBihMobef._.z_m_motmax_kor_strang_S6_S3 1 100 0 2 DISPLAY_IDENTIFIER z_m_motmax_kor_strang.iBihMobef ECU_ADDRESS 0xFFF8C8CB /end MEASUREMENT
/begin MEASUREMENT iBihMobef.m_motmax_stall "min. Auswahl zwischen m_motmax_strang und m_motmax_wd" SWORD UMR_NM__1_1_0_S6_S3 1 100 0 1640 DISPLAY_IDENTIFIER m_motmax_stall.iBihMobef ECU_ADDRESS 0xFFF8C8CC /end MEASUREMENT
/begin MEASUREMENT iBihMobef.m_motmax_strang "maximal zulaessiges Getr.moment bei Stallspeed zum Strangschutz" SWORD UMR_NM__1_1_0_S6_S3 1 100 0 1640 DISPLAY_IDENTIFIER m_motmax_strang.iBihMobef ECU_ADDRESS 0xFFF8C8CE /end MEASUREMENT
/begin MEASUREMENT iBihMobef.f_rganglimitaktiv "Einstiegsbedingung R-Ganglimit erfüllt" UBYTE Conv.cBihMobef._.f_rganglimitaktiv_S6_S3 1 100 0 1 BIT_MASK 0x1 DISPLAY_IDENTIFIER f_rganglimitaktiv.iBihMobef ECU_ADDRESS 0xFFF8C8D0 /end MEASUREMENT
/begin MEASUREMENT iBihMobef.fl_meschlupfaktiv "FLAG: Zur Kennzeichnung, ob Schlupferkennung in aktuellen Gang aktiv war" UBYTE Conv.cBihMobef._.fl_meschlupfaktiv_S6_S3 1 100 0 1 BIT_MASK 0x1 DISPLAY_IDENTIFIER fl_meschlupfaktiv.iBihMobef ECU_ADDRESS 0xFFF8C8D1 /end MEASUREMENT
/begin MEASUREMENT iBihMobef.flag_meschlupf "Getriebeschutz wegen Schlupferkennung ausserhalb Schaltung aktiv/nicht aktiv" UBYTE Conv.cBihMobef._.flag_meschlupf_S6_S3 1 100 0 1 BIT_MASK 0x1 DISPLAY_IDENTIFIER flag_meschlupf.iBihMobef ECU_ADDRESS 0xFFF8C8D2 /end MEASUREMENT
/begin MEASUREMENT iBihMobef.counter_meschlupf "Zähler zur Erfassung der Anzahl an Momenteneingriffen aufgrund schlupfender Kupplungen" UWORD UMR___1_1_0_S6_S3 1 100 0 65535 DISPLAY_IDENTIFIER counter_meschlupf.iBihMobef ECU_ADDRESS 0xFFF8C8D4 /end MEASUREMENT
/begin MEASUREMENT iBihMobef.nd_synschutz "nd_syn fuer gefuehrter Getriebeschutz bei Schlupf" SWORD UMR_U_MIN_1_1_0_S6_S3 1 100 -8160 8160 DISPLAY_IDENTIFIER nd_synschutz.iBihMobef ECU_ADDRESS 0xFFF8C8D6 /end MEASUREMENT
/begin MEASUREMENT iBihMobef.timer16_meuw "Timer Motoreingriffszeitueberwachung" UWORD UMR_MSEC__10_1_0_S6_S3 1 100 0 655350 DISPLAY_IDENTIFIER timer16_meuw.iBihMobef ECU_ADDRESS 0xFFF8C8D8 /end MEASUREMENT
/begin MEASUREMENT iBihMobef.timer_metot "Timer ME-Unterbrechung" UBYTE UMR_MSEC__10_1_0_S6_S3 1 100 0 2550 DISPLAY_IDENTIFIER timer_metot.iBihMobef ECU_ADDRESS 0xFFF8C8DA /end MEASUREMENT
/begin MEASUREMENT iBihMobef.timer_m_motmax_schlupf_aktiv "Timer fuer gef. Getriebeschutz bei Schlupf" UWORD UMR_MSEC__10_1_0_S6_S3 1 100 0 655350 DISPLAY_IDENTIFIER timer_m_motmax_schlupf_aktiv.iBihMobef ECU_ADDRESS 0xFFF8C8DC /end MEASUREMENT
/begin MEASUREMENT iBihMobef.timer_ra_m_motmax_schlupf "Timer fuer Aufregelrampe gef. Getriebeschutz bei Schlupf" UBYTE UMR_MSEC__10_1_0_S6_S3 1 100 0 2550 DISPLAY_IDENTIFIER timer_ra_m_motmax_schlupf.iBihMobef ECU_ADDRESS 0xFFF8C8DE /end MEASUREMENT
/begin MEASUREMENT iBihMobef.z_m_motmax_schlupf "Zustand m_motmax bei Schlupf" UBYTE Conv.cBihMobef._.z_m_motmax_schlupf_S6_S3 1 100 0 2 DISPLAY_IDENTIFIER z_m_motmax_schlupf.iBihMobef ECU_ADDRESS 0xFFF8C8DF /end MEASUREMENT
/begin MEASUREMENT iBihMobef.m_getrmax_schlupf "maximal zulaessiges Getr.moment bei Schlupf (noch ohne Sicherheit)" SWORD UMR_NM__1_1_0_S6_S3 1 100 0 1640 DISPLAY_IDENTIFIER m_getrmax_schlupf.iBihMobef ECU_ADDRESS 0xFFF8C8E0 /end MEASUREMENT
/begin MEASUREMENT iBihMobef.m_t_meschlupfaktiv "Wert des Turbinenmoments zum Zeitpunkt der Berechnung von m_getrmax_schlupf" SWORD UMR_NM__1_1_0_S6_S3 1 100 0 1640 DISPLAY_IDENTIFIER m_t_meschlupfaktiv.iBihMobef ECU_ADDRESS 0xFFF8C8E2 /end MEASUREMENT
/begin MEASUREMENT iBihMobef.m_motortraegheit "berechnete Motortraegheit" UBYTE UMR_NM__1_1_0_S6_S3 1 100 0 250 DISPLAY_IDENTIFIER m_motortraegheit.iBihMobef ECU_ADDRESS 0xFFF8C8E4 /end MEASUREMENT
/begin MEASUREMENT iBihMobef.timer_ndsynme "Zustandstimer für Geführten Getriebeschutz bei Schlupferkennung" UWORD UMR_MSEC__10_1_0_S6_S3 1 100 0 655350 DISPLAY_IDENTIFIER timer_ndsynme.iBihMobef ECU_ADDRESS 0xFFF8C8E6 /end MEASUREMENT
/begin MEASUREMENT iBihMobef.timer_ndsynpsyseff "Zustandstimer für Schlupferkennung für Effizienzsystemdruck" UWORD UMR_MSEC__10_1_0_S6_S3 1 100 0 655350 DISPLAY_IDENTIFIER timer_ndsynpsyseff.iBihMobef ECU_ADDRESS 0xFFF8C8E8 /end MEASUREMENT
/begin MEASUREMENT iBihMomen.TimerK0Verlust.time "Zeit des Timers" UWORD UMR_SEC__1_100_0_S6_S3 1 100 0 655.35 DISPLAY_IDENTIFIER TimerK0Verlust.iBihMomen ECU_ADDRESS 0xFFF8A0C0 /end MEASUREMENT
/begin MEASUREMENT iBihMomen.md_motsollist "m_motsoll-m_motkor_in, Eingangsgroesse fuer KL_FGMMOTMDMOT" SWORD UMR_NM__1_1_0_S6_S3 1 100 -400 1640 DISPLAY_IDENTIFIER md_motsollist.iBihMomen ECU_ADDRESS 0xFFF8A0B4 /end MEASUREMENT
/begin MEASUREMENT iBihMomen.m_ab_dyn "Dynamisches Abtriebsmoment" SWORD UMR_NM__1_1_0_S6_S3 1 100 -32768 32767 DISPLAY_IDENTIFIER m_ab_dyn.iBihMomen ECU_ADDRESS 0xFFF8A0B6 /end MEASUREMENT
/begin MEASUREMENT iBihMomen.m_getrverl "Getriebeverlustmoment" SWORD UMR_NM__1_1_0_S6_S3 1 100 0 200 DISPLAY_IDENTIFIER m_getrverl.iBihMomen ECU_ADDRESS 0xFFF8A0B8 /end MEASUREMENT
/begin MEASUREMENT iBihMomen.z_t_mverl_k0 "Zustandsgröße" UBYTE Conv.cBihMomen._.z_t_mverl_k0_S6_S3 1 100 0 2 DISPLAY_IDENTIFIER z_t_mverl_k0.iBihMomen ECU_ADDRESS 0xFFF8A0BA /end MEASUREMENT
/begin MEASUREMENT iBihMomen.n_tsynist "Synchrondrehzahl der Turbine bei aktueller Abtriebsdrehzahl n_ab und eingelegtem Istgang" SWORD UMR_U_MIN_1_1_0_S6_S3 1 100 0 32767 DISPLAY_IDENTIFIER n_tsynist.iBihMomen ECU_ADDRESS 0xFFF8A0BC /end MEASUREMENT
/begin MEASUREMENT iBihMomen.n_tsynziel "Synchrondrehzahl der Turbine bei aktueller Abtriebsdrehzahl n_ab und eingelegtem Zielgang_sas" SWORD UMR_U_MIN_1_1_0_S6_S3 1 100 0 32767 DISPLAY_IDENTIFIER n_tsynziel.iBihMomen ECU_ADDRESS 0xFFF8A0BE /end MEASUREMENT
/begin MEASUREMENT iBihSigna.timer_zielgang_aenderung.timer "Der aktuelle Timerwert" UBYTE UMR_MSEC__10_1_0_S6_S3 1 100 0 2550 DISPLAY_IDENTIFIER timer_zielgang_aenderung.iBihSigna ECU_ADDRESS 0xFFF8C952 /end MEASUREMENT
/begin MEASUREMENT iBihSigna.timer_sbc_aktiv.timer "Der aktuelle Timerwert" UBYTE UMR_MSEC__10_1_0_S6_S3 1 100 0 2550 DISPLAY_IDENTIFIER timer_sbc_aktiv.iBihSigna ECU_ADDRESS 0xFFF8C953 /end MEASUREMENT
/begin MEASUREMENT iBihSigna.fl_req_deactvt_actv_dampg "Deaktivierung aktive Schwingungsdaempfung" UBYTE Conv.cBihSigna._.fl_req_deactvt_actv_dampg_S6_S3 1 100 0 1 BIT_MASK 0x1 DISPLAY_IDENTIFIER fl_req_deactvt_actv_dampg.iBihSigna ECU_ADDRESS 0xFFF8C948 /end MEASUREMENT
/begin MEASUREMENT iBihSigna.bremsbed "Bremsbedingung mit Feststellbremse" UBYTE Conv.cBihSigna._.bremsbed_S6_S3 1 100 0 1 BIT_MASK 0x1 DISPLAY_IDENTIFIER bremsbed.iBihSigna ECU_ADDRESS 0xFFF8C949 /end MEASUREMENT
/begin MEASUREMENT iBihSigna.bremsbed_ofstb "Bremsbedingung ohne Feststellbremse" UBYTE Conv.cBihSigna._.bremsbed_ofstb_S6_S3 1 100 0 1 BIT_MASK 0x1 DISPLAY_IDENTIFIER bremsbed_ofstb.iBihSigna ECU_ADDRESS 0xFFF8C94A /end MEASUREMENT
/begin MEASUREMENT iBihSigna.z_sbc_timer "Zustand Timer umschaltung" UBYTE Conv.cBihSigna._.z_sbc_timer_S6_S3 1 100 0 2 DISPLAY_IDENTIFIER z_sbc_timer.iBihSigna ECU_ADDRESS 0xFFF8C94B /end MEASUREMENT
/begin MEASUREMENT iBihSigna.zeit_t_sbc_aktiv "Zeit fuer die der Wert 3 bei der Berechnung von GET_SBC_AKTIV gehalten wird" UWORD UMR___1_1_0_S6_S3 1 100 0 10000 DISPLAY_IDENTIFIER zeit_t_sbc_aktiv.iBihSigna ECU_ADDRESS 0xFFF8C94C /end MEASUREMENT
/begin MEASUREMENT iBihSigna.sbc_aktiv "Wert bei der Berechnung von GET_SBC_AKTIV gehalten wird" UBYTE UMR___1_1_0_S6_S3 1 100 0 10 DISPLAY_IDENTIFIER sbc_aktiv.iBihSigna ECU_ADDRESS 0xFFF8C94E /end MEASUREMENT
/begin MEASUREMENT iBihSigna.z_e_fahren_verzoegert "Zustandsgröße" UBYTE Conv.cBihSigna._.z_e_fahren_verzoegert_S6_S3 1 100 0 1 DISPLAY_IDENTIFIER z_e_fahren_verzoegert.iBihSigna ECU_ADDRESS 0xFFF8C94F /end MEASUREMENT
/begin MEASUREMENT iBihSigna.timer_sollgang_pruefung "-" UBYTE UMR___1_1_0_S6_S3 1 100 0 255 DISPLAY_IDENTIFIER timer_sollgang_pruefung.iBihSigna ECU_ADDRESS 0xFFF8C950 /end MEASUREMENT
/begin MEASUREMENT iBihPumpendruck.z_pumpendruck "Zustandsgroesse zur Bestimmung Pumpendruck vorhanden" UBYTE Conv.cBihPumpendruck._.z_pumpendruck_S6_S3 1 100 0 4 DISPLAY_IDENTIFIER z_pumpendruck.iBihPumpendruck ECU_ADDRESS 0xFFF8A3A4 /end MEASUREMENT
/begin MEASUREMENT iBihMPuauf.Pt1MPuAuf.x "Filterwert" SLONG UMR___1_300_0_S6_S3 1 100 -7158278.82667 7158278.82333 DISPLAY_IDENTIFIER Pt1MPuAuf.iBihMPuauf ECU_ADDRESS 0xFFF8C938 /end MEASUREMENT
/begin MEASUREMENT iBihMPuauf.m_puauf "Pumpenaufnahmemoment" SWORD UMR_NM__1_1_0_S6_S3 1 100 0 1640 DISPLAY_IDENTIFIER m_puauf.iBihMPuauf ECU_ADDRESS 0xFFF8C934 /end MEASUREMENT
/begin MEASUREMENT iBihMPuauf.n_mot_pu "Eingangsgroesse fuer KF_MPUAUF" UWORD UMR_U_MIN_1_1_0_S6_S3 1 100 0 10000 DISPLAY_IDENTIFIER n_mot_pu.iBihMPuauf ECU_ADDRESS 0xFFF8C936 /end MEASUREMENT
/begin MEASUREMENT iBihMGetrauf.m_getrauf "Getriebeaufnahmemoment" SWORD UMR_NM__1_1_0_S6_S3 1 100 -1200 1200 DISPLAY_IDENTIFIER m_getrauf.iBihMGetrauf ECU_ADDRESS 0xFFF8A0C2 /end MEASUREMENT
/begin MEASUREMENT iKorDraus.gwk_moeglich "Flag ob GWK-Betrieb moeglich ist" UBYTE Conv.cKorDraus._.gwk_moeglich_S6_S3 1 100 0 1 BIT_MASK 0x1 DISPLAY_IDENTIFIER gwk_moeglich.iKorDraus ECU_ADDRESS 0xFFF8A102 /end MEASUREMENT
/begin MEASUREMENT iKorDraus.k0_hydraulisch_moeglich "Flag ob K0-Betrieb hydraulisch moeglich ist" UBYTE Conv.cKorDraus._.k0_hydraulisch_moeglich_S6_S3 1 100 0 1 BIT_MASK 0x1 DISPLAY_IDENTIFIER k0_hydraulisch_moeglich.iKorDraus ECU_ADDRESS 0xFFF8A103 /end MEASUREMENT
/begin MEASUREMENT iKorDraus.st_k0_filling_mode "Befuellart der K0-Kupplung" UBYTE Conv.cKorDraus._.st_k0_filling_mode_S6_S3 1 100 0 3 DISPLAY_IDENTIFIER st_k0_filling_mode.iKorDraus ECU_ADDRESS 0xFFF8A104 /end MEASUREMENT
/begin MEASUREMENT iKorDraus.kup_pruefpuls "Kupplung, die mit einem Pruefpuls beaufschlagt wird" UBYTE Conv.cKorDraus._.kup_pruefpuls_S6_S3 1 100 0 6 DISPLAY_IDENTIFIER kup_pruefpuls.iKorDraus ECU_ADDRESS 0xFFF8A105 /end MEASUREMENT
/begin MEASUREMENT iKorDraus.kfl_zuletzt "Kraftfluss-Zustand, der zuletzt angenommen wurde" UBYTE Conv.cKorDraus._.kfl_zuletzt_S6_S3 1 100 0 2 DISPLAY_IDENTIFIER kfl_zuletzt.iKorDraus ECU_ADDRESS 0xFFF8A106 /end MEASUREMENT
/begin MEASUREMENT iKorDraus.gang_kfl_zuletzt "Gang, in dem zuletzt Kraftfluss erkannt wurde" SBYTE Conv.cKorDraus._.gang_kfl_zuletzt_S6_S3 1 100 -1 8 DISPLAY_IDENTIFIER gang_kfl_zuletzt.iKorDraus ECU_ADDRESS 0xFFF8A107 /end MEASUREMENT
/begin MEASUREMENT iKorDraus.kup_zu_in_n "Schliessende Kupplung in KEIN_KFL" UBYTE Conv.cKorDraus._.kup_zu_in_n_S6_S3 1 100 0 5 DISPLAY_IDENTIFIER kup_zu_in_n.iKorDraus ECU_ADDRESS 0xFFF8A108 /end MEASUREMENT
/begin MEASUREMENT iKorDraus.druckausgabe_kup_zu_in_n_aktiv "Flag ob Druckausgabe Schiessende Kuppung in KEIN_KFL aktiv ist" UBYTE Conv.cKorDraus._.druckausgabe_kup_zu_in_n_aktiv_S6_S3 1 100 0 1 BIT_MASK 0x1 DISPLAY_IDENTIFIER druckausgabe_kup_zu_in_n_aktiv.iKorDraus ECU_ADDRESS 0xFFF8A109 /end MEASUREMENT
/begin MEASUREMENT iKorDraus.kup_pf_in_n "Fülldruck-Kupplung in KEIN_KFL" UBYTE Conv.cKorDraus._.kup_pf_in_n_S6_S3 1 100 0 5 DISPLAY_IDENTIFIER kup_pf_in_n.iKorDraus ECU_ADDRESS 0xFFF8A10A /end MEASUREMENT
/begin MEASUREMENT iKorDraus.druckausgabe_kup_pf_in_n_aktiv "Flag ob Druckausgabe Fülldruck-Kuppung in KEIN_KFL aktiv ist" UBYTE Conv.cKorDraus._.druckausgabe_kup_pf_in_n_aktiv_S6_S3 1 100 0 1 BIT_MASK 0x1 DISPLAY_IDENTIFIER druckausgabe_kup_pf_in_n_aktiv.iKorDraus ECU_ADDRESS 0xFFF8A10B /end MEASUREMENT
/begin MEASUREMENT iKorDraus.p_kup_pf_in_n "Druckwert Fülldruck-Kupplung in KEIN_KFL" UWORD UMR_BAR__1_1000_0_S6_S3 1 100 0 20 DISPLAY_IDENTIFIER p_kup_pf_in_n.iKorDraus ECU_ADDRESS 0xFFF8A10C /end MEASUREMENT
/begin MEASUREMENT iKorDraus.statisch_p_kup_pf_in_n "Flag STATISCH zur Druckausgabe Fülldruck-Kuppung in KEIN_KFL" UBYTE Conv.cKorDraus._.statisch_p_kup_pf_in_n_S6_S3 1 100 0 1 BIT_MASK 0x1 DISPLAY_IDENTIFIER statisch_p_kup_pf_in_n.iKorDraus ECU_ADDRESS 0xFFF8A10E /end MEASUREMENT
/begin MEASUREMENT iKorDraus.timer_pof1kplbinn "Zeit seit Neustart für Druckoffset Kup. B in Neutral" UBYTE UMR_MSEC__10_1_0_S6_S3 1 100 0 2550 DISPLAY_IDENTIFIER timer_pof1kplbinn.iKorDraus ECU_ADDRESS 0xFFF8A10F /end MEASUREMENT
/begin MEASUREMENT iKorDraus.z_pof1kplbinn "Zustand Druckoffset P_OF1KPLBINN" UBYTE Conv.cKorDraus._.z_pof1kplbinn_S6_S3 1 100 0 3 DISPLAY_IDENTIFIER z_pof1kplbinn.iKorDraus ECU_ADDRESS 0xFFF8A110 /end MEASUREMENT
/begin MEASUREMENT iKorDraus.posv_uew_hyd_aktiv "Flag ob Hydraulikansteuerung POS P bei POSV-Ueberwachung aktiv ist" UBYTE Conv.cKorDraus._.posv_uew_hyd_aktiv_S6_S3 1 100 0 1 BIT_MASK 0x1 DISPLAY_IDENTIFIER posv_uew_hyd_aktiv.iKorDraus ECU_ADDRESS 0xFFF8A111 /end MEASUREMENT
/begin MEASUREMENT iKorDraus.timer_cruise "Zeit seit Start der Fahrbetriebstask" UBYTE UMR_MSEC__10_1_0_S6_S3 1 100 0 2550 DISPLAY_IDENTIFIER timer_cruise.iKorDraus ECU_ADDRESS 0xFFF8A112 /end MEASUREMENT
/begin MEASUREMENT iMvsZentr.iTimerParksp.timer "Der aktuelle Timerwert" UBYTE UMR_MSEC__10_1_0_S6_S3 1 100 0 2550 DISPLAY_IDENTIFIER iTimerParksp.iMvsZentr ECU_ADDRESS 0xFFF8D57C /end MEASUREMENT
/begin MEASUREMENT iMvsZentr.iTimerKeinKfl.timer "Der aktuelle Timerwert" UBYTE UMR_MSEC__10_1_0_S6_S3 1 100 0 2550 DISPLAY_IDENTIFIER iTimerKeinKfl.iMvsZentr ECU_ADDRESS 0xFFF8D57D /end MEASUREMENT
/begin MEASUREMENT iMvsZentr.iTimerMagnet.timer "Der aktuelle Timerwert" UWORD UMR_MSEC__10_1_0_S6_S3 1 100 0 655350 DISPLAY_IDENTIFIER iTimerMagnet.iMvsZentr ECU_ADDRESS 0xFFF8D57E /end MEASUREMENT
/begin MEASUREMENT iMvsZentr.ps_zustand "berechneter Zustandgröße Parsperre" UBYTE Conv.cMvsZentr._.ps_zustand_S6_S3 1 100 0 4 DISPLAY_IDENTIFIER ps_zustand.iMvsZentr ECU_ADDRESS 0xFFF8D578 /end MEASUREMENT
/begin MEASUREMENT iMvsZentr.ps_aktiv "repraesentiert den Zustand der Parksperren-Ansteuerung (Wichtig: Initialisierung muss false sein!)" UBYTE Conv.cMvsZentr._.ps_aktiv_S6_S3 1 100 0 1 BIT_MASK 0x1 DISPLAY_IDENTIFIER ps_aktiv.iMvsZentr ECU_ADDRESS 0xFFF8D579 /end MEASUREMENT
/begin MEASUREMENT iMvsZentr.ps_aktiv_permanent "repraesentiert den Zustand der Parksperren-Ansteuerung Permanentmagnet (Wichtig: Initialisierung muss false sein!)" UBYTE Conv.cMvsZentr._.ps_aktiv_permanent_S6_S3 1 100 0 1 BIT_MASK 0x1 DISPLAY_IDENTIFIER ps_aktiv_permanent.iMvsZentr ECU_ADDRESS 0xFFF8D57A /end MEASUREMENT
/begin MEASUREMENT iMvsZentr.ps_magnet_timeout "Parksperren-Ansteuerung Permanentmagnet Timeout" UBYTE Conv.cMvsZentr._.ps_magnet_timeout_S6_S3 1 100 0 1 BIT_MASK 0x1 DISPLAY_IDENTIFIER ps_magnet_timeout.iMvsZentr ECU_ADDRESS 0xFFF8D57B /end MEASUREMENT
/begin COMPU_METHOD SBW_VKMH_S1_S3 "int = ((phys * 1) / 1) - (0) km/h" RAT_FUNC "%2.0" "km/h" COEFFS 0 1 -0 0 0 1 /end COMPU_METHOD
/begin COMPU_METHOD UMR___1_300_0_S6_S3 "int = ((phys * 300) / 1) - (0) [-]" RAT_FUNC "%7.5" "[-]" COEFFS 0 300 -0 0 0 1 /end COMPU_METHOD
/begin COMPU_METHOD UMR___1_1_0_S6_S3 "int = ((phys * 1) / 1) - (0) [-]" RAT_FUNC "%2.0" "[-]" COEFFS 0 1 -0 0 0 1 /end COMPU_METHOD
/begin COMPU_METHOD UMR_NM__1_1_0_S6_S3 "int = ((phys * 1) / 1) - (0) [Nm]" RAT_FUNC "%2.0" "[Nm]" COEFFS 0 1 -0 0 0 1 /end COMPU_METHOD
/begin COMPU_METHOD UMR_BAR__1_1000_0_S6_S3 "int = ((phys * 1000) / 1) - (0) [bar]" RAT_FUNC "%5.3" "[bar]" COEFFS 0 1000 -0 0 0 1 /end COMPU_METHOD
/begin COMPU_METHOD UMR_U_MIN_1_1_0_S6_S3 "int = ((phys * 1) / 1) - (0) [U/min]" RAT_FUNC "%2.0" "[U/min]" COEFFS 0 1 -0 0 0 1 /end COMPU_METHOD
/begin COMPU_METHOD UMR_MSEC__10_1_0_S6_S3 "int = ((phys * 1) / 10) - (0) [ms]" RAT_FUNC "%2.0" "[ms]" COEFFS 0 1 -0 0 0 10 /end COMPU_METHOD
/begin COMPU_METHOD UMR_SEC__1_100_0_S6_S3 "int = ((phys * 100) / 1) - (0) [s]" RAT_FUNC "%4.2" "[s]" COEFFS 0 100 -0 0 0 1 /end COMPU_METHOD
/begin COMPU_METHOD UMR_GRADC__1_1_0_S6_S3 "int = ((phys * 1) / 1) - (0) [°C]" RAT_FUNC "%2.0" "[°C]" COEFFS 0 1 -0 0 0 1 /end COMPU_METHOD
/begin COMPU_METHOD UMR_GRADC__1_1_M40_S6_S3 "int = ((phys * 1) / 1) - (-40) [°C]" RAT_FUNC "%2.0" "[°C]" COEFFS 0 1 40 0 0 1 /end COMPU_METHOD
/begin COMPU_METHOD Conv.cAzsSollgangMoeglich._.sollgang_moeglich_S6_S3 "Umrechnung fuer Messgroesse cAzsSollgangMoeglich::sollgang_moeglich" TAB_VERB "%4.0" "" COMPU_TAB_REF Conv.cAzsSollgangMoeglich._.sollgang_moeglich_S6_S3 /end COMPU_METHOD
/begin COMPU_METHOD Conv.cAzsVorgabeGang._.gang_schleppstart_S6_S3 "Umrechnung fuer Messgroesse cAzsVorgabeGang::gang_schleppstart" TAB_VERB "%4.0" "" COMPU_TAB_REF Conv.cAzsVorgabeGang._.gang_schleppstart_S6_S3 /end COMPU_METHOD
/begin COMPU_METHOD Conv.cAzsVorgabeGang._.vorgabegang_S6_S3 "Umrechnung fuer Messgroesse cAzsVorgabeGang::vorgabegang" TAB_VERB "%4.0" "" COMPU_TAB_REF Conv.cAzsVorgabeGang._.vorgabegang_S6_S3 /end COMPU_METHOD
/begin COMPU_METHOD Conv.cAzsVorgabeGang._.f_abbruch_vorb_angefordert_S6_S3 "Umrechnung fuer Messgroesse cAzsVorgabeGang::f_abbruch_vorb_angefordert" TAB_VERB "%4.0" "" COMPU_TAB_REF Conv.cAzsVorgabeGang._.f_abbruch_vorb_angefordert_S6_S3 /end COMPU_METHOD
/begin COMPU_METHOD Conv.cAzsVorgabeGang._.f_schleppstart_erkannt_S6_S3 "Umrechnung fuer Messgroesse cAzsVorgabeGang::f_schleppstart_erkannt" TAB_VERB "%4.0" "" COMPU_TAB_REF Conv.cAzsVorgabeGang._.f_schleppstart_erkannt_S6_S3 /end COMPU_METHOD
/begin COMPU_METHOD Conv.cAzsVorgabeGang._.z_abbruch_rsrs_S6_S3 "Umrechnung fuer Messgroesse cAzsVorgabeGang::z_abbruch_rsrs" TAB_VERB "%4.0" "" COMPU_TAB_REF Conv.cAzsVorgabeGang._.z_abbruch_rsrs_S6_S3 /end COMPU_METHOD
/begin COMPU_METHOD Conv.cAzsZielgangSoll._.zielgang_soll_S6_S3 "Umrechnung fuer Messgroesse cAzsZielgangSoll::zielgang_soll" TAB_VERB "%4.0" "" COMPU_TAB_REF Conv.cAzsZielgangSoll._.zielgang_soll_S6_S3 /end COMPU_METHOD
/begin COMPU_METHOD Conv.cAzsZielgang._.f_schalt_abbruch_invers_S6_S3 "Umrechnung fuer Messgroesse cAzsZielgang::f_schalt_abbruch_invers" TAB_VERB "%4.0" "" COMPU_TAB_REF Conv.cAzsZielgang._.f_schalt_abbruch_invers_S6_S3 /end COMPU_METHOD
/begin COMPU_METHOD Conv.cAzsZielgang._.zielgang_S6_S3 "Umrechnung fuer Messgroesse cAzsZielgang::zielgang" TAB_VERB "%4.0" "" COMPU_TAB_REF Conv.cAzsZielgang._.zielgang_S6_S3 /end COMPU_METHOD
/begin COMPU_METHOD Conv.cAzsZielgangSas._.schaltung_S6_S3 "Umrechnung fuer Messgroesse cAzsZielgangSas::schaltung" TAB_VERB "%4.0" "" COMPU_TAB_REF Conv.cAzsZielgangSas._.schaltung_S6_S3 /end COMPU_METHOD
/begin COMPU_METHOD Conv.cAzsZielgangSas._.schaltart_S6_S3 "Umrechnung fuer Messgroesse cAzsZielgangSas::schaltart" TAB_VERB "%4.0" "" COMPU_TAB_REF Conv.cAzsZielgangSas._.schaltart_S6_S3 /end COMPU_METHOD
/begin COMPU_METHOD Conv.cAzsZielgangSas._.schaltinfo_S6_S3 "Umrechnung fuer Messgroesse cAzsZielgangSas::schaltinfo" TAB_VERB "%4.0" "" COMPU_TAB_REF Conv.cAzsZielgangSas._.schaltinfo_S6_S3 /end COMPU_METHOD
/begin COMPU_METHOD Conv.cAzsZielgangSas._.zielgang_sas_S6_S3 "Umrechnung fuer Messgroesse cAzsZielgangSas::zielgang_sas" TAB_VERB "%4.0" "" COMPU_TAB_REF Conv.cAzsZielgangSas._.zielgang_sas_S6_S3 /end COMPU_METHOD
/begin COMPU_METHOD Conv.cAzsZielgangSas._.zielgang_sas_komp_S6_S3 "Umrechnung fuer Messgroesse cAzsZielgangSas::zielgang_sas_komp" TAB_VERB "%4.0" "" COMPU_TAB_REF Conv.cAzsZielgangSas._.zielgang_sas_komp_S6_S3 /end COMPU_METHOD
/begin COMPU_METHOD Conv.cAzsIstGang._.istgang_S6_S3 "Umrechnung fuer Messgroesse cAzsIstGang::istgang" TAB_VERB "%4.0" "" COMPU_TAB_REF Conv.cAzsIstGang._.istgang_S6_S3 /end COMPU_METHOD
/begin COMPU_METHOD Conv.cAzsIstGang._.f_saf_abbruch_invers_S6_S3 "Umrechnung fuer Messgroesse cAzsIstGang::f_saf_abbruch_invers" TAB_VERB "%4.0" "" COMPU_TAB_REF Conv.cAzsIstGang._.f_saf_abbruch_invers_S6_S3 /end COMPU_METHOD
/begin COMPU_METHOD Conv.cAzsIstGang._.f_saf_folgeschaltung_S6_S3 "Umrechnung fuer Messgroesse cAzsIstGang::f_saf_folgeschaltung" TAB_VERB "%4.0" "" COMPU_TAB_REF Conv.cAzsIstGang._.f_saf_folgeschaltung_S6_S3 /end COMPU_METHOD
/begin COMPU_METHOD Conv.cAzsIstGang._.f_saf_freigegeben_S6_S3 "Umrechnung fuer Messgroesse cAzsIstGang::f_saf_freigegeben" TAB_VERB "%4.0" "" COMPU_TAB_REF Conv.cAzsIstGang._.f_saf_freigegeben_S6_S3 /end COMPU_METHOD
/begin COMPU_METHOD Conv.cSchaltung._.manuell_S6_S3 "Umrechnung fuer Messgroesse cSchaltung::manuell" TAB_VERB "%4.0" "" COMPU_TAB_REF Conv.cSchaltung._.manuell_S6_S3 /end COMPU_METHOD
/begin COMPU_METHOD Conv.cSchaltung._.kup_mass_S6_S3 "Umrechnung fuer Messgroesse cSchaltung::kup_mass" TAB_VERB "%4.0" "" COMPU_TAB_REF Conv.cSchaltung._.kup_mass_S6_S3 /end COMPU_METHOD
/begin COMPU_METHOD Conv.cSchaltung._.k_ab_S6_S3 "Umrechnung fuer Messgroesse cSchaltung::k_ab" TAB_VERB "%4.0" "" COMPU_TAB_REF Conv.cSchaltung._.k_ab_S6_S3 /end COMPU_METHOD
/begin COMPU_METHOD Conv.cSchaltung._.k_zu_S6_S3 "Umrechnung fuer Messgroesse cSchaltung::k_zu" TAB_VERB "%4.0" "" COMPU_TAB_REF Conv.cSchaltung._.k_zu_S6_S3 /end COMPU_METHOD
/begin COMPU_METHOD Conv.cSchaltung._.schaltart_S6_S3 "Umrechnung fuer Messgroesse cSchaltung::schaltart" TAB_VERB "%4.0" "" COMPU_TAB_REF Conv.cSchaltung._.schaltart_S6_S3 /end COMPU_METHOD
/begin COMPU_METHOD Conv.cSchaltung._.istgang_S6_S3 "Umrechnung fuer Messgroesse cSchaltung::istgang" TAB_VERB "%4.0" "" COMPU_TAB_REF Conv.cSchaltung._.istgang_S6_S3 /end COMPU_METHOD
/begin COMPU_METHOD Conv.cSchaltung._.zielgang_sas_S6_S3 "Umrechnung fuer Messgroesse cSchaltung::zielgang_sas" TAB_VERB "%4.0" "" COMPU_TAB_REF Conv.cSchaltung._.zielgang_sas_S6_S3 /end COMPU_METHOD
/begin COMPU_METHOD Conv.cSchaltungMitVerzoegerung._.sollgang_S6_S3 "Umrechnung fuer Messgroesse cSchaltungMitVerzoegerung::sollgang" TAB_VERB "%4.0" "" COMPU_TAB_REF Conv.cSchaltungMitVerzoegerung._.sollgang_S6_S3 /end COMPU_METHOD
/begin COMPU_METHOD Conv.cSchaltungMitVerzoegerung._.k_a_schalt_verh_S6_S3 "Umrechnung fuer Messgroesse cSchaltungMitVerzoegerung::k_a_schalt_verh" TAB_VERB "%4.0" "" COMPU_TAB_REF Conv.cSchaltungMitVerzoegerung._.k_a_schalt_verh_S6_S3 /end COMPU_METHOD
/begin COMPU_METHOD Conv.cSchaltungMitVerzoegerung._.k_b_schalt_verh_S6_S3 "Umrechnung fuer Messgroesse cSchaltungMitVerzoegerung::k_b_schalt_verh" TAB_VERB "%4.0" "" COMPU_TAB_REF Conv.cSchaltungMitVerzoegerung._.k_b_schalt_verh_S6_S3 /end COMPU_METHOD
/begin COMPU_METHOD Conv.cSchaltungMitVerzoegerung._.k_c_schalt_verh_S6_S3 "Umrechnung fuer Messgroesse cSchaltungMitVerzoegerung::k_c_schalt_verh" TAB_VERB "%4.0" "" COMPU_TAB_REF Conv.cSchaltungMitVerzoegerung._.k_c_schalt_verh_S6_S3 /end COMPU_METHOD
/begin COMPU_METHOD Conv.cSchaltungMitVerzoegerung._.k_d_schalt_verh_S6_S3 "Umrechnung fuer Messgroesse cSchaltungMitVerzoegerung::k_d_schalt_verh" TAB_VERB "%4.0" "" COMPU_TAB_REF Conv.cSchaltungMitVerzoegerung._.k_d_schalt_verh_S6_S3 /end COMPU_METHOD
/begin COMPU_METHOD Conv.cSchaltungMitVerzoegerung._.k_e_schalt_verh_S6_S3 "Umrechnung fuer Messgroesse cSchaltungMitVerzoegerung::k_e_schalt_verh" TAB_VERB "%4.0" "" COMPU_TAB_REF Conv.cSchaltungMitVerzoegerung._.k_e_schalt_verh_S6_S3 /end COMPU_METHOD
/begin COMPU_METHOD Conv.cAzsKupMassnahmenKoord._.reduzierung_m_mot_max_S6_S3 "Umrechnung fuer Messgroesse cAzsKupMassnahmenKoord::reduzierung_m_mot_max" TAB_VERB "%4.0" "" COMPU_TAB_REF Conv.cAzsKupMassnahmenKoord._.reduzierung_m_mot_max_S6_S3 /end COMPU_METHOD
/begin COMPU_METHOD Conv.cAzsKupMassnahmenKoord._.beeinfl_spont_index_S6_S3 "Umrechnung fuer Messgroesse cAzsKupMassnahmenKoord::beeinfl_spont_index" TAB_VERB "%4.0" "" COMPU_TAB_REF Conv.cAzsKupMassnahmenKoord._.beeinfl_spont_index_S6_S3 /end COMPU_METHOD
/begin COMPU_METHOD Conv.cAzsKupMassnahmenKoord._.zustand_schaltungsverh_S6_S3 "Umrechnung fuer Messgroesse cAzsKupMassnahmenKoord::zustand_schaltungsverh" TAB_VERB "%4.0" "" COMPU_TAB_REF Conv.cAzsKupMassnahmenKoord._.zustand_schaltungsverh_S6_S3 /end COMPU_METHOD
/begin COMPU_METHOD Conv.cAzsKupMassnahmenKoord._.versch_schalt_verh_S6_S3 "Umrechnung fuer Messgroesse cAzsKupMassnahmenKoord::versch_schalt_verh" TAB_VERB "%4.0" "" COMPU_TAB_REF Conv.cAzsKupMassnahmenKoord._.versch_schalt_verh_S6_S3 /end COMPU_METHOD
/begin COMPU_METHOD Conv.cAzsKupMassnahmenKoord._.kup_mass_global_S6_S3 "Umrechnung fuer Messgroesse cAzsKupMassnahmenKoord::kup_mass_global" TAB_VERB "%4.0" "" COMPU_TAB_REF Conv.cAzsKupMassnahmenKoord._.kup_mass_global_S6_S3 /end COMPU_METHOD
/begin COMPU_METHOD Conv.cBihMomenHsHss._.z_mmotmax_hss_S6_S3 "Umrechnung fuer Messgroesse cBihMomenHsHss::z_mmotmax_hss" TAB_VERB "%4.0" "" COMPU_TAB_REF Conv.cBihMomenHsHss._.z_mmotmax_hss_S6_S3 /end COMPU_METHOD
/begin COMPU_METHOD Conv.cBihMomenHsHss._.zielgang_hss_S6_S3 "Umrechnung fuer Messgroesse cBihMomenHsHss::zielgang_hss" TAB_VERB "%4.0" "" COMPU_TAB_REF Conv.cBihMomenHsHss._.zielgang_hss_S6_S3 /end COMPU_METHOD
/begin COMPU_METHOD Conv.cBihMomenHsHss._.istgang_hss_S6_S3 "Umrechnung fuer Messgroesse cBihMomenHsHss::istgang_hss" TAB_VERB "%4.0" "" COMPU_TAB_REF Conv.cBihMomenHsHss._.istgang_hss_S6_S3 /end COMPU_METHOD
/begin COMPU_METHOD Conv.cBihMeRedAbs._.me_red_status_S6_S3 "Umrechnung fuer Messgroesse cBihMeRedAbs::me_red_status" TAB_VERB "%4.0" "" COMPU_TAB_REF Conv.cBihMeRedAbs._.me_red_status_S6_S3 /end COMPU_METHOD
/begin COMPU_METHOD Conv.cBihMeRedAbs._.me_red_status_komp_S6_S3 "Umrechnung fuer Messgroesse cBihMeRedAbs::me_red_status_komp" TAB_VERB "%4.0" "" COMPU_TAB_REF Conv.cBihMeRedAbs._.me_red_status_komp_S6_S3 /end COMPU_METHOD
/begin COMPU_METHOD Conv.cBihMobef._.flag_schlupf_psyseff_S6_S3 "Umrechnung fuer Messgroesse cBihMobef::flag_schlupf_psyseff" TAB_VERB "%4.0" "" COMPU_TAB_REF Conv.cBihMobef._.flag_schlupf_psyseff_S6_S3 /end COMPU_METHOD
/begin COMPU_METHOD Conv.cBihMobef._.funk_ge_mmotmax_S6_S3 "Umrechnung fuer Messgroesse cBihMobef::funk_ge_mmotmax" TAB_VERB "%4.0" "" COMPU_TAB_REF Conv.cBihMobef._.funk_ge_mmotmax_S6_S3 /end COMPU_METHOD
/begin COMPU_METHOD Conv.cBihMobef._.z_m_motmax_kor_strang_S6_S3 "Umrechnung fuer Messgroesse cBihMobef::z_m_motmax_kor_strang" TAB_VERB "%4.0" "" COMPU_TAB_REF Conv.cBihMobef._.z_m_motmax_kor_strang_S6_S3 /end COMPU_METHOD
/begin COMPU_METHOD Conv.cBihMobef._.f_rganglimitaktiv_S6_S3 "Umrechnung fuer Messgroesse cBihMobef::f_rganglimitaktiv" TAB_VERB "%4.0" "" COMPU_TAB_REF Conv.cBihMobef._.f_rganglimitaktiv_S6_S3 /end COMPU_METHOD
/begin COMPU_METHOD Conv.cBihMobef._.fl_meschlupfaktiv_S6_S3 "Umrechnung fuer Messgroesse cBihMobef::fl_meschlupfaktiv" TAB_VERB "%4.0" "" COMPU_TAB_REF Conv.cBihMobef._.fl_meschlupfaktiv_S6_S3 /end COMPU_METHOD
/begin COMPU_METHOD Conv.cBihMobef._.flag_meschlupf_S6_S3 "Umrechnung fuer Messgroesse cBihMobef::flag_meschlupf" TAB_VERB "%4.0" "" COMPU_TAB_REF Conv.cBihMobef._.flag_meschlupf_S6_S3 /end COMPU_METHOD
/begin COMPU_METHOD Conv.cBihMobef._.z_m_motmax_schlupf_S6_S3 "Umrechnung fuer Messgroesse cBihMobef::z_m_motmax_schlupf" TAB_VERB "%4.0" "" COMPU_TAB_REF Conv.cBihMobef._.z_m_motmax_schlupf_S6_S3 /end COMPU_METHOD
/begin COMPU_METHOD Conv.cBihMomen._.z_t_mverl_k0_S6_S3 "Umrechnung fuer Messgroesse cBihMomen::z_t_mverl_k0" TAB_VERB "%4.0" "" COMPU_TAB_REF Conv.cBihMomen._.z_t_mverl_k0_S6_S3 /end COMPU_METHOD
/begin COMPU_METHOD Conv.cBihSigna._.fl_req_deactvt_actv_dampg_S6_S3 "Umrechnung fuer Messgroesse cBihSigna::fl_req_deactvt_actv_dampg" TAB_VERB "%4.0" "" COMPU_TAB_REF Conv.cBihSigna._.fl_req_deactvt_actv_dampg_S6_S3 /end COMPU_METHOD
/begin COMPU_METHOD Conv.cBihSigna._.bremsbed_S6_S3 "Umrechnung fuer Messgroesse cBihSigna::bremsbed" TAB_VERB "%4.0" "" COMPU_TAB_REF Conv.cBihSigna._.bremsbed_S6_S3 /end COMPU_METHOD
/begin COMPU_METHOD Conv.cBihSigna._.bremsbed_ofstb_S6_S3 "Umrechnung fuer Messgroesse cBihSigna::bremsbed_ofstb" TAB_VERB "%4.0" "" COMPU_TAB_REF Conv.cBihSigna._.bremsbed_ofstb_S6_S3 /end COMPU_METHOD
/begin COMPU_METHOD Conv.cBihSigna._.z_sbc_timer_S6_S3 "Umrechnung fuer Messgroesse cBihSigna::z_sbc_timer" TAB_VERB "%4.0" "" COMPU_TAB_REF Conv.cBihSigna._.z_sbc_timer_S6_S3 /end COMPU_METHOD
/begin COMPU_METHOD Conv.cBihSigna._.z_e_fahren_verzoegert_S6_S3 "Umrechnung fuer Messgroesse cBihSigna::z_e_fahren_verzoegert" TAB_VERB "%4.0" "" COMPU_TAB_REF Conv.cBihSigna._.z_e_fahren_verzoegert_S6_S3 /end COMPU_METHOD
/begin COMPU_METHOD Conv.cBihPumpendruck._.z_pumpendruck_S6_S3 "Umrechnung fuer Messgroesse cBihPumpendruck::z_pumpendruck" TAB_VERB "%4.0" "" COMPU_TAB_REF Conv.cBihPumpendruck._.z_pumpendruck_S6_S3 /end COMPU_METHOD
/begin COMPU_METHOD Conv.cKorDraus._.gwk_moeglich_S6_S3 "Umrechnung fuer Messgroesse cKorDraus::gwk_moeglich" TAB_VERB "%4.0" "" COMPU_TAB_REF Conv.cKorDraus._.gwk_moeglich_S6_S3 /end COMPU_METHOD
/begin COMPU_METHOD Conv.cKorDraus._.k0_hydraulisch_moeglich_S6_S3 "Umrechnung fuer Messgroesse cKorDraus::k0_hydraulisch_moeglich" TAB_VERB "%4.0" "" COMPU_TAB_REF Conv.cKorDraus._.k0_hydraulisch_moeglich_S6_S3 /end COMPU_METHOD
/begin COMPU_METHOD Conv.cKorDraus._.st_k0_filling_mode_S6_S3 "Umrechnung fuer Messgroesse cKorDraus::st_k0_filling_mode" TAB_VERB "%4.0" "" COMPU_TAB_REF Conv.cKorDraus._.st_k0_filling_mode_S6_S3 /end COMPU_METHOD
/begin COMPU_METHOD Conv.cKorDraus._.kup_pruefpuls_S6_S3 "Umrechnung fuer Messgroesse cKorDraus::kup_pruefpuls" TAB_VERB "%4.0" "" COMPU_TAB_REF Conv.cKorDraus._.kup_pruefpuls_S6_S3 /end COMPU_METHOD
/begin COMPU_METHOD Conv.cKorDraus._.kfl_zuletzt_S6_S3 "Umrechnung fuer Messgroesse cKorDraus::kfl_zuletzt" TAB_VERB "%4.0" "" COMPU_TAB_REF Conv.cKorDraus._.kfl_zuletzt_S6_S3 /end COMPU_METHOD
/begin COMPU_METHOD Conv.cKorDraus._.gang_kfl_zuletzt_S6_S3 "Umrechnung fuer Messgroesse cKorDraus::gang_kfl_zuletzt" TAB_VERB "%4.0" "" COMPU_TAB_REF Conv.cKorDraus._.gang_kfl_zuletzt_S6_S3 /end COMPU_METHOD
/begin COMPU_METHOD Conv.cKorDraus._.kup_zu_in_n_S6_S3 "Umrechnung fuer Messgroesse cKorDraus::kup_zu_in_n" TAB_VERB "%4.0" "" COMPU_TAB_REF Conv.cKorDraus._.kup_zu_in_n_S6_S3 /end COMPU_METHOD
/begin COMPU_METHOD Conv.cKorDraus._.druckausgabe_kup_zu_in_n_aktiv_S6_S3 "Umrechnung fuer Messgroesse cKorDraus::druckausgabe_kup_zu_in_n_aktiv" TAB_VERB "%4.0" "" COMPU_TAB_REF Conv.cKorDraus._.druckausgabe_kup_zu_in_n_aktiv_S6_S3 /end COMPU_METHOD
/begin COMPU_METHOD Conv.cKorDraus._.kup_pf_in_n_S6_S3 "Umrechnung fuer Messgroesse cKorDraus::kup_pf_in_n" TAB_VERB "%4.0" "" COMPU_TAB_REF Conv.cKorDraus._.kup_pf_in_n_S6_S3 /end COMPU_METHOD
/begin COMPU_METHOD Conv.cKorDraus._.druckausgabe_kup_pf_in_n_aktiv_S6_S3 "Umrechnung fuer Messgroesse cKorDraus::druckausgabe_kup_pf_in_n_aktiv" TAB_VERB "%4.0" "" COMPU_TAB_REF Conv.cKorDraus._.druckausgabe_kup_pf_in_n_aktiv_S6_S3 /end COMPU_METHOD
/begin COMPU_METHOD Conv.cKorDraus._.statisch_p_kup_pf_in_n_S6_S3 "Umrechnung fuer Messgroesse cKorDraus::statisch_p_kup_pf_in_n" TAB_VERB "%4.0" "" COMPU_TAB_REF Conv.cKorDraus._.statisch_p_kup_pf_in_n_S6_S3 /end COMPU_METHOD
/begin COMPU_METHOD Conv.cKorDraus._.z_pof1kplbinn_S6_S3 "Umrechnung fuer Messgroesse cKorDraus::z_pof1kplbinn" TAB_VERB "%4.0" "" COMPU_TAB_REF Conv.cKorDraus._.z_pof1kplbinn_S6_S3 /end COMPU_METHOD
/begin COMPU_METHOD Conv.cKorDraus._.posv_uew_hyd_aktiv_S6_S3 "Umrechnung fuer Messgroesse cKorDraus::posv_uew_hyd_aktiv" TAB_VERB "%4.0" "" COMPU_TAB_REF Conv.cKorDraus._.posv_uew_hyd_aktiv_S6_S3 /end COMPU_METHOD
/begin COMPU_METHOD Conv.cMvsZentr._.ps_zustand_S6_S3 "Umrechnung fuer Messgroesse cMvsZentr::ps_zustand" TAB_VERB "%4.0" "" COMPU_TAB_REF Conv.cMvsZentr._.ps_zustand_S6_S3 /end COMPU_METHOD
/begin COMPU_METHOD Conv.cMvsZentr._.ps_aktiv_S6_S3 "Umrechnung fuer Messgroesse cMvsZentr::ps_aktiv" TAB_VERB "%4.0" "" COMPU_TAB_REF Conv.cMvsZentr._.ps_aktiv_S6_S3 /end COMPU_METHOD
/begin COMPU_METHOD Conv.cMvsZentr._.ps_aktiv_permanent_S6_S3 "Umrechnung fuer Messgroesse cMvsZentr::ps_aktiv_permanent" TAB_VERB "%4.0" "" COMPU_TAB_REF Conv.cMvsZentr._.ps_aktiv_permanent_S6_S3 /end COMPU_METHOD
/begin COMPU_METHOD Conv.cMvsZentr._.ps_magnet_timeout_S6_S3 "Umrechnung fuer Messgroesse cMvsZentr::ps_magnet_timeout" TAB_VERB "%4.0" "" COMPU_TAB_REF Conv.cMvsZentr._.ps_magnet_timeout_S6_S3 /end COMPU_METHOD
/begin COMPU_VTAB Conv.cAzsSollgangMoeglich._.sollgang_moeglich_S6_S3 "Umrechnung fuer Messgroesse cAzsSollgangMoeglich::sollgang_moeglich" TAB_VERB 10 -1 "GR1" 0 "KEIN_GANG" 1 "G1" 2 "G2" 3 "G3" 4 "G4" 5 "G5" 6 "G6" 7 "G7" 8 "G8" /end COMPU_VTAB
/begin COMPU_VTAB Conv.cAzsVorgabeGang._.gang_schleppstart_S6_S3 "Umrechnung fuer Messgroesse cAzsVorgabeGang::gang_schleppstart" TAB_VERB 10 -1 "GR1" 0 "KEIN_GANG" 1 "G1" 2 "G2" 3 "G3" 4 "G4" 5 "G5" 6 "G6" 7 "G7" 8 "G8" /end COMPU_VTAB
/begin COMPU_VTAB Conv.cAzsVorgabeGang._.vorgabegang_S6_S3 "Umrechnung fuer Messgroesse cAzsVorgabeGang::vorgabegang" TAB_VERB 10 -1 "GR1" 0 "KEIN_GANG" 1 "G1" 2 "G2" 3 "G3" 4 "G4" 5 "G5" 6 "G6" 7 "G7" 8 "G8" /end COMPU_VTAB
/begin COMPU_VTAB Conv.cAzsVorgabeGang._.f_abbruch_vorb_angefordert_S6_S3 "Umrechnung fuer Messgroesse cAzsVorgabeGang::f_abbruch_vorb_angefordert" TAB_VERB 2 0 "kein Abbruch" 1 "Abbruch" /end COMPU_VTAB
/begin COMPU_VTAB Conv.cAzsVorgabeGang._.f_schleppstart_erkannt_S6_S3 "Umrechnung fuer Messgroesse cAzsVorgabeGang::f_schleppstart_erkannt" TAB_VERB 2 0 "keine Anforderung durch Schleppstartfkt." 1 "Anforderung durch Schleppstartfkt." /end COMPU_VTAB
/begin COMPU_VTAB Conv.cAzsVorgabeGang._.z_abbruch_rsrs_S6_S3 "Umrechnung fuer Messgroesse cAzsVorgabeGang::z_abbruch_rsrs" TAB_VERB 3 0 "RSRS_PASSIV" 1 "RSRS_ABBRUCH_RS" 2 "RSRS_NEUE_SCHALTUNG" /end COMPU_VTAB
/begin COMPU_VTAB Conv.cAzsZielgangSoll._.zielgang_soll_S6_S3 "Umrechnung fuer Messgroesse cAzsZielgangSoll::zielgang_soll" TAB_VERB 10 -1 "GR1" 0 "KEIN_GANG" 1 "G1" 2 "G2" 3 "G3" 4 "G4" 5 "G5" 6 "G6" 7 "G7" 8 "G8" /end COMPU_VTAB
/begin COMPU_VTAB Conv.cAzsZielgang._.f_schalt_abbruch_invers_S6_S3 "Umrechnung fuer Messgroesse cAzsZielgang::f_schalt_abbruch_invers" TAB_VERB 2 0 "kein Abbruch" 1 "Abbruch" /end COMPU_VTAB
/begin COMPU_VTAB Conv.cAzsZielgang._.zielgang_S6_S3 "Umrechnung fuer Messgroesse cAzsZielgang::zielgang" TAB_VERB 10 -1 "GR1" 0 "KEIN_GANG" 1 "G1" 2 "G2" 3 "G3" 4 "G4" 5 "G5" 6 "G6" 7 "G7" 8 "G8" /end COMPU_VTAB
/begin COMPU_VTAB Conv.cAzsZielgangSas._.schaltung_S6_S3 "Umrechnung fuer Messgroesse cAzsZielgangSas::schaltung" TAB_VERB 2 0 "keine laufende Schaltung" 1 "laufende Schaltung" /end COMPU_VTAB
/begin COMPU_VTAB Conv.cAzsZielgangSas._.schaltart_S6_S3 "Umrechnung fuer Messgroesse cAzsZielgangSas::schaltart" TAB_VERB 3 0 "n.def" 1 "Hochschaltung" 2 "Rueckschaltung" /end COMPU_VTAB
/begin COMPU_VTAB Conv.cAzsZielgangSas._.schaltinfo_S6_S3 "Umrechnung fuer Messgroesse cAzsZielgangSas::schaltinfo" TAB_VERB 5 0 "keine Schaltung" 1 "Einfach-Hochschaltung" 2 "Mehrfachhochschaltung" 3 "Einfach-Rueckschaltung" 4 "Mehrfachrueckschaltung" /end COMPU_VTAB
/begin COMPU_VTAB Conv.cAzsZielgangSas._.zielgang_sas_S6_S3 "Umrechnung fuer Messgroesse cAzsZielgangSas::zielgang_sas" TAB_VERB 10 -1 "GR1" 0 "KEIN_GANG" 1 "G1" 2 "G2" 3 "G3" 4 "G4" 5 "G5" 6 "G6" 7 "G7" 8 "G8" /end COMPU_VTAB
/begin COMPU_VTAB Conv.cAzsZielgangSas._.zielgang_sas_komp_S6_S3 "Umrechnung fuer Messgroesse cAzsZielgangSas::zielgang_sas_komp" TAB_VERB 10 0 "R-Gang" -1 "R_Gang" -2 "1. Gang" -3 "2. Gang" -4 "3. Gang" -5 "4. Gang" -6 "5. Gang" -7 "6. Gang" -8 "7. Gang" -9 "8. Gang" /end COMPU_VTAB
/begin COMPU_VTAB Conv.cAzsIstGang._.istgang_S6_S3 "Umrechnung fuer Messgroesse cAzsIstGang::istgang" TAB_VERB 10 -1 "GR1" 0 "KEIN_GANG" 1 "G1" 2 "G2" 3 "G3" 4 "G4" 5 "G5" 6 "G6" 7 "G7" 8 "G8" /end COMPU_VTAB
/begin COMPU_VTAB Conv.cAzsIstGang._.f_saf_abbruch_invers_S6_S3 "Umrechnung fuer Messgroesse cAzsIstGang::f_saf_abbruch_invers" TAB_VERB 2 0 "FALSE" 1 "TRUE" /end COMPU_VTAB
/begin COMPU_VTAB Conv.cAzsIstGang._.f_saf_folgeschaltung_S6_S3 "Umrechnung fuer Messgroesse cAzsIstGang::f_saf_folgeschaltung" TAB_VERB 2 0 "FALSE" 1 "TRUE" /end COMPU_VTAB
/begin COMPU_VTAB Conv.cAzsIstGang._.f_saf_freigegeben_S6_S3 "Umrechnung fuer Messgroesse cAzsIstGang::f_saf_freigegeben" TAB_VERB 2 0 "FALSE" 1 "TRUE" /end COMPU_VTAB
/begin COMPU_VTAB Conv.cSchaltung._.manuell_S6_S3 "Umrechnung fuer Messgroesse cSchaltung::manuell" TAB_VERB 3 1 "keine manuelle Schaltung" 2 "manuelle Schaltung" 255 "Initialwert o. nach Reset" /end COMPU_VTAB
/begin COMPU_VTAB Conv.cSchaltung._.kup_mass_S6_S3 "Umrechnung fuer Messgroesse cSchaltung::kup_mass" TAB_VERB 6 0 "KEINE" 1 "K_A" 2 "K_B" 3 "K_C" 4 "K_D" 5 "K_E" /end COMPU_VTAB
/begin COMPU_VTAB Conv.cSchaltung._.k_ab_S6_S3 "Umrechnung fuer Messgroesse cSchaltung::k_ab" TAB_VERB 6 0 "KEINE" 1 "K_A" 2 "K_B" 3 "K_C" 4 "K_D" 5 "K_E" /end COMPU_VTAB
/begin COMPU_VTAB Conv.cSchaltung._.k_zu_S6_S3 "Umrechnung fuer Messgroesse cSchaltung::k_zu" TAB_VERB 6 0 "KEINE" 1 "K_A" 2 "K_B" 3 "K_C" 4 "K_D" 5 "K_E" /end COMPU_VTAB
/begin COMPU_VTAB Conv.cSchaltung._.schaltart_S6_S3 "Umrechnung fuer Messgroesse cSchaltung::schaltart" TAB_VERB 3 0 "n.def" 1 "Hochschaltung" 2 "Rueckschaltung" /end COMPU_VTAB
/begin COMPU_VTAB Conv.cSchaltung._.istgang_S6_S3 "Umrechnung fuer Messgroesse cSchaltung::istgang" TAB_VERB 3 0 "n.def" 1 "Hochschaltung" 2 "Rueckschaltung" /end COMPU_VTAB
/begin COMPU_VTAB Conv.cSchaltung._.zielgang_sas_S6_S3 "Umrechnung fuer Messgroesse cSchaltung::zielgang_sas" TAB_VERB 3 0 "n.def" 1 "Hochschaltung" 2 "Rueckschaltung" /end COMPU_VTAB
/begin COMPU_VTAB Conv.cSchaltungMitVerzoegerung._.sollgang_S6_S3 "Umrechnung fuer Messgroesse cSchaltungMitVerzoegerung::sollgang" TAB_VERB 10 -1 "GR1" 0 "KEIN_GANG" 1 "G1" 2 "G2" 3 "G3" 4 "G4" 5 "G5" 6 "G6" 7 "G7" 8 "G8" /end COMPU_VTAB
/begin COMPU_VTAB Conv.cSchaltungMitVerzoegerung._.k_a_schalt_verh_S6_S3 "Umrechnung fuer Messgroesse cSchaltungMitVerzoegerung::k_a_schalt_verh" TAB_VERB 2 0 "FALSE" 1 "TRUE" /end COMPU_VTAB
/begin COMPU_VTAB Conv.cSchaltungMitVerzoegerung._.k_b_schalt_verh_S6_S3 "Umrechnung fuer Messgroesse cSchaltungMitVerzoegerung::k_b_schalt_verh" TAB_VERB 2 0 "FALSE" 1 "TRUE" /end COMPU_VTAB
/begin COMPU_VTAB Conv.cSchaltungMitVerzoegerung._.k_c_schalt_verh_S6_S3 "Umrechnung fuer Messgroesse cSchaltungMitVerzoegerung::k_c_schalt_verh" TAB_VERB 2 0 "FALSE" 1 "TRUE" /end COMPU_VTAB
/begin COMPU_VTAB Conv.cSchaltungMitVerzoegerung._.k_d_schalt_verh_S6_S3 "Umrechnung fuer Messgroesse cSchaltungMitVerzoegerung::k_d_schalt_verh" TAB_VERB 2 0 "FALSE" 1 "TRUE" /end COMPU_VTAB
/begin COMPU_VTAB Conv.cSchaltungMitVerzoegerung._.k_e_schalt_verh_S6_S3 "Umrechnung fuer Messgroesse cSchaltungMitVerzoegerung::k_e_schalt_verh" TAB_VERB 2 0 "FALSE" 1 "TRUE" /end COMPU_VTAB
/begin COMPU_VTAB Conv.cAzsKupMassnahmenKoord._.reduzierung_m_mot_max_S6_S3 "Umrechnung fuer Messgroesse cAzsKupMassnahmenKoord::reduzierung_m_mot_max" TAB_VERB 4 0 "undefiniert Reduzierung des max. Motormoment" 1 "keine Reduzierung des max. Motormoment" 2 "keine Reduzierung des max. Motormoment und Fehlercode zurück nehmen." 3 "Reduzierung des max. Motormoment" /end COMPU_VTAB
/begin COMPU_VTAB Conv.cAzsKupMassnahmenKoord._.beeinfl_spont_index_S6_S3 "Umrechnung fuer Messgroesse cAzsKupMassnahmenKoord::beeinfl_spont_index" TAB_VERB 4 0 "undefinierte Beeinflussung des Spontanitätsindex" 1 "keine Beeinflussung des Spontanitätsindex" 2 "keine Beeinflussung des Spontanitätsindex und Fehlercode zurück nehmen." 3 "Beeinflussung des Spontanitätsindex" /end COMPU_VTAB
/begin COMPU_VTAB Conv.cAzsKupMassnahmenKoord._.zustand_schaltungsverh_S6_S3 "Umrechnung fuer Messgroesse cAzsKupMassnahmenKoord::zustand_schaltungsverh" TAB_VERB 3 0 "undefinierte" 1 "keine Schaltungsverhinderung" 2 "Schaltungsverhinderung" /end COMPU_VTAB
/begin COMPU_VTAB Conv.cAzsKupMassnahmenKoord._.versch_schalt_verh_S6_S3 "Umrechnung fuer Messgroesse cAzsKupMassnahmenKoord::versch_schalt_verh" TAB_VERB 2 0 "die Schaltung wurde nicht verhindert" 1 "die Schaltung wurde verhindert" /end COMPU_VTAB
/begin COMPU_VTAB Conv.cAzsKupMassnahmenKoord._.kup_mass_global_S6_S3 "Umrechnung fuer Messgroesse cAzsKupMassnahmenKoord::kup_mass_global" TAB_VERB 6 0 "KEINE" 1 "K_A" 2 "K_B" 3 "K_C" 4 "K_D" 5 "K_E" /end COMPU_VTAB
/begin COMPU_VTAB Conv.cBihMomenHsHss._.z_mmotmax_hss_S6_S3 "Umrechnung fuer Messgroesse cBihMomenHsHss::z_mmotmax_hss" TAB_VERB 5 0 "Passiv" 1 "Aktiv" 2 "Rampe 1" 3 "Rampe 2" 4 "Ende" /end COMPU_VTAB
/begin COMPU_VTAB Conv.cBihMomenHsHss._.zielgang_hss_S6_S3 "Umrechnung fuer Messgroesse cBihMomenHsHss::zielgang_hss" TAB_VERB 10 -1 "GR1" 0 "KEIN_GANG" 1 "G1" 2 "G2" 3 "G3" 4 "G4" 5 "G5" 6 "G6" 7 "G7" 8 "G8" /end COMPU_VTAB
/begin COMPU_VTAB Conv.cBihMomenHsHss._.istgang_hss_S6_S3 "Umrechnung fuer Messgroesse cBihMomenHsHss::istgang_hss" TAB_VERB 10 -1 "GR1" 0 "KEIN_GANG" 1 "G1" 2 "G2" 3 "G3" 4 "G4" 5 "G5" 6 "G6" 7 "G7" 8 "G8" /end COMPU_VTAB
/begin COMPU_VTAB Conv.cBihMeRedAbs._.me_red_status_S6_S3 "Umrechnung fuer Messgroesse cBihMeRedAbs::me_red_status" TAB_VERB 4 0 "keine Momentenanforderung" 1 "Momentenerhoehung" 2 "Momentenerniedrigung" 3 "Signal ungueltig" /end COMPU_VTAB
/begin COMPU_VTAB Conv.cBihMeRedAbs._.me_red_status_komp_S6_S3 "Umrechnung fuer Messgroesse cBihMeRedAbs::me_red_status_komp" TAB_VERB 4 255 "keine Momentenanforderung" 254 "Momentenerhoehung" 253 "Momentenerniedrigung" 252 "Signal ungueltig" /end COMPU_VTAB
/begin COMPU_VTAB Conv.cBihMobef._.flag_schlupf_psyseff_S6_S3 "Umrechnung fuer Messgroesse cBihMobef::flag_schlupf_psyseff" TAB_VERB 2 0 "nicht aktiv" 1 "aktiv" /end COMPU_VTAB
/begin COMPU_VTAB Conv.cBihMobef._.funk_ge_mmotmax_S6_S3 "Umrechnung fuer Messgroesse cBihMobef::funk_ge_mmotmax" TAB_VERB 7 0 "FUNK_GE_MMOTMAX_INAKTIV" 1 "FUNK_GE_MMOTMAX_BASISFUNKTION" 2 "FUNK_GE_MMOTMAX_ERROR" 3 "FUNK_GE_MMOTMAX_CSN" 4 "FUNK_GE_MMOTMAX_MSA_MOTORSTART_AKTIV" 5 "FUNK_GE_MMOTMAX_MSA_OHNE_HIS" 6 "FUNK_GE_MMOTMAX_AFU" /end COMPU_VTAB
/begin COMPU_VTAB Conv.cBihMobef._.z_m_motmax_kor_strang_S6_S3 "Umrechnung fuer Messgroesse cBihMobef::z_m_motmax_kor_strang" TAB_VERB 3 0 "Passiv" 1 "Abregelrampe" 2 "Aufregelrampe" /end COMPU_VTAB
/begin COMPU_VTAB Conv.cBihMobef._.f_rganglimitaktiv_S6_S3 "Umrechnung fuer Messgroesse cBihMobef::f_rganglimitaktiv" TAB_VERB 2 0 "nicht aktiv" 1 "aktiv" /end COMPU_VTAB
/begin COMPU_VTAB Conv.cBihMobef._.fl_meschlupfaktiv_S6_S3 "Umrechnung fuer Messgroesse cBihMobef::fl_meschlupfaktiv" TAB_VERB 2 0 "noch nicht aktiv" 1 "bereits aktiv" /end COMPU_VTAB
/begin COMPU_VTAB Conv.cBihMobef._.flag_meschlupf_S6_S3 "Umrechnung fuer Messgroesse cBihMobef::flag_meschlupf" TAB_VERB 2 0 "nicht aktiv" 1 "aktiv" /end COMPU_VTAB
/begin COMPU_VTAB Conv.cBihMobef._.z_m_motmax_schlupf_S6_S3 "Umrechnung fuer Messgroesse cBihMobef::z_m_motmax_schlupf" TAB_VERB 3 0 "nicht aktiv" 1 "aktiv" 2 "Aufregelrampe" /end COMPU_VTAB
/begin COMPU_VTAB Conv.cBihMomen._.z_t_mverl_k0_S6_S3 "Umrechnung fuer Messgroesse cBihMomen::z_t_mverl_k0" TAB_VERB 3 0 "Timer passiv Schleppmoment K0" 1 "Timer aktiv  Schleppmoment K0" 2 "Timer passiv kein Schleppmoment von K0" /end COMPU_VTAB
/begin COMPU_VTAB Conv.cBihSigna._.fl_req_deactvt_actv_dampg_S6_S3 "Umrechnung fuer Messgroesse cBihSigna::fl_req_deactvt_actv_dampg" TAB_VERB 2 0 "Keine Deaktivierung ADA erlaubt" 1 "Deaktivierung ADA verboten" /end COMPU_VTAB
/begin COMPU_VTAB Conv.cBihSigna._.bremsbed_S6_S3 "Umrechnung fuer Messgroesse cBihSigna::bremsbed" TAB_VERB 2 0 "nicht betaetigt" 1 "betaetigt" /end COMPU_VTAB
/begin COMPU_VTAB Conv.cBihSigna._.bremsbed_ofstb_S6_S3 "Umrechnung fuer Messgroesse cBihSigna::bremsbed_ofstb" TAB_VERB 2 0 "nicht betaetigt" 1 "betaetigt" /end COMPU_VTAB
/begin COMPU_VTAB Conv.cBihSigna._.z_sbc_timer_S6_S3 "Umrechnung fuer Messgroesse cBihSigna::z_sbc_timer" TAB_VERB 3 0 "Passiv" 1 "Sbc Timer gestartet" 2 "Timer aktive" /end COMPU_VTAB
/begin COMPU_VTAB Conv.cBihSigna._.z_e_fahren_verzoegert_S6_S3 "Umrechnung fuer Messgroesse cBihSigna::z_e_fahren_verzoegert" TAB_VERB 2 0 "keine Schaltung" 1 "Schaltung aktiv" /end COMPU_VTAB
/begin COMPU_VTAB Conv.cBihPumpendruck._.z_pumpendruck_S6_S3 "Umrechnung fuer Messgroesse cBihPumpendruck::z_pumpendruck" TAB_VERB 5 0 "Z_PD_INIT" 1 "Z_PD_KEIN_DRUCK" 2 "Z_PD_EVT_DRUCK" 3 "Z_PD_SICHER_DRUCK" 4 "Z_PD_DRUCK_ABBAUEN" /end COMPU_VTAB
/begin COMPU_VTAB Conv.cKorDraus._.gwk_moeglich_S6_S3 "Umrechnung fuer Messgroesse cKorDraus::gwk_moeglich" TAB_VERB 2 0 "GWK-Betrieb nicht moeglich" 1 "GWK-Betrieb moeglich" /end COMPU_VTAB
/begin COMPU_VTAB Conv.cKorDraus._.k0_hydraulisch_moeglich_S6_S3 "Umrechnung fuer Messgroesse cKorDraus::k0_hydraulisch_moeglich" TAB_VERB 2 0 "K0-Betrieb hydraulisch nicht moeglich" 1 "K0-Betrieb hydraulisch moeglich" /end COMPU_VTAB
/begin COMPU_VTAB Conv.cKorDraus._.st_k0_filling_mode_S6_S3 "Umrechnung fuer Messgroesse cKorDraus::st_k0_filling_mode" TAB_VERB 4 0 "Keine Befuellung" 1 "Standard Befuellung" 2 "Optimierte Befuellung" 3 "Reduzierte Befuellung" /end COMPU_VTAB
/begin COMPU_VTAB Conv.cKorDraus._.kup_pruefpuls_S6_S3 "Umrechnung fuer Messgroesse cKorDraus::kup_pruefpuls" TAB_VERB 7 0 "KEINE_KUPPLUNG" 1 "K_A" 2 "K_B" 3 "K_C" 4 "K_D" 5 "K_E" 6 "K_K0" /end COMPU_VTAB
/begin COMPU_VTAB Conv.cKorDraus._.kfl_zuletzt_S6_S3 "Umrechnung fuer Messgroesse cKorDraus::kfl_zuletzt" TAB_VERB 3 0 "Kein Kraftfluss (nur Initialisierung)" 1 "Kraftfluss vorwaerts" 2 "Kraffluss rueckwaerts" /end COMPU_VTAB
/begin COMPU_VTAB Conv.cKorDraus._.gang_kfl_zuletzt_S6_S3 "Umrechnung fuer Messgroesse cKorDraus::gang_kfl_zuletzt" TAB_VERB 10 -1 "GR1" 0 "KEIN_GANG" 1 "G1" 2 "G2" 3 "G3" 4 "G4" 5 "G5" 6 "G6" 7 "G7" 8 "G8" /end COMPU_VTAB
/begin COMPU_VTAB Conv.cKorDraus._.kup_zu_in_n_S6_S3 "Umrechnung fuer Messgroesse cKorDraus::kup_zu_in_n" TAB_VERB 6 0 "KEINE" 1 "K_A" 2 "K_B" 3 "K_C" 4 "K_D" 5 "K_E" /end COMPU_VTAB
/begin COMPU_VTAB Conv.cKorDraus._.druckausgabe_kup_zu_in_n_aktiv_S6_S3 "Umrechnung fuer Messgroesse cKorDraus::druckausgabe_kup_zu_in_n_aktiv" TAB_VERB 2 0 "Keine Druckausgabe schiessende Kuppung in KEIN_KFL aktiv" 1 "Druckausgabe schiessende Kuppung in KEIN_KFL aktiv" /end COMPU_VTAB
/begin COMPU_VTAB Conv.cKorDraus._.kup_pf_in_n_S6_S3 "Umrechnung fuer Messgroesse cKorDraus::kup_pf_in_n" TAB_VERB 6 0 "KEINE" 1 "K_A" 2 "K_B" 3 "K_C" 4 "K_D" 5 "K_E" /end COMPU_VTAB
/begin COMPU_VTAB Conv.cKorDraus._.druckausgabe_kup_pf_in_n_aktiv_S6_S3 "Umrechnung fuer Messgroesse cKorDraus::druckausgabe_kup_pf_in_n_aktiv" TAB_VERB 2 0 "Keine Druckausgabe Fülldruck-Kuppung in KEIN_KFL aktiv" 1 "Druckausgabe Fülldruck-Kuppung in KEIN_KFL aktiv" /end COMPU_VTAB
/begin COMPU_VTAB Conv.cKorDraus._.statisch_p_kup_pf_in_n_S6_S3 "Umrechnung fuer Messgroesse cKorDraus::statisch_p_kup_pf_in_n" TAB_VERB 2 0 "Keine STATISCH Ansteuerung der Fülldruck-Kuppung in KEIN_KFL aktiv" 1 "STATISCH Ansteuerung der Fülldruck-Kuppung in KEIN_KFL aktiv" /end COMPU_VTAB
/begin COMPU_VTAB Conv.cKorDraus._.z_pof1kplbinn_S6_S3 "Umrechnung fuer Messgroesse cKorDraus::z_pof1kplbinn" TAB_VERB 4 0 "Passiv" 1 "Warten bis POSV-Uebweachung beendet" 2 "Warten bis Kolben Kpl B anliegt" 3 "Druckoffset P_OF1KPLBINN wird aktiv ausgegeben." /end COMPU_VTAB
/begin COMPU_VTAB Conv.cKorDraus._.posv_uew_hyd_aktiv_S6_S3 "Umrechnung fuer Messgroesse cKorDraus::posv_uew_hyd_aktiv" TAB_VERB 2 0 "Keine Hydraulikansteuerung POS P bei POSV-Ueberwachung aktiv ist" 1 "Hydraulikansteuerung POS P bei POSV-Ueberwachung aktiv ist" /end COMPU_VTAB
/begin COMPU_VTAB Conv.cMvsZentr._.ps_zustand_S6_S3 "Umrechnung fuer Messgroesse cMvsZentr::ps_zustand" TAB_VERB 5 0 "Parksperre unbekannt" 1 "Parksperre geloest" 2 "Parksperre loesen" 3 "Parksperre einlegen" 4 "Parksperre eingelegt" /end COMPU_VTAB
/begin COMPU_VTAB Conv.cMvsZentr._.ps_aktiv_S6_S3 "Umrechnung fuer Messgroesse cMvsZentr::ps_aktiv" TAB_VERB 2 0 "Parksperren-Ansteuerung ist NICHT aktiv" 1 "Parksperren-Ansteuerung ist aktiv" /end COMPU_VTAB
/begin COMPU_VTAB Conv.cMvsZentr._.ps_aktiv_permanent_S6_S3 "Umrechnung fuer Messgroesse cMvsZentr::ps_aktiv_permanent" TAB_VERB 2 0 "Parksperren-Ansteuerung ist NICHT aktiv" 1 "Parksperren-Ansteuerung ist aktiv" /end COMPU_VTAB
/begin COMPU_VTAB Conv.cMvsZentr._.ps_magnet_timeout_S6_S3 "Umrechnung fuer Messgroesse cMvsZentr::ps_magnet_timeout" TAB_VERB 2 0 "NICHT aktiv" 1 "Timeout erreicht -> Spule abschalten" /end COMPU_VTAB
/begin FUNCTION AZS_SCHALTUNG "beinhaltet die verschiedenen Klassen/Gaenge, die an einer Schaltung beteiligt sind"
 /begin LOC_MEASUREMENT iAzsIstgang.f_saf_abbruch_invers iAzsIstgang.f_saf_folgeschaltung iAzsIstgang.f_saf_freigegeben iAzsIstgang.istgang iAzsSollgangMoeglich.sollgang_moeglich iAzsVorgabeGang.f_abbruch_vorb_angefordert iAzsVorgabeGang.f_schleppstart_erkannt iAzsVorgabeGang.gang_schleppstart iAzsVorgabeGang.vorgabegang iAzsVorgabeGang.z_abbruch_rsrs iAzsZielgang.f_schalt_abbruch_invers iAzsZielgang.zielgang iAzsZielgangSas.schaltart iAzsZielgangSas.schaltinfo iAzsZielgangSas.schaltung iAzsZielgangSas.zielgang_sas iAzsZielgangSas.zielgang_sas_komp iAzsZielgangSoll.zielgang_soll /end LOC_MEASUREMENT
/end FUNCTION
/begin FUNCTION AZS_UEBERWACHUNG "Kupplungsschutz und Plausibilisierung der AZS Gang- und Kfl-Groessen"
 /begin LOC_MEASUREMENT iAzsKupMassnahmenKoord.beeinfl_spont_index iAzsKupMassnahmenKoord.c_kup_mass_global iAzsKupMassnahmenKoord.iSchaltungTrans.istgang iAzsKupMassnahmenKoord.iSchaltungTrans.k_ab iAzsKupMassnahmenKoord.iSchaltungTrans.k_ab_temp iAzsKupMassnahmenKoord.iSchaltungTrans.k_zu iAzsKupMassnahmenKoord.iSchaltungTrans.k_zu_temp iAzsKupMassnahmenKoord.iSchaltungTrans.kup_mass iAzsKupMassnahmenKoord.iSchaltungTrans.manuell iAzsKupMassnahmenKoord.iSchaltungTrans.schaltart iAzsKupMassnahmenKoord.iSchaltungTrans.temp_schwelle_hys_k_ab iAzsKupMassnahmenKoord.iSchaltungTrans.temp_schwelle_hys_k_zu iAzsKupMassnahmenKoord.iSchaltungTrans.temp_schwelle_k_ab iAzsKupMassnahmenKoord.iSchaltungTrans.temp_schwelle_k_zu iAzsKupMassnahmenKoord.iSchaltungTrans.zielgang_sas iAzsKupMassnahmenKoord.iSchaltungVerz.cSchaltung._.istgang iAzsKupMassnahmenKoord.iSchaltungVerz.cSchaltung._.k_ab iAzsKupMassnahmenKoord.iSchaltungVerz.cSchaltung._.k_ab_temp iAzsKupMassnahmenKoord.iSchaltungVerz.cSchaltung._.k_zu iAzsKupMassnahmenKoord.iSchaltungVerz.cSchaltung._.k_zu_temp iAzsKupMassnahmenKoord.iSchaltungVerz.cSchaltung._.kup_mass iAzsKupMassnahmenKoord.iSchaltungVerz.cSchaltung._.manuell iAzsKupMassnahmenKoord.iSchaltungVerz.cSchaltung._.schaltart iAzsKupMassnahmenKoord.iSchaltungVerz.cSchaltung._.temp_schwelle_hys_k_ab iAzsKupMassnahmenKoord.iSchaltungVerz.cSchaltung._.temp_schwelle_hys_k_zu iAzsKupMassnahmenKoord.iSchaltungVerz.cSchaltung._.temp_schwelle_k_ab iAzsKupMassnahmenKoord.iSchaltungVerz.cSchaltung._.temp_schwelle_k_zu iAzsKupMassnahmenKoord.iSchaltungVerz.cSchaltung._.zielgang_sas iAzsKupMassnahmenKoord.iSchaltungVerz.iVerzZeit.time iAzsKupMassnahmenKoord.iSchaltungVerz.k_a_schalt_verh iAzsKupMassnahmenKoord.iSchaltungVerz.k_b_schalt_verh iAzsKupMassnahmenKoord.iSchaltungVerz.k_c_schalt_verh iAzsKupMassnahmenKoord.iSchaltungVerz.k_d_schalt_verh iAzsKupMassnahmenKoord.iSchaltungVerz.k_e_schalt_verh iAzsKupMassnahmenKoord.iSchaltungVerz.sollgang iAzsKupMassnahmenKoord.kup_mass_global iAzsKupMassnahmenKoord.reduzierung_m_mot_max iAzsKupMassnahmenKoord.versch_schalt_verh iAzsKupMassnahmenKoord.zustand_schaltungsverh /end LOC_MEASUREMENT
/end FUNCTION
/begin FUNCTION BIH "Das Paket BIH enthÃ¤lt alle Klassen und FunktionalitÃ¤ten, welche fÃ¼r die Signalaufbereitung der Komponentenschnittstellen notwendig sind." /begin SUB_FUNCTION BIH_HILFSMODULE /end SUB_FUNCTION /end FUNCTION
/begin FUNCTION BIH_HILFSMODULE "In BIH_HILFSMODULE sind Hilffunktionen zur Berechung der Schnittstellen enthalten"
 /begin LOC_MEASUREMENT iBihHotmode.c_maxhotmode iBihMeRedAbs.me_red_abs iBihMeRedAbs.me_red_abs_komp iBihMeRedAbs.me_red_status iBihMeRedAbs.me_red_status_komp iBihMobef.counter_meschlupf iBihMobef.f_rganglimitaktiv iBihMobef.fl_meschlupfaktiv iBihMobef.flag_meschlupf iBihMobef.flag_schlupf_psyseff iBihMobef.funk_ge_mmotmax iBihMobef.m_getrmax_schlupf iBihMobef.m_motmax_getr iBihMobef.m_motmax_getr_alt iBihMobef.m_motmax_getr_neu iBihMobef.m_motmax_stall iBihMobef.m_motmax_strang iBihMobef.m_motortraegheit iBihMobef.m_t_meschlupfaktiv iBihMobef.me_abs iBihMobef.me_diff iBihMobef.nd_synmmotmax iBihMobef.nd_synschutz iBihMobef.timer16_meuw iBihMobef.timer_m_motmax_schlupf_aktiv iBihMobef.timer_metot iBihMobef.timer_ndsynme iBihMobef.timer_ndsynpsyseff iBihMobef.timer_notlaufsprung iBihMobef.timer_ra_m_motmax iBihMobef.timer_ra_m_motmax_schlupf iBihMobef.timer_vstall iBihMobef.z_m_motmax_kor_strang iBihMobef.z_m_motmax_schlupf iBihMomen.TimerK0Verlust.time iBihMomen.m_ab_dyn iBihMomen.m_getrverl iBihMomen.md_motsollist iBihMomen.n_tsynist iBihMomen.n_tsynziel iBihMomen.z_t_mverl_k0 iBihMomenHsHss.hss_m_motmaxhss_hys iBihMomenHsHss.hss_momotmaxndhss iBihMomenHsHss.hss_tvsyncghss iBihMomenHsHss.iTimerGesamtHssPhase.timer iBihMomenHsHss.iTimerGesamtHssStartRampe3.timer iBihMomenHsHss.istgang_hss iBihMomenHsHss.m_mot_hss iBihMomenHsHss.m_motmax_hss iBihMomenHsHss.me_sas_hss iBihMomenHsHss.z_mmotmax_hss iBihMomenHsHss.zielgang_hss iBihNeigungssignal.steigung_hang_filter iBihNeigungssignal.timer_neigung iBihPumpendruck.z_pumpendruck iBihSigna.bremsbed iBihSigna.bremsbed_ofstb iBihSigna.fl_req_deactvt_actv_dampg iBihSigna.sbc_aktiv iBihSigna.timer_sbc_aktiv.timer iBihSigna.timer_sollgang_pruefung iBihSigna.timer_zielgang_aenderung.timer iBihSigna.z_e_fahren_verzoegert iBihSigna.z_sbc_timer iBihSigna.zeit_t_sbc_aktiv /end LOC_MEASUREMENT
 /begin SUB_FUNCTION GETRIEBEAUFNAHMEMOMENT /end SUB_FUNCTION
/end FUNCTION
/begin FUNCTION GETRIEBEAUFNAHMEMOMENT "Getriebeaufnahmemoment besteht aus dem Wandleraufnahmemoment, Pumpenaufnahmemoment und dyn. Wandleraufnahmemoment"
 /begin LOC_MEASUREMENT iBihMGetrauf.m_getrauf iBihMPuauf.Pt1MPuAuf.x iBihMPuauf.m_puauf iBihMPuauf.n_mot_pu /end LOC_MEASUREMENT
/end FUNCTION
/begin FUNCTION HYD "Das Paket HYD enthält Klassen und Funktionalitäten, welche zur Hydraulikansteuerung und -nachbildung notwendig sind. Alle Klassen lassen sich den Untergruppen Kupplungsansteuerung (HYD_ANSTEUERUNG) und Hydrauliknachbildung (HYD_NACHBILDUNG) zuordnen."
 /begin SUB_FUNCTION HYD_ANSTEUERUNG HYD_DRUCKVORGABE HYD_NACHBILDUNG HYD_EDS_NACHBILDUNG /end SUB_FUNCTION
/end FUNCTION
/begin FUNCTION HYD_ANSTEUERUNG "Hydraulikansteuerung"
 /begin LOC_MEASUREMENT iKorDraus.druckausgabe_kup_pf_in_n_aktiv iKorDraus.druckausgabe_kup_zu_in_n_aktiv iKorDraus.gang_kfl_zuletzt iKorDraus.gwk_moeglich iKorDraus.k0_hydraulisch_moeglich iKorDraus.kfl_zuletzt iKorDraus.kup_pf_in_n iKorDraus.kup_pruefpuls iKorDraus.kup_zu_in_n iKorDraus.p_kup_pf_in_n iKorDraus.posv_uew_hyd_aktiv iKorDraus.st_k0_filling_mode iKorDraus.statisch_p_kup_pf_in_n iKorDraus.timer_cruise iKorDraus.timer_pof1kplbinn iKorDraus.z_pof1kplbinn iMvsZentr.iTimerKeinKfl.timer iMvsZentr.iTimerMagnet.timer iMvsZentr.iTimerParksp.timer iMvsZentr.ps_aktiv iMvsZentr.ps_aktiv_permanent iMvsZentr.ps_magnet_timeout iMvsZentr.ps_zustand /end LOC_MEASUREMENT
/end FUNCTION
/end MODULE
/end PROJECT
