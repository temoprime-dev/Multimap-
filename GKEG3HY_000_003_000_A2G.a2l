ASAP2_VERSION 1 51
/begin PROJECT _929_929 "Gen2_BMW_System_Supplier_Lib"
/begin HEADER "" VERSION "C_03_03" PROJECT_NO _929_929 /end HEADER
/begin MODULE DIM ""
/begin MOD_COMMON "" BYTE_ORDER MSB_FIRST ALIGNMENT_BYTE 1 ALIGNMENT_WORD 2 ALIGNMENT_LONG 4 ALIGNMENT_FLOAT32_IEEE 4 /end MOD_COMMON
/begin MEASUREMENT iKorGskup.kup_gsk "Nr. der Geregelten Schaltkupplung (SAD, CSC, Bypass, IAE)" UBYTE Conv.cKorGskup._.kup_gsk_S6_S3 1 100 0 7 DISPLAY_IDENTIFIER kup_gsk.iKorGskup ECU_ADDRESS 0xFFF8A114 /end MEASUREMENT
/begin MEASUREMENT iKorGskup.gsk_funktion "aktuelle GSK Funktion" UBYTE Conv.cKorGskup._.gsk_funktion_S6_S3 1 100 0 4 DISPLAY_IDENTIFIER gsk_funktion.iKorGskup ECU_ADDRESS 0xFFF8A115 /end MEASUREMENT
/begin MEASUREMENT iKorGskup.p_gsk "Druck fuer geregelte Schaltkupplung" SWORD UMR_MBAR__1_1_0_S6_S3 1 100 -1000 12750 DISPLAY_IDENTIFIER p_gsk.iKorGskup ECU_ADDRESS 0xFFF8A116 /end MEASUREMENT
/begin MEASUREMENT iKorGskup.gsk_aktiv "FLAG: GSK Ansteuerung aktiv" UBYTE Conv.cKorGskup._.gsk_aktiv_S6_S3 1 100 0 1 BIT_MASK 0x1 DISPLAY_IDENTIFIER gsk_aktiv.iKorGskup ECU_ADDRESS 0xFFF8A118 /end MEASUREMENT
/begin MEASUREMENT iKorGskup.f_kraftschl_kup_fa "FLAG: Kraftschl.Kup mindestens in FA" UBYTE Conv.cKorGskup._.f_kraftschl_kup_fa_S6_S3 1 100 0 1 BIT_MASK 0x1 DISPLAY_IDENTIFIER f_kraftschl_kup_fa.iKorGskup ECU_ADDRESS 0xFFF8A119 /end MEASUREMENT
/begin MEASUREMENT iKorGskup.me_gsk_abs_diff "Momentenanforderung GSK als absolute Differenz zu den anderen Eingriffen" SWORD UMR_NM__1_1_0_S6_S3 1 100 -2000 2000 DISPLAY_IDENTIFIER me_gsk_abs_diff.iKorGskup ECU_ADDRESS 0xFFF8A11A /end MEASUREMENT
/begin MEASUREMENT iKorGskup.fehler_gsk_regeln_verboten "HPSYS: Regeln der GSK nicht erlaubt" UBYTE Conv.cKorGskup._.fehler_gsk_regeln_verboten_S6_S3 1 100 0 1 BIT_MASK 0x1 DISPLAY_IDENTIFIER fehler_gsk_regeln_verboten.iKorGskup ECU_ADDRESS 0xFFF8A11C /end MEASUREMENT
/begin MEASUREMENT iKorGskup.p_gsk_wirk "aktueller Wirkdruck der aktuellen geregelten Schalt-Kupplung" SWORD UMR_MBAR__1_1_0_S6_S3 1 100 -1000 12750 DISPLAY_IDENTIFIER p_gsk_wirk.iKorGskup ECU_ADDRESS 0xFFF8A11E /end MEASUREMENT
/begin MEASUREMENT iKorGskup.gsk_zustand "Zustandsgroesse GSK (CSC)" UBYTE Conv.cKorGskup._.gsk_zustand_S6_S3 1 100 0 8 DISPLAY_IDENTIFIER gsk_zustand.iKorGskup ECU_ADDRESS 0xFFF8A120 /end MEASUREMENT
/begin MEASUREMENT iKorGskup.m_motmax_gsk "maximal zulaessiges Motormoment aus GSK (CSC, Bypass)" SWORD UMR_NM__1_1_0_S6_S3 1 100 -400 1640 DISPLAY_IDENTIFIER m_motmax_gsk.iKorGskup ECU_ADDRESS 0xFFF8A122 /end MEASUREMENT
/begin MEASUREMENT iKorGskup.f_gsk_schlupft "FLAG: !!!ACHTUNG!!!GSK Ansteuerung aktiv wird nicht Zyklisch bestimmt die Messgröße ist nur zur Darstellung der Abfrag QuGskSchlupft" UBYTE Conv.cKorGskup._.f_gsk_schlupft_S6_S3 1 100 0 1 BIT_MASK 0x1 DISPLAY_IDENTIFIER f_gsk_schlupft.iKorGskup ECU_ADDRESS 0xFFF8A124 /end MEASUREMENT
/begin MEASUREMENT iKasEkopl.TimerZEkopl.time "Zeit des Timers" UWORD UMR_SEC__1_100_0_S6_S3 1 100 0 655.35 DISPLAY_IDENTIFIER time.TimerZEkopl.iKasEkopl ECU_ADDRESS 0xFFF8ED9E /end MEASUREMENT
/begin MEASUREMENT iKasEkopl.TimerZEkopl.maxtime "Endzeit" UWORD UMR_SEC__1_100_0_S6_S3 1 100 0 655.35 DISPLAY_IDENTIFIER maxtime.TimerZEkopl.iKasEkopl ECU_ADDRESS 0xFFF8EDA0 /end MEASUREMENT
/begin MEASUREMENT iKasEkopl.TimerSchlEkop.time "Zeit des Timers" UWORD UMR_SEC__1_100_0_S6_S3 1 100 0 655.35 DISPLAY_IDENTIFIER time.TimerSchlEkop.iKasEkopl ECU_ADDRESS 0xFFF8EDA2 /end MEASUREMENT
/begin MEASUREMENT iKasEkopl.TimerSchlEkop.maxtime "Endzeit" UWORD UMR_SEC__1_100_0_S6_S3 1 100 0 655.35 DISPLAY_IDENTIFIER maxtime.TimerSchlEkop.iKasEkopl ECU_ADDRESS 0xFFF8EDA4 /end MEASUREMENT
/begin MEASUREMENT iKasEkopl.Pt1MoEntkoppl.x "Filterwert" SLONG UMR___1_300_0_S6_S3 1 100 -7158278.82667 7158278.82333 DISPLAY_IDENTIFIER Pt1MoEntkoppl.iKasEkopl ECU_ADDRESS 0xFFF8EDA8 /end MEASUREMENT
/begin MEASUREMENT iKasEkopl.z_entkoppeln "Zustand der Anfahrkupplung" UBYTE Conv.cKasEkopl._.z_entkoppeln_S6_S3 1 100 0 3 DISPLAY_IDENTIFIER z_entkoppeln.iKasEkopl ECU_ADDRESS 0xFFF8ED84 /end MEASUREMENT
/begin MEASUREMENT iKasEkopl.m_vorsteuer_entkoppeln "Vorsteuermoment für Entkopplung" SWORD UMR_NM__1_1_0_S6_S3 1 100 -400 1640 DISPLAY_IDENTIFIER m_vorsteuer_entkoppeln.iKasEkopl ECU_ADDRESS 0xFFF8ED86 /end MEASUREMENT
/begin MEASUREMENT iKasEkopl.m_vorsteuer_entkoppeln_init "Vorsteuermoment Initialisierungswert für Entkopplung" SWORD UMR_NM__1_1_0_S6_S3 1 100 -400 1640 DISPLAY_IDENTIFIER m_vorsteuer_entkoppeln_init.iKasEkopl ECU_ADDRESS 0xFFF8ED88 /end MEASUREMENT
/begin MEASUREMENT iKasEkopl.m_max_alter_has_entkopl "gespeichertes m_max_has beim Eintritt in Zustand Entkoppeln" SWORD UMR_NM__1_1_0_S6_S3 1 100 -400 1640 DISPLAY_IDENTIFIER m_max_alter_has_entkopl.iKasEkopl ECU_ADDRESS 0xFFF8ED8A /end MEASUREMENT
/begin MEASUREMENT iKasEkopl.mo_vorsteuer_entkoppeln "Ofset auf Vorsteuermoment für Entkopplung" SWORD UMR_NM__1_1_0_S6_S3 1 100 -400 1640 DISPLAY_IDENTIFIER mo_vorsteuer_entkoppeln.iKasEkopl ECU_ADDRESS 0xFFF8ED8C /end MEASUREMENT
/begin MEASUREMENT iKasEkopl.m_soll_entkoppeln_init "Init Wert für Sollmoment Entkopplung" SWORD UMR_NM__1_1_0_S6_S3 1 100 -400 1640 DISPLAY_IDENTIFIER m_soll_entkoppeln_init.iKasEkopl ECU_ADDRESS 0xFFF8ED8E /end MEASUREMENT
/begin MEASUREMENT iKasEkopl.mo_vorstschl_entkoppeln "Offset auf Vorsteuermoment für Entkopplung_Schliessen" SLONG UMR_NM__1_100_0_S6_S3 1 100 -1300 1500 DISPLAY_IDENTIFIER mo_vorstschl_entkoppeln.iKasEkopl ECU_ADDRESS 0xFFF8ED90 /end MEASUREMENT
/begin MEASUREMENT iKasEkopl.m_regler_entkoppeln "Reglermoment für Entkopplung" FLOAT32_IEEE UMR_NM__1_1_0_S6_S3 1 100 -400 1640 DISPLAY_IDENTIFIER m_regler_entkoppeln.iKasEkopl ECU_ADDRESS 0xFFF8ED94 /end MEASUREMENT
/begin MEASUREMENT iKasEkopl.m_mot_init "Motormomentenwert zu Beginn des SCHLIESSEN_ENTKOPPELN Zustandes" SWORD UMR_NM__1_1_0_S6_S3 1 100 -400 1640 DISPLAY_IDENTIFIER m_mot_init.iKasEkopl ECU_ADDRESS 0xFFF8ED98 /end MEASUREMENT
/begin MEASUREMENT iKasEkopl.m_max_has_entkoppeln "Internes Moment von m_max_has_iae" SWORD UMR_NM__1_1_0_S6_S3 1 100 -400 1640 DISPLAY_IDENTIFIER m_max_has_entkoppeln.iKasEkopl ECU_ADDRESS 0xFFF8ED9A /end MEASUREMENT
/begin MEASUREMENT iKasEkopl.flag_mo_aktiv_entkoppl "Momentenoffset wird im Entkoppeln aufgeschaltet" UBYTE Conv.cKasEkopl._.flag_mo_aktiv_entkoppl_S6_S3 1 100 0 1 BIT_MASK 0x1 DISPLAY_IDENTIFIER flag_mo_aktiv_entkoppl.iKasEkopl ECU_ADDRESS 0xFFF8ED9C /end MEASUREMENT
/begin MEASUREMENT iIaeKordi.TimerZIae.time "Zeit des Timers" UWORD UMR_SEC__1_100_0_S6_S3 1 100 0 655.35 DISPLAY_IDENTIFIER time.TimerZIae.iIaeKordi ECU_ADDRESS 0xFFF8A0FA /end MEASUREMENT
/begin MEASUREMENT iIaeKordi.TimerZIae.maxtime "Endzeit" UWORD UMR_SEC__1_100_0_S6_S3 1 100 0 655.35 DISPLAY_IDENTIFIER maxtime.TimerZIae.iIaeKordi ECU_ADDRESS 0xFFF8A0FC /end MEASUREMENT
/begin MEASUREMENT iIaeKordi.z_iae "Zustand der Anfahrkupplung" UBYTE Conv.cIaeKordi._.z_iae_S6_S3 1 100 0 9 DISPLAY_IDENTIFIER z_iae.iIaeKordi ECU_ADDRESS 0xFFF8A0F0 /end MEASUREMENT
/begin MEASUREMENT iIaeKordi.z_iae_temp "letzter Zustand der Anfahrkupplung" UBYTE Conv.cIaeKordi._.z_iae_temp_S6_S3 1 100 0 10 DISPLAY_IDENTIFIER z_iae_temp.iIaeKordi ECU_ADDRESS 0xFFF8A0F1 /end MEASUREMENT
/begin MEASUREMENT iIaeKordi.t_nds_zu_iae "Zeit seit wann die Schwelle NDS_ZU unterschritten ist" UBYTE UMR_MSEC__10_1_0_S6_S3 1 100 0 2550 DISPLAY_IDENTIFIER t_nds_zu_iae.iIaeKordi ECU_ADDRESS 0xFFF8A0F2 /end MEASUREMENT
/begin MEASUREMENT iIaeKordi.flag_zu_gewesen_iae "IAE war schon einmal zu" UBYTE Conv.cIaeKordi._.flag_zu_gewesen_iae_S6_S3 1 100 0 1 BIT_MASK 0x1 DISPLAY_IDENTIFIER flag_zu_gewesen_iae.iIaeKordi ECU_ADDRESS 0xFFF8A0F3 /end MEASUREMENT
/begin MEASUREMENT iIaeKordi.timer_z_iae "Zeit im aktuellen IAE Zustand" UWORD UMR_MSEC__10_1_0_S6_S3 1 100 0 600000 DISPLAY_IDENTIFIER timer_z_iae.iIaeKordi ECU_ADDRESS 0xFFF8A0F4 /end MEASUREMENT
/begin MEASUREMENT iIaeKordi.t_angelegt_iae "Zeit im Zustand Stillstand" UWORD UMR_MSEC__10_1_0_S6_S3 1 100 0 600000 DISPLAY_IDENTIFIER t_angelegt_iae.iIaeKordi ECU_ADDRESS 0xFFF8A0F6 /end MEASUREMENT
/begin MEASUREMENT iIaeKordi.kup_status_iae "Kupplungsstatus der Anfahrkupplung" UBYTE Conv.cIaeKordi._.kup_status_iae_S6_S3 1 100 0 8 DISPLAY_IDENTIFIER kup_status_iae.iIaeKordi ECU_ADDRESS 0xFFF8A0F8 /end MEASUREMENT
/begin MEASUREMENT iIaeAdauf.iTLaufUefiae.timer "Der aktuelle Timerwert" UBYTE UMR_MSEC__10_1_0_S6_S3 1 100 0 2550 DISPLAY_IDENTIFIER iTLaufUefiae.iIaeAdauf ECU_ADDRESS 0xFFF8A0EF /end MEASUREMENT
/begin MEASUREMENT iIaeAdauf.mue_ist_uefiae "Durch Adaption ermittelter Reibwert" SWORD UMR_NM_BAR_1_1_0_S6_S3 1 100 0 1000 DISPLAY_IDENTIFIER mue_ist_uefiae.iIaeAdauf ECU_ADDRESS 0xFFF8A0CA /end MEASUREMENT
/begin MEASUREMENT iIaeAdauf.mue_start_uefiae "Startwert des verwendeten Mue Werts" SWORD UMR_NM_BAR_1_1_0_S6_S3 1 100 0 1000 DISPLAY_IDENTIFIER mue_start_uefiae.iIaeAdauf ECU_ADDRESS 0xFFF8A0CC /end MEASUREMENT
/begin MEASUREMENT iIaeAdauf.mue_mw_uefiae "Mittelwert des verwendeten Mue Werts in der beobachteten Zeit" SWORD UMR_NM_BAR_1_1_0_S6_S3 1 100 0 1000 DISPLAY_IDENTIFIER mue_mw_uefiae.iIaeAdauf ECU_ADDRESS 0xFFF8A0CE /end MEASUREMENT
/begin MEASUREMENT iIaeAdauf.mue_diff "Gemessene Differenz MUE-Soll MUE-Ist" SWORD UMR_NM_BAR_1_1_0_S6_S3 1 100 -1000 1000 DISPLAY_IDENTIFIER mue_diff.iIaeAdauf ECU_ADDRESS 0xFFF8A0D0 /end MEASUREMENT
/begin MEASUREMENT iIaeAdauf.mue_kor_j_uefiae "Korrekturwert aus dem Traegheitskorrekturkenfeld zur zur Verbesserung von TAB_MTM_MOT_UEFIAE" SBYTE UMR_NM_BAR_1_1_0_S6_S3 1 100 -100 100 DISPLAY_IDENTIFIER mue_kor_j_uefiae.iIaeAdauf ECU_ADDRESS 0xFFF8A0D2 /end MEASUREMENT
/begin MEASUREMENT iIaeAdauf.m_motist_start_uefiae "gefiltertes und verzögertes Motormoment mit Eingriffen" SWORD UMR_NM__1_1_0_S6_S3 1 100 -400 1640 DISPLAY_IDENTIFIER m_motist_start_uefiae.iIaeAdauf ECU_ADDRESS 0xFFF8A0D4 /end MEASUREMENT
/begin MEASUREMENT iIaeAdauf.m_motist_mw_uefiae "Mittelwert des gefiltertes und verzögertes Motormoment mit Eingriffen" SWORD UMR_NM__1_1_0_S6_S3 1 100 -400 1640 DISPLAY_IDENTIFIER m_motist_mw_uefiae.iIaeAdauf ECU_ADDRESS 0xFFF8A0D6 /end MEASUREMENT
/begin MEASUREMENT iIaeAdauf.m_soll_start_uefiae "IAE Sollmoment Getriebeeingangsseitig" SWORD UMR_NM__1_1_0_S6_S3 1 100 -400 1640 DISPLAY_IDENTIFIER m_soll_start_uefiae.iIaeAdauf ECU_ADDRESS 0xFFF8A0D8 /end MEASUREMENT
/begin MEASUREMENT iIaeAdauf.m_soll_mw_uefiae "Mittelwert des IAE Sollmoment Getriebeeingangsseitig" SWORD UMR_NM__1_1_0_S6_S3 1 100 -400 1640 DISPLAY_IDENTIFIER m_soll_mw_uefiae.iIaeAdauf ECU_ADDRESS 0xFFF8A0DA /end MEASUREMENT
/begin MEASUREMENT iIaeAdauf.m_stell_start_uefiae "IAE Stellmoment Anfahrkupplung" SWORD UMR_NM__1_1_0_S6_S3 1 100 -400 1640 DISPLAY_IDENTIFIER m_stell_start_uefiae.iIaeAdauf ECU_ADDRESS 0xFFF8A0DC /end MEASUREMENT
/begin MEASUREMENT iIaeAdauf.m_stell_mw_uefiae "Mittelwert des IAE Stellmoment Anfahrkupplung" SWORD UMR_NM__1_1_0_S6_S3 1 100 -400 1640 DISPLAY_IDENTIFIER m_stell_mw_uefiae.iIaeAdauf ECU_ADDRESS 0xFFF8A0DE /end MEASUREMENT
/begin MEASUREMENT iIaeAdauf.nd_start_uefiae "Differenzdrehzahl am Anfahrelement" SWORD UMR_U_MIN_1_1_0_S6_S3 1 100 -8160 8160 DISPLAY_IDENTIFIER nd_start_uefiae.iIaeAdauf ECU_ADDRESS 0xFFF8A0E0 /end MEASUREMENT
/begin MEASUREMENT iIaeAdauf.nd_mw_uefiae "Mittelwert der Differenzdrehzahl am Anfahrelement" SWORD UMR_U_MIN_1_1_0_S6_S3 1 100 -8160 8160 DISPLAY_IDENTIFIER nd_mw_uefiae.iIaeAdauf ECU_ADDRESS 0xFFF8A0E2 /end MEASUREMENT
/begin MEASUREMENT iIaeAdauf.ng_mot_start_uefiae "Gradient der Motordrehzahll" SWORD UMR_U_MINSEC_1_1_0_S6_S3 1 100 -10000 10000 DISPLAY_IDENTIFIER ng_mot_start_uefiae.iIaeAdauf ECU_ADDRESS 0xFFF8A0E4 /end MEASUREMENT
/begin MEASUREMENT iIaeAdauf.ng_mot_mw_uefiae "Mittelwert des Gradient der Motordrehzahll" SWORD UMR_U_MINSEC_1_1_0_S6_S3 1 100 -10000 10000 DISPLAY_IDENTIFIER ng_mot_mw_uefiae.iIaeAdauf ECU_ADDRESS 0xFFF8A0E6 /end MEASUREMENT
/begin MEASUREMENT iIaeAdauf.p_stell_start_uefiae "StellDruck fuer integrierte Anfahrkupplung" SWORD UMR_BAR__1_1000_0_S6_S3 1 100 -1 12.75 DISPLAY_IDENTIFIER p_stell_start_uefiae.iIaeAdauf ECU_ADDRESS 0xFFF8A0E8 /end MEASUREMENT
/begin MEASUREMENT iIaeAdauf.mue_adawert_lesen "Mue- Offset aus aktiven Adaptionswerten ausgelesen" SBYTE UMR_NM_BAR_1_1_0_S6_S3 1 100 -100 100 DISPLAY_IDENTIFIER mue_adawert_lesen.iIaeAdauf ECU_ADDRESS 0xFFF8A0EA /end MEASUREMENT
/begin MEASUREMENT iIaeAdauf.mue_adawert_schreiben "Mue- Offset der in das ADA KF geschieben wird" SBYTE UMR_NM_BAR_1_1_0_S6_S3 1 100 -100 100 DISPLAY_IDENTIFIER mue_adawert_schreiben.iIaeAdauf ECU_ADDRESS 0xFFF8A0EB /end MEASUREMENT
/begin MEASUREMENT iIaeAdauf.zielgang_start_uefiae "Ziel-Gang zum Startzeipunkt Beobachung" SBYTE Conv.cIaeAdauf._.zielgang_start_uefiae_S6_S3 1 100 -1 8 DISPLAY_IDENTIFIER zielgang_start_uefiae.iIaeAdauf ECU_ADDRESS 0xFFF8A0EC /end MEASUREMENT
/begin MEASUREMENT iIaeAdauf.kfl_ziel_start_uefiea "kfl_ziel zum Startzeipunkt Beobachung" UBYTE Conv.cIaeAdauf._.kfl_ziel_start_uefiea_S6_S3 1 100 0 2 DISPLAY_IDENTIFIER kfl_ziel_start_uefiea.iIaeAdauf ECU_ADDRESS 0xFFF8A0ED /end MEASUREMENT
/begin MEASUREMENT iIaeAdauf.z_ada_uefiae "Zustand der IAE Uebertragunsfaehigkeits-Adaption" UBYTE Conv.cIaeAdauf._.z_ada_uefiae_S6_S3 1 100 0 1 DISPLAY_IDENTIFIER z_ada_uefiae.iIaeAdauf ECU_ADDRESS 0xFFF8A0EE /end MEASUREMENT
/begin MEASUREMENT iIaeDraus.TimerHysSchl.time "Zeit des Timers" UWORD UMR_SEC__1_100_0_S6_S3 1 100 0 655.35 DISPLAY_IDENTIFIER time.TimerHysSchl.iIaeDraus ECU_ADDRESS 0xFFF8CF2E /end MEASUREMENT
/begin MEASUREMENT iIaeDraus.TimerHysSchl.maxtime "Endzeit" UWORD UMR_SEC__1_100_0_S6_S3 1 100 0 655.35 DISPLAY_IDENTIFIER maxtime.TimerHysSchl.iIaeDraus ECU_ADDRESS 0xFFF8CF30 /end MEASUREMENT
/begin MEASUREMENT iIaeDraus.TimerHyskompan.time "Zeit des Timers" UWORD UMR_SEC__1_100_0_S6_S3 1 100 0 655.35 DISPLAY_IDENTIFIER time.TimerHyskompan.iIaeDraus ECU_ADDRESS 0xFFF8CF32 /end MEASUREMENT
/begin MEASUREMENT iIaeDraus.TimerHyskompan.maxtime "Endzeit" UWORD UMR_SEC__1_100_0_S6_S3 1 100 0 655.35 DISPLAY_IDENTIFIER maxtime.TimerHyskompan.iIaeDraus ECU_ADDRESS 0xFFF8CF34 /end MEASUREMENT
/begin MEASUREMENT iIaeDraus.TimerPoDyn.time "Zeit des Timers" UWORD UMR_SEC__1_100_0_S6_S3 1 100 0 655.35 DISPLAY_IDENTIFIER time.TimerPoDyn.iIaeDraus ECU_ADDRESS 0xFFF8CF36 /end MEASUREMENT
/begin MEASUREMENT iIaeDraus.TimerPoDyn.maxtime "Endzeit" UWORD UMR_SEC__1_100_0_S6_S3 1 100 0 655.35 DISPLAY_IDENTIFIER maxtime.TimerPoDyn.iIaeDraus ECU_ADDRESS 0xFFF8CF38 /end MEASUREMENT
/begin MEASUREMENT iIaeDraus.Dt1PGStell.Pt1Si16.x "Filterwert" SLONG UMR___1_300_0_S6_S3 1 100 -7158278.82667 7158278.82333 DISPLAY_IDENTIFIER Pt1Si16.Dt1PGStell.iIaeDraus ECU_ADDRESS 0xFFF8CF40 /end MEASUREMENT
/begin MEASUREMENT iIaeDraus.Dt1PGStell.xp "Ableitung vom Eingangswert" SWORD UMR___1_1_0_S6_S3 1 100 -32768 32767 DISPLAY_IDENTIFIER Dt1PGStell.iIaeDraus ECU_ADDRESS 0xFFF8CF3C /end MEASUREMENT
/begin MEASUREMENT iIaeDraus.Pt1PDStellHysS.x "Filterwert" SLONG UMR___1_300_0_S6_S3 1 100 -7158278.82667 7158278.82333 DISPLAY_IDENTIFIER Pt1PDStellHysS.iIaeDraus ECU_ADDRESS 0xFFF8CF44 /end MEASUREMENT
/begin MEASUREMENT iIaeDraus.Pt1PoHysKo.x "Filterwert" SLONG UMR___1_300_0_S6_S3 1 100 -7158278.82667 7158278.82333 DISPLAY_IDENTIFIER Pt1PoHysKo.iIaeDraus ECU_ADDRESS 0xFFF8CF48 /end MEASUREMENT
/begin MEASUREMENT iIaeDraus.Pt1PoDyn.x "Filterwert" SLONG UMR___1_300_0_S6_S3 1 100 -7158278.82667 7158278.82333 DISPLAY_IDENTIFIER Pt1PoDyn.iIaeDraus ECU_ADDRESS 0xFFF8CF4C /end MEASUREMENT
/begin MEASUREMENT iIaeDraus.Pt1Mue.x "Filterwert" SLONG UMR___1_300_0_S6_S3 1 100 -7158278.82667 7158278.82333 DISPLAY_IDENTIFIER Pt1Mue.iIaeDraus ECU_ADDRESS 0xFFF8CF50 /end MEASUREMENT
/begin MEASUREMENT iIaeDraus.Pt1PStellbasis.x "Filterwert" SLONG UMR___1_300_0_S6_S3 1 100 -7158278.82667 7158278.82333 DISPLAY_IDENTIFIER Pt1PStellbasis.iIaeDraus ECU_ADDRESS 0xFFF8CF54 /end MEASUREMENT
/begin MEASUREMENT iIaeDraus.Pt2PIst.x "Filterwert" FLOAT32_IEEE UMR___1_1_0_S6_S3 1 100 -2147483648 2147483647 FORMAT "%4.2" DISPLAY_IDENTIFIER x.Pt2PIst.iIaeDraus ECU_ADDRESS 0xFFF8CF58 /end MEASUREMENT
/begin MEASUREMENT iIaeDraus.Pt2PIst.xp "Ableitung vom Eingangswert" FLOAT32_IEEE UMR__SEC_1_1_0_S6_S3 1 100 -2147483648 2147483647 FORMAT "%4.2" DISPLAY_IDENTIFIER xp.Pt2PIst.iIaeDraus ECU_ADDRESS 0xFFF8CF5C /end MEASUREMENT
/begin MEASUREMENT iIaeDraus.nd_iae_kf_mue "Differenzdrehzahl am Anfahrelement, Absolutwert minimalbegrenzt für MUE-Berechnung" SWORD UMR_U_MIN_1_1_0_S6_S3 1 100 -8160 8160 DISPLAY_IDENTIFIER nd_iae_kf_mue.iIaeDraus ECU_ADDRESS 0xFFF8CF08 /end MEASUREMENT
/begin MEASUREMENT iIaeDraus.p_stell_basis_iae "Basis-Stelldruck an der IAE direkt aus m_stell_iae berechnet" SWORD UMR_BAR__1_1000_0_S6_S3 1 100 -1 12.75 DISPLAY_IDENTIFIER p_stell_basis_iae.iIaeDraus ECU_ADDRESS 0xFFF8CF0A /end MEASUREMENT
/begin MEASUREMENT iIaeDraus.p_ist_basis_iae "PT2-gefiltertes p_stell_basis" SWORD UMR_BAR__1_1000_0_S6_S3 1 100 -1 12.75 DISPLAY_IDENTIFIER p_ist_basis_iae.iIaeDraus ECU_ADDRESS 0xFFF8CF0C /end MEASUREMENT
/begin MEASUREMENT iIaeDraus.pd_hysschleife_iae "Abzufilterder Differenzdruck nach der Hysterese-Schleife" SWORD UMR_BAR__1_1000_0_S6_S3 1 100 -1 12.75 DISPLAY_IDENTIFIER pd_hysschleife_iae.iIaeDraus ECU_ADDRESS 0xFFF8CF0E /end MEASUREMENT
/begin MEASUREMENT iIaeDraus.po_hys_iae "Druckoffset resultierend aus Hysteresekompensation gesamt" SWORD UMR_BAR__1_1000_0_S6_S3 1 100 -3 12.75 DISPLAY_IDENTIFIER po_hys_iae.iIaeDraus ECU_ADDRESS 0xFFF8CF10 /end MEASUREMENT
/begin MEASUREMENT iIaeDraus.po_dyn_iae "Druckoffset für Druckpeak" SWORD UMR_BAR__1_1000_0_S6_S3 1 100 -3 12.75 DISPLAY_IDENTIFIER po_dyn_iae.iIaeDraus ECU_ADDRESS 0xFFF8CF12 /end MEASUREMENT
/begin MEASUREMENT iIaeDraus.t_po_dyn_iae "Dauer des Druckpeaks" UWORD UMR_MSEC__10_1_0_S6_S3 1 100 0 600000 DISPLAY_IDENTIFIER t_po_dyn_iae.iIaeDraus ECU_ADDRESS 0xFFF8CF14 /end MEASUREMENT
/begin MEASUREMENT iIaeDraus.mpt_po_dyn_iae "Filterparameter für po_dyn_iae" UBYTE UMR___1_100_0_S6_S3 1 100 0 1 DISPLAY_IDENTIFIER mpt_po_dyn_iae.iIaeDraus ECU_ADDRESS 0xFFF8CF16 /end MEASUREMENT
/begin MEASUREMENT iIaeDraus.po_hyskomp_iae "Druckoffset resultierend aus Hysteresekompensation" SWORD UMR_BAR__1_1000_0_S6_S3 1 100 -3 12.75 DISPLAY_IDENTIFIER po_hyskomp_iae.iIaeDraus ECU_ADDRESS 0xFFF8CF18 /end MEASUREMENT
/begin MEASUREMENT iIaeDraus.z_hyskomp_iae "Zustand der Hysteresekompensation im Stillstand" UBYTE Conv.cIaeDraus._.z_hyskomp_iae_S6_S3 1 100 0 4 DISPLAY_IDENTIFIER z_hyskomp_iae.iIaeDraus ECU_ADDRESS 0xFFF8CF1A /end MEASUREMENT
/begin MEASUREMENT iIaeDraus.flag_p_stell_max_iae "Hysterese-Schleife aktiv" UBYTE Conv.cIaeDraus._.flag_p_stell_max_iae_S6_S3 1 100 0 1 BIT_MASK 0x1 DISPLAY_IDENTIFIER flag_p_stell_max_iae.iIaeDraus ECU_ADDRESS 0xFFF8CF1B /end MEASUREMENT
/begin MEASUREMENT iIaeDraus.f_hysschleife_aktiv_iae "Hysterese-Schleife aktiv" UBYTE Conv.cIaeDraus._.f_hysschleife_aktiv_iae_S6_S3 1 100 0 1 BIT_MASK 0x1 DISPLAY_IDENTIFIER f_hysschleife_aktiv_iae.iIaeDraus ECU_ADDRESS 0xFFF8CF1C /end MEASUREMENT
/begin MEASUREMENT iIaeDraus.f_hysschleife_moeglich_iae "Hysterese-Schleife moeglich" UBYTE Conv.cIaeDraus._.f_hysschleife_moeglich_iae_S6_S3 1 100 0 1 BIT_MASK 0x1 DISPLAY_IDENTIFIER f_hysschleife_moeglich_iae.iIaeDraus ECU_ADDRESS 0xFFF8CF1D /end MEASUREMENT
/begin MEASUREMENT iIaeDraus.flag_po_dyn_aktiv_iae "Druckpeakaufschaltung aktiv" UBYTE Conv.cIaeDraus._.flag_po_dyn_aktiv_iae_S6_S3 1 100 0 1 BIT_MASK 0x1 DISPLAY_IDENTIFIER flag_po_dyn_aktiv_iae.iIaeDraus ECU_ADDRESS 0xFFF8CF1E /end MEASUREMENT
/begin MEASUREMENT iIaeDraus.flag_m_max_alt "Hysterese-Schleife moeglich" UBYTE Conv.cIaeDraus._.flag_m_max_alt_S6_S3 1 100 0 1 BIT_MASK 0x1 DISPLAY_IDENTIFIER flag_m_max_alt.iIaeDraus ECU_ADDRESS 0xFFF8CF1F /end MEASUREMENT
/begin MEASUREMENT iIaeDraus.flag_init_ausinaktiv_iae "Initialisierung nach Inaktiv" UBYTE Conv.cIaeDraus._.flag_init_ausinaktiv_iae_S6_S3 1 100 0 1 BIT_MASK 0x1 DISPLAY_IDENTIFIER flag_init_ausinaktiv_iae.iIaeDraus ECU_ADDRESS 0xFFF8CF20 /end MEASUREMENT
/begin MEASUREMENT iIaeDraus.mue_iae "Wandlerübertragung" SWORD UMR_NM_BAR_1_1_0_S6_S3 1 100 0 30000 DISPLAY_IDENTIFIER mue_iae.iIaeDraus ECU_ADDRESS 0xFFF8CF22 /end MEASUREMENT
/begin MEASUREMENT iIaeDraus.p_stellalt_iae "StellDruck fuer integrierte Anfahrkupplung" SWORD UMR_BAR__1_1000_0_S6_S3 1 100 -1 12.75 DISPLAY_IDENTIFIER p_stellalt_iae.iIaeDraus ECU_ADDRESS 0xFFF8CF24 /end MEASUREMENT
/begin MEASUREMENT iIaeDraus.p_stell_init_iae "StellDruck fuer integrierte Anfahrkupplung bei Zustandsuebergang" SWORD UMR_BAR__1_1000_0_S6_S3 1 100 -1 12.75 DISPLAY_IDENTIFIER p_stell_init_iae.iIaeDraus ECU_ADDRESS 0xFFF8CF26 /end MEASUREMENT
/begin MEASUREMENT iIaeDraus.p_stell_iae "StellDruck fuer integrierte Anfahrkupplung" SWORD UMR_BAR__1_1000_0_S6_S3 1 100 -1 12.75 DISPLAY_IDENTIFIER p_stell_iae.iIaeDraus ECU_ADDRESS 0xFFF8CF28 /end MEASUREMENT
/begin MEASUREMENT iIaeDraus.p_ada_iae_ap_iea "Druckoffset ADA IAE AP IAE Adaption" SWORD UMR_BAR__1_1000_0_S6_S3 1 100 -1 1 DISPLAY_IDENTIFIER p_ada_iae_ap_iea.iIaeDraus ECU_ADDRESS 0xFFF8CF2A /end MEASUREMENT
/begin MEASUREMENT iIaeDraus.p_ada_iae_ap_iep "Druckoffset ADA IAE AP IAP Adaption" SWORD UMR_BAR__1_1000_0_S6_S3 1 100 -1 1 DISPLAY_IDENTIFIER p_ada_iae_ap_iep.iIaeDraus ECU_ADDRESS 0xFFF8CF2C /end MEASUREMENT
/begin MEASUREMENT iIaeSigna.Pt1JAnfahrtIae.x "Filterwert" SLONG UMR___1_300_0_S6_S3 1 100 -7158278.82667 7158278.82333 DISPLAY_IDENTIFIER Pt1JAnfahrtIae.iIaeSigna ECU_ADDRESS 0xFFF8D13C /end MEASUREMENT
/begin MEASUREMENT iIaeSigna.Dt1Pbremsg.Pt1Si16.x "Filterwert" SLONG UMR___1_300_0_S6_S3 1 100 -7158278.82667 7158278.82333 DISPLAY_IDENTIFIER Pt1Si16.Dt1Pbremsg.iIaeSigna ECU_ADDRESS 0xFFF8D144 /end MEASUREMENT
/begin MEASUREMENT iIaeSigna.Dt1Pbremsg.xp "Ableitung vom Eingangswert" SWORD UMR___1_1_0_S6_S3 1 100 -32768 32767 DISPLAY_IDENTIFIER Dt1Pbremsg.iIaeSigna ECU_ADDRESS 0xFFF8D140 /end MEASUREMENT
/begin MEASUREMENT iIaeSigna.Dt1Dkig.Pt1Si16.x "Filterwert" SLONG UMR___1_300_0_S6_S3 1 100 -7158278.82667 7158278.82333 DISPLAY_IDENTIFIER Pt1Si16.Dt1Dkig.iIaeSigna ECU_ADDRESS 0xFFF8D14C /end MEASUREMENT
/begin MEASUREMENT iIaeSigna.Dt1Dkig.xp "Ableitung vom Eingangswert" SWORD UMR___1_1_0_S6_S3 1 100 -32768 32767 DISPLAY_IDENTIFIER Dt1Dkig.iIaeSigna ECU_ADDRESS 0xFFF8D148 /end MEASUREMENT
/begin MEASUREMENT iIaeSigna.Dt1NgAb.Pt1Si16.x "Filterwert" SLONG UMR___1_300_0_S6_S3 1 100 -7158278.82667 7158278.82333 DISPLAY_IDENTIFIER Pt1Si16.Dt1NgAb.iIaeSigna ECU_ADDRESS 0xFFF8D154 /end MEASUREMENT
/begin MEASUREMENT iIaeSigna.Dt1NgAb.xp "Ableitung vom Eingangswert" SWORD UMR___1_1_0_S6_S3 1 100 -32768 32767 DISPLAY_IDENTIFIER Dt1NgAb.iIaeSigna ECU_ADDRESS 0xFFF8D150 /end MEASUREMENT
/begin MEASUREMENT iIaeSigna.Dt1NgMot.Pt1Si16.x "Filterwert" SLONG UMR___1_300_0_S6_S3 1 100 -7158278.82667 7158278.82333 DISPLAY_IDENTIFIER Pt1Si16.Dt1NgMot.iIaeSigna ECU_ADDRESS 0xFFF8D15C /end MEASUREMENT
/begin MEASUREMENT iIaeSigna.Dt1NgMot.xp "Ableitung vom Eingangswert" SWORD UMR___1_1_0_S6_S3 1 100 -32768 32767 DISPLAY_IDENTIFIER Dt1NgMot.iIaeSigna ECU_ADDRESS 0xFFF8D158 /end MEASUREMENT
/begin MEASUREMENT iIaeSigna.Dt1NgGetrein.Pt1Si16.x "Filterwert" SLONG UMR___1_300_0_S6_S3 1 100 -7158278.82667 7158278.82333 DISPLAY_IDENTIFIER Pt1Si16.Dt1NgGetrein.iIaeSigna ECU_ADDRESS 0xFFF8D164 /end MEASUREMENT
/begin MEASUREMENT iIaeSigna.Dt1NgGetrein.xp "Ableitung vom Eingangswert" SWORD UMR___1_1_0_S6_S3 1 100 -32768 32767 DISPLAY_IDENTIFIER Dt1NgGetrein.iIaeSigna ECU_ADDRESS 0xFFF8D160 /end MEASUREMENT
/begin MEASUREMENT iIaeSigna.Dt1MgMotist.Pt1Si16.x "Filterwert" SLONG UMR___1_300_0_S6_S3 1 100 -7158278.82667 7158278.82333 DISPLAY_IDENTIFIER Pt1Si16.Dt1MgMotist.iIaeSigna ECU_ADDRESS 0xFFF8D16C /end MEASUREMENT
/begin MEASUREMENT iIaeSigna.Dt1MgMotist.xp "Ableitung vom Eingangswert" SWORD UMR___1_1_0_S6_S3 1 100 -32768 32767 DISPLAY_IDENTIFIER Dt1MgMotist.iIaeSigna ECU_ADDRESS 0xFFF8D168 /end MEASUREMENT
/begin MEASUREMENT iIaeSigna.Pt1Nue.x "Filterwert" SLONG UMR___1_300_0_S6_S3 1 100 -7158278.82667 7158278.82333 DISPLAY_IDENTIFIER Pt1Nue.iIaeSigna ECU_ADDRESS 0xFFF8D170 /end MEASUREMENT
/begin MEASUREMENT iIaeSigna.Pt1NdMot.x "Filterwert" SLONG UMR___1_300_0_S6_S3 1 100 -7158278.82667 7158278.82333 DISPLAY_IDENTIFIER Pt1NdMot.iIaeSigna ECU_ADDRESS 0xFFF8D174 /end MEASUREMENT
/begin MEASUREMENT iIaeSigna.Pt1NdGetrein.x "Filterwert" SLONG UMR___1_300_0_S6_S3 1 100 -7158278.82667 7158278.82333 DISPLAY_IDENTIFIER Pt1NdGetrein.iIaeSigna ECU_ADDRESS 0xFFF8D178 /end MEASUREMENT
/begin MEASUREMENT iIaeSigna.Pt1Dki.x "Filterwert" SLONG UMR___1_300_0_S6_S3 1 100 -7158278.82667 7158278.82333 DISPLAY_IDENTIFIER Pt1Dki.iIaeSigna ECU_ADDRESS 0xFFF8D17C /end MEASUREMENT
/begin MEASUREMENT iIaeSigna.Pt1PBrems.x "Filterwert" SLONG UMR___1_300_0_S6_S3 1 100 -7158278.82667 7158278.82333 DISPLAY_IDENTIFIER Pt1PBrems.iIaeSigna ECU_ADDRESS 0xFFF8D180 /end MEASUREMENT
/begin MEASUREMENT iIaeSigna.Pt1MMotist.x "Filterwert" SLONG UMR___1_300_0_S6_S3 1 100 -7158278.82667 7158278.82333 DISPLAY_IDENTIFIER Pt1MMotist.iIaeSigna ECU_ADDRESS 0xFFF8D184 /end MEASUREMENT
/begin MEASUREMENT iIaeSigna.Pt1MMotistoe.x "Filterwert" SLONG UMR___1_300_0_S6_S3 1 100 -7158278.82667 7158278.82333 DISPLAY_IDENTIFIER Pt1MMotistoe.iIaeSigna ECU_ADDRESS 0xFFF8D188 /end MEASUREMENT
/begin MEASUREMENT iIaeSigna.Pt1MMotsolloe.x "Filterwert" SLONG UMR___1_300_0_S6_S3 1 100 -7158278.82667 7158278.82333 DISPLAY_IDENTIFIER Pt1MMotsolloe.iIaeSigna ECU_ADDRESS 0xFFF8D18C /end MEASUREMENT
/begin MEASUREMENT iIaeSigna.Pt1MMotgem.x "Filterwert" SLONG UMR___1_300_0_S6_S3 1 100 -7158278.82667 7158278.82333 DISPLAY_IDENTIFIER Pt1MMotgem.iIaeSigna ECU_ADDRESS 0xFFF8D190 /end MEASUREMENT
/begin MEASUREMENT iIaeSigna.Pt1NAb.x "Filterwert" SLONG UMR___1_300_0_S6_S3 1 100 -7158278.82667 7158278.82333 DISPLAY_IDENTIFIER Pt1NAb.iIaeSigna ECU_ADDRESS 0xFFF8D194 /end MEASUREMENT
/begin MEASUREMENT iIaeSigna.Pt1NT.x "Filterwert" SLONG UMR___1_300_0_S6_S3 1 100 -7158278.82667 7158278.82333 DISPLAY_IDENTIFIER Pt1NT.iIaeSigna ECU_ADDRESS 0xFFF8D198 /end MEASUREMENT
/begin MEASUREMENT iIaeSigna.Pt1NMot.x "Filterwert" SLONG UMR___1_300_0_S6_S3 1 100 -7158278.82667 7158278.82333 DISPLAY_IDENTIFIER Pt1NMot.iIaeSigna ECU_ADDRESS 0xFFF8D19C /end MEASUREMENT
/begin MEASUREMENT iIaeSigna.Pt1NdIae.x "Filterwert" SLONG UMR___1_300_0_S6_S3 1 100 -7158278.82667 7158278.82333 DISPLAY_IDENTIFIER Pt1NdIae.iIaeSigna ECU_ADDRESS 0xFFF8D1A0 /end MEASUREMENT
/begin MEASUREMENT iIaeSigna.Pt1AxrefIae.x "Filterwert" SLONG UMR___1_300_0_S6_S3 1 100 -7158278.82667 7158278.82333 DISPLAY_IDENTIFIER Pt1AxrefIae.iIaeSigna ECU_ADDRESS 0xFFF8D1A4 /end MEASUREMENT
/begin MEASUREMENT iIaeSigna.Pt2NeigungIae.x "Filterwert" FLOAT32_IEEE UMR___1_1_0_S6_S3 1 100 -2147483648 2147483647 FORMAT "%4.2" DISPLAY_IDENTIFIER x.Pt2NeigungIae.iIaeSigna ECU_ADDRESS 0xFFF8D1A8 /end MEASUREMENT
/begin MEASUREMENT iIaeSigna.Pt2NeigungIae.xp "Ableitung vom Eingangswert" FLOAT32_IEEE UMR__SEC_1_1_0_S6_S3 1 100 -2147483648 2147483647 FORMAT "%4.2" DISPLAY_IDENTIFIER xp.Pt2NeigungIae.iIaeSigna ECU_ADDRESS 0xFFF8D1AC /end MEASUREMENT
/begin MEASUREMENT iIaeSigna.Dt1NdgIae.Pt1Si16.x "Filterwert" SLONG UMR___1_300_0_S6_S3 1 100 -7158278.82667 7158278.82333 DISPLAY_IDENTIFIER Pt1Si16.Dt1NdgIae.iIaeSigna ECU_ADDRESS 0xFFF8D1B4 /end MEASUREMENT
/begin MEASUREMENT iIaeSigna.Dt1NdgIae.xp "Ableitung vom Eingangswert" SWORD UMR___1_1_0_S6_S3 1 100 -32768 32767 DISPLAY_IDENTIFIER Dt1NdgIae.iIaeSigna ECU_ADDRESS 0xFFF8D1B0 /end MEASUREMENT
/begin MEASUREMENT iIaeSigna.DelayMMotgem.write_index "Index der aktuellen Bufferposition" SBYTE UMR___1_1_0_S6_S3 1 100 0 10 DISPLAY_IDENTIFIER DelayMMotgem.iIaeSigna ECU_ADDRESS 0xFFF8D1B8 /end MEASUREMENT
/begin MEASUREMENT iIaeSigna.DelayMMotist.write_index "Index der aktuellen Bufferposition" SBYTE UMR___1_1_0_S6_S3 1 100 0 10 DISPLAY_IDENTIFIER DelayMMotist.iIaeSigna ECU_ADDRESS 0xFFF8D1CE /end MEASUREMENT
/begin MEASUREMENT iIaeSigna.DelayMMotistoe.write_index "Index der aktuellen Bufferposition" SBYTE UMR___1_1_0_S6_S3 1 100 0 10 DISPLAY_IDENTIFIER DelayMMotistoe.iIaeSigna ECU_ADDRESS 0xFFF8D1E4 /end MEASUREMENT
/begin MEASUREMENT iIaeSigna.DelayMMotsolloe.write_index "Index der aktuellen Bufferposition" SBYTE UMR___1_1_0_S6_S3 1 100 0 10 DISPLAY_IDENTIFIER DelayMMotsolloe.iIaeSigna ECU_ADDRESS 0xFFF8D1FA /end MEASUREMENT
/begin MEASUREMENT iIaeSigna.DelayNab.write_index "Index der aktuellen Bufferposition" SBYTE UMR___1_1_0_S6_S3 1 100 0 10 DISPLAY_IDENTIFIER DelayNab.iIaeSigna ECU_ADDRESS 0xFFF8D210 /end MEASUREMENT
/begin MEASUREMENT iIaeSigna.DelayNt.write_index "Index der aktuellen Bufferposition" SBYTE UMR___1_1_0_S6_S3 1 100 0 10 DISPLAY_IDENTIFIER DelayNt.iIaeSigna ECU_ADDRESS 0xFFF8D226 /end MEASUREMENT
/begin MEASUREMENT iIaeSigna.x_kf_ns_sync_iae "Eingangsgroesse für KF_NS_SYNC_IAE" SWORD UMR___1_1000_0_S6_S3 1 100 -30 30 DISPLAY_IDENTIFIER x_kf_ns_sync_iae.iIaeSigna ECU_ADDRESS 0xFFF8D0DC /end MEASUREMENT
/begin MEASUREMENT iIaeSigna.mot_last_iae "Lastzustand des Motors" SWORD UMR_NM__1_1_0_S6_S3 1 100 -400 1640 DISPLAY_IDENTIFIER mot_last_iae.iIaeSigna ECU_ADDRESS 0xFFF8D0DE /end MEASUREMENT
/begin MEASUREMENT iIaeSigna.asr_regelt_iae "asr regelt" UBYTE Conv.cIaeSigna._.asr_regelt_iae_S6_S3 1 100 0 1 BIT_MASK 0x1 DISPLAY_IDENTIFIER asr_regelt_iae.iIaeSigna ECU_ADDRESS 0xFFF8D0E0 /end MEASUREMENT
/begin MEASUREMENT iIaeSigna.flag_init_signa_iae "Signalaufbereitung und Tempmodell initialisiert" UBYTE Conv.cIaeSigna._.flag_init_signa_iae_S6_S3 1 100 0 1 BIT_MASK 0x1 DISPLAY_IDENTIFIER flag_init_signa_iae.iIaeSigna ECU_ADDRESS 0xFFF8D0E1 /end MEASUREMENT
/begin MEASUREMENT iIaeSigna.nue_iae "Drehzahlverhältnis n_getrein_ausab/n_mot" SWORD UMR___1_1000_0_S6_S3 1 100 0 30 DISPLAY_IDENTIFIER nue_iae.iIaeSigna ECU_ADDRESS 0xFFF8D0E2 /end MEASUREMENT
/begin MEASUREMENT iIaeSigna.mot_stress_iae "Motorstress" SWORD UMR_PROZENT__16_10_0_S6_S3 1 100 0 204.8 DISPLAY_IDENTIFIER mot_stress_iae.iIaeSigna ECU_ADDRESS 0xFFF8D0E4 /end MEASUREMENT
/begin MEASUREMENT iIaeSigna.pw_reib_iae "Verlustleistung" SLONG UMR_KW__1_1000_0_S6_S3 1 100 0 2147483.647 DISPLAY_IDENTIFIER pw_reib_iae.iIaeSigna ECU_ADDRESS 0xFFF8D0E8 /end MEASUREMENT
/begin MEASUREMENT iIaeSigna.m_reib_iae "Reibmoment an der Kupplung zur berechnung der Verlustleistung" SWORD UMR_NM__1_1_0_S6_S3 1 100 0 1640 DISPLAY_IDENTIFIER m_reib_iae.iIaeSigna ECU_ADDRESS 0xFFF8D0EC /end MEASUREMENT
/begin MEASUREMENT iIaeSigna.flag_mreibzumstell_iae "nd im ZU größer Schwelle - m_reib wird mit m_stell beschrieben" UBYTE Conv.cIaeSigna._.flag_mreibzumstell_iae_S6_S3 1 100 0 1 BIT_MASK 0x1 DISPLAY_IDENTIFIER flag_mreibzumstell_iae.iIaeSigna ECU_ADDRESS 0xFFF8D0EE /end MEASUREMENT
/begin MEASUREMENT iIaeSigna.m_motist_iae "gefiltertes und verzögertes Motormoment mit Eingriffen" SWORD UMR_NM__1_1_0_S6_S3 1 100 -400 1640 DISPLAY_IDENTIFIER m_motist_iae.iIaeSigna ECU_ADDRESS 0xFFF8D0F0 /end MEASUREMENT
/begin MEASUREMENT iIaeSigna.m_motistoe_iae "gefiltertes Motormoment ohne Eingriffen" SWORD UMR_NM__1_1_0_S6_S3 1 100 -400 1640 DISPLAY_IDENTIFIER m_motistoe_iae.iIaeSigna ECU_ADDRESS 0xFFF8D0F2 /end MEASUREMENT
/begin MEASUREMENT iIaeSigna.m_motsolloe_iae "gefiltertes Motorsollmoment ohne Eingriffen" SWORD UMR_NM__1_1_0_S6_S3 1 100 -400 1640 DISPLAY_IDENTIFIER m_motsolloe_iae.iIaeSigna ECU_ADDRESS 0xFFF8D0F4 /end MEASUREMENT
/begin MEASUREMENT iIaeSigna.m_motgem_iae "gemitteltes Motormomen" SWORD UMR_NM__1_1_0_S6_S3 1 100 -400 1640 DISPLAY_IDENTIFIER m_motgem_iae.iIaeSigna ECU_ADDRESS 0xFFF8D0F6 /end MEASUREMENT
/begin MEASUREMENT iIaeSigna.mg_motist_iae "Gradient vom Motoristmoment mit Eingriffe" SWORD UMR_NM_SEC_1_1_0_S6_S3 1 100 -32768 32767 DISPLAY_IDENTIFIER mg_motist_iae.iIaeSigna ECU_ADDRESS 0xFFF8D0F8 /end MEASUREMENT
/begin MEASUREMENT iIaeSigna.n_mot_iae "gefilterte Motordrehzahl" SWORD UMR_U_MIN_1_1_0_S6_S3 1 100 0 8160 DISPLAY_IDENTIFIER n_mot_iae.iIaeSigna ECU_ADDRESS 0xFFF8D0FA /end MEASUREMENT
/begin MEASUREMENT iIaeSigna.ng_mot_iae "Gradient der Motordrehzahll" SWORD UMR_U_MINSEC_1_1_0_S6_S3 1 100 -10000 10000 DISPLAY_IDENTIFIER ng_mot_iae.iIaeSigna ECU_ADDRESS 0xFFF8D0FC /end MEASUREMENT
/begin MEASUREMENT iIaeSigna.ng_getrein_iae "Gradient der Motordrehzahll" SWORD UMR_U_MINSEC_1_1_0_S6_S3 1 100 -10000 10000 DISPLAY_IDENTIFIER ng_getrein_iae.iIaeSigna ECU_ADDRESS 0xFFF8D0FE /end MEASUREMENT
/begin MEASUREMENT iIaeSigna.n_motsoll_ll_iae "gefilterte Motordrehzahl" SWORD UMR_U_MIN_1_1_0_S6_S3 1 100 0 8160 DISPLAY_IDENTIFIER n_motsoll_ll_iae.iIaeSigna ECU_ADDRESS 0xFFF8D100 /end MEASUREMENT
/begin MEASUREMENT iIaeSigna.n_getrein_iae "Getriebeeingangsdrehzahl aus Abtriebsdrehzahl berechnet" SWORD UMR_U_MIN_1_1_0_S6_S3 1 100 0 8160 DISPLAY_IDENTIFIER n_getrein_iae.iIaeSigna ECU_ADDRESS 0xFFF8D102 /end MEASUREMENT
/begin MEASUREMENT iIaeSigna.nd_getrein_iae "Differenz zwischen Getriebeeingangsdrehzahl und Motorleerlaufdrehzahl" SWORD UMR_U_MIN_1_1_0_S6_S3 1 100 -8160 8160 DISPLAY_IDENTIFIER nd_getrein_iae.iIaeSigna ECU_ADDRESS 0xFFF8D104 /end MEASUREMENT
/begin MEASUREMENT iIaeSigna.nd_getrein_basis_ll_iae "Basis für Differenz zwischen Getriebeeingangsdrehzahl und Motorleerlaufdrehzahl" SWORD UMR_U_MIN_1_1_0_S6_S3 1 100 -8160 8160 DISPLAY_IDENTIFIER nd_getrein_basis_ll_iae.iIaeSigna ECU_ADDRESS 0xFFF8D106 /end MEASUREMENT
/begin MEASUREMENT iIaeSigna.ns_getrein_oeffnen_iae "Schwelle für Getriebeeingangsdrehzahl zum Öffnen" SWORD UMR_U_MIN_1_1_0_S6_S3 1 100 0 8160 DISPLAY_IDENTIFIER ns_getrein_oeffnen_iae.iIaeSigna ECU_ADDRESS 0xFFF8D108 /end MEASUREMENT
/begin MEASUREMENT iIaeSigna.ns_getrein_schliess_iae "Schwelle für Getriebeeingangsdrehzahl zum Schliessen" SWORD UMR_U_MIN_1_1_0_S6_S3 1 100 0 8160 DISPLAY_IDENTIFIER ns_getrein_schliess_iae.iIaeSigna ECU_ADDRESS 0xFFF8D10A /end MEASUREMENT
/begin MEASUREMENT iIaeSigna.n_ab_iae "gefilterte und verzögerte Abtriebsdrehzahl" SWORD UMR_U_MIN_1_1_0_S6_S3 1 100 0 8160 DISPLAY_IDENTIFIER n_ab_iae.iIaeSigna ECU_ADDRESS 0xFFF8D10C /end MEASUREMENT
/begin MEASUREMENT iIaeSigna.n_t_iae "gefilterte und verzögerte Turbinendrehzahl" SWORD UMR_U_MIN_1_1_0_S6_S3 1 100 0 8160 DISPLAY_IDENTIFIER n_t_iae.iIaeSigna ECU_ADDRESS 0xFFF8D10E /end MEASUREMENT
/begin MEASUREMENT iIaeSigna.ng_ab_iae "Gradient der Abtriebsdrehzahll" SWORD UMR_U_MINSEC_1_1_0_S6_S3 1 100 -10000 10000 DISPLAY_IDENTIFIER ng_ab_iae.iIaeSigna ECU_ADDRESS 0xFFF8D110 /end MEASUREMENT
/begin MEASUREMENT iIaeSigna.nd_iae_kf "Differenzdrehzahl am Anfahrelement, Absolutwert, zustandsabhängig" SWORD UMR_U_MIN_1_1_0_S6_S3 1 100 -8160 8160 DISPLAY_IDENTIFIER nd_iae_kf.iIaeSigna ECU_ADDRESS 0xFFF8D112 /end MEASUREMENT
/begin MEASUREMENT iIaeSigna.nd_iae_betrag "Differenzdrehzahl am Anfahrelement, Absolutwert" SWORD UMR_U_MIN_1_1_0_S6_S3 1 100 -8160 8160 DISPLAY_IDENTIFIER nd_iae_betrag.iIaeSigna ECU_ADDRESS 0xFFF8D114 /end MEASUREMENT
/begin MEASUREMENT iIaeSigna.nd_iae "Differenzdrehzahl am Anfahrelement" SWORD UMR_U_MIN_1_1_0_S6_S3 1 100 -8160 8160 DISPLAY_IDENTIFIER nd_iae.iIaeSigna ECU_ADDRESS 0xFFF8D116 /end MEASUREMENT
/begin MEASUREMENT iIaeSigna.ndg_iae "Gradinet der Differenzdrehzahl am Anfahrelement" SWORD UMR_U_MINSEC_1_1_0_S6_S3 1 100 -32768 32767 DISPLAY_IDENTIFIER ndg_iae.iIaeSigna ECU_ADDRESS 0xFFF8D118 /end MEASUREMENT
/begin MEASUREMENT iIaeSigna.nd_mot_iae "Differenzdrehzahl zwischen Motor" SWORD UMR_U_MIN_1_1_0_S6_S3 1 100 -8160 8160 DISPLAY_IDENTIFIER nd_mot_iae.iIaeSigna ECU_ADDRESS 0xFFF8D11A /end MEASUREMENT
/begin MEASUREMENT iIaeSigna.p_brems_iae "gefilterter Bremsdruck" SWORD UMR_BAR__1_100_0_S6_S3 1 100 -100 300 DISPLAY_IDENTIFIER p_brems_iae.iIaeSigna ECU_ADDRESS 0xFFF8D11C /end MEASUREMENT
/begin MEASUREMENT iIaeSigna.p_brems_roh_iae "ungefilterter Bremsdruck" SWORD UMR_BAR__1_100_0_S6_S3 1 100 -100 300 DISPLAY_IDENTIFIER p_brems_roh_iae.iIaeSigna ECU_ADDRESS 0xFFF8D11E /end MEASUREMENT
/begin MEASUREMENT iIaeSigna.fas_aktiv_iae "Fahrerassistenzsystem aktiv" UBYTE Conv.cIaeSigna._.fas_aktiv_iae_S6_S3 1 100 0 1 BIT_MASK 0x1 DISPLAY_IDENTIFIER fas_aktiv_iae.iIaeSigna ECU_ADDRESS 0xFFF8D120 /end MEASUREMENT
/begin MEASUREMENT iIaeSigna.ps_brems_angelegt_iae "Bremsdruckschwelle" SWORD UMR_BAR__1_100_0_S6_S3 1 100 -100 300 DISPLAY_IDENTIFIER ps_brems_angelegt_iae.iIaeSigna ECU_ADDRESS 0xFFF8D122 /end MEASUREMENT
/begin MEASUREMENT iIaeSigna.f_brems_angelegt_iae "Flag für Bremsdruckbedingung" UBYTE Conv.cIaeSigna._.f_brems_angelegt_iae_S6_S3 1 100 0 1 BIT_MASK 0x1 DISPLAY_IDENTIFIER f_brems_angelegt_iae.iIaeSigna ECU_ADDRESS 0xFFF8D124 /end MEASUREMENT
/begin MEASUREMENT iIaeSigna.f_angelegt_iae "Flag für Bremsdruckbedingung" UBYTE Conv.cIaeSigna._.f_angelegt_iae_S6_S3 1 100 0 1 BIT_MASK 0x1 DISPLAY_IDENTIFIER f_angelegt_iae.iIaeSigna ECU_ADDRESS 0xFFF8D125 /end MEASUREMENT
/begin MEASUREMENT iIaeSigna.pg_brems_iae "Bremsdruckgradient" SWORD UMR_BAR_SEC_1_1_0_S6_S3 1 100 -10000 10000 DISPLAY_IDENTIFIER pg_brems_iae.iIaeSigna ECU_ADDRESS 0xFFF8D126 /end MEASUREMENT
/begin MEASUREMENT iIaeSigna.dki_iae "gefiltertes Fahrpedal" UBYTE UMR_PROZENT__20_51_0_S6_S3 1 100 0 100 DISPLAY_IDENTIFIER dki_iae.iIaeSigna ECU_ADDRESS 0xFFF8D128 /end MEASUREMENT
/begin MEASUREMENT iIaeSigna.dkig_iae "Gradient vom Fahrpedal" SWORD UMR_PROZENT_SEC_20_51_0_S6_S3 1 100 -3921.56862745 3921.56862745 DISPLAY_IDENTIFIER dkig_iae.iIaeSigna ECU_ADDRESS 0xFFF8D12A /end MEASUREMENT
/begin MEASUREMENT iIaeSigna.kfl_sollneutral_iae "Anforderung von Zwangsneutral" UBYTE Conv.cIaeSigna._.kfl_sollneutral_iae_S6_S3 1 100 0 1 BIT_MASK 0x1 DISPLAY_IDENTIFIER kfl_sollneutral_iae.iIaeSigna ECU_ADDRESS 0xFFF8D12C /end MEASUREMENT
/begin MEASUREMENT iIaeSigna.n_ab_dir_iae "Drehrichtung Abtrieb intern IAE" SBYTE Conv.cIaeSigna._.n_ab_dir_iae_S6_S3 1 100 -1 1 DISPLAY_IDENTIFIER n_ab_dir_iae.iIaeSigna ECU_ADDRESS 0xFFF8D12D /end MEASUREMENT
/begin MEASUREMENT iIaeSigna.n_motsollmax_iae "Maximalwert aus n_motsoll_ll_iae, n_mot_solleer und n_mot_llsoll_has" SWORD UMR_U_MIN_1_1_0_S6_S3 1 100 0 8160 DISPLAY_IDENTIFIER n_motsollmax_iae.iIaeSigna ECU_ADDRESS 0xFFF8D12E /end MEASUREMENT
/begin MEASUREMENT iIaeSigna.n_motanfahr_basis_iae "Basisdrehzahl für die Berechnung der Anfahrdrehzahl im Zustand Anfahren" SWORD UMR_U_MIN_1_1_0_S6_S3 1 100 0 8160 DISPLAY_IDENTIFIER n_motanfahr_basis_iae.iIaeSigna ECU_ADDRESS 0xFFF8D130 /end MEASUREMENT
/begin MEASUREMENT iIaeSigna.neigung_iae "Neigung in Grad Steigung" SWORD UMR_GRAD__1_3_M128_S6_S3 1 100 -42.6666666667 42 DISPLAY_IDENTIFIER neigung_iae.iIaeSigna ECU_ADDRESS 0xFFF8D132 /end MEASUREMENT
/begin MEASUREMENT iIaeSigna.neigung_nmin_iae "Neigung in Grad Steigung" SWORD UMR_GRAD__1_3_M128_S6_S3 1 100 -42.6666666667 42 DISPLAY_IDENTIFIER neigung_nmin_iae.iIaeSigna ECU_ADDRESS 0xFFF8D134 /end MEASUREMENT
/begin MEASUREMENT iIaeSigna.j_anfahrt_iae "Massenträgheitsmoment des Antriebsstrangs (VM, EM und Getriebe bis IAE)" SWORD UMR___1_1000_0_S6_S3 1 100 0 6 DISPLAY_IDENTIFIER j_anfahrt_iae.iIaeSigna ECU_ADDRESS 0xFFF8D136 /end MEASUREMENT
/begin MEASUREMENT iIaeSigna.ax_ref_filt_diagiae "Laengsbeschleunigung" SWORD UMR_M_SEC2_1_32_0_S6_S3 1 100 -1024 1023.96875 DISPLAY_IDENTIFIER ax_ref_filt_diagiae.iIaeSigna ECU_ADDRESS 0xFFF8D138 /end MEASUREMENT
/begin MEASUREMENT iIaeSigna.z_nmotll_aktiv_iae "Motorleerlaufregler" UBYTE Conv.cIaeSigna._.z_nmotll_aktiv_iae_S6_S3 1 100 0 1 BIT_MASK 0x1 DISPLAY_IDENTIFIER z_nmotll_aktiv_iae.iIaeSigna ECU_ADDRESS 0xFFF8D13A /end MEASUREMENT
/begin MEASUREMENT iIaeMomen.BibPIDIae.stellgr_i_alt "verzoegerte I-Stellgroesse" FLOAT32_IEEE UMR___1_1_0_S6_S3 1 100 -1E+037 1E+037 FORMAT "%4.2" DISPLAY_IDENTIFIER stellgr_i_alt.BibPIDIae.iIaeMomen ECU_ADDRESS 0xFFF8D070 /end MEASUREMENT
/begin MEASUREMENT iIaeMomen.BibPIDIae.stellgr_d_alt "verzoegerte D-Stellgroesse" FLOAT32_IEEE UMR___1_1_0_S6_S3 1 100 -1E+037 1E+037 FORMAT "%4.2" DISPLAY_IDENTIFIER stellgr_d_alt.BibPIDIae.iIaeMomen ECU_ADDRESS 0xFFF8D074 /end MEASUREMENT
/begin MEASUREMENT iIaeMomen.BibPIDIae.faktor_p "Param. P-Anteil" FLOAT32_IEEE UMR___1_1_0_S6_S3 1 100 -1E+037 1E+037 FORMAT "%4.2" DISPLAY_IDENTIFIER faktor_p.BibPIDIae.iIaeMomen ECU_ADDRESS 0xFFF8D078 /end MEASUREMENT
/begin MEASUREMENT iIaeMomen.BibPIDIae.faktor_i "Param. I-Anteil" FLOAT32_IEEE UMR___1_1_0_S6_S3 1 100 -1E+037 1E+037 FORMAT "%4.2" DISPLAY_IDENTIFIER faktor_i.BibPIDIae.iIaeMomen ECU_ADDRESS 0xFFF8D07C /end MEASUREMENT
/begin MEASUREMENT iIaeMomen.BibPIDIae.faktor_d "Param. D-Anteil" FLOAT32_IEEE UMR___1_1_0_S6_S3 1 100 -1E+037 1E+037 FORMAT "%4.2" DISPLAY_IDENTIFIER faktor_d.BibPIDIae.iIaeMomen ECU_ADDRESS 0xFFF8D080 /end MEASUREMENT
/begin MEASUREMENT iIaeMomen.BibPIDIae.faktor_t1 "Param. T1-Anteil" FLOAT32_IEEE UMR___1_1_0_S6_S3 1 100 -1E+037 1E+037 FORMAT "%4.2" DISPLAY_IDENTIFIER faktor_t1.BibPIDIae.iIaeMomen ECU_ADDRESS 0xFFF8D084 /end MEASUREMENT
/begin MEASUREMENT iIaeMomen.BibPIDIae.stell_max "maximale Stellgroesse" FLOAT32_IEEE UMR___1_1_0_S6_S3 1 100 -1E+037 1E+037 FORMAT "%4.2" DISPLAY_IDENTIFIER stell_max.BibPIDIae.iIaeMomen ECU_ADDRESS 0xFFF8D088 /end MEASUREMENT
/begin MEASUREMENT iIaeMomen.BibPIDIae.stell_min "minimale Stellgroesse" FLOAT32_IEEE UMR___1_1_0_S6_S3 1 100 -1E+037 1E+037 FORMAT "%4.2" DISPLAY_IDENTIFIER stell_min.BibPIDIae.iIaeMomen ECU_ADDRESS 0xFFF8D08C /end MEASUREMENT
/begin MEASUREMENT iIaeMomen.BibPIDIae.regel_diff_alt "verzoeg. Regeldifferenz" FLOAT32_IEEE UMR___1_1_0_S6_S3 1 100 -1E+037 1E+037 FORMAT "%4.2" DISPLAY_IDENTIFIER regel_diff_alt.BibPIDIae.iIaeMomen ECU_ADDRESS 0xFFF8D090 /end MEASUREMENT
/begin MEASUREMENT iIaeMomen.BibPIDIae.stellgr_alt "verzoegerte Stellgroesse" FLOAT32_IEEE UMR___1_1_0_S6_S3 1 100 -1E+037 1E+037 FORMAT "%4.2" DISPLAY_IDENTIFIER stellgr_alt.BibPIDIae.iIaeMomen ECU_ADDRESS 0xFFF8D094 /end MEASUREMENT
/begin MEASUREMENT iIaeMomen.BibPIDIae.stellgr_i_modulo "Ganzzahl. Rest d. I-Quotient" FLOAT32_IEEE UMR___1_1_0_S6_S3 1 100 -1E+037 1E+037 FORMAT "%4.2" DISPLAY_IDENTIFIER stellgr_i_modulo.BibPIDIae.iIaeMomen ECU_ADDRESS 0xFFF8D098 /end MEASUREMENT
/begin MEASUREMENT iIaeMomen.Pt2NMotAnfahrt.x "Filterwert" FLOAT32_IEEE UMR___1_1_0_S6_S3 1 100 -2147483648 2147483647 FORMAT "%4.2" DISPLAY_IDENTIFIER x.Pt2NMotAnfahrt.iIaeMomen ECU_ADDRESS 0xFFF8D0A0 /end MEASUREMENT
/begin MEASUREMENT iIaeMomen.Pt2NMotAnfahrt.xp "Ableitung vom Eingangswert" FLOAT32_IEEE UMR__SEC_1_1_0_S6_S3 1 100 -2147483648 2147483647 FORMAT "%4.2" DISPLAY_IDENTIFIER xp.Pt2NMotAnfahrt.iIaeMomen ECU_ADDRESS 0xFFF8D0A4 /end MEASUREMENT
/begin MEASUREMENT iIaeMomen.Pt1NMotAnfah.x "Filterwert" SLONG UMR___1_300_0_S6_S3 1 100 -7158278.82667 7158278.82333 DISPLAY_IDENTIFIER Pt1NMotAnfah.iIaeMomen ECU_ADDRESS 0xFFF8D0A8 /end MEASUREMENT
/begin MEASUREMENT iIaeMomen.Pt1IStuetz.x "Filterwert" SLONG UMR___1_300_0_S6_S3 1 100 -7158278.82667 7158278.82333 DISPLAY_IDENTIFIER Pt1IStuetz.iIaeMomen ECU_ADDRESS 0xFFF8D0AC /end MEASUREMENT
/begin MEASUREMENT iIaeMomen.Pt1FMBasisAnfahrtIae.x "Filterwert" FLOAT32_IEEE UMR___1_1_0_S6_S3 1 100 -1000000000 1000000000 FORMAT "%4.2" DISPLAY_IDENTIFIER Pt1FMBasisAnfahrtIae.iIaeMomen ECU_ADDRESS 0xFFF8D0B0 /end MEASUREMENT
/begin MEASUREMENT iIaeMomen.Pt2MIstVorstIae.x "Filterwert" FLOAT32_IEEE UMR___1_1_0_S6_S3 1 100 -2147483648 2147483647 FORMAT "%4.2" DISPLAY_IDENTIFIER x.Pt2MIstVorstIae.iIaeMomen ECU_ADDRESS 0xFFF8D0B4 /end MEASUREMENT
/begin MEASUREMENT iIaeMomen.Pt2MIstVorstIae.xp "Ableitung vom Eingangswert" FLOAT32_IEEE UMR__SEC_1_1_0_S6_S3 1 100 -2147483648 2147483647 FORMAT "%4.2" DISPLAY_IDENTIFIER xp.Pt2MIstVorstIae.iIaeMomen ECU_ADDRESS 0xFFF8D0B8 /end MEASUREMENT
/begin MEASUREMENT iIaeMomen.TimerKflMiaeauf.time "Zeit des Timers" UWORD UMR_SEC__1_100_0_S6_S3 1 100 0 655.35 DISPLAY_IDENTIFIER time.TimerKflMiaeauf.iIaeMomen ECU_ADDRESS 0xFFF8D0BC /end MEASUREMENT
/begin MEASUREMENT iIaeMomen.TimerKflMiaeauf.maxtime "Endzeit" UWORD UMR_SEC__1_100_0_S6_S3 1 100 0 655.35 DISPLAY_IDENTIFIER maxtime.TimerKflMiaeauf.iIaeMomen ECU_ADDRESS 0xFFF8D0BE /end MEASUREMENT
/begin MEASUREMENT iIaeMomen.TimerMiaeaufAnfahr.time "Zeit des Timers" UWORD UMR_SEC__1_100_0_S6_S3 1 100 0 655.35 DISPLAY_IDENTIFIER time.TimerMiaeaufAnfahr.iIaeMomen ECU_ADDRESS 0xFFF8D0C0 /end MEASUREMENT
/begin MEASUREMENT iIaeMomen.TimerMiaeaufAnfahr.maxtime "Endzeit" UWORD UMR_SEC__1_100_0_S6_S3 1 100 0 655.35 DISPLAY_IDENTIFIER maxtime.TimerMiaeaufAnfahr.iIaeMomen ECU_ADDRESS 0xFFF8D0C2 /end MEASUREMENT
/begin MEASUREMENT iIaeMomen.TimerNachMmaxHas.time "Zeit des Timers" UWORD UMR_SEC__1_100_0_S6_S3 1 100 0 655.35 DISPLAY_IDENTIFIER time.TimerNachMmaxHas.iIaeMomen ECU_ADDRESS 0xFFF8D0C4 /end MEASUREMENT
/begin MEASUREMENT iIaeMomen.TimerNachMmaxHas.maxtime "Endzeit" UWORD UMR_SEC__1_100_0_S6_S3 1 100 0 655.35 DISPLAY_IDENTIFIER maxtime.TimerNachMmaxHas.iIaeMomen ECU_ADDRESS 0xFFF8D0C6 /end MEASUREMENT
/begin MEASUREMENT iIaeMomen.TimerUefIstuetz.time "Zeit des Timers" UWORD UMR_SEC__1_100_0_S6_S3 1 100 0 655.35 DISPLAY_IDENTIFIER time.TimerUefIstuetz.iIaeMomen ECU_ADDRESS 0xFFF8D0C8 /end MEASUREMENT
/begin MEASUREMENT iIaeMomen.TimerUefIstuetz.maxtime "Endzeit" UWORD UMR_SEC__1_100_0_S6_S3 1 100 0 655.35 DISPLAY_IDENTIFIER maxtime.TimerUefIstuetz.iIaeMomen ECU_ADDRESS 0xFFF8D0CA /end MEASUREMENT
/begin MEASUREMENT iIaeMomen.TimerUefKriechen.time "Zeit des Timers" UWORD UMR_SEC__1_100_0_S6_S3 1 100 0 655.35 DISPLAY_IDENTIFIER time.TimerUefKriechen.iIaeMomen ECU_ADDRESS 0xFFF8D0CC /end MEASUREMENT
/begin MEASUREMENT iIaeMomen.TimerUefKriechen.maxtime "Endzeit" UWORD UMR_SEC__1_100_0_S6_S3 1 100 0 655.35 DISPLAY_IDENTIFIER maxtime.TimerUefKriechen.iIaeMomen ECU_ADDRESS 0xFFF8D0CE /end MEASUREMENT
/begin MEASUREMENT iIaeMomen.TimerUefMVorKriechen.time "Zeit des Timers" UWORD UMR_SEC__1_100_0_S6_S3 1 100 0 655.35 DISPLAY_IDENTIFIER time.TimerUefMVorKriechen.iIaeMomen ECU_ADDRESS 0xFFF8D0D0 /end MEASUREMENT
/begin MEASUREMENT iIaeMomen.TimerUefMVorKriechen.maxtime "Endzeit" UWORD UMR_SEC__1_100_0_S6_S3 1 100 0 655.35 DISPLAY_IDENTIFIER maxtime.TimerUefMVorKriechen.iIaeMomen ECU_ADDRESS 0xFFF8D0D2 /end MEASUREMENT
/begin MEASUREMENT iIaeMomen.TimerPulsCue.time "Zeit des Timers" UWORD UMR_SEC__1_100_0_S6_S3 1 100 0 655.35 DISPLAY_IDENTIFIER time.TimerPulsCue.iIaeMomen ECU_ADDRESS 0xFFF8D0D4 /end MEASUREMENT
/begin MEASUREMENT iIaeMomen.TimerPulsCue.maxtime "Endzeit" UWORD UMR_SEC__1_100_0_S6_S3 1 100 0 655.35 DISPLAY_IDENTIFIER maxtime.TimerPulsCue.iIaeMomen ECU_ADDRESS 0xFFF8D0D6 /end MEASUREMENT
/begin MEASUREMENT iIaeMomen.TimerPulsCueAktiv.time "Zeit des Timers" UWORD UMR_SEC__1_100_0_S6_S3 1 100 0 655.35 DISPLAY_IDENTIFIER time.TimerPulsCueAktiv.iIaeMomen ECU_ADDRESS 0xFFF8D0D8 /end MEASUREMENT
/begin MEASUREMENT iIaeMomen.TimerPulsCueAktiv.maxtime "Endzeit" UWORD UMR_SEC__1_100_0_S6_S3 1 100 0 655.35 DISPLAY_IDENTIFIER maxtime.TimerPulsCueAktiv.iIaeMomen ECU_ADDRESS 0xFFF8D0DA /end MEASUREMENT
/begin MEASUREMENT iIaeMomen.flag_ueflaeuft_iae "Überführungsfunktion im Zustand läuft" UBYTE Conv.cIaeMomen._.flag_ueflaeuft_iae_S6_S3 1 100 0 1 BIT_MASK 0x1 DISPLAY_IDENTIFIER flag_ueflaeuft_iae.iIaeMomen ECU_ADDRESS 0xFFF8CF7C /end MEASUREMENT
/begin MEASUREMENT iIaeMomen.flag_initsoll_einmal_iae "damit der Sollwerts beim Einstieg in Anfahren auf jeden Fall einmal initialisiert wird." UBYTE Conv.cIaeMomen._.flag_initsoll_einmal_iae_S6_S3 1 100 0 1 BIT_MASK 0x1 DISPLAY_IDENTIFIER flag_initsoll_einmal_iae.iIaeMomen ECU_ADDRESS 0xFFF8CF7D /end MEASUREMENT
/begin MEASUREMENT iIaeMomen.flag_initsollanfahr_iae "Initialisierungfase des Sollwerts im Anfahren aktiv" UBYTE Conv.cIaeMomen._.flag_initsollanfahr_iae_S6_S3 1 100 0 1 BIT_MASK 0x1 DISPLAY_IDENTIFIER flag_initsollanfahr_iae.iIaeMomen ECU_ADDRESS 0xFFF8CF7E /end MEASUREMENT
/begin MEASUREMENT iIaeMomen.flag_t_ueffix_iae "Flag wird gesetzt, wenn t_uef_iae fix ist, und nur zum Zustandswechsel gesetzt wird" UBYTE Conv.cIaeMomen._.flag_t_ueffix_iae_S6_S3 1 100 0 1 BIT_MASK 0x1 DISPLAY_IDENTIFIER flag_t_ueffix_iae.iIaeMomen ECU_ADDRESS 0xFFF8CF7F /end MEASUREMENT
/begin MEASUREMENT iIaeMomen.flag_kaltanfahren_aktiv_iae "IAE fährt im Kaltanfahr-Modus an" UBYTE Conv.cIaeMomen._.flag_kaltanfahren_aktiv_iae_S6_S3 1 100 0 1 BIT_MASK 0x1 DISPLAY_IDENTIFIER flag_kaltanfahren_aktiv_iae.iIaeMomen ECU_ADDRESS 0xFFF8CF80 /end MEASUREMENT
/begin MEASUREMENT iIaeMomen.f_m_basis_anfahrt_iae "Faktor auf Anfahmoment im H/E-Anfahren IAE" FLOAT32_IEEE UMR___1_1_0_3_S6_S3 1 100 0 30 FORMAT "%5.3" DISPLAY_IDENTIFIER f_m_basis_anfahrt_iae.iIaeMomen ECU_ADDRESS 0xFFF8CF84 /end MEASUREMENT
/begin MEASUREMENT iIaeMomen.f_nganfahrt_iae "Faktor auf Anfahrdrehzahlgradient während GE" SWORD UMR___1_100_0_S6_S3 1 100 0 2 DISPLAY_IDENTIFIER f_nganfahrt_iae.iIaeMomen ECU_ADDRESS 0xFFF8CF88 /end MEASUREMENT
/begin MEASUREMENT iIaeMomen.ms_motanfahrinit_iae "Motormoment beim Eintritt in Zustand Anfahren" SWORD UMR_NM__1_1_0_S6_S3 1 100 -400 1640 DISPLAY_IDENTIFIER ms_motanfahrinit_iae.iIaeMomen ECU_ADDRESS 0xFFF8CF8A /end MEASUREMENT
/begin MEASUREMENT iIaeMomen.ns_motanfahrinit_iae "Motordrehzahl beim Eintritt in Zustand Anfahren" SWORD UMR_U_MIN_1_1_0_S6_S3 1 100 0 8160 DISPLAY_IDENTIFIER ns_motanfahrinit_iae.iIaeMomen ECU_ADDRESS 0xFFF8CF8C /end MEASUREMENT
/begin MEASUREMENT iIaeMomen.flag_stall_anfahr_iae "Überführungsfunktion im Zustand läuft" UBYTE Conv.cIaeMomen._.flag_stall_anfahr_iae_S6_S3 1 100 0 1 BIT_MASK 0x1 DISPLAY_IDENTIFIER flag_stall_anfahr_iae.iIaeMomen ECU_ADDRESS 0xFFF8CF8E /end MEASUREMENT
/begin MEASUREMENT iIaeMomen.n_motanfahr_dki_iae "Motorsolldrehzahl im Zustand Anfahren - dki abh. Anteil" SWORD UMR_U_MIN_1_1_0_S6_S3 1 100 -8160 8160 DISPLAY_IDENTIFIER n_motanfahr_dki_iae.iIaeMomen ECU_ADDRESS 0xFFF8CF90 /end MEASUREMENT
/begin MEASUREMENT iIaeMomen.t_pt2_anfahrt_iae "PT2-Filterzeitkonstante für Anfahrsolldrehzahl" SWORD UMR_MSEC__1_1_0_S6_S3 1 100 0 32000 DISPLAY_IDENTIFIER t_pt2_anfahrt_iae.iIaeMomen ECU_ADDRESS 0xFFF8CF92 /end MEASUREMENT
/begin MEASUREMENT iIaeMomen.n_motanfahr_gef_iae "Motorsolldrehzahl im Zustand Anfahren (PT2-gefiltert)" SWORD UMR_U_MIN_1_1_0_S6_S3 1 100 0 8160 DISPLAY_IDENTIFIER n_motanfahr_gef_iae.iIaeMomen ECU_ADDRESS 0xFFF8CF94 /end MEASUREMENT
/begin MEASUREMENT iIaeMomen.ng_motanfahr_gef_iae "Motorsolldrehzahlgradient im Zustand Anfahren (PT2-gefiltert)" SWORD UMR_U_MINSEC_1_1_0_S6_S3 1 100 -10000 10000 DISPLAY_IDENTIFIER ng_motanfahr_gef_iae.iIaeMomen ECU_ADDRESS 0xFFF8CF96 /end MEASUREMENT
/begin MEASUREMENT iIaeMomen.n_motsollanfahr_iae "Motorsolldrehzahl im Zustand Anfahren ungefiltert" SWORD UMR_U_MIN_1_1_0_S6_S3 1 100 0 8160 DISPLAY_IDENTIFIER n_motsollanfahr_iae.iIaeMomen ECU_ADDRESS 0xFFF8CF98 /end MEASUREMENT
/begin MEASUREMENT iIaeMomen.n_motsollanfahr_roh_iae "Rohwert vor Filter von Motorsolldrehzahl im Zustand Anfahren ungefiltert" SWORD UMR_U_MIN_1_1_0_S6_S3 1 100 0 8160 DISPLAY_IDENTIFIER n_motsollanfahr_roh_iae.iIaeMomen ECU_ADDRESS 0xFFF8CF9A /end MEASUREMENT
/begin MEASUREMENT iIaeMomen.n_grenzentk_iae "Drehzahlgrenze zum Umschalten von kup_status nach STATUS_IAE_ENTKOPP_ANF" SWORD UMR_U_MIN_1_1_0_S6_S3 1 100 0 8160 DISPLAY_IDENTIFIER n_grenzentk_iae.iIaeMomen ECU_ADDRESS 0xFFF8CF9C /end MEASUREMENT
/begin MEASUREMENT iIaeMomen.n_emknick_iae "Knickdrehzahl" SWORD UMR_U_MIN_1_1_0_S6_S3 1 100 0 8160 DISPLAY_IDENTIFIER n_emknick_iae.iIaeMomen ECU_ADDRESS 0xFFF8CF9E /end MEASUREMENT
/begin MEASUREMENT iIaeMomen.nd_motsollanfahr_iae "(n_motsollanfahr_iae - n_mot_iae)" SWORD UMR_U_MIN_1_1_0_S6_S3 1 100 -10000 10000 DISPLAY_IDENTIFIER nd_motsollanfahr_iae.iIaeMomen ECU_ADDRESS 0xFFF8CFA0 /end MEASUREMENT
/begin MEASUREMENT iIaeMomen.nd_motentkoppeln_init_iae "nd_motsollanfahr_iae-Wert bei Setzen von kup_status_iae Entkoppeln_anfahren" SWORD UMR_U_MIN_1_1_0_S6_S3 1 100 -10000 10000 DISPLAY_IDENTIFIER nd_motentkoppeln_init_iae.iIaeMomen ECU_ADDRESS 0xFFF8CFA2 /end MEASUREMENT
/begin MEASUREMENT iIaeMomen.n_motanfahr_grad_iae "Drehzahloffset aus Gradient auf Anfahrdrehzahl" SLONG UMR_U_MIN_1_100_0_S6_S3 1 100 -8160 8160 DISPLAY_IDENTIFIER n_motanfahr_grad_iae.iIaeMomen ECU_ADDRESS 0xFFF8CFA4 /end MEASUREMENT
/begin MEASUREMENT iIaeMomen.i_stuetz_iae "Stützfaktor der IAE-Kupplung" SWORD UMR___1_1000_0_S6_S3 1 100 0 6 DISPLAY_IDENTIFIER i_stuetz_iae.iIaeMomen ECU_ADDRESS 0xFFF8CFA8 /end MEASUREMENT
/begin MEASUREMENT iIaeMomen.i_stuetzalt_iae "Stützfaktor der IAE-Kupplung alt" SWORD UMR___1_1000_0_S6_S3 1 100 0 6 DISPLAY_IDENTIFIER i_stuetzalt_iae.iIaeMomen ECU_ADDRESS 0xFFF8CFAA /end MEASUREMENT
/begin MEASUREMENT iIaeMomen.i_stuetzziel_iae "Stützfaktor der IAE-Kupplung ziel" SWORD UMR___1_1000_0_S6_S3 1 100 0 6 DISPLAY_IDENTIFIER i_stuetzziel_iae.iIaeMomen ECU_ADDRESS 0xFFF8CFAC /end MEASUREMENT
/begin MEASUREMENT iIaeMomen.t_syn_temp_iae "vorausberechnete Zeit bis Erreichen Synchron zielgang" SWORD UMR_MSEC__10_1_0_S6_S3 1 100 -327680 327670 DISPLAY_IDENTIFIER t_syn_temp_iae.iIaeMomen ECU_ADDRESS 0xFFF8CFAE /end MEASUREMENT
/begin MEASUREMENT iIaeMomen.flag_schrittschaltung_merk_iae "Kopie von schrittschaltung zur Flankenerkennung" UBYTE Conv.cIaeMomen._.flag_schrittschaltung_merk_iae_S6_S3 1 100 0 1 BIT_MASK 0x1 DISPLAY_IDENTIFIER flag_schrittschaltung_merk_iae.iIaeMomen ECU_ADDRESS 0xFFF8CFB0 /end MEASUREMENT
/begin MEASUREMENT iIaeMomen.flag_f_m_basis_anfahrt_init "Flag zur Initialisierung von f_m_basis bei Neueinstieg ins Anfahren" UBYTE Conv.cIaeMomen._.flag_f_m_basis_anfahrt_init_S6_S3 1 100 0 1 BIT_MASK 0x1 DISPLAY_IDENTIFIER flag_f_m_basis_anfahrt_init.iIaeMomen ECU_ADDRESS 0xFFF8CFB1 /end MEASUREMENT
/begin MEASUREMENT iIaeMomen.m_soll_iae "IAE Sollmoment Getriebeeingangsseitig" SWORD UMR_NM__1_1_0_S6_S3 1 100 -400 1640 DISPLAY_IDENTIFIER m_soll_iae.iIaeMomen ECU_ADDRESS 0xFFF8CFB2 /end MEASUREMENT
/begin MEASUREMENT iIaeMomen.flag_miaeauf_keinkfl_iae "m_iaeauf-Berechnung bei kein_kfl" UBYTE Conv.cIaeMomen._.flag_miaeauf_keinkfl_iae_S6_S3 1 100 0 1 BIT_MASK 0x1 DISPLAY_IDENTIFIER flag_miaeauf_keinkfl_iae.iIaeMomen ECU_ADDRESS 0xFFF8CFB4 /end MEASUREMENT
/begin MEASUREMENT iIaeMomen.m_iaeauf "IAE-AufnahmemomentMoment" SWORD UMR_NM__1_1_0_S6_S3 1 100 -400 1640 DISPLAY_IDENTIFIER m_iaeauf.iIaeMomen ECU_ADDRESS 0xFFF8CFB6 /end MEASUREMENT
/begin MEASUREMENT iIaeMomen.m_iaeauf_max_iae "Maximal zulässiges IAE-Aufnahmemomentmoment" SWORD UMR_NM__1_1_0_S6_S3 1 100 -400 1640 DISPLAY_IDENTIFIER m_iaeauf_max_iae.iIaeMomen ECU_ADDRESS 0xFFF8CFB8 /end MEASUREMENT
/begin MEASUREMENT iIaeMomen.m_iaeauf_ramp "Rampe IAE-AufnahmemomentMoment" SLONG UMR_NM__1_100_0_S6_S3 1 100 -1000 1000 DISPLAY_IDENTIFIER m_iaeauf_ramp.iIaeMomen ECU_ADDRESS 0xFFF8CFBC /end MEASUREMENT
/begin MEASUREMENT iIaeMomen.sig_rampe_miaeauf "Vorzeichen der Rampe IAE-AufnahmemomentMoment" SBYTE UMR___1_1_0_S6_S3 1 100 -1 1 DISPLAY_IDENTIFIER sig_rampe_miaeauf.iIaeMomen ECU_ADDRESS 0xFFF8CFC0 /end MEASUREMENT
/begin MEASUREMENT iIaeMomen.z_rampe_miaeauf "Status der Rampe auf neues m_iaeauf" UBYTE Conv.cIaeMomen._.z_rampe_miaeauf_S6_S3 1 100 0 2 DISPLAY_IDENTIFIER z_rampe_miaeauf.iIaeMomen ECU_ADDRESS 0xFFF8CFC1 /end MEASUREMENT
/begin MEASUREMENT iIaeMomen.m_soll_iae_init "Sollmoment bei Start Synchronisieren" SWORD UMR_NM__1_1_0_S6_S3 1 100 -400 1640 DISPLAY_IDENTIFIER m_soll_iae_init.iIaeMomen ECU_ADDRESS 0xFFF8CFC2 /end MEASUREMENT
/begin MEASUREMENT iIaeMomen.dki_maxiae "max. Wert gefiltertes Fahrpedal" UBYTE UMR_PROZENT__20_51_0_S6_S3 1 100 0 100 DISPLAY_IDENTIFIER dki_maxiae.iIaeMomen ECU_ADDRESS 0xFFF8CFC4 /end MEASUREMENT
/begin MEASUREMENT iIaeMomen.mo_soll_iae "Momentenoffset für Solldruck" SLONG UMR_NM__1_100_0_S6_S3 1 100 0 1500 DISPLAY_IDENTIFIER mo_soll_iae.iIaeMomen ECU_ADDRESS 0xFFF8CFC8 /end MEASUREMENT
/begin MEASUREMENT iIaeMomen.m_soll_still_iae "IAE Sollmoment im STILLSTAND" SWORD UMR_NM__1_1_0_S6_S3 1 100 -400 1640 DISPLAY_IDENTIFIER m_soll_still_iae.iIaeMomen ECU_ADDRESS 0xFFF8CFCC /end MEASUREMENT
/begin MEASUREMENT iIaeMomen.m_stell_iae "IAE Stellmoment Anfahrkupplung" SWORD UMR_NM__1_1_0_S6_S3 1 100 -400 1640 DISPLAY_IDENTIFIER m_stell_iae.iIaeMomen ECU_ADDRESS 0xFFF8CFCE /end MEASUREMENT
/begin MEASUREMENT iIaeMomen.m_vorsteuer_iae "Vorsteuermoment für integrierte Anfahrkupplung" SWORD UMR_NM__1_1_0_S6_S3 1 100 -400 1640 DISPLAY_IDENTIFIER m_vorsteuer_iae.iIaeMomen ECU_ADDRESS 0xFFF8CFD0 /end MEASUREMENT
/begin MEASUREMENT iIaeMomen.m_vorkriechziel_iae "Zielwert fuer Vorsteuermoment im Kriechen" SWORD UMR_NM__1_1_0_S6_S3 1 100 -400 1640 DISPLAY_IDENTIFIER m_vorkriechziel_iae.iIaeMomen ECU_ADDRESS 0xFFF8CFD2 /end MEASUREMENT
/begin MEASUREMENT iIaeMomen.m_kriech_min_iae "Untergrenze Kriechmoment" SWORD UMR_NM__1_1_0_S6_S3 1 100 -400 1640 DISPLAY_IDENTIFIER m_kriech_min_iae.iIaeMomen ECU_ADDRESS 0xFFF8CFD4 /end MEASUREMENT
/begin MEASUREMENT iIaeMomen.m_kriech_max_iae "Obergrenze Kriechmoment" SWORD UMR_NM__1_1_0_S6_S3 1 100 -400 1640 DISPLAY_IDENTIFIER m_kriech_max_iae.iIaeMomen ECU_ADDRESS 0xFFF8CFD6 /end MEASUREMENT
/begin MEASUREMENT iIaeMomen.m_kriech_max_ziel_iae "Obergrenze Kriechmoment vor der Überführung" SWORD UMR_NM__1_1_0_S6_S3 1 100 -400 1640 DISPLAY_IDENTIFIER m_kriech_max_ziel_iae.iIaeMomen ECU_ADDRESS 0xFFF8CFD8 /end MEASUREMENT
/begin MEASUREMENT iIaeMomen.mo_vorstkreichen_iae "Offset auf Vorsteuermoment im Kriechen" SLONG UMR_NM__1_100_0_S6_S3 1 100 -1500 1500 DISPLAY_IDENTIFIER mo_vorstkreichen_iae.iIaeMomen ECU_ADDRESS 0xFFF8CFDC /end MEASUREMENT
/begin MEASUREMENT iIaeMomen.m_basis_anfahrt_iae "Basis für Anfahrmoment im H/E-Anfahren IAE" SWORD UMR_NM__1_1_0_S6_S3 1 100 -400 1640 DISPLAY_IDENTIFIER m_basis_anfahrt_iae.iIaeMomen ECU_ADDRESS 0xFFF8CFE0 /end MEASUREMENT
/begin MEASUREMENT iIaeMomen.m_basis_anfahrt_korr_iae "KorrekturmomentBasis für Anfahrmoment im H/E-Anfahren IAE" SWORD UMR_NM__1_1_0_S6_S3 1 100 -400 1640 DISPLAY_IDENTIFIER m_basis_anfahrt_korr_iae.iIaeMomen ECU_ADDRESS 0xFFF8CFE2 /end MEASUREMENT
/begin MEASUREMENT iIaeMomen.m_basis_anfahrt_min_iae "Basis fuer minimales Anfahrmoment im H/E-Anfahren IAE" SWORD UMR_NM__1_1_0_S6_S3 1 100 -400 1640 DISPLAY_IDENTIFIER m_basis_anfahrt_min_iae.iIaeMomen ECU_ADDRESS 0xFFF8CFE4 /end MEASUREMENT
/begin MEASUREMENT iIaeMomen.m_anfahrt_min_iae "minimales Anfahrmoment im H/E-Anfahren IAE" SWORD UMR_NM__1_1_0_S6_S3 1 100 -400 1640 DISPLAY_IDENTIFIER m_anfahrt_min_iae.iIaeMomen ECU_ADDRESS 0xFFF8CFE6 /end MEASUREMENT
/begin MEASUREMENT iIaeMomen.m_regler_iae "Reglermoment für integrierte Anfahrkupplung" SWORD UMR_NM__1_1_0_S6_S3 1 100 -1000 1000 DISPLAY_IDENTIFIER m_regler_iae.iIaeMomen ECU_ADDRESS 0xFFF8CFE8 /end MEASUREMENT
/begin MEASUREMENT iIaeMomen.m_alt_iae "Moment aus letztem Zustand" SWORD UMR_NM__1_1_0_S6_S3 1 100 -400 1640 DISPLAY_IDENTIFIER m_alt_iae.iIaeMomen ECU_ADDRESS 0xFFF8CFEA /end MEASUREMENT
/begin MEASUREMENT iIaeMomen.m_ziel_iae "Zeil-Moment für Überführung der Vorsteuerung" SWORD UMR_NM__1_1_0_S6_S3 1 100 -400 1640 DISPLAY_IDENTIFIER m_ziel_iae.iIaeMomen ECU_ADDRESS 0xFFF8CFEC /end MEASUREMENT
/begin MEASUREMENT iIaeMomen.typ_uef_m "Typ der Überführungsfunktion für Momente" UBYTE Conv.cIaeMomen._.typ_uef_m_S6_S3 1 100 0 4 DISPLAY_IDENTIFIER typ_uef_m.iIaeMomen ECU_ADDRESS 0xFFF8CFEE /end MEASUREMENT
/begin MEASUREMENT iIaeMomen.t_uef_m_iae "Dauer der Überführungsfunktion für Momentenüberführung" SWORD UMR_MSEC__10_1_0_S6_S3 1 100 0 320000 DISPLAY_IDENTIFIER t_uef_m_iae.iIaeMomen ECU_ADDRESS 0xFFF8CFF0 /end MEASUREMENT
/begin MEASUREMENT iIaeMomen.t_uef_nd_iae "Dauer der Überführungsfunktion für Drehzahlsüberführung" SWORD UMR_MSEC__10_1_0_S6_S3 1 100 0 320000 DISPLAY_IDENTIFIER t_uef_nd_iae.iIaeMomen ECU_ADDRESS 0xFFF8CFF2 /end MEASUREMENT
/begin MEASUREMENT iIaeMomen.t_uef_m_zu_kriech_iae "Dauer der Überführungsfunktion für Momentenüberführung speziell von Zu nach Kriechen" SWORD UMR_MSEC__10_1_0_S6_S3 1 100 0 320000 DISPLAY_IDENTIFIER t_uef_m_zu_kriech_iae.iIaeMomen ECU_ADDRESS 0xFFF8CFF4 /end MEASUREMENT
/begin MEASUREMENT iIaeMomen.kd_iae "Reglerparameter D-Anteil" FLOAT32_IEEE UMR___1_1_0_S6_S3 1 100 -10000 10000 FORMAT "%4.2" DISPLAY_IDENTIFIER kd_iae.iIaeMomen ECU_ADDRESS 0xFFF8CFF8 /end MEASUREMENT
/begin MEASUREMENT iIaeMomen.ki_iae "Reglerparameter I-Anteil" FLOAT32_IEEE UMR___1_1_0_S6_S3 1 100 -10000 10000 FORMAT "%4.2" DISPLAY_IDENTIFIER ki_iae.iIaeMomen ECU_ADDRESS 0xFFF8CFFC /end MEASUREMENT
/begin MEASUREMENT iIaeMomen.kp_iae "Reglerparameter P-Anteil" FLOAT32_IEEE UMR___1_1_0_S6_S3 1 100 -10000 10000 FORMAT "%4.2" DISPLAY_IDENTIFIER kp_iae.iIaeMomen ECU_ADDRESS 0xFFF8D000 /end MEASUREMENT
/begin MEASUREMENT iIaeMomen.cd_iae "Reglerkoeffizienten" FLOAT32_IEEE UMR___1_1_0_S6_S3 1 100 -10000 10000 FORMAT "%4.2" DISPLAY_IDENTIFIER cd_iae.iIaeMomen ECU_ADDRESS 0xFFF8D004 /end MEASUREMENT
/begin MEASUREMENT iIaeMomen.ci_iae "Reglerkoeffizienten" FLOAT32_IEEE UMR___1_1_0_S6_S3 1 100 -10000 10000 FORMAT "%4.2" DISPLAY_IDENTIFIER ci_iae.iIaeMomen ECU_ADDRESS 0xFFF8D008 /end MEASUREMENT
/begin MEASUREMENT iIaeMomen.cp_iae "Reglerkoeffizienten" FLOAT32_IEEE UMR___1_1_0_S6_S3 1 100 -10000 10000 FORMAT "%4.2" DISPLAY_IDENTIFIER cp_iae.iIaeMomen ECU_ADDRESS 0xFFF8D00C /end MEASUREMENT
/begin MEASUREMENT iIaeMomen.ct1_iae "Reglerkoeffizienten" FLOAT32_IEEE UMR___1_1_0_S6_S3 1 100 -10000 10000 FORMAT "%4.2" DISPLAY_IDENTIFIER ct1_iae.iIaeMomen ECU_ADDRESS 0xFFF8D010 /end MEASUREMENT
/begin MEASUREMENT iIaeMomen.m_regler_p_iae "P-Anteil Regler" FLOAT32_IEEE UMR_NM__1_1_0_S6_S3 1 100 -1000 1000 DISPLAY_IDENTIFIER m_regler_p_iae.iIaeMomen ECU_ADDRESS 0xFFF8D014 /end MEASUREMENT
/begin MEASUREMENT iIaeMomen.m_regler_d_iae "D-Anteil Regler" FLOAT32_IEEE UMR_NM__1_1_0_S6_S3 1 100 -1000 1000 DISPLAY_IDENTIFIER m_regler_d_iae.iIaeMomen ECU_ADDRESS 0xFFF8D018 /end MEASUREMENT
/begin MEASUREMENT iIaeMomen.m_regler_i_iae "I-Anteil Regler" FLOAT32_IEEE UMR_NM__1_1_0_S6_S3 1 100 -1000 1000 DISPLAY_IDENTIFIER m_regler_i_iae.iIaeMomen ECU_ADDRESS 0xFFF8D01C /end MEASUREMENT
/begin MEASUREMENT iIaeMomen.xd_iae "Reglerdifferenz" FLOAT32_IEEE UMR___1_1_0_S6_S3 1 100 -10000 10000 FORMAT "%4.2" DISPLAY_IDENTIFIER xd_iae.iIaeMomen ECU_ADDRESS 0xFFF8D020 /end MEASUREMENT
/begin MEASUREMENT iIaeMomen.nd_kriechziel_iae "Sollkriechdrehzahl Zielwert" SWORD UMR_U_MIN_1_1_0_S6_S3 1 100 -10000 10000 DISPLAY_IDENTIFIER nd_kriechziel_iae.iIaeMomen ECU_ADDRESS 0xFFF8D024 /end MEASUREMENT
/begin MEASUREMENT iIaeMomen.nd_kriechstart_iae "Differenzdrehzahl beim ReglerStart" SWORD UMR_U_MIN_1_1_0_S6_S3 1 100 -10000 10000 DISPLAY_IDENTIFIER nd_kriechstart_iae.iIaeMomen ECU_ADDRESS 0xFFF8D026 /end MEASUREMENT
/begin MEASUREMENT iIaeMomen.nd_kriechsoll_iae "Sollkriechdrehzahl" SWORD UMR_U_MIN_1_1_0_S6_S3 1 100 -10000 10000 DISPLAY_IDENTIFIER nd_kriechsoll_iae.iIaeMomen ECU_ADDRESS 0xFFF8D028 /end MEASUREMENT
/begin MEASUREMENT iIaeMomen.flag_regler_aktiv "Regler ist aktiv" UBYTE Conv.cIaeMomen._.flag_regler_aktiv_S6_S3 1 100 0 1 BIT_MASK 0x1 DISPLAY_IDENTIFIER flag_regler_aktiv.iIaeMomen ECU_ADDRESS 0xFFF8D02A /end MEASUREMENT
/begin MEASUREMENT iIaeMomen.flag_first_reglerinit_iae "Regler im Kriechen wurde schon mal initialisiert Nur einmalig setzen" UBYTE Conv.cIaeMomen._.flag_first_reglerinit_iae_S6_S3 1 100 0 1 BIT_MASK 0x1 DISPLAY_IDENTIFIER flag_first_reglerinit_iae.iIaeMomen ECU_ADDRESS 0xFFF8D02B /end MEASUREMENT
/begin MEASUREMENT iIaeMomen.z_mo_kriech_aktiv_iae "Vorsteueroffset im Kriechen aktiv" UBYTE Conv.cIaeMomen._.z_mo_kriech_aktiv_iae_S6_S3 1 100 0 3 DISPLAY_IDENTIFIER z_mo_kriech_aktiv_iae.iIaeMomen ECU_ADDRESS 0xFFF8D02C /end MEASUREMENT
/begin MEASUREMENT iIaeMomen.z_modusiae_temp "Altwert von z_modus_iae" UBYTE Conv.cIaeMomen._.z_modusiae_temp_S6_S3 1 100 0 2 DISPLAY_IDENTIFIER z_modusiae_temp.iIaeMomen ECU_ADDRESS 0xFFF8D02D /end MEASUREMENT
/begin MEASUREMENT iIaeMomen.flag_zu_erreicht_iae "Zu-Rampe beendet" UBYTE Conv.cIaeMomen._.flag_zu_erreicht_iae_S6_S3 1 100 0 1 BIT_MASK 0x1 DISPLAY_IDENTIFIER flag_zu_erreicht_iae.iIaeMomen ECU_ADDRESS 0xFFF8D02E /end MEASUREMENT
/begin MEASUREMENT iIaeMomen.flag_nsmotmaxc_iae "Motordrehzahl im Anfahrvorgang einmalig über NS_MOTANFAHRMAXC_IAE" UBYTE Conv.cIaeMomen._.flag_nsmotmaxc_iae_S6_S3 1 100 0 1 BIT_MASK 0x1 DISPLAY_IDENTIFIER flag_nsmotmaxc_iae.iIaeMomen ECU_ADDRESS 0xFFF8D02F /end MEASUREMENT
/begin MEASUREMENT iIaeMomen.flag_kriechmax_ramp "Rampe maximales Kriechmoment" UBYTE Conv.cIaeMomen._.flag_kriechmax_ramp_S6_S3 1 100 0 1 BIT_MASK 0x1 DISPLAY_IDENTIFIER flag_kriechmax_ramp.iIaeMomen ECU_ADDRESS 0xFFF8D030 /end MEASUREMENT
/begin MEASUREMENT iIaeMomen.m_kriechmax_ramp "Rampenwert des Kriechmoments" SLONG UMR_NM__1_100_0_S6_S3 1 100 -4 16.4 DISPLAY_IDENTIFIER m_kriechmax_ramp.iIaeMomen ECU_ADDRESS 0xFFF8D034 /end MEASUREMENT
/begin MEASUREMENT iIaeMomen.m_motistoe_iae_init "Motormoment Initialisierungswert bei Zustandsstart" SWORD UMR_NM__1_1_0_S6_S3 1 100 -400 1640 DISPLAY_IDENTIFIER m_motistoe_iae_init.iIaeMomen ECU_ADDRESS 0xFFF8D038 /end MEASUREMENT
/begin MEASUREMENT iIaeMomen.m_iaeauf_alt "altes IAE-AufnahmemomentMoment aus letztem Zustand" SWORD UMR_NM__1_1_0_S6_S3 1 100 -400 1640 DISPLAY_IDENTIFIER m_iaeauf_alt.iIaeMomen ECU_ADDRESS 0xFFF8D03A /end MEASUREMENT
/begin MEASUREMENT iIaeMomen.m_iaeauf_frozen "eingefrorenes IAE-AufnahmemomentMoment" SWORD UMR_NM__1_1_0_S6_S3 1 100 -400 1640 DISPLAY_IDENTIFIER m_iaeauf_frozen.iIaeMomen ECU_ADDRESS 0xFFF8D03C /end MEASUREMENT
/begin MEASUREMENT iIaeMomen.f_miaeaufdki_iae "Faktor m_iaeauf für Lastrückmahme im Anfahren" FLOAT32_IEEE UMR___1_1_0_S6_S3 1 100 0 2 FORMAT "%4.2" DISPLAY_IDENTIFIER f_miaeaufdki_iae.iIaeMomen ECU_ADDRESS 0xFFF8D040 /end MEASUREMENT
/begin MEASUREMENT iIaeMomen.f_mschlepp_iae "Faktor m_schlepp_iae für Rückfilterung im Anfahren Synchronisieren und Zu" FLOAT32_IEEE UMR___1_1_0_S6_S3 1 100 0 2 FORMAT "%4.2" DISPLAY_IDENTIFIER f_mschlepp_iae.iIaeMomen ECU_ADDRESS 0xFFF8D044 /end MEASUREMENT
/begin MEASUREMENT iIaeMomen.m_schlepp_iae "IAE-Schleppmoment" SWORD UMR_NM__1_1_0_S6_S3 1 100 -400 1640 DISPLAY_IDENTIFIER m_schlepp_iae.iIaeMomen ECU_ADDRESS 0xFFF8D048 /end MEASUREMENT
/begin MEASUREMENT iIaeMomen.m_schlepp_auf_iae "IAE-Schleppmoment fuer Aufnahmemoment" SWORD UMR_NM__1_1_0_S6_S3 1 100 -400 1640 DISPLAY_IDENTIFIER m_schlepp_auf_iae.iIaeMomen ECU_ADDRESS 0xFFF8D04A /end MEASUREMENT
/begin MEASUREMENT iIaeMomen.m_schlepp_getr_iae "IAE-Schleppmoment Getriebe" SWORD UMR_NM__1_1_0_S6_S3 1 100 -400 1640 DISPLAY_IDENTIFIER m_schlepp_getr_iae.iIaeMomen ECU_ADDRESS 0xFFF8D04C /end MEASUREMENT
/begin MEASUREMENT iIaeMomen.m_ist_iae "IAE-Ist-Moment" SWORD UMR_NM__1_1_0_S6_S3 1 100 -400 1640 DISPLAY_IDENTIFIER m_ist_iae.iIaeMomen ECU_ADDRESS 0xFFF8D04E /end MEASUREMENT
/begin MEASUREMENT iIaeMomen.m_ist_vorst_iae_froz "eingefrorenes IAE-Ist-Vorst-Moment" SWORD UMR_NM__1_1_0_S6_S3 1 100 -400 1640 DISPLAY_IDENTIFIER m_ist_vorst_iae_froz.iIaeMomen ECU_ADDRESS 0xFFF8D050 /end MEASUREMENT
/begin MEASUREMENT iIaeMomen.m_ist_vorst_iae "IAE-Ist-Vorst-Moment" SWORD UMR_NM__1_1_0_S6_S3 1 100 -400 1640 DISPLAY_IDENTIFIER m_ist_vorst_iae.iIaeMomen ECU_ADDRESS 0xFFF8D052 /end MEASUREMENT
/begin MEASUREMENT iIaeMomen.m_ist_vorst_max_anfahr_iae "IAE-Ist-Vorst-Moment im Anfahren" SWORD UMR_NM__1_1_0_S6_S3 1 100 -400 1640 DISPLAY_IDENTIFIER m_ist_vorst_max_anfahr_iae.iIaeMomen ECU_ADDRESS 0xFFF8D054 /end MEASUREMENT
/begin MEASUREMENT iIaeMomen.m_ist_vorst_alt_iae "Altwert von IAE-Ist-Vorst-Moment" SWORD UMR_NM__1_1_0_S6_S3 1 100 -400 1640 DISPLAY_IDENTIFIER m_ist_vorst_alt_iae.iIaeMomen ECU_ADDRESS 0xFFF8D056 /end MEASUREMENT
/begin MEASUREMENT iIaeMomen.t_uef_miaeaufanf_iae "Dauer der Überführungfunktion für m_ist_vorst_iae im und aus Anfahren" SWORD UMR_MSEC__10_1_0_S6_S3 1 100 -327680 327670 DISPLAY_IDENTIFIER t_uef_miaeaufanf_iae.iIaeMomen ECU_ADDRESS 0xFFF8D058 /end MEASUREMENT
/begin MEASUREMENT iIaeMomen.typ_uef_miaeaufanf_iae "Typ der Überführungfunktion für m_ist_vorst_iae im und aus Anfahren" UBYTE Conv.cIaeMomen._.typ_uef_miaeaufanf_iae_S6_S3 1 100 0 4 DISPLAY_IDENTIFIER typ_uef_miaeaufanf_iae.iIaeMomen ECU_ADDRESS 0xFFF8D05A /end MEASUREMENT
/begin MEASUREMENT iIaeMomen.flag_initmistvorst_iae "Initialisierung von m_ist_vorst_iae" UBYTE Conv.cIaeMomen._.flag_initmistvorst_iae_S6_S3 1 100 0 1 BIT_MASK 0x1 DISPLAY_IDENTIFIER flag_initmistvorst_iae.iIaeMomen ECU_ADDRESS 0xFFF8D05B /end MEASUREMENT
/begin MEASUREMENT iIaeMomen.kfl_ziel_tmp_iae "kfl_ziel" UBYTE Conv.cIaeMomen._.kfl_ziel_tmp_iae_S6_S3 1 100 0 2 DISPLAY_IDENTIFIER kfl_ziel_tmp_iae.iIaeMomen ECU_ADDRESS 0xFFF8D05C /end MEASUREMENT
/begin MEASUREMENT iIaeMomen.t_dauer_iuef_hs_iae "Dauer der Überführungfunktion für den Stützfaktor bei HS" SWORD UMR_MSEC__10_1_0_S6_S3 1 100 -327680 327670 DISPLAY_IDENTIFIER t_dauer_iuef_hs_iae.iIaeMomen ECU_ADDRESS 0xFFF8D05E /end MEASUREMENT
/begin MEASUREMENT iIaeMomen.f_sign_puls_iae "Vorzeichen vom Puls für Ubertemperaturrippeln" SBYTE UMR___1_1_0_S6_S3 1 100 -1 1 DISPLAY_IDENTIFIER f_sign_puls_iae.iIaeMomen ECU_ADDRESS 0xFFF8D060 /end MEASUREMENT
/begin MEASUREMENT iIaeMomen.m_puls_cueber_iae "Momentenpuls bei Übertemperatur" SWORD UMR_NM__1_1_0_S6_S3 1 100 -400 1640 DISPLAY_IDENTIFIER m_puls_cueber_iae.iIaeMomen ECU_ADDRESS 0xFFF8D062 /end MEASUREMENT
/begin MEASUREMENT iIaeMomen.m_puls_cueber_roh_iae "Momentenpuls bei Übertemperatur Rohwert" SLONG UMR_NM__1_1_0_S6_S3 1 100 -400 1640 DISPLAY_IDENTIFIER m_puls_cueber_roh_iae.iIaeMomen ECU_ADDRESS 0xFFF8D064 /end MEASUREMENT
/begin MEASUREMENT iIaeMomen.flag_pulscue_aktiv_iae "Momentenpuls bei Übertemperatur aktiv" UBYTE Conv.cIaeMomen._.flag_pulscue_aktiv_iae_S6_S3 1 100 0 1 BIT_MASK 0x1 DISPLAY_IDENTIFIER flag_pulscue_aktiv_iae.iIaeMomen ECU_ADDRESS 0xFFF8D068 /end MEASUREMENT
/begin MEASUREMENT iIaeMomen.flag_schaltung_aktiv_iae "schaltung aktiv" UBYTE Conv.cIaeMomen._.flag_schaltung_aktiv_iae_S6_S3 1 100 0 1 BIT_MASK 0x1 DISPLAY_IDENTIFIER flag_schaltung_aktiv_iae.iIaeMomen ECU_ADDRESS 0xFFF8D069 /end MEASUREMENT
/begin MEASUREMENT iIaeMomen.flag_mvorberechnug_aktiv_iae "Berechnung von m_vorsteuer im Kriechen aktiv" UBYTE Conv.cIaeMomen._.flag_mvorberechnug_aktiv_iae_S6_S3 1 100 0 1 BIT_MASK 0x1 DISPLAY_IDENTIFIER flag_mvorberechnug_aktiv_iae.iIaeMomen ECU_ADDRESS 0xFFF8D06A /end MEASUREMENT
/begin MEASUREMENT iIaeMomen.status_uef_zu_kriech_init_iae "Berechnung von m_vorsteuer im Kriechen aktiv" UBYTE Conv.cIaeMomen._.status_uef_zu_kriech_init_iae_S6_S3 1 100 0 2 DISPLAY_IDENTIFIER status_uef_zu_kriech_init_iae.iIaeMomen ECU_ADDRESS 0xFFF8D06B /end MEASUREMENT
/begin MEASUREMENT iIaeMomen.st_anfagradbegrenz_iae "Status der Begrenzung für n_motanfahr_grad_iae" UBYTE Conv.cIaeMomen._.st_anfagradbegrenz_iae_S6_S3 1 100 0 2 DISPLAY_IDENTIFIER st_anfagradbegrenz_iae.iIaeMomen ECU_ADDRESS 0xFFF8D06C /end MEASUREMENT
/begin MEASUREMENT iIaeDiagn.Pt1Mdidiagiae.x "Filterwert" SLONG UMR___1_300_0_S6_S3 1 100 -7158278.82667 7158278.82333 DISPLAY_IDENTIFIER Pt1Mdidiagiae.iIaeDiagn ECU_ADDRESS 0xFFF8CEE0 /end MEASUREMENT
/begin MEASUREMENT iIaeDiagn.Pt1Axrefiae.x "Filterwert" SLONG UMR___1_300_0_S6_S3 1 100 -7158278.82667 7158278.82333 DISPLAY_IDENTIFIER Pt1Axrefiae.iIaeDiagn ECU_ADDRESS 0xFFF8CEE4 /end MEASUREMENT
/begin MEASUREMENT iIaeDiagn.TimerNoOpenDiagiae.time "Zeit des Timers" UWORD UMR_SEC__1_100_0_S6_S3 1 100 0 655.35 DISPLAY_IDENTIFIER time.TimerNoOpenDiagiae.iIaeDiagn ECU_ADDRESS 0xFFF8CEE8 /end MEASUREMENT
/begin MEASUREMENT iIaeDiagn.TimerNoOpenDiagiae.maxtime "Endzeit" UWORD UMR_SEC__1_100_0_S6_S3 1 100 0 655.35 DISPLAY_IDENTIFIER maxtime.TimerNoOpenDiagiae.iIaeDiagn ECU_ADDRESS 0xFFF8CEEA /end MEASUREMENT
/begin MEASUREMENT iIaeDiagn.TimerNoCloseDiagiae.time "Zeit des Timers" UWORD UMR_SEC__1_100_0_S6_S3 1 100 0 655.35 DISPLAY_IDENTIFIER time.TimerNoCloseDiagiae.iIaeDiagn ECU_ADDRESS 0xFFF8CEEC /end MEASUREMENT
/begin MEASUREMENT iIaeDiagn.TimerNoCloseDiagiae.maxtime "Endzeit" UWORD UMR_SEC__1_100_0_S6_S3 1 100 0 655.35 DISPLAY_IDENTIFIER maxtime.TimerNoCloseDiagiae.iIaeDiagn ECU_ADDRESS 0xFFF8CEEE /end MEASUREMENT
/begin MEASUREMENT iIaeDiagn.TimerCloseNgab.time "Zeit des Timers" UWORD UMR_SEC__1_100_0_S6_S3 1 100 0 655.35 DISPLAY_IDENTIFIER time.TimerCloseNgab.iIaeDiagn ECU_ADDRESS 0xFFF8CEF0 /end MEASUREMENT
/begin MEASUREMENT iIaeDiagn.TimerCloseNgab.maxtime "Endzeit" UWORD UMR_SEC__1_100_0_S6_S3 1 100 0 655.35 DISPLAY_IDENTIFIER maxtime.TimerCloseNgab.iIaeDiagn ECU_ADDRESS 0xFFF8CEF2 /end MEASUREMENT
/begin MEASUREMENT iIaeDiagn.TimerCloseRueckF.time "Zeit des Timers" UWORD UMR_SEC__1_100_0_S6_S3 1 100 0 655.35 DISPLAY_IDENTIFIER time.TimerCloseRueckF.iIaeDiagn ECU_ADDRESS 0xFFF8CEF4 /end MEASUREMENT
/begin MEASUREMENT iIaeDiagn.TimerCloseRueckF.maxtime "Endzeit" UWORD UMR_SEC__1_100_0_S6_S3 1 100 0 655.35 DISPLAY_IDENTIFIER maxtime.TimerCloseRueckF.iIaeDiagn ECU_ADDRESS 0xFFF8CEF6 /end MEASUREMENT
/begin MEASUREMENT iIaeDiagn.TimerNoopenRueckF.time "Zeit des Timers" UWORD UMR_SEC__1_100_0_S6_S3 1 100 0 655.35 DISPLAY_IDENTIFIER time.TimerNoopenRueckF.iIaeDiagn ECU_ADDRESS 0xFFF8CEF8 /end MEASUREMENT
/begin MEASUREMENT iIaeDiagn.TimerNoopenRueckF.maxtime "Endzeit" UWORD UMR_SEC__1_100_0_S6_S3 1 100 0 655.35 DISPLAY_IDENTIFIER maxtime.TimerNoopenRueckF.iIaeDiagn ECU_ADDRESS 0xFFF8CEFA /end MEASUREMENT
/begin MEASUREMENT iIaeDiagn.TimerCloseBewAktiv.time "Zeit des Timers" UWORD UMR_SEC__1_100_0_S6_S3 1 100 0 655.35 DISPLAY_IDENTIFIER time.TimerCloseBewAktiv.iIaeDiagn ECU_ADDRESS 0xFFF8CEFC /end MEASUREMENT
/begin MEASUREMENT iIaeDiagn.TimerCloseBewAktiv.maxtime "Endzeit" UWORD UMR_SEC__1_100_0_S6_S3 1 100 0 655.35 DISPLAY_IDENTIFIER maxtime.TimerCloseBewAktiv.iIaeDiagn ECU_ADDRESS 0xFFF8CEFE /end MEASUREMENT
/begin MEASUREMENT iIaeDiagn.TimerNocloseBewAktiv.time "Zeit des Timers" UWORD UMR_SEC__1_100_0_S6_S3 1 100 0 655.35 DISPLAY_IDENTIFIER time.TimerNocloseBewAktiv.iIaeDiagn ECU_ADDRESS 0xFFF8CF00 /end MEASUREMENT
/begin MEASUREMENT iIaeDiagn.TimerNocloseBewAktiv.maxtime "Endzeit" UWORD UMR_SEC__1_100_0_S6_S3 1 100 0 655.35 DISPLAY_IDENTIFIER maxtime.TimerNocloseBewAktiv.iIaeDiagn ECU_ADDRESS 0xFFF8CF02 /end MEASUREMENT
/begin MEASUREMENT iIaeDiagn.TimerNoopenBewAktiv.time "Zeit des Timers" UWORD UMR_SEC__1_100_0_S6_S3 1 100 0 655.35 DISPLAY_IDENTIFIER time.TimerNoopenBewAktiv.iIaeDiagn ECU_ADDRESS 0xFFF8CF04 /end MEASUREMENT
/begin MEASUREMENT iIaeDiagn.TimerNoopenBewAktiv.maxtime "Endzeit" UWORD UMR_SEC__1_100_0_S6_S3 1 100 0 655.35 DISPLAY_IDENTIFIER maxtime.TimerNoopenBewAktiv.iIaeDiagn ECU_ADDRESS 0xFFF8CF06 /end MEASUREMENT
/begin MEASUREMENT iIaeDiagn.index_mot_diagiae "Hilfgröße für KF_MDI_DIAGIA: End_mot_iae oder (n_mot_iae/n_motsoll_ll_iae)*100" SWORD UMR___1_1_0_S6_S3 1 100 -10000 10000 DISPLAY_IDENTIFIER index_mot_diagiae.iIaeDiagn ECU_ADDRESS 0xFFF8CEC0 /end MEASUREMENT
/begin MEASUREMENT iIaeDiagn.mdi_diagiae "Motordrückindex" UBYTE UMR_U_MIN_1_1_0_S6_S3 1 100 0 100 DISPLAY_IDENTIFIER mdi_diagiae.iIaeDiagn ECU_ADDRESS 0xFFF8CEC2 /end MEASUREMENT
/begin MEASUREMENT iIaeDiagn.flag_close_diagiae "Flag für Erkennung KFC_IAECLOSE" UBYTE Conv.cIaeDiagn._.flag_close_diagiae_S6_S3 1 100 0 1 BIT_MASK 0x1 DISPLAY_IDENTIFIER flag_close_diagiae.iIaeDiagn ECU_ADDRESS 0xFFF8CEC3 /end MEASUREMENT
/begin MEASUREMENT iIaeDiagn.flag_noopen_diagiae "Flag für Erkennung KFC_IAENOOPEN" UBYTE Conv.cIaeDiagn._.flag_noopen_diagiae_S6_S3 1 100 0 1 BIT_MASK 0x1 DISPLAY_IDENTIFIER flag_noopen_diagiae.iIaeDiagn ECU_ADDRESS 0xFFF8CEC4 /end MEASUREMENT
/begin MEASUREMENT iIaeDiagn.flag_noclose_diagiae "Flag für Erkennung KFC_IAENOCLOSE" UBYTE Conv.cIaeDiagn._.flag_noclose_diagiae_S6_S3 1 100 0 1 BIT_MASK 0x1 DISPLAY_IDENTIFIER flag_noclose_diagiae.iIaeDiagn ECU_ADDRESS 0xFFF8CEC5 /end MEASUREMENT
/begin MEASUREMENT iIaeDiagn.flag_hot_diagiae "Flag für Erkennung KFC_IAEHOT" UBYTE Conv.cIaeDiagn._.flag_hot_diagiae_S6_S3 1 100 0 1 BIT_MASK 0x1 DISPLAY_IDENTIFIER flag_hot_diagiae.iIaeDiagn ECU_ADDRESS 0xFFF8CEC6 /end MEASUREMENT
/begin MEASUREMENT iIaeDiagn.flag_timer_hot_diagiae "Timer für Erkennung KFC_IAEHOT berechnen" UBYTE Conv.cIaeDiagn._.flag_timer_hot_diagiae_S6_S3 1 100 0 1 BIT_MASK 0x1 DISPLAY_IDENTIFIER flag_timer_hot_diagiae.iIaeDiagn ECU_ADDRESS 0xFFF8CEC7 /end MEASUREMENT
/begin MEASUREMENT iIaeDiagn.n_stoer_noclose_diagiae "Stoerzaehler fuer Ungenuegendes Schliessen" UBYTE UMR___1_1_0_S6_S3 1 100 0 100 DISPLAY_IDENTIFIER n_stoer_noclose_diagiae.iIaeDiagn ECU_ADDRESS 0xFFF8CEC8 /end MEASUREMENT
/begin MEASUREMENT iIaeDiagn.m_motistoe_temp_diagiae "gespeichertes Motormoment" SWORD UMR_NM__1_1_0_S6_S3 1 100 -400 1640 DISPLAY_IDENTIFIER m_motistoe_temp_diagiae.iIaeDiagn ECU_ADDRESS 0xFFF8CECA /end MEASUREMENT
/begin MEASUREMENT iIaeDiagn.ctr_hot_diagiae "Integral über die Temperaturdifferenz zur Diagnose von Übertemperatur an der IAE" FLOAT32_IEEE UMR_KSEC__1_1_0_S6_S3 1 100 0 32000 FORMAT "%5.3" DISPLAY_IDENTIFIER ctr_hot_diagiae.iIaeDiagn ECU_ADDRESS 0xFFF8CECC /end MEASUREMENT
/begin MEASUREMENT iIaeDiagn.ax_integral_diagiae "Laengsbeschleunigung-Summe, wird noch mit dt in Sek. multipliziert für Vergleich mit AXS_CLOSE_DIAGIAE" SLONG UMR_M_SEC_1_3200_0_S6_S3 1 100 -671088.64 671088.639687 DISPLAY_IDENTIFIER ax_integral_diagiae.iIaeDiagn ECU_ADDRESS 0xFFF8CED0 /end MEASUREMENT
/begin MEASUREMENT iIaeDiagn.flag_spassfahrt_diagiae "Spassfahrt aktiv" UBYTE Conv.cIaeDiagn._.flag_spassfahrt_diagiae_S6_S3 1 100 0 1 BIT_MASK 0x1 DISPLAY_IDENTIFIER flag_spassfahrt_diagiae.iIaeDiagn ECU_ADDRESS 0xFFF8CED4 /end MEASUREMENT
/begin MEASUREMENT iIaeDiagn.flag_sammelbed_diagiae "Gesammelte Gleichteil-Bedingungen zur Aktivierung der Diagnosen" UBYTE Conv.cIaeDiagn._.flag_sammelbed_diagiae_S6_S3 1 100 0 1 BIT_MASK 0x1 DISPLAY_IDENTIFIER flag_sammelbed_diagiae.iIaeDiagn ECU_ADDRESS 0xFFF8CED5 /end MEASUREMENT
/begin MEASUREMENT iIaeDiagn.flag_max_p_haupt_diagiae "maximaler Systemdruck gefordert" UBYTE Conv.cIaeDiagn._.flag_max_p_haupt_diagiae_S6_S3 1 100 0 1 BIT_MASK 0x1 DISPLAY_IDENTIFIER flag_max_p_haupt_diagiae.iIaeDiagn ECU_ADDRESS 0xFFF8CED6 /end MEASUREMENT
/begin MEASUREMENT iIaeDiagn.flag_mmot_gespeichert_diagiae "Motormoment in diesem Anfahrzyklus gespeichert" UBYTE Conv.cIaeDiagn._.flag_mmot_gespeichert_diagiae_S6_S3 1 100 0 1 BIT_MASK 0x1 DISPLAY_IDENTIFIER flag_mmot_gespeichert_diagiae.iIaeDiagn ECU_ADDRESS 0xFFF8CED7 /end MEASUREMENT
/begin MEASUREMENT iIaeDiagn.flag_rueckf_mmot_diagiae "Hilfflag für die Auswertung der Rückfilterung IAENOCLOSE" UBYTE Conv.cIaeDiagn._.flag_rueckf_mmot_diagiae_S6_S3 1 100 0 1 BIT_MASK 0x1 DISPLAY_IDENTIFIER flag_rueckf_mmot_diagiae.iIaeDiagn ECU_ADDRESS 0xFFF8CED8 /end MEASUREMENT
/begin MEASUREMENT iIaeDiagn.flag_rueckf_msollnmot_diagiae "Hilfflag für die Auswertung der Rückfilterung IAENOCLOSE" UBYTE Conv.cIaeDiagn._.flag_rueckf_msollnmot_diagiae_S6_S3 1 100 0 1 BIT_MASK 0x1 DISPLAY_IDENTIFIER flag_rueckf_msollnmot_diagiae.iIaeDiagn ECU_ADDRESS 0xFFF8CED9 /end MEASUREMENT
/begin MEASUREMENT iIaeDiagn.flag_noclose_hogez_diagiae "Hilfflag das anzeigt ob n_stoer_noclose_diagiae im aktuellen Anfahrvorgang bereits hochgezählt wurde" UBYTE Conv.cIaeDiagn._.flag_noclose_hogez_diagiae_S6_S3 1 100 0 1 BIT_MASK 0x1 DISPLAY_IDENTIFIER flag_noclose_hogez_diagiae.iIaeDiagn ECU_ADDRESS 0xFFF8CEDA /end MEASUREMENT
/begin MEASUREMENT iIaeDiagn.flag_close_bew_aktiv_diagiae "Diagnose für Erkennung KFC_IAECLOSE aktiv" UBYTE Conv.cIaeDiagn._.flag_close_bew_aktiv_diagiae_S6_S3 1 100 0 1 BIT_MASK 0x1 DISPLAY_IDENTIFIER flag_close_bew_aktiv_diagiae.iIaeDiagn ECU_ADDRESS 0xFFF8CEDB /end MEASUREMENT
/begin MEASUREMENT iIaeDiagn.flag_noopen_bew_aktiv_diagiae "Diagnose für Erkennung KFC_IAENOOPEN aktiv" UBYTE Conv.cIaeDiagn._.flag_noopen_bew_aktiv_diagiae_S6_S3 1 100 0 1 BIT_MASK 0x1 DISPLAY_IDENTIFIER flag_noopen_bew_aktiv_diagiae.iIaeDiagn ECU_ADDRESS 0xFFF8CEDC /end MEASUREMENT
/begin MEASUREMENT iIaeDiagn.flag_noclose_bew_aktiv_diagiae "Diagnose für Erkennung KFC_IAENOCLOSE aktiv" UBYTE Conv.cIaeDiagn._.flag_noclose_bew_aktiv_diagiae_S6_S3 1 100 0 1 BIT_MASK 0x1 DISPLAY_IDENTIFIER flag_noclose_bew_aktiv_diagiae.iIaeDiagn ECU_ADDRESS 0xFFF8CEDD /end MEASUREMENT
/begin MEASUREMENT iIaeDiagn.status_iae_hotinfo "Info über IAE-Hot-Status" UBYTE Conv.cIaeDiagn._.status_iae_hotinfo_S6_S3 1 100 0 2 DISPLAY_IDENTIFIER status_iae_hotinfo.iIaeDiagn ECU_ADDRESS 0xFFF8CEDE /end MEASUREMENT
/begin MEASUREMENT iIaeDiagn.z_close_diagiae "Zustand der Fehlererkennung IAE_CLOSE" UBYTE Conv.cIaeDiagn._.z_close_diagiae_S6_S3 1 100 0 2 DISPLAY_IDENTIFIER z_close_diagiae.iIaeDiagn ECU_ADDRESS 0xFFF8CEDF /end MEASUREMENT
/begin MEASUREMENT iIaeTempm.TimerVzInit.time "Zeit des Timers" UWORD UMR_SEC__1_100_0_S6_S3 1 100 0 655.35 DISPLAY_IDENTIFIER time.TimerVzInit.iIaeTempm ECU_ADDRESS 0xFFF8D252 /end MEASUREMENT
/begin MEASUREMENT iIaeTempm.TimerVzInit.maxtime "Endzeit" UWORD UMR_SEC__1_100_0_S6_S3 1 100 0 655.35 DISPLAY_IDENTIFIER maxtime.TimerVzInit.iIaeTempm ECU_ADDRESS 0xFFF8D254 /end MEASUREMENT
/begin MEASUREMENT iIaeTempm.c_iae "Temperatur fuer integrierte Anfahrkupplung" UWORD UMR_GRADC__1_1_M40_S6_S3 1 100 -40 500 DISPLAY_IDENTIFIER c_iae.iIaeTempm ECU_ADDRESS 0xFFF8D23C /end MEASUREMENT
/begin MEASUREMENT iIaeTempm.c_iae_fl "Temperatur in Float fuer integrierte Anfahrkupplung" FLOAT32_IEEE UMR_GRADC__1_1_0_S6_S3 1 100 -40 500 DISPLAY_IDENTIFIER c_iae_fl.iIaeTempm ECU_ADDRESS 0xFFF8D240 /end MEASUREMENT
/begin MEASUREMENT iIaeTempm.alpha_iae "Temperaturkoeffizient alpha der IAE" FLOAT32_IEEE UMR_W_K_1_1_0_S6_S3 1 100 0 1000 DISPLAY_IDENTIFIER alpha_iae.iIaeTempm ECU_ADDRESS 0xFFF8D244 /end MEASUREMENT
/begin MEASUREMENT iIaeTempm.c_kuehl_iae "Temperatur des Kuehloels" FLOAT32_IEEE UMR_GRADC__1_1_0_S6_S3 1 100 -40 500 DISPLAY_IDENTIFIER c_kuehl_iae.iIaeTempm ECU_ADDRESS 0xFFF8D248 /end MEASUREMENT
/begin MEASUREMENT iIaeTempm.q_ab_iae "[W] Abfliessende Verlustleistung der Kupplung" FLOAT32_IEEE UMR_W__1_1_0_S6_S3 1 100 -1000000 1000000 DISPLAY_IDENTIFIER q_ab_iae.iIaeTempm ECU_ADDRESS 0xFFF8D24C /end MEASUREMENT
/begin MEASUREMENT iIaeTempm.z_temp_init_iae "Status der Initialisierung des Temperaturmodell der IAE" UBYTE Conv.cIaeTempm._.z_temp_init_iae_S6_S3 1 100 0 2 DISPLAY_IDENTIFIER z_temp_init_iae.iIaeTempm ECU_ADDRESS 0xFFF8D250 /end MEASUREMENT
/begin MEASUREMENT iIaeTempm.flag_tempsperr_timerini_iae "Timer für init-Verzögerung der c_iae-Abstelltemperatur" UBYTE Conv.cIaeTempm._.flag_tempsperr_timerini_iae_S6_S3 1 100 0 1 BIT_MASK 0x1 DISPLAY_IDENTIFIER flag_tempsperr_timerini_iae.iIaeTempm ECU_ADDRESS 0xFFF8D251 /end MEASUREMENT
/begin MEASUREMENT iIaeKuehl.Pt1Vpsoll.x "Filterwert" SLONG UMR___1_300_0_S6_S3 1 100 -7158278.82667 7158278.82333 DISPLAY_IDENTIFIER Pt1Vpsoll.iIaeKuehl ECU_ADDRESS 0xFFF8CF70 /end MEASUREMENT
/begin MEASUREMENT iIaeKuehl.Pt1VpKuehlKorr.x "Filterwert" SLONG UMR___1_300_0_S6_S3 1 100 -7158278.82667 7158278.82333 DISPLAY_IDENTIFIER Pt1VpKuehlKorr.iIaeKuehl ECU_ADDRESS 0xFFF8CF74 /end MEASUREMENT
/begin MEASUREMENT iIaeKuehl.TimerZModusIae.time "Zeit des Timers" UWORD UMR_SEC__1_100_0_S6_S3 1 100 0 655.35 DISPLAY_IDENTIFIER time.TimerZModusIae.iIaeKuehl ECU_ADDRESS 0xFFF8CF78 /end MEASUREMENT
/begin MEASUREMENT iIaeKuehl.TimerZModusIae.maxtime "Endzeit" UWORD UMR_SEC__1_100_0_S6_S3 1 100 0 655.35 DISPLAY_IDENTIFIER maxtime.TimerZModusIae.iIaeKuehl ECU_ADDRESS 0xFFF8CF7A /end MEASUREMENT
/begin MEASUREMENT iIaeKuehl.vp_kuehl_soll_iae "Kuehloelvolumenstrom soll" SWORD UMR_LITER_MIN_1_10_0_S6_S3 1 100 0 50 DISPLAY_IDENTIFIER vp_kuehl_soll_iae.iIaeKuehl ECU_ADDRESS 0xFFF8CF60 /end MEASUREMENT
/begin MEASUREMENT iIaeKuehl.vp_kuehl_soll_roh_iae "Kuehloelvolumenstrom soll" SWORD UMR_LITER_MIN_1_10_0_S6_S3 1 100 0 50 DISPLAY_IDENTIFIER vp_kuehl_soll_roh_iae.iIaeKuehl ECU_ADDRESS 0xFFF8CF62 /end MEASUREMENT
/begin MEASUREMENT iIaeKuehl.vp_kuehl_korr_iae "Kuehloelvolumenstrom korrigiert" SWORD UMR_LITER_MIN_1_10_0_S6_S3 1 100 0 50 DISPLAY_IDENTIFIER vp_kuehl_korr_iae.iIaeKuehl ECU_ADDRESS 0xFFF8CF64 /end MEASUREMENT
/begin MEASUREMENT iIaeKuehl.vp_kuehl_max_iae "maximaler Kuehloelvolumenstrom Iae" SWORD UMR_LITER_MIN_1_10_0_S6_S3 1 100 0 50 DISPLAY_IDENTIFIER vp_kuehl_max_iae.iIaeKuehl ECU_ADDRESS 0xFFF8CF66 /end MEASUREMENT
/begin MEASUREMENT iIaeKuehl.flag_kuehlung_im_inaktiv "Kuehlung im Zustand INAKTIV aktiv" UBYTE UMR___1_1_0_S6_S3 1 100 0 1 BIT_MASK 0x1 DISPLAY_IDENTIFIER flag_kuehlung_im_inaktiv.iIaeKuehl ECU_ADDRESS 0xFFF8CF68 /end MEASUREMENT
/begin MEASUREMENT iIaeKuehl.vp_sek_k0_iae "Kuehloelvolumenstrom für K0" SWORD UMR_LITER_MIN_1_10_0_S6_S3 1 100 0 50 DISPLAY_IDENTIFIER vp_sek_k0_iae.iIaeKuehl ECU_ADDRESS 0xFFF8CF6A /end MEASUREMENT
/begin MEASUREMENT iIaeKuehl.p_kuehl_soll_iae "Soll-Kühlöldruck" SWORD UMR_BAR__1_1000_0_S6_S3 1 100 -1 12.75 DISPLAY_IDENTIFIER p_kuehl_soll_iae.iIaeKuehl ECU_ADDRESS 0xFFF8CF6C /end MEASUREMENT
/begin MEASUREMENT iIaeKuehl.f_min_em_kuehl_iae "Anforderung einer min EM-Drehzahl wegen Kuehlung IAE" UBYTE UMR___1_1_0_S6_S3 1 100 0 1 BIT_MASK 0x1 DISPLAY_IDENTIFIER f_min_em_kuehl_iae.iIaeKuehl ECU_ADDRESS 0xFFF8CF6E /end MEASUREMENT
/begin MEASUREMENT iIaeMotmx.TimerStallIae.time "Zeit des Timers" UWORD UMR_SEC__1_100_0_S6_S3 1 100 0 655.35 DISPLAY_IDENTIFIER time.TimerStallIae.iIaeMotmx ECU_ADDRESS 0xFFF8ED6A /end MEASUREMENT
/begin MEASUREMENT iIaeMotmx.TimerStallIae.maxtime "Endzeit" UWORD UMR_SEC__1_100_0_S6_S3 1 100 0 655.35 DISPLAY_IDENTIFIER maxtime.TimerStallIae.iIaeMotmx ECU_ADDRESS 0xFFF8ED6C /end MEASUREMENT
/begin MEASUREMENT iIaeMotmx.Pt1MMotmax.x "Filterwert" SLONG UMR___1_300_0_S6_S3 1 100 -7158278.82667 7158278.82333 DISPLAY_IDENTIFIER Pt1MMotmax.iIaeMotmx ECU_ADDRESS 0xFFF8ED70 /end MEASUREMENT
/begin MEASUREMENT iIaeMotmx.TimerMotMaxTempIae.time "Zeit des Timers" UWORD UMR_SEC__1_100_0_S6_S3 1 100 0 655.35 DISPLAY_IDENTIFIER time.TimerMotMaxTempIae.iIaeMotmx ECU_ADDRESS 0xFFF8ED74 /end MEASUREMENT
/begin MEASUREMENT iIaeMotmx.TimerMotMaxTempIae.maxtime "Endzeit" UWORD UMR_SEC__1_100_0_S6_S3 1 100 0 655.35 DISPLAY_IDENTIFIER maxtime.TimerMotMaxTempIae.iIaeMotmx ECU_ADDRESS 0xFFF8ED76 /end MEASUREMENT
/begin MEASUREMENT iIaeMotmx.m_motmax_iae "Motormomentenbegrenzung der IAE" SWORD UMR_NM__1_1_0_S6_S3 1 100 -400 1640 DISPLAY_IDENTIFIER m_motmax_iae.iIaeMotmx ECU_ADDRESS 0xFFF8ED30 /end MEASUREMENT
/begin MEASUREMENT iIaeMotmx.m_motmax_max_iae "Obergrenze Motormomentenbegrenzung der IAE" SWORD UMR_NM__1_1_0_S6_S3 1 100 -400 1640 DISPLAY_IDENTIFIER m_motmax_max_iae.iIaeMotmx ECU_ADDRESS 0xFFF8ED32 /end MEASUREMENT
/begin MEASUREMENT iIaeMotmx.m_motmaxmax100_iae "maximales Motormomentenbegrenzung der IAE" SLONG UMR_NM__1_100_0_S6_S3 1 100 -400 1640 DISPLAY_IDENTIFIER m_motmaxmax100_iae.iIaeMotmx ECU_ADDRESS 0xFFF8ED34 /end MEASUREMENT
/begin MEASUREMENT iIaeMotmx.m_motmax_roh_iae "Motormomentenbegrenzung der IAE ungefiltert" SWORD UMR_NM__1_1_0_S6_S3 1 100 -400 1640 DISPLAY_IDENTIFIER m_motmax_roh_iae.iIaeMotmx ECU_ADDRESS 0xFFF8ED38 /end MEASUREMENT
/begin MEASUREMENT iIaeMotmx.m_motmax100_iae "Motormomentenbegrenzung der IAE" SLONG UMR_NM__1_100_0_S6_S3 1 100 -400 1640 DISPLAY_IDENTIFIER m_motmax100_iae.iIaeMotmx ECU_ADDRESS 0xFFF8ED3C /end MEASUREMENT
/begin MEASUREMENT iIaeMotmx.m_motmaxtemp_iae "Motormomentenbegrenzung der IAE Belagtemperaturschutz" SWORD UMR_NM__1_1_0_S6_S3 1 100 -400 1640 DISPLAY_IDENTIFIER m_motmaxtemp_iae.iIaeMotmx ECU_ADDRESS 0xFFF8ED40 /end MEASUREMENT
/begin MEASUREMENT iIaeMotmx.m_motmaxtemp100_iae "Motormomentenbegrenzung der IAE Belagtemperaturschutz" SLONG UMR_NM__1_100_0_S6_S3 1 100 -400 1640 DISPLAY_IDENTIFIER m_motmaxtemp100_iae.iIaeMotmx ECU_ADDRESS 0xFFF8ED44 /end MEASUREMENT
/begin MEASUREMENT iIaeMotmx.m_motmaxndiff_iae "Motormomentenbegrenzung der IAE Differenzdrehzahlschutzfunktion" SWORD UMR_NM__1_1_0_S6_S3 1 100 -400 1640 DISPLAY_IDENTIFIER m_motmaxndiff_iae.iIaeMotmx ECU_ADDRESS 0xFFF8ED48 /end MEASUREMENT
/begin MEASUREMENT iIaeMotmx.m_motmaxndiff100_iae "Motormomentenbegrenzung der IAE Differenzdrehzahlschutzfunktion" SLONG UMR_NM__1_100_0_S6_S3 1 100 -400 1640 DISPLAY_IDENTIFIER m_motmaxndiff100_iae.iIaeMotmx ECU_ADDRESS 0xFFF8ED4C /end MEASUREMENT
/begin MEASUREMENT iIaeMotmx.m_motmaxregdiff_iae "Motormomentenbegrenzung der IAE Anfahrdrehzahlschutzfunktion" SWORD UMR_NM__1_1_0_S6_S3 1 100 -400 1640 DISPLAY_IDENTIFIER m_motmaxregdiff_iae.iIaeMotmx ECU_ADDRESS 0xFFF8ED50 /end MEASUREMENT
/begin MEASUREMENT iIaeMotmx.m_motmaxregdiff100_iae "Motormomentenbegrenzung der IAE Anfahrdrehzahlschutzfunktion" SLONG UMR_NM__1_100_0_S6_S3 1 100 -400 1640 DISPLAY_IDENTIFIER m_motmaxregdiff100_iae.iIaeMotmx ECU_ADDRESS 0xFFF8ED54 /end MEASUREMENT
/begin MEASUREMENT iIaeMotmx.m_motmaxstall_iae "Motormomentenbegrenzung der IAE Stallspeed" SWORD UMR_NM__1_1_0_S6_S3 1 100 -400 1640 DISPLAY_IDENTIFIER m_motmaxstall_iae.iIaeMotmx ECU_ADDRESS 0xFFF8ED58 /end MEASUREMENT
/begin MEASUREMENT iIaeMotmx.m_motmaxstall100_iae "Motormomentenbegrenzung der IAE Stallspeed" SLONG UMR_NM__1_100_0_S6_S3 1 100 -400 1640 DISPLAY_IDENTIFIER m_motmaxstall100_iae.iIaeMotmx ECU_ADDRESS 0xFFF8ED5C /end MEASUREMENT
/begin MEASUREMENT iIaeMotmx.flag_stallspeed_iae "Stallspeed aktiv" UBYTE Conv.cIaeMotmx._.flag_stallspeed_iae_S6_S3 1 100 0 1 BIT_MASK 0x1 DISPLAY_IDENTIFIER flag_stallspeed_iae.iIaeMotmx ECU_ADDRESS 0xFFF8ED60 /end MEASUREMENT
/begin MEASUREMENT iIaeMotmx.flag_motmaxndiff_iae "Momentenbegrenzung-Drehzahldifferenz-IAE aktiv" UBYTE Conv.cIaeMotmx._.flag_motmaxndiff_iae_S6_S3 1 100 0 1 BIT_MASK 0x1 DISPLAY_IDENTIFIER flag_motmaxndiff_iae.iIaeMotmx ECU_ADDRESS 0xFFF8ED61 /end MEASUREMENT
/begin MEASUREMENT iIaeMotmx.flag_motmaxregdiff_iae "Momentenbegrenzung-Anfahrdrehzahl-IAE aktiv" UBYTE Conv.cIaeMotmx._.flag_motmaxregdiff_iae_S6_S3 1 100 0 1 BIT_MASK 0x1 DISPLAY_IDENTIFIER flag_motmaxregdiff_iae.iIaeMotmx ECU_ADDRESS 0xFFF8ED62 /end MEASUREMENT
/begin MEASUREMENT iIaeMotmx.flag_motmaxstall_iae "Momentenbegrenzung-Stallspeed-IAE aktiv" UBYTE Conv.cIaeMotmx._.flag_motmaxstall_iae_S6_S3 1 100 0 1 BIT_MASK 0x1 DISPLAY_IDENTIFIER flag_motmaxstall_iae.iIaeMotmx ECU_ADDRESS 0xFFF8ED63 /end MEASUREMENT
/begin MEASUREMENT iIaeMotmx.flag_motmaxtemp_iae "Momentenbegrenzung-Temperaturschutz-IAE aktiv" UBYTE Conv.cIaeMotmx._.flag_motmaxtemp_iae_S6_S3 1 100 0 1 BIT_MASK 0x1 DISPLAY_IDENTIFIER flag_motmaxtemp_iae.iIaeMotmx ECU_ADDRESS 0xFFF8ED64 /end MEASUREMENT
/begin MEASUREMENT iIaeMotmx.flag_timermotmaxtemp_iae "Momentenbegrenzung-Temperaturschutz-IAE aktiv" UBYTE Conv.cIaeMotmx._.flag_timermotmaxtemp_iae_S6_S3 1 100 0 1 BIT_MASK 0x1 DISPLAY_IDENTIFIER flag_timermotmaxtemp_iae.iIaeMotmx ECU_ADDRESS 0xFFF8ED65 /end MEASUREMENT
/begin MEASUREMENT iIaeMotmx.timer_mot_max_temp_iae "Zeit" UWORD UMR_MSEC__10_1_0_S6_S3 1 100 0 300000 DISPLAY_IDENTIFIER timer_mot_max_temp_iae.iIaeMotmx ECU_ADDRESS 0xFFF8ED66 /end MEASUREMENT
/begin MEASUREMENT iIaeMotmx.timer_stallspeed_iae "Zeit im Stallspeed" SWORD UMR_MSEC__10_1_0_S6_S3 1 100 0 300000 DISPLAY_IDENTIFIER timer_stallspeed_iae.iIaeMotmx ECU_ADDRESS 0xFFF8ED68 /end MEASUREMENT
/begin MEASUREMENT iGeaKordi.timer_gega_laeuft "Zeitdauer seit Start GE/GA" UBYTE UMR_MSEC__10_1_0_S6_S3 1 100 0 2550 DISPLAY_IDENTIFIER timer_gega_laeuft.iGeaKordi ECU_ADDRESS 0xFFF8A256 /end MEASUREMENT
/begin MEASUREMENT iGeaKordi.timer_ga "Zeit seit Start Gangauslegen" UBYTE UMR_MSEC__10_1_0_S6_S3 1 100 0 2550 DISPLAY_IDENTIFIER timer_ga.iGeaKordi ECU_ADDRESS 0xFFF8A257 /end MEASUREMENT
/begin MEASUREMENT iSasAnGeaKraftschl.pgo_gea_rampe.cBibRampeGradSi16._.letzter_wert "Speichert den letzten Eingangswert" FLOAT32_IEEE UMR___1_1_0_S6_S3 1 100 -1E+037 1E+037 FORMAT "%4.2" DISPLAY_IDENTIFIER letzter_wert._.cBibRampeGradSi16.pgo_gea_rampe.iSasAnGeaKraftschl ECU_ADDRESS 0xFFF8F058 /end MEASUREMENT
/begin MEASUREMENT iSasAnGeaKraftschl.pgo_gea_rampe.cBibRampeGradSi16._.letzter_ms_timer "Speichert den letzten BS-Timer" UWORD UMR_MSEC__1_1_0_S6_S3 1 100 0 65535 DISPLAY_IDENTIFIER letzter_ms_timer._.cBibRampeGradSi16.pgo_gea_rampe.iSasAnGeaKraftschl ECU_ADDRESS 0xFFF8F05C /end MEASUREMENT
/begin MEASUREMENT iSasAnGeaKraftschl.pgo_gea_rampe.cBibRampeGradSi16._.minimum "Minimum Begrenzung" FLOAT32_IEEE UMR___1_1_0_S6_S3 1 100 -1E+037 1E+037 FORMAT "%4.2" DISPLAY_IDENTIFIER minimum._.cBibRampeGradSi16.pgo_gea_rampe.iSasAnGeaKraftschl ECU_ADDRESS 0xFFF8F060 /end MEASUREMENT
/begin MEASUREMENT iSasAnGeaKraftschl.pgo_gea_rampe.cBibRampeGradSi16._.maximum "Maximum Begrenzung" FLOAT32_IEEE UMR___1_1_0_S6_S3 1 100 -1E+037 1E+037 FORMAT "%4.2" DISPLAY_IDENTIFIER maximum._.cBibRampeGradSi16.pgo_gea_rampe.iSasAnGeaKraftschl ECU_ADDRESS 0xFFF8F064 /end MEASUREMENT
/begin MEASUREMENT iSasAnGeaKraftschl.gea_ablauf_aktiv "Flag: Gangein-/auslegen aktiv" UBYTE Conv.cSasAnGea._.gea_ablauf_aktiv_S6_S3 1 100 0 1 BIT_MASK 0x1 DISPLAY_IDENTIFIER gea_ablauf_aktiv.iSasAnGeaKraftschl ECU_ADDRESS 0xFFF8F01C /end MEASUREMENT
/begin MEASUREMENT iSasAnGeaKraftschl.ra1_ge_gestartet "FLAG: Rampe 1 KZU gestartet" UBYTE Conv.cSasAnGea._.ra1_ge_gestartet_S6_S3 1 100 0 1 BIT_MASK 0x1 DISPLAY_IDENTIFIER ra1_ge_gestartet.iSasAnGeaKraftschl ECU_ADDRESS 0xFFF8F01D /end MEASUREMENT
/begin MEASUREMENT iSasAnGeaKraftschl.ra2_ge_gestartet "FLAG: Rampe 2 KZU gestartet" UBYTE Conv.cSasAnGea._.ra2_ge_gestartet_S6_S3 1 100 0 1 BIT_MASK 0x1 DISPLAY_IDENTIFIER ra2_ge_gestartet.iSasAnGeaKraftschl ECU_ADDRESS 0xFFF8F01E /end MEASUREMENT
/begin MEASUREMENT iSasAnGeaKraftschl.ra3_ge_gestartet "FLAG: Rampe 3 KZU gestartet" UBYTE Conv.cSasAnGea._.ra3_ge_gestartet_S6_S3 1 100 0 1 BIT_MASK 0x1 DISPLAY_IDENTIFIER ra3_ge_gestartet.iSasAnGeaKraftschl ECU_ADDRESS 0xFFF8F01F /end MEASUREMENT
/begin MEASUREMENT iSasAnGeaKraftschl.synchron_verboten "FLAG: Synchron erreichen ist verboten" UBYTE Conv.cSasAnGea._.synchron_verboten_S6_S3 1 100 0 1 BIT_MASK 0x1 DISPLAY_IDENTIFIER synchron_verboten.iSasAnGeaKraftschl ECU_ADDRESS 0xFFF8F020 /end MEASUREMENT
/begin MEASUREMENT iSasAnGeaKraftschl.erste_schaltung "Flag: 1. Befuellung einer Kupplung" UBYTE Conv.cSasAnGea._.erste_schaltung_S6_S3 1 100 0 1 BIT_MASK 0x1 DISPLAY_IDENTIFIER erste_schaltung.iSasAnGeaKraftschl ECU_ADDRESS 0xFFF8F021 /end MEASUREMENT
/begin MEASUREMENT iSasAnGeaKraftschl.f_verb_ada_erste_bef "Flag: 1. Befuellung einer Kupplung verbietet Ada" UBYTE Conv.cSasAnGea._.f_verb_ada_erste_bef_S6_S3 1 100 0 1 BIT_MASK 0x1 DISPLAY_IDENTIFIER f_verb_ada_erste_bef.iSasAnGeaKraftschl ECU_ADDRESS 0xFFF8F022 /end MEASUREMENT
/begin MEASUREMENT iSasAnGeaKraftschl.ende_kab_gestartet "Flag: Zustand Ende der abschaltenden Kupplung gestartet" UBYTE Conv.cSasAnGea._.ende_kab_gestartet_S6_S3 1 100 0 1 BIT_MASK 0x1 DISPLAY_IDENTIFIER ende_kab_gestartet.iSasAnGeaKraftschl ECU_ADDRESS 0xFFF8F023 /end MEASUREMENT
/begin MEASUREMENT iSasAnGeaKraftschl.fa_kzu_gestartet "Flag: Fuellausgleich KZU gestartet" UBYTE Conv.cSasAnGea._.fa_kzu_gestartet_S6_S3 1 100 0 1 BIT_MASK 0x1 DISPLAY_IDENTIFIER fa_kzu_gestartet.iSasAnGeaKraftschl ECU_ADDRESS 0xFFF8F024 /end MEASUREMENT
/begin MEASUREMENT iSasAnGeaKraftschl.schliessen_kup_in_n_gestartet "Flag: Kupplungsansteuerung in Neutral wurde gestartet" UBYTE Conv.cSasAnGea._.schliessen_kup_in_n_gestartet_S6_S3 1 100 0 1 BIT_MASK 0x1 DISPLAY_IDENTIFIER schliessen_kup_in_n_gestartet.iSasAnGeaKraftschl ECU_ADDRESS 0xFFF8F025 /end MEASUREMENT
/begin MEASUREMENT iSasAnGeaKraftschl.p_gea "Druckwert aus Druckberechnung Ge/Ga" SWORD UMR_BAR__1_1000_0_S6_S3 1 100 0 20 DISPLAY_IDENTIFIER p_gea.iSasAnGeaKraftschl ECU_ADDRESS 0xFFF8F026 /end MEASUREMENT
/begin MEASUREMENT iSasAnGeaKraftschl.p_stgea "Gesteuerter Druckanteil aus Druckberechnung Ge/Ga" SWORD UMR_BAR__1_1000_0_S6_S3 1 100 0 20 DISPLAY_IDENTIFIER p_stgea.iSasAnGeaKraftschl ECU_ADDRESS 0xFFF8F028 /end MEASUREMENT
/begin MEASUREMENT iSasAnGeaKraftschl.timer16_ra1_ge "Timer der mit Beginn der Rampe 1 startet" UWORD UMR_MSEC__10_1_0_S6_S3 1 100 0 655350 DISPLAY_IDENTIFIER timer16_ra1_ge.iSasAnGeaKraftschl ECU_ADDRESS 0xFFF8F02A /end MEASUREMENT
/begin MEASUREMENT iSasAnGeaKraftschl.statisch_gea "Flag: Statischansteuerung der GE/GA-Kupplung" UBYTE Conv.cSasAnGea._.statisch_gea_S6_S3 1 100 0 1 BIT_MASK 0x1 DISPLAY_IDENTIFIER statisch_gea.iSasAnGeaKraftschl ECU_ADDRESS 0xFFF8F02C /end MEASUREMENT
/begin MEASUREMENT iSasAnGeaKraftschl.z_gea "Zustand Gangein-/auslegen" UBYTE Conv.cSasAnGea._.z_gea_S6_S3 1 100 0 30 DISPLAY_IDENTIFIER z_gea.iSasAnGeaKraftschl ECU_ADDRESS 0xFFF8F02D /end MEASUREMENT
/begin MEASUREMENT iSasAnGeaKraftschl.t_maxgea "Maximalzeit des GE/GA" UWORD UMR_MSEC__10_1_0_S6_S3 1 100 0 50000 DISPLAY_IDENTIFIER t_maxgea.iSasAnGeaKraftschl ECU_ADDRESS 0xFFF8F02E /end MEASUREMENT
/begin MEASUREMENT iSasAnGeaKraftschl.f_timeout "FLAG: Timeout" UBYTE Conv.cSasAnGea._.f_timeout_S6_S3 1 100 0 1 BIT_MASK 0x1 DISPLAY_IDENTIFIER f_timeout.iSasAnGeaKraftschl ECU_ADDRESS 0xFFF8F030 /end MEASUREMENT
/begin MEASUREMENT iSasAnGeaKraftschl.schalttyp_gea "Schalttyp des Gea-Ablaufs" UBYTE Conv.cSasAnGea._.schalttyp_gea_S6_S3 1 100 0 5 DISPLAY_IDENTIFIER schalttyp_gea.iSasAnGeaKraftschl ECU_ADDRESS 0xFFF8F031 /end MEASUREMENT
/begin MEASUREMENT iSasAnGeaKraftschl.schnellfuellung_beendet "FLAG: Schnellfuellung beendet" UBYTE Conv.cSasAnGea._.schnellfuellung_beendet_S6_S3 1 100 0 1 BIT_MASK 0x1 DISPLAY_IDENTIFIER schnellfuellung_beendet.iSasAnGeaKraftschl ECU_ADDRESS 0xFFF8F032 /end MEASUREMENT
/begin MEASUREMENT iSasAnGeaKraftschl.f_schnellfuellung_gestartet "FLAG: Schnellfuellung wurde gestartet" UBYTE Conv.cSasAnGea._.f_schnellfuellung_gestartet_S6_S3 1 100 0 1 BIT_MASK 0x1 DISPLAY_IDENTIFIER f_schnellfuellung_gestartet.iSasAnGeaKraftschl ECU_ADDRESS 0xFFF8F033 /end MEASUREMENT
/begin MEASUREMENT iSasAnGeaKraftschl.t_timeout "Zeit von Start Gangeinlegen bis Start Timeoutfunktion" UWORD UMR_MSEC__10_1_0_S6_S3 1 100 0 50000 DISPLAY_IDENTIFIER t_timeout.iSasAnGeaKraftschl ECU_ADDRESS 0xFFF8F034 /end MEASUREMENT
/begin MEASUREMENT iSasAnGeaKraftschl.instanz_nr "Instanzennummer des Gea-Ablaufs" UBYTE Conv.cSasAnGea._.instanz_nr_S6_S3 1 100 2 4 DISPLAY_IDENTIFIER instanz_nr.iSasAnGeaKraftschl ECU_ADDRESS 0xFFF8F036 /end MEASUREMENT
/begin MEASUREMENT iSasAnGeaKraftschl.kzu_voll_bei_start "KZU war schon befuellt bei Start Schaltung" UBYTE Conv.cSasAnGea._.kzu_voll_bei_start_S6_S3 1 100 0 1 BIT_MASK 0x1 DISPLAY_IDENTIFIER kzu_voll_bei_start.iSasAnGeaKraftschl ECU_ADDRESS 0xFFF8F037 /end MEASUREMENT
/begin MEASUREMENT iSasAnGeaKraftschl.f_pokzu_kfl_zuletzt_wechsel "FLAG: Druckoffset bei KFL-Wechsel verwenden" UBYTE Conv.cSasAnGea._.f_pokzu_kfl_zuletzt_wechsel_S6_S3 1 100 0 1 BIT_MASK 0x1 DISPLAY_IDENTIFIER f_pokzu_kfl_zuletzt_wechsel.iSasAnGeaKraftschl ECU_ADDRESS 0xFFF8F038 /end MEASUREMENT
/begin MEASUREMENT iSasAnGeaKraftschl.f_pfmin_erreicht "FLAG: Kupplung hat p_fmin erreicht" UBYTE Conv.cSasAnGea._.f_pfmin_erreicht_S6_S3 1 100 0 1 BIT_MASK 0x1 DISPLAY_IDENTIFIER f_pfmin_erreicht.iSasAnGeaKraftschl ECU_ADDRESS 0xFFF8F039 /end MEASUREMENT
/begin MEASUREMENT iSasAnGeaKraftschl.kup_ge "Kupplung Gangeinlegen" UBYTE Conv.cSasAnGea._.kup_ge_S6_S3 1 100 0 5 DISPLAY_IDENTIFIER kup_ge.iSasAnGeaKraftschl ECU_ADDRESS 0xFFF8F03A /end MEASUREMENT
/begin MEASUREMENT iSasAnGeaKraftschl.kup_ga "Kupplung Gangauslegen" UBYTE Conv.cSasAnGea._.kup_ga_S6_S3 1 100 0 5 DISPLAY_IDENTIFIER kup_ga.iSasAnGeaKraftschl ECU_ADDRESS 0xFFF8F03B /end MEASUREMENT
/begin MEASUREMENT iSasAnGeaKraftschl.zaehler_zgea "Zustandszaehler Gea-Ablauf" UBYTE UMR___1_1_0_S6_S3 1 100 0 255 DISPLAY_IDENTIFIER zaehler_zgea.iSasAnGeaKraftschl ECU_ADDRESS 0xFFF8F03C /end MEASUREMENT
/begin MEASUREMENT iSasAnGeaKraftschl.p_adaptgea "Adaptionsdruck Ge/Ga" SWORD UMR_BAR__1_1000_0_S6_S3 1 100 -32.768 32.767 DISPLAY_IDENTIFIER p_adaptgea.iSasAnGeaKraftschl ECU_ADDRESS 0xFFF8F03E /end MEASUREMENT
/begin MEASUREMENT iSasAnGeaKraftschl.p_offgea "Offsetdruck Ge/Ga" SWORD UMR_BAR__1_1000_0_S6_S3 1 100 -32.768 32.767 DISPLAY_IDENTIFIER p_offgea.iSasAnGeaKraftschl ECU_ADDRESS 0xFFF8F040 /end MEASUREMENT
/begin MEASUREMENT iSasAnGeaKraftschl.p_0stgea "Zustandsanfangsdruck gesteuerter Anteil Ge/Ga" SWORD UMR_BAR__1_1000_0_S6_S3 1 100 -32.768 32.767 DISPLAY_IDENTIFIER p_0stgea.iSasAnGeaKraftschl ECU_ADDRESS 0xFFF8F042 /end MEASUREMENT
/begin MEASUREMENT iSasAnGeaKraftschl.po_mtgea "Momentenabhaengiger Druckoffset Ge/Ga" SWORD UMR_BAR__1_1000_0_S6_S3 1 100 -32.768 32.767 DISPLAY_IDENTIFIER po_mtgea.iSasAnGeaKraftschl ECU_ADDRESS 0xFFF8F044 /end MEASUREMENT
/begin MEASUREMENT iSasAnGeaKraftschl.pgo_nabgea "Schaltdruckgradienten Offset" SWORD UMR_BAR_SEC_1_10_0_S6_S3 1 100 -3276.8 3276.7 DISPLAY_IDENTIFIER pgo_nabgea.iSasAnGeaKraftschl ECU_ADDRESS 0xFFF8F046 /end MEASUREMENT
/begin MEASUREMENT iSasAnGeaKraftschl.t_0kzu_gea "Zeitdauer des zuletzt durchlaufenen Zustands bei KZU" SWORD UMR_MSEC__10_1_0_S6_S3 1 100 -327680 327670 DISPLAY_IDENTIFIER t_0kzu_gea.iSasAnGeaKraftschl ECU_ADDRESS 0xFFF8F048 /end MEASUREMENT
/begin MEASUREMENT iSasAnGeaKraftschl.t_zgea "Zustandszeitdauer des aktuellen Gea-Zustands" SWORD UMR_MSEC__10_1_0_S6_S3 1 100 -327680 327670 DISPLAY_IDENTIFIER t_zgea.iSasAnGeaKraftschl ECU_ADDRESS 0xFFF8F04A /end MEASUREMENT
/begin MEASUREMENT iSasAnGeaKraftschl.timer_zgea "Zustandstimer Gea-Ablauf" UWORD UMR_MSEC__10_1_0_S6_S3 1 100 0 655350 DISPLAY_IDENTIFIER timer_zgea.iSasAnGeaKraftschl ECU_ADDRESS 0xFFF8F04C /end MEASUREMENT
/begin MEASUREMENT iSasAnGeaKraftschl.timer_start_fa_kzu "Timer Zeit seit Start Fuellausgleich KZU (bei Gea)" UBYTE UMR_MSEC__10_1_0_S6_S3 1 100 0 2550 DISPLAY_IDENTIFIER timer_start_fa_kzu.iSasAnGeaKraftschl ECU_ADDRESS 0xFFF8F04E /end MEASUREMENT
/begin MEASUREMENT iSasAnGeaKraftschl.dauer_ra1_ge_kzu "Zeitdauer der Rampe 1 der KZU (bei Gea)" SWORD UMR_MSEC__10_1_0_S6_S3 1 100 -327680 327670 DISPLAY_IDENTIFIER dauer_ra1_ge_kzu.iSasAnGeaKraftschl ECU_ADDRESS 0xFFF8F050 /end MEASUREMENT
/begin MEASUREMENT iSasAnGeaKraftschl.nd_nmotnt_init_ga "Gemerkter Wert von nd_nmot_nt bei Initialisierung GA" SWORD UMR_U_MIN_1_1_0_S6_S3 1 100 -10000 10000 DISPLAY_IDENTIFIER nd_nmotnt_init_ga.iSasAnGeaKraftschl ECU_ADDRESS 0xFFF8F052 /end MEASUREMENT
/begin MEASUREMENT iSasAnGeaKraftschl.to_sf_kflwe "Offset Schnellfüllzeit bei DNR und RND" SWORD UMR_MSEC__1_1_0_S6_S3 1 100 -1000 1000 DISPLAY_IDENTIFIER to_sf_kflwe.iSasAnGeaKraftschl ECU_ADDRESS 0xFFF8F054 /end MEASUREMENT
/begin MEASUREMENT iSasAnGeaKraftschl.po_fkzu_aktiv "Verzoegerung der Druckoffsetzausgabe wegen evtl. Druckuebernahme durch IAE" UBYTE Conv.cSasAnGea._.po_fkzu_aktiv_S6_S3 1 100 0 1 BIT_MASK 0x1 DISPLAY_IDENTIFIER po_fkzu_aktiv.iSasAnGeaKraftschl ECU_ADDRESS 0xFFF8F056 /end MEASUREMENT
/begin MEASUREMENT iSasAnGeaNichtKraftschl1.pgo_gea_rampe.cBibRampeGradSi16._.letzter_wert "Speichert den letzten Eingangswert" FLOAT32_IEEE UMR___1_1_0_S6_S3 1 100 -1E+037 1E+037 FORMAT "%4.2" DISPLAY_IDENTIFIER letzter_wert._.cBibRampeGradSi16.pgo_gea_rampe.iSasAnGeaNichtKraftschl1 ECU_ADDRESS 0xFFF8F0C0 /end MEASUREMENT
/begin MEASUREMENT iSasAnGeaNichtKraftschl1.pgo_gea_rampe.cBibRampeGradSi16._.letzter_ms_timer "Speichert den letzten BS-Timer" UWORD UMR_MSEC__1_1_0_S6_S3 1 100 0 65535 DISPLAY_IDENTIFIER letzter_ms_timer._.cBibRampeGradSi16.pgo_gea_rampe.iSasAnGeaNichtKraftschl1 ECU_ADDRESS 0xFFF8F0C4 /end MEASUREMENT
/begin MEASUREMENT iSasAnGeaNichtKraftschl1.pgo_gea_rampe.cBibRampeGradSi16._.minimum "Minimum Begrenzung" FLOAT32_IEEE UMR___1_1_0_S6_S3 1 100 -1E+037 1E+037 FORMAT "%4.2" DISPLAY_IDENTIFIER minimum._.cBibRampeGradSi16.pgo_gea_rampe.iSasAnGeaNichtKraftschl1 ECU_ADDRESS 0xFFF8F0C8 /end MEASUREMENT
/begin MEASUREMENT iSasAnGeaNichtKraftschl1.pgo_gea_rampe.cBibRampeGradSi16._.maximum "Maximum Begrenzung" FLOAT32_IEEE UMR___1_1_0_S6_S3 1 100 -1E+037 1E+037 FORMAT "%4.2" DISPLAY_IDENTIFIER maximum._.cBibRampeGradSi16.pgo_gea_rampe.iSasAnGeaNichtKraftschl1 ECU_ADDRESS 0xFFF8F0CC /end MEASUREMENT
/begin MEASUREMENT iSasAnGeaNichtKraftschl1.gea_ablauf_aktiv "Flag: Gangein-/auslegen aktiv" UBYTE Conv.cSasAnGea._.gea_ablauf_aktiv_S6_S3 1 100 0 1 BIT_MASK 0x1 DISPLAY_IDENTIFIER gea_ablauf_aktiv.iSasAnGeaNichtKraftschl1 ECU_ADDRESS 0xFFF8F084 /end MEASUREMENT
/begin MEASUREMENT iSasAnGeaNichtKraftschl1.ra1_ge_gestartet "FLAG: Rampe 1 KZU gestartet" UBYTE Conv.cSasAnGea._.ra1_ge_gestartet_S6_S3 1 100 0 1 BIT_MASK 0x1 DISPLAY_IDENTIFIER ra1_ge_gestartet.iSasAnGeaNichtKraftschl1 ECU_ADDRESS 0xFFF8F085 /end MEASUREMENT
/begin MEASUREMENT iSasAnGeaNichtKraftschl1.ra2_ge_gestartet "FLAG: Rampe 2 KZU gestartet" UBYTE Conv.cSasAnGea._.ra2_ge_gestartet_S6_S3 1 100 0 1 BIT_MASK 0x1 DISPLAY_IDENTIFIER ra2_ge_gestartet.iSasAnGeaNichtKraftschl1 ECU_ADDRESS 0xFFF8F086 /end MEASUREMENT
/begin MEASUREMENT iSasAnGeaNichtKraftschl1.ra3_ge_gestartet "FLAG: Rampe 3 KZU gestartet" UBYTE Conv.cSasAnGea._.ra3_ge_gestartet_S6_S3 1 100 0 1 BIT_MASK 0x1 DISPLAY_IDENTIFIER ra3_ge_gestartet.iSasAnGeaNichtKraftschl1 ECU_ADDRESS 0xFFF8F087 /end MEASUREMENT
/begin MEASUREMENT iSasAnGeaNichtKraftschl1.synchron_verboten "FLAG: Synchron erreichen ist verboten" UBYTE Conv.cSasAnGea._.synchron_verboten_S6_S3 1 100 0 1 BIT_MASK 0x1 DISPLAY_IDENTIFIER synchron_verboten.iSasAnGeaNichtKraftschl1 ECU_ADDRESS 0xFFF8F088 /end MEASUREMENT
/begin MEASUREMENT iSasAnGeaNichtKraftschl1.erste_schaltung "Flag: 1. Befuellung einer Kupplung" UBYTE Conv.cSasAnGea._.erste_schaltung_S6_S3 1 100 0 1 BIT_MASK 0x1 DISPLAY_IDENTIFIER erste_schaltung.iSasAnGeaNichtKraftschl1 ECU_ADDRESS 0xFFF8F089 /end MEASUREMENT
/begin MEASUREMENT iSasAnGeaNichtKraftschl1.f_verb_ada_erste_bef "Flag: 1. Befuellung einer Kupplung verbietet Ada" UBYTE Conv.cSasAnGea._.f_verb_ada_erste_bef_S6_S3 1 100 0 1 BIT_MASK 0x1 DISPLAY_IDENTIFIER f_verb_ada_erste_bef.iSasAnGeaNichtKraftschl1 ECU_ADDRESS 0xFFF8F08A /end MEASUREMENT
/begin MEASUREMENT iSasAnGeaNichtKraftschl1.ende_kab_gestartet "Flag: Zustand Ende der abschaltenden Kupplung gestartet" UBYTE Conv.cSasAnGea._.ende_kab_gestartet_S6_S3 1 100 0 1 BIT_MASK 0x1 DISPLAY_IDENTIFIER ende_kab_gestartet.iSasAnGeaNichtKraftschl1 ECU_ADDRESS 0xFFF8F08B /end MEASUREMENT
/begin MEASUREMENT iSasAnGeaNichtKraftschl1.fa_kzu_gestartet "Flag: Fuellausgleich KZU gestartet" UBYTE Conv.cSasAnGea._.fa_kzu_gestartet_S6_S3 1 100 0 1 BIT_MASK 0x1 DISPLAY_IDENTIFIER fa_kzu_gestartet.iSasAnGeaNichtKraftschl1 ECU_ADDRESS 0xFFF8F08C /end MEASUREMENT
/begin MEASUREMENT iSasAnGeaNichtKraftschl1.schliessen_kup_in_n_gestartet "Flag: Kupplungsansteuerung in Neutral wurde gestartet" UBYTE Conv.cSasAnGea._.schliessen_kup_in_n_gestartet_S6_S3 1 100 0 1 BIT_MASK 0x1 DISPLAY_IDENTIFIER schliessen_kup_in_n_gestartet.iSasAnGeaNichtKraftschl1 ECU_ADDRESS 0xFFF8F08D /end MEASUREMENT
/begin MEASUREMENT iSasAnGeaNichtKraftschl1.p_gea "Druckwert aus Druckberechnung Ge/Ga" SWORD UMR_BAR__1_1000_0_S6_S3 1 100 0 20 DISPLAY_IDENTIFIER p_gea.iSasAnGeaNichtKraftschl1 ECU_ADDRESS 0xFFF8F08E /end MEASUREMENT
/begin MEASUREMENT iSasAnGeaNichtKraftschl1.p_stgea "Gesteuerter Druckanteil aus Druckberechnung Ge/Ga" SWORD UMR_BAR__1_1000_0_S6_S3 1 100 0 20 DISPLAY_IDENTIFIER p_stgea.iSasAnGeaNichtKraftschl1 ECU_ADDRESS 0xFFF8F090 /end MEASUREMENT
/begin MEASUREMENT iSasAnGeaNichtKraftschl1.timer16_ra1_ge "Timer der mit Beginn der Rampe 1 startet" UWORD UMR_MSEC__10_1_0_S6_S3 1 100 0 655350 DISPLAY_IDENTIFIER timer16_ra1_ge.iSasAnGeaNichtKraftschl1 ECU_ADDRESS 0xFFF8F092 /end MEASUREMENT
/begin MEASUREMENT iSasAnGeaNichtKraftschl1.statisch_gea "Flag: Statischansteuerung der GE/GA-Kupplung" UBYTE Conv.cSasAnGea._.statisch_gea_S6_S3 1 100 0 1 BIT_MASK 0x1 DISPLAY_IDENTIFIER statisch_gea.iSasAnGeaNichtKraftschl1 ECU_ADDRESS 0xFFF8F094 /end MEASUREMENT
/begin MEASUREMENT iSasAnGeaNichtKraftschl1.z_gea "Zustand Gangein-/auslegen" UBYTE Conv.cSasAnGea._.z_gea_S6_S3 1 100 0 30 DISPLAY_IDENTIFIER z_gea.iSasAnGeaNichtKraftschl1 ECU_ADDRESS 0xFFF8F095 /end MEASUREMENT
/begin MEASUREMENT iSasAnGeaNichtKraftschl1.t_maxgea "Maximalzeit des GE/GA" UWORD UMR_MSEC__10_1_0_S6_S3 1 100 0 50000 DISPLAY_IDENTIFIER t_maxgea.iSasAnGeaNichtKraftschl1 ECU_ADDRESS 0xFFF8F096 /end MEASUREMENT
/begin MEASUREMENT iSasAnGeaNichtKraftschl1.f_timeout "FLAG: Timeout" UBYTE Conv.cSasAnGea._.f_timeout_S6_S3 1 100 0 1 BIT_MASK 0x1 DISPLAY_IDENTIFIER f_timeout.iSasAnGeaNichtKraftschl1 ECU_ADDRESS 0xFFF8F098 /end MEASUREMENT
/begin MEASUREMENT iSasAnGeaNichtKraftschl1.schalttyp_gea "Schalttyp des Gea-Ablaufs" UBYTE Conv.cSasAnGea._.schalttyp_gea_S6_S3 1 100 0 5 DISPLAY_IDENTIFIER schalttyp_gea.iSasAnGeaNichtKraftschl1 ECU_ADDRESS 0xFFF8F099 /end MEASUREMENT
/begin MEASUREMENT iSasAnGeaNichtKraftschl1.schnellfuellung_beendet "FLAG: Schnellfuellung beendet" UBYTE Conv.cSasAnGea._.schnellfuellung_beendet_S6_S3 1 100 0 1 BIT_MASK 0x1 DISPLAY_IDENTIFIER schnellfuellung_beendet.iSasAnGeaNichtKraftschl1 ECU_ADDRESS 0xFFF8F09A /end MEASUREMENT
/begin MEASUREMENT iSasAnGeaNichtKraftschl1.f_schnellfuellung_gestartet "FLAG: Schnellfuellung wurde gestartet" UBYTE Conv.cSasAnGea._.f_schnellfuellung_gestartet_S6_S3 1 100 0 1 BIT_MASK 0x1 DISPLAY_IDENTIFIER f_schnellfuellung_gestartet.iSasAnGeaNichtKraftschl1 ECU_ADDRESS 0xFFF8F09B /end MEASUREMENT
/begin MEASUREMENT iSasAnGeaNichtKraftschl1.t_timeout "Zeit von Start Gangeinlegen bis Start Timeoutfunktion" UWORD UMR_MSEC__10_1_0_S6_S3 1 100 0 50000 DISPLAY_IDENTIFIER t_timeout.iSasAnGeaNichtKraftschl1 ECU_ADDRESS 0xFFF8F09C /end MEASUREMENT
/begin MEASUREMENT iSasAnGeaNichtKraftschl1.instanz_nr "Instanzennummer des Gea-Ablaufs" UBYTE Conv.cSasAnGea._.instanz_nr_S6_S3 1 100 2 4 DISPLAY_IDENTIFIER instanz_nr.iSasAnGeaNichtKraftschl1 ECU_ADDRESS 0xFFF8F09E /end MEASUREMENT
/begin MEASUREMENT iSasAnGeaNichtKraftschl1.kzu_voll_bei_start "KZU war schon befuellt bei Start Schaltung" UBYTE Conv.cSasAnGea._.kzu_voll_bei_start_S6_S3 1 100 0 1 BIT_MASK 0x1 DISPLAY_IDENTIFIER kzu_voll_bei_start.iSasAnGeaNichtKraftschl1 ECU_ADDRESS 0xFFF8F09F /end MEASUREMENT
/begin MEASUREMENT iSasAnGeaNichtKraftschl1.f_pokzu_kfl_zuletzt_wechsel "FLAG: Druckoffset bei KFL-Wechsel verwenden" UBYTE Conv.cSasAnGea._.f_pokzu_kfl_zuletzt_wechsel_S6_S3 1 100 0 1 BIT_MASK 0x1 DISPLAY_IDENTIFIER f_pokzu_kfl_zuletzt_wechsel.iSasAnGeaNichtKraftschl1 ECU_ADDRESS 0xFFF8F0A0 /end MEASUREMENT
/begin MEASUREMENT iSasAnGeaNichtKraftschl1.f_pfmin_erreicht "FLAG: Kupplung hat p_fmin erreicht" UBYTE Conv.cSasAnGea._.f_pfmin_erreicht_S6_S3 1 100 0 1 BIT_MASK 0x1 DISPLAY_IDENTIFIER f_pfmin_erreicht.iSasAnGeaNichtKraftschl1 ECU_ADDRESS 0xFFF8F0A1 /end MEASUREMENT
/begin MEASUREMENT iSasAnGeaNichtKraftschl1.kup_ge "Kupplung Gangeinlegen" UBYTE Conv.cSasAnGea._.kup_ge_S6_S3 1 100 0 5 DISPLAY_IDENTIFIER kup_ge.iSasAnGeaNichtKraftschl1 ECU_ADDRESS 0xFFF8F0A2 /end MEASUREMENT
/begin MEASUREMENT iSasAnGeaNichtKraftschl1.kup_ga "Kupplung Gangauslegen" UBYTE Conv.cSasAnGea._.kup_ga_S6_S3 1 100 0 5 DISPLAY_IDENTIFIER kup_ga.iSasAnGeaNichtKraftschl1 ECU_ADDRESS 0xFFF8F0A3 /end MEASUREMENT
/begin MEASUREMENT iSasAnGeaNichtKraftschl1.zaehler_zgea "Zustandszaehler Gea-Ablauf" UBYTE UMR___1_1_0_S6_S3 1 100 0 255 DISPLAY_IDENTIFIER zaehler_zgea.iSasAnGeaNichtKraftschl1 ECU_ADDRESS 0xFFF8F0A4 /end MEASUREMENT
/begin MEASUREMENT iSasAnGeaNichtKraftschl1.p_adaptgea "Adaptionsdruck Ge/Ga" SWORD UMR_BAR__1_1000_0_S6_S3 1 100 -32.768 32.767 DISPLAY_IDENTIFIER p_adaptgea.iSasAnGeaNichtKraftschl1 ECU_ADDRESS 0xFFF8F0A6 /end MEASUREMENT
/begin MEASUREMENT iSasAnGeaNichtKraftschl1.p_offgea "Offsetdruck Ge/Ga" SWORD UMR_BAR__1_1000_0_S6_S3 1 100 -32.768 32.767 DISPLAY_IDENTIFIER p_offgea.iSasAnGeaNichtKraftschl1 ECU_ADDRESS 0xFFF8F0A8 /end MEASUREMENT
/begin MEASUREMENT iSasAnGeaNichtKraftschl1.p_0stgea "Zustandsanfangsdruck gesteuerter Anteil Ge/Ga" SWORD UMR_BAR__1_1000_0_S6_S3 1 100 -32.768 32.767 DISPLAY_IDENTIFIER p_0stgea.iSasAnGeaNichtKraftschl1 ECU_ADDRESS 0xFFF8F0AA /end MEASUREMENT
/begin MEASUREMENT iSasAnGeaNichtKraftschl1.po_mtgea "Momentenabhaengiger Druckoffset Ge/Ga" SWORD UMR_BAR__1_1000_0_S6_S3 1 100 -32.768 32.767 DISPLAY_IDENTIFIER po_mtgea.iSasAnGeaNichtKraftschl1 ECU_ADDRESS 0xFFF8F0AC /end MEASUREMENT
/begin MEASUREMENT iSasAnGeaNichtKraftschl1.pgo_nabgea "Schaltdruckgradienten Offset" SWORD UMR_BAR_SEC_1_10_0_S6_S3 1 100 -3276.8 3276.7 DISPLAY_IDENTIFIER pgo_nabgea.iSasAnGeaNichtKraftschl1 ECU_ADDRESS 0xFFF8F0AE /end MEASUREMENT
/begin MEASUREMENT iSasAnGeaNichtKraftschl1.t_0kzu_gea "Zeitdauer des zuletzt durchlaufenen Zustands bei KZU" SWORD UMR_MSEC__10_1_0_S6_S3 1 100 -327680 327670 DISPLAY_IDENTIFIER t_0kzu_gea.iSasAnGeaNichtKraftschl1 ECU_ADDRESS 0xFFF8F0B0 /end MEASUREMENT
/begin MEASUREMENT iSasAnGeaNichtKraftschl1.t_zgea "Zustandszeitdauer des aktuellen Gea-Zustands" SWORD UMR_MSEC__10_1_0_S6_S3 1 100 -327680 327670 DISPLAY_IDENTIFIER t_zgea.iSasAnGeaNichtKraftschl1 ECU_ADDRESS 0xFFF8F0B2 /end MEASUREMENT
/begin MEASUREMENT iSasAnGeaNichtKraftschl1.timer_zgea "Zustandstimer Gea-Ablauf" UWORD UMR_MSEC__10_1_0_S6_S3 1 100 0 655350 DISPLAY_IDENTIFIER timer_zgea.iSasAnGeaNichtKraftschl1 ECU_ADDRESS 0xFFF8F0B4 /end MEASUREMENT
/begin MEASUREMENT iSasAnGeaNichtKraftschl1.timer_start_fa_kzu "Timer Zeit seit Start Fuellausgleich KZU (bei Gea)" UBYTE UMR_MSEC__10_1_0_S6_S3 1 100 0 2550 DISPLAY_IDENTIFIER timer_start_fa_kzu.iSasAnGeaNichtKraftschl1 ECU_ADDRESS 0xFFF8F0B6 /end MEASUREMENT
/begin MEASUREMENT iSasAnGeaNichtKraftschl1.dauer_ra1_ge_kzu "Zeitdauer der Rampe 1 der KZU (bei Gea)" SWORD UMR_MSEC__10_1_0_S6_S3 1 100 -327680 327670 DISPLAY_IDENTIFIER dauer_ra1_ge_kzu.iSasAnGeaNichtKraftschl1 ECU_ADDRESS 0xFFF8F0B8 /end MEASUREMENT
/begin MEASUREMENT iSasAnGeaNichtKraftschl1.nd_nmotnt_init_ga "Gemerkter Wert von nd_nmot_nt bei Initialisierung GA" SWORD UMR_U_MIN_1_1_0_S6_S3 1 100 -10000 10000 DISPLAY_IDENTIFIER nd_nmotnt_init_ga.iSasAnGeaNichtKraftschl1 ECU_ADDRESS 0xFFF8F0BA /end MEASUREMENT
/begin MEASUREMENT iSasAnGeaNichtKraftschl1.to_sf_kflwe "Offset Schnellfüllzeit bei DNR und RND" SWORD UMR_MSEC__1_1_0_S6_S3 1 100 -1000 1000 DISPLAY_IDENTIFIER to_sf_kflwe.iSasAnGeaNichtKraftschl1 ECU_ADDRESS 0xFFF8F0BC /end MEASUREMENT
/begin MEASUREMENT iSasAnGeaNichtKraftschl1.po_fkzu_aktiv "Verzoegerung der Druckoffsetzausgabe wegen evtl. Druckuebernahme durch IAE" UBYTE Conv.cSasAnGea._.po_fkzu_aktiv_S6_S3 1 100 0 1 BIT_MASK 0x1 DISPLAY_IDENTIFIER po_fkzu_aktiv.iSasAnGeaNichtKraftschl1 ECU_ADDRESS 0xFFF8F0BE /end MEASUREMENT
/begin MEASUREMENT iSasAnGeaNichtKraftschl2.pgo_gea_rampe.cBibRampeGradSi16._.letzter_wert "Speichert den letzten Eingangswert" FLOAT32_IEEE UMR___1_1_0_S6_S3 1 100 -1E+037 1E+037 FORMAT "%4.2" DISPLAY_IDENTIFIER letzter_wert._.cBibRampeGradSi16.pgo_gea_rampe.iSasAnGeaNichtKraftschl2 ECU_ADDRESS 0xFFF8F128 /end MEASUREMENT
/begin MEASUREMENT iSasAnGeaNichtKraftschl2.pgo_gea_rampe.cBibRampeGradSi16._.letzter_ms_timer "Speichert den letzten BS-Timer" UWORD UMR_MSEC__1_1_0_S6_S3 1 100 0 65535 DISPLAY_IDENTIFIER letzter_ms_timer._.cBibRampeGradSi16.pgo_gea_rampe.iSasAnGeaNichtKraftschl2 ECU_ADDRESS 0xFFF8F12C /end MEASUREMENT
/begin MEASUREMENT iSasAnGeaNichtKraftschl2.pgo_gea_rampe.cBibRampeGradSi16._.minimum "Minimum Begrenzung" FLOAT32_IEEE UMR___1_1_0_S6_S3 1 100 -1E+037 1E+037 FORMAT "%4.2" DISPLAY_IDENTIFIER minimum._.cBibRampeGradSi16.pgo_gea_rampe.iSasAnGeaNichtKraftschl2 ECU_ADDRESS 0xFFF8F130 /end MEASUREMENT
/begin MEASUREMENT iSasAnGeaNichtKraftschl2.pgo_gea_rampe.cBibRampeGradSi16._.maximum "Maximum Begrenzung" FLOAT32_IEEE UMR___1_1_0_S6_S3 1 100 -1E+037 1E+037 FORMAT "%4.2" DISPLAY_IDENTIFIER maximum._.cBibRampeGradSi16.pgo_gea_rampe.iSasAnGeaNichtKraftschl2 ECU_ADDRESS 0xFFF8F134 /end MEASUREMENT
/begin MEASUREMENT iSasAnGeaNichtKraftschl2.gea_ablauf_aktiv "Flag: Gangein-/auslegen aktiv" UBYTE Conv.cSasAnGea._.gea_ablauf_aktiv_S6_S3 1 100 0 1 BIT_MASK 0x1 DISPLAY_IDENTIFIER gea_ablauf_aktiv.iSasAnGeaNichtKraftschl2 ECU_ADDRESS 0xFFF8F0EC /end MEASUREMENT
/begin MEASUREMENT iSasAnGeaNichtKraftschl2.ra1_ge_gestartet "FLAG: Rampe 1 KZU gestartet" UBYTE Conv.cSasAnGea._.ra1_ge_gestartet_S6_S3 1 100 0 1 BIT_MASK 0x1 DISPLAY_IDENTIFIER ra1_ge_gestartet.iSasAnGeaNichtKraftschl2 ECU_ADDRESS 0xFFF8F0ED /end MEASUREMENT
/begin MEASUREMENT iSasAnGeaNichtKraftschl2.ra2_ge_gestartet "FLAG: Rampe 2 KZU gestartet" UBYTE Conv.cSasAnGea._.ra2_ge_gestartet_S6_S3 1 100 0 1 BIT_MASK 0x1 DISPLAY_IDENTIFIER ra2_ge_gestartet.iSasAnGeaNichtKraftschl2 ECU_ADDRESS 0xFFF8F0EE /end MEASUREMENT
/begin MEASUREMENT iSasAnGeaNichtKraftschl2.ra3_ge_gestartet "FLAG: Rampe 3 KZU gestartet" UBYTE Conv.cSasAnGea._.ra3_ge_gestartet_S6_S3 1 100 0 1 BIT_MASK 0x1 DISPLAY_IDENTIFIER ra3_ge_gestartet.iSasAnGeaNichtKraftschl2 ECU_ADDRESS 0xFFF8F0EF /end MEASUREMENT
/begin MEASUREMENT iSasAnGeaNichtKraftschl2.synchron_verboten "FLAG: Synchron erreichen ist verboten" UBYTE Conv.cSasAnGea._.synchron_verboten_S6_S3 1 100 0 1 BIT_MASK 0x1 DISPLAY_IDENTIFIER synchron_verboten.iSasAnGeaNichtKraftschl2 ECU_ADDRESS 0xFFF8F0F0 /end MEASUREMENT
/begin MEASUREMENT iSasAnGeaNichtKraftschl2.erste_schaltung "Flag: 1. Befuellung einer Kupplung" UBYTE Conv.cSasAnGea._.erste_schaltung_S6_S3 1 100 0 1 BIT_MASK 0x1 DISPLAY_IDENTIFIER erste_schaltung.iSasAnGeaNichtKraftschl2 ECU_ADDRESS 0xFFF8F0F1 /end MEASUREMENT
/begin MEASUREMENT iSasAnGeaNichtKraftschl2.f_verb_ada_erste_bef "Flag: 1. Befuellung einer Kupplung verbietet Ada" UBYTE Conv.cSasAnGea._.f_verb_ada_erste_bef_S6_S3 1 100 0 1 BIT_MASK 0x1 DISPLAY_IDENTIFIER f_verb_ada_erste_bef.iSasAnGeaNichtKraftschl2 ECU_ADDRESS 0xFFF8F0F2 /end MEASUREMENT
/begin MEASUREMENT iSasAnGeaNichtKraftschl2.ende_kab_gestartet "Flag: Zustand Ende der abschaltenden Kupplung gestartet" UBYTE Conv.cSasAnGea._.ende_kab_gestartet_S6_S3 1 100 0 1 BIT_MASK 0x1 DISPLAY_IDENTIFIER ende_kab_gestartet.iSasAnGeaNichtKraftschl2 ECU_ADDRESS 0xFFF8F0F3 /end MEASUREMENT
/begin MEASUREMENT iSasAnGeaNichtKraftschl2.fa_kzu_gestartet "Flag: Fuellausgleich KZU gestartet" UBYTE Conv.cSasAnGea._.fa_kzu_gestartet_S6_S3 1 100 0 1 BIT_MASK 0x1 DISPLAY_IDENTIFIER fa_kzu_gestartet.iSasAnGeaNichtKraftschl2 ECU_ADDRESS 0xFFF8F0F4 /end MEASUREMENT
/begin MEASUREMENT iSasAnGeaNichtKraftschl2.schliessen_kup_in_n_gestartet "Flag: Kupplungsansteuerung in Neutral wurde gestartet" UBYTE Conv.cSasAnGea._.schliessen_kup_in_n_gestartet_S6_S3 1 100 0 1 BIT_MASK 0x1 DISPLAY_IDENTIFIER schliessen_kup_in_n_gestartet.iSasAnGeaNichtKraftschl2 ECU_ADDRESS 0xFFF8F0F5 /end MEASUREMENT
/begin MEASUREMENT iSasAnGeaNichtKraftschl2.p_gea "Druckwert aus Druckberechnung Ge/Ga" SWORD UMR_BAR__1_1000_0_S6_S3 1 100 0 20 DISPLAY_IDENTIFIER p_gea.iSasAnGeaNichtKraftschl2 ECU_ADDRESS 0xFFF8F0F6 /end MEASUREMENT
/begin MEASUREMENT iSasAnGeaNichtKraftschl2.p_stgea "Gesteuerter Druckanteil aus Druckberechnung Ge/Ga" SWORD UMR_BAR__1_1000_0_S6_S3 1 100 0 20 DISPLAY_IDENTIFIER p_stgea.iSasAnGeaNichtKraftschl2 ECU_ADDRESS 0xFFF8F0F8 /end MEASUREMENT
/begin MEASUREMENT iSasAnGeaNichtKraftschl2.timer16_ra1_ge "Timer der mit Beginn der Rampe 1 startet" UWORD UMR_MSEC__10_1_0_S6_S3 1 100 0 655350 DISPLAY_IDENTIFIER timer16_ra1_ge.iSasAnGeaNichtKraftschl2 ECU_ADDRESS 0xFFF8F0FA /end MEASUREMENT
/begin MEASUREMENT iSasAnGeaNichtKraftschl2.statisch_gea "Flag: Statischansteuerung der GE/GA-Kupplung" UBYTE Conv.cSasAnGea._.statisch_gea_S6_S3 1 100 0 1 BIT_MASK 0x1 DISPLAY_IDENTIFIER statisch_gea.iSasAnGeaNichtKraftschl2 ECU_ADDRESS 0xFFF8F0FC /end MEASUREMENT
/begin MEASUREMENT iSasAnGeaNichtKraftschl2.z_gea "Zustand Gangein-/auslegen" UBYTE Conv.cSasAnGea._.z_gea_S6_S3 1 100 0 30 DISPLAY_IDENTIFIER z_gea.iSasAnGeaNichtKraftschl2 ECU_ADDRESS 0xFFF8F0FD /end MEASUREMENT
/begin MEASUREMENT iSasAnGeaNichtKraftschl2.t_maxgea "Maximalzeit des GE/GA" UWORD UMR_MSEC__10_1_0_S6_S3 1 100 0 50000 DISPLAY_IDENTIFIER t_maxgea.iSasAnGeaNichtKraftschl2 ECU_ADDRESS 0xFFF8F0FE /end MEASUREMENT
/begin MEASUREMENT iSasAnGeaNichtKraftschl2.f_timeout "FLAG: Timeout" UBYTE Conv.cSasAnGea._.f_timeout_S6_S3 1 100 0 1 BIT_MASK 0x1 DISPLAY_IDENTIFIER f_timeout.iSasAnGeaNichtKraftschl2 ECU_ADDRESS 0xFFF8F100 /end MEASUREMENT
/begin MEASUREMENT iSasAnGeaNichtKraftschl2.schalttyp_gea "Schalttyp des Gea-Ablaufs" UBYTE Conv.cSasAnGea._.schalttyp_gea_S6_S3 1 100 0 5 DISPLAY_IDENTIFIER schalttyp_gea.iSasAnGeaNichtKraftschl2 ECU_ADDRESS 0xFFF8F101 /end MEASUREMENT
/begin MEASUREMENT iSasAnGeaNichtKraftschl2.schnellfuellung_beendet "FLAG: Schnellfuellung beendet" UBYTE Conv.cSasAnGea._.schnellfuellung_beendet_S6_S3 1 100 0 1 BIT_MASK 0x1 DISPLAY_IDENTIFIER schnellfuellung_beendet.iSasAnGeaNichtKraftschl2 ECU_ADDRESS 0xFFF8F102 /end MEASUREMENT
/begin MEASUREMENT iSasAnGeaNichtKraftschl2.f_schnellfuellung_gestartet "FLAG: Schnellfuellung wurde gestartet" UBYTE Conv.cSasAnGea._.f_schnellfuellung_gestartet_S6_S3 1 100 0 1 BIT_MASK 0x1 DISPLAY_IDENTIFIER f_schnellfuellung_gestartet.iSasAnGeaNichtKraftschl2 ECU_ADDRESS 0xFFF8F103 /end MEASUREMENT
/begin MEASUREMENT iSasAnGeaNichtKraftschl2.t_timeout "Zeit von Start Gangeinlegen bis Start Timeoutfunktion" UWORD UMR_MSEC__10_1_0_S6_S3 1 100 0 50000 DISPLAY_IDENTIFIER t_timeout.iSasAnGeaNichtKraftschl2 ECU_ADDRESS 0xFFF8F104 /end MEASUREMENT
/begin MEASUREMENT iSasAnGeaNichtKraftschl2.instanz_nr "Instanzennummer des Gea-Ablaufs" UBYTE Conv.cSasAnGea._.instanz_nr_S6_S3 1 100 2 4 DISPLAY_IDENTIFIER instanz_nr.iSasAnGeaNichtKraftschl2 ECU_ADDRESS 0xFFF8F106 /end MEASUREMENT
/begin MEASUREMENT iSasAnGeaNichtKraftschl2.kzu_voll_bei_start "KZU war schon befuellt bei Start Schaltung" UBYTE Conv.cSasAnGea._.kzu_voll_bei_start_S6_S3 1 100 0 1 BIT_MASK 0x1 DISPLAY_IDENTIFIER kzu_voll_bei_start.iSasAnGeaNichtKraftschl2 ECU_ADDRESS 0xFFF8F107 /end MEASUREMENT
/begin MEASUREMENT iSasAnGeaNichtKraftschl2.f_pokzu_kfl_zuletzt_wechsel "FLAG: Druckoffset bei KFL-Wechsel verwenden" UBYTE Conv.cSasAnGea._.f_pokzu_kfl_zuletzt_wechsel_S6_S3 1 100 0 1 BIT_MASK 0x1 DISPLAY_IDENTIFIER f_pokzu_kfl_zuletzt_wechsel.iSasAnGeaNichtKraftschl2 ECU_ADDRESS 0xFFF8F108 /end MEASUREMENT
/begin MEASUREMENT iSasAnGeaNichtKraftschl2.f_pfmin_erreicht "FLAG: Kupplung hat p_fmin erreicht" UBYTE Conv.cSasAnGea._.f_pfmin_erreicht_S6_S3 1 100 0 1 BIT_MASK 0x1 DISPLAY_IDENTIFIER f_pfmin_erreicht.iSasAnGeaNichtKraftschl2 ECU_ADDRESS 0xFFF8F109 /end MEASUREMENT
/begin MEASUREMENT iSasAnGeaNichtKraftschl2.kup_ge "Kupplung Gangeinlegen" UBYTE Conv.cSasAnGea._.kup_ge_S6_S3 1 100 0 5 DISPLAY_IDENTIFIER kup_ge.iSasAnGeaNichtKraftschl2 ECU_ADDRESS 0xFFF8F10A /end MEASUREMENT
/begin MEASUREMENT iSasAnGeaNichtKraftschl2.kup_ga "Kupplung Gangauslegen" UBYTE Conv.cSasAnGea._.kup_ga_S6_S3 1 100 0 5 DISPLAY_IDENTIFIER kup_ga.iSasAnGeaNichtKraftschl2 ECU_ADDRESS 0xFFF8F10B /end MEASUREMENT
/begin MEASUREMENT iSasAnGeaNichtKraftschl2.zaehler_zgea "Zustandszaehler Gea-Ablauf" UBYTE UMR___1_1_0_S6_S3 1 100 0 255 DISPLAY_IDENTIFIER zaehler_zgea.iSasAnGeaNichtKraftschl2 ECU_ADDRESS 0xFFF8F10C /end MEASUREMENT
/begin MEASUREMENT iSasAnGeaNichtKraftschl2.p_adaptgea "Adaptionsdruck Ge/Ga" SWORD UMR_BAR__1_1000_0_S6_S3 1 100 -32.768 32.767 DISPLAY_IDENTIFIER p_adaptgea.iSasAnGeaNichtKraftschl2 ECU_ADDRESS 0xFFF8F10E /end MEASUREMENT
/begin MEASUREMENT iSasAnGeaNichtKraftschl2.p_offgea "Offsetdruck Ge/Ga" SWORD UMR_BAR__1_1000_0_S6_S3 1 100 -32.768 32.767 DISPLAY_IDENTIFIER p_offgea.iSasAnGeaNichtKraftschl2 ECU_ADDRESS 0xFFF8F110 /end MEASUREMENT
/begin MEASUREMENT iSasAnGeaNichtKraftschl2.p_0stgea "Zustandsanfangsdruck gesteuerter Anteil Ge/Ga" SWORD UMR_BAR__1_1000_0_S6_S3 1 100 -32.768 32.767 DISPLAY_IDENTIFIER p_0stgea.iSasAnGeaNichtKraftschl2 ECU_ADDRESS 0xFFF8F112 /end MEASUREMENT
/begin MEASUREMENT iSasAnGeaNichtKraftschl2.po_mtgea "Momentenabhaengiger Druckoffset Ge/Ga" SWORD UMR_BAR__1_1000_0_S6_S3 1 100 -32.768 32.767 DISPLAY_IDENTIFIER po_mtgea.iSasAnGeaNichtKraftschl2 ECU_ADDRESS 0xFFF8F114 /end MEASUREMENT
/begin MEASUREMENT iSasAnGeaNichtKraftschl2.pgo_nabgea "Schaltdruckgradienten Offset" SWORD UMR_BAR_SEC_1_10_0_S6_S3 1 100 -3276.8 3276.7 DISPLAY_IDENTIFIER pgo_nabgea.iSasAnGeaNichtKraftschl2 ECU_ADDRESS 0xFFF8F116 /end MEASUREMENT
/begin MEASUREMENT iSasAnGeaNichtKraftschl2.t_0kzu_gea "Zeitdauer des zuletzt durchlaufenen Zustands bei KZU" SWORD UMR_MSEC__10_1_0_S6_S3 1 100 -327680 327670 DISPLAY_IDENTIFIER t_0kzu_gea.iSasAnGeaNichtKraftschl2 ECU_ADDRESS 0xFFF8F118 /end MEASUREMENT
/begin MEASUREMENT iSasAnGeaNichtKraftschl2.t_zgea "Zustandszeitdauer des aktuellen Gea-Zustands" SWORD UMR_MSEC__10_1_0_S6_S3 1 100 -327680 327670 DISPLAY_IDENTIFIER t_zgea.iSasAnGeaNichtKraftschl2 ECU_ADDRESS 0xFFF8F11A /end MEASUREMENT
/begin MEASUREMENT iSasAnGeaNichtKraftschl2.timer_zgea "Zustandstimer Gea-Ablauf" UWORD UMR_MSEC__10_1_0_S6_S3 1 100 0 655350 DISPLAY_IDENTIFIER timer_zgea.iSasAnGeaNichtKraftschl2 ECU_ADDRESS 0xFFF8F11C /end MEASUREMENT
/begin MEASUREMENT iSasAnGeaNichtKraftschl2.timer_start_fa_kzu "Timer Zeit seit Start Fuellausgleich KZU (bei Gea)" UBYTE UMR_MSEC__10_1_0_S6_S3 1 100 0 2550 DISPLAY_IDENTIFIER timer_start_fa_kzu.iSasAnGeaNichtKraftschl2 ECU_ADDRESS 0xFFF8F11E /end MEASUREMENT
/begin MEASUREMENT iSasAnGeaNichtKraftschl2.dauer_ra1_ge_kzu "Zeitdauer der Rampe 1 der KZU (bei Gea)" SWORD UMR_MSEC__10_1_0_S6_S3 1 100 -327680 327670 DISPLAY_IDENTIFIER dauer_ra1_ge_kzu.iSasAnGeaNichtKraftschl2 ECU_ADDRESS 0xFFF8F120 /end MEASUREMENT
/begin MEASUREMENT iSasAnGeaNichtKraftschl2.nd_nmotnt_init_ga "Gemerkter Wert von nd_nmot_nt bei Initialisierung GA" SWORD UMR_U_MIN_1_1_0_S6_S3 1 100 -10000 10000 DISPLAY_IDENTIFIER nd_nmotnt_init_ga.iSasAnGeaNichtKraftschl2 ECU_ADDRESS 0xFFF8F122 /end MEASUREMENT
/begin MEASUREMENT iSasAnGeaNichtKraftschl2.to_sf_kflwe "Offset Schnellfüllzeit bei DNR und RND" SWORD UMR_MSEC__1_1_0_S6_S3 1 100 -1000 1000 DISPLAY_IDENTIFIER to_sf_kflwe.iSasAnGeaNichtKraftschl2 ECU_ADDRESS 0xFFF8F124 /end MEASUREMENT
/begin MEASUREMENT iSasAnGeaNichtKraftschl2.po_fkzu_aktiv "Verzoegerung der Druckoffsetzausgabe wegen evtl. Druckuebernahme durch IAE" UBYTE Conv.cSasAnGea._.po_fkzu_aktiv_S6_S3 1 100 0 1 BIT_MASK 0x1 DISPLAY_IDENTIFIER po_fkzu_aktiv.iSasAnGeaNichtKraftschl2 ECU_ADDRESS 0xFFF8F126 /end MEASUREMENT
/begin COMPU_METHOD SBW_PROZENT_1_10_M3000_S1_S3 "int = ((phys * 10) / 1) - (-3000) %" RAT_FUNC "%4.2" "%" COEFFS 0 10 3000 0 0 1 /end COMPU_METHOD
/begin COMPU_METHOD UMR___1_1000_0_S6_S3 "int = ((phys * 1000) / 1) - (0) [-]" RAT_FUNC "%5.3" "[-]" COEFFS 0 1000 -0 0 0 1 /end COMPU_METHOD
/begin COMPU_METHOD UMR___1_300_0_S6_S3 "int = ((phys * 300) / 1) - (0) [-]" RAT_FUNC "%7.5" "[-]" COEFFS 0 300 -0 0 0 1 /end COMPU_METHOD
/begin COMPU_METHOD UMR___1_100_0_S6_S3 "int = ((phys * 100) / 1) - (0) [-]" RAT_FUNC "%4.2" "[-]" COEFFS 0 100 -0 0 0 1 /end COMPU_METHOD
/begin COMPU_METHOD UMR___1_1_0_S6_S3 "int = ((phys * 1) / 1) - (0) [-]" RAT_FUNC "%2.0" "[-]" COEFFS 0 1 -0 0 0 1 /end COMPU_METHOD
/begin COMPU_METHOD UMR___1_1_0_3_S6_S3 "int = ((phys * 1) / 1) - (0) [-]" RAT_FUNC "%2.0" "[-]" COEFFS 0 1 -0 0 0 1 /end COMPU_METHOD
/begin COMPU_METHOD UMR_NM__1_100_0_S6_S3 "int = ((phys * 100) / 1) - (0) [Nm]" RAT_FUNC "%4.2" "[Nm]" COEFFS 0 100 -0 0 0 1 /end COMPU_METHOD
/begin COMPU_METHOD UMR_NM__1_1_0_S6_S3 "int = ((phys * 1) / 1) - (0) [Nm]" RAT_FUNC "%2.0" "[Nm]" COEFFS 0 1 -0 0 0 1 /end COMPU_METHOD
/begin COMPU_METHOD UMR_NM_SEC_1_1_0_S6_S3 "int = ((phys * 1) / 1) - (0) [Nm/s]" RAT_FUNC "%2.0" "[Nm/s]" COEFFS 0 1 -0 0 0 1 /end COMPU_METHOD
/begin COMPU_METHOD UMR_NM_BAR_1_1_0_S6_S3 "int = ((phys * 1) / 1) - (0) [Nm/bar]" RAT_FUNC "%2.0" "[Nm/bar]" COEFFS 0 1 -0 0 0 1 /end COMPU_METHOD
/begin COMPU_METHOD UMR_MBAR__1_1_0_S6_S3 "int = ((phys * 1) / 1) - (0) [mbar]" RAT_FUNC "%2.0" "[mbar]" COEFFS 0 1 -0 0 0 1 /end COMPU_METHOD
/begin COMPU_METHOD UMR_BAR__1_1000_0_S6_S3 "int = ((phys * 1000) / 1) - (0) [bar]" RAT_FUNC "%5.3" "[bar]" COEFFS 0 1000 -0 0 0 1 /end COMPU_METHOD
/begin COMPU_METHOD UMR_BAR__1_100_0_S6_S3 "int = ((phys * 100) / 1) - (0) [bar]" RAT_FUNC "%4.2" "[bar]" COEFFS 0 100 -0 0 0 1 /end COMPU_METHOD
/begin COMPU_METHOD UMR_BAR_SEC_1_10_0_S6_S3 "int = ((phys * 10) / 1) - (0) [bar/s]" RAT_FUNC "%3.1" "[bar/s]" COEFFS 0 10 -0 0 0 1 /end COMPU_METHOD
/begin COMPU_METHOD UMR_BAR_SEC_1_1_0_S6_S3 "int = ((phys * 1) / 1) - (0) [bar/s]" RAT_FUNC "%2.0" "[bar/s]" COEFFS 0 1 -0 0 0 1 /end COMPU_METHOD
/begin COMPU_METHOD UMR_U_MIN_1_1_0_S6_S3 "int = ((phys * 1) / 1) - (0) [U/min]" RAT_FUNC "%2.0" "[U/min]" COEFFS 0 1 -0 0 0 1 /end COMPU_METHOD
/begin COMPU_METHOD UMR_U_MIN_1_100_0_S6_S3 "int = ((phys * 100) / 1) - (0) [U/min]" RAT_FUNC "%4.2" "[U/min]" COEFFS 0 100 -0 0 0 1 /end COMPU_METHOD
/begin COMPU_METHOD UMR_U_MINSEC_1_1_0_S6_S3 "int = ((phys * 1) / 1) - (0) [U/(min*s)]" RAT_FUNC "%2.0" "[U/(min*s)]" COEFFS 0 1 -0 0 0 1 /end COMPU_METHOD
/begin COMPU_METHOD UMR_MSEC__1_1_0_S6_S3 "int = ((phys * 1) / 1) - (0) [ms]" RAT_FUNC "%2.0" "[ms]" COEFFS 0 1 -0 0 0 1 /end COMPU_METHOD
/begin COMPU_METHOD UMR_MSEC__10_1_0_S6_S3 "int = ((phys * 1) / 10) - (0) [ms]" RAT_FUNC "%2.0" "[ms]" COEFFS 0 1 -0 0 0 10 /end COMPU_METHOD
/begin COMPU_METHOD UMR_SEC__1_100_0_S6_S3 "int = ((phys * 100) / 1) - (0) [s]" RAT_FUNC "%4.2" "[s]" COEFFS 0 100 -0 0 0 1 /end COMPU_METHOD
/begin COMPU_METHOD UMR__SEC_1_1_0_S6_S3 "int = ((phys * 1) / 1) - (0) [1/s]" RAT_FUNC "%2.0" "[1/s]" COEFFS 0 1 -0 0 0 1 /end COMPU_METHOD
/begin COMPU_METHOD UMR_GRADC__1_1_0_S6_S3 "int = ((phys * 1) / 1) - (0) [°C]" RAT_FUNC "%2.0" "[°C]" COEFFS 0 1 -0 0 0 1 /end COMPU_METHOD
/begin COMPU_METHOD UMR_GRADC__1_1_M40_S6_S3 "int = ((phys * 1) / 1) - (-40) [°C]" RAT_FUNC "%2.0" "[°C]" COEFFS 0 1 40 0 0 1 /end COMPU_METHOD
/begin COMPU_METHOD UMR_KSEC__1_1_0_S6_S3 "int = ((phys * 1) / 1) - (0) [K*s]" RAT_FUNC "%2.0" "[K*s]" COEFFS 0 1 -0 0 0 1 /end COMPU_METHOD
/begin COMPU_METHOD UMR_PROZENT__20_51_0_S6_S3 "int = ((phys * 51) / 20) - (0) [%]" RAT_FUNC "%6.4" "[%]" COEFFS 0 51 -0 0 0 20 /end COMPU_METHOD
/begin COMPU_METHOD UMR_PROZENT__16_10_0_S6_S3 "int = ((phys * 10) / 16) - (0) [%]" RAT_FUNC "%3.1" "[%]" COEFFS 0 10 -0 0 0 16 /end COMPU_METHOD
/begin COMPU_METHOD UMR_PROZENT_SEC_20_51_0_S6_S3 "int = ((phys * 51) / 20) - (0) [%/s]" RAT_FUNC "%6.4" "[%/s]" COEFFS 0 51 -0 0 0 20 /end COMPU_METHOD
/begin COMPU_METHOD UMR_M_SEC_1_3200_0_S6_S3 "int = ((phys * 3200) / 1) - (0) [m/s]" RAT_FUNC "%6.4" "[m/s]" COEFFS 0 3200 -0 0 0 1 /end COMPU_METHOD
/begin COMPU_METHOD UMR_GRAD__1_3_M128_S6_S3 "int = ((phys * 3) / 1) - (-128) [Grad]" RAT_FUNC "%5.3" "[Grad]" COEFFS 0 3 128 0 0 1 /end COMPU_METHOD
/begin COMPU_METHOD UMR_W__1_1_0_S6_S3 "int = ((phys * 1) / 1) - (0) [W]" RAT_FUNC "%2.0" "[W]" COEFFS 0 1 -0 0 0 1 /end COMPU_METHOD
/begin COMPU_METHOD UMR_KW__1_1000_0_S6_S3 "int = ((phys * 1000) / 1) - (0) [KW]" RAT_FUNC "%5.3" "[KW]" COEFFS 0 1000 -0 0 0 1 /end COMPU_METHOD
/begin COMPU_METHOD UMR_W_K_1_1_0_S6_S3 "int = ((phys * 1) / 1) - (0) [W/K]" RAT_FUNC "%2.0" "[W/K]" COEFFS 0 1 -0 0 0 1 /end COMPU_METHOD
/begin COMPU_METHOD UMR_LITER_MIN_1_10_0_S6_S3 "int = ((phys * 10) / 1) - (0) [Liter/min]" RAT_FUNC "%3.1" "[Liter/min]" COEFFS 0 10 -0 0 0 1 /end COMPU_METHOD
/begin COMPU_METHOD UMR_M_SEC2_1_32_0_S6_S3 "int = ((phys * 32) / 1) - (0) [m/s^2]" RAT_FUNC "%4.2" "[m/s^2]" COEFFS 0 32 -0 0 0 1 /end COMPU_METHOD
/begin COMPU_METHOD Conv.cKorGskup._.kup_gsk_S6_S3 "Umrechnung fuer Messgroesse cKorGskup::kup_gsk" TAB_VERB "%4.0" "" COMPU_TAB_REF Conv.cKorGskup._.kup_gsk_S6_S3 /end COMPU_METHOD
/begin COMPU_METHOD Conv.cKorGskup._.gsk_funktion_S6_S3 "Umrechnung fuer Messgroesse cKorGskup::gsk_funktion" TAB_VERB "%4.0" "" COMPU_TAB_REF Conv.cKorGskup._.gsk_funktion_S6_S3 /end COMPU_METHOD
/begin COMPU_METHOD Conv.cKorGskup._.gsk_aktiv_S6_S3 "Umrechnung fuer Messgroesse cKorGskup::gsk_aktiv" TAB_VERB "%4.0" "" COMPU_TAB_REF Conv.cKorGskup._.gsk_aktiv_S6_S3 /end COMPU_METHOD
/begin COMPU_METHOD Conv.cKorGskup._.f_kraftschl_kup_fa_S6_S3 "Umrechnung fuer Messgroesse cKorGskup::f_kraftschl_kup_fa" TAB_VERB "%4.0" "" COMPU_TAB_REF Conv.cKorGskup._.f_kraftschl_kup_fa_S6_S3 /end COMPU_METHOD
/begin COMPU_METHOD Conv.cKorGskup._.fehler_gsk_regeln_verboten_S6_S3 "Umrechnung fuer Messgroesse cKorGskup::fehler_gsk_regeln_verboten" TAB_VERB "%4.0" "" COMPU_TAB_REF Conv.cKorGskup._.fehler_gsk_regeln_verboten_S6_S3 /end COMPU_METHOD
/begin COMPU_METHOD Conv.cKorGskup._.gsk_zustand_S6_S3 "Umrechnung fuer Messgroesse cKorGskup::gsk_zustand" TAB_VERB "%4.0" "" COMPU_TAB_REF Conv.cKorGskup._.gsk_zustand_S6_S3 /end COMPU_METHOD
/begin COMPU_METHOD Conv.cKorGskup._.f_gsk_schlupft_S6_S3 "Umrechnung fuer Messgroesse cKorGskup::f_gsk_schlupft" TAB_VERB "%4.0" "" COMPU_TAB_REF Conv.cKorGskup._.f_gsk_schlupft_S6_S3 /end COMPU_METHOD
/begin COMPU_METHOD Conv.cKasEkopl._.z_entkoppeln_S6_S3 "Umrechnung fuer Messgroesse cKasEkopl::z_entkoppeln" TAB_VERB "%4.0" "" COMPU_TAB_REF Conv.cKasEkopl._.z_entkoppeln_S6_S3 /end COMPU_METHOD
/begin COMPU_METHOD Conv.cKasEkopl._.flag_mo_aktiv_entkoppl_S6_S3 "Umrechnung fuer Messgroesse cKasEkopl::flag_mo_aktiv_entkoppl" TAB_VERB "%4.0" "" COMPU_TAB_REF Conv.cKasEkopl._.flag_mo_aktiv_entkoppl_S6_S3 /end COMPU_METHOD
/begin COMPU_METHOD Conv.cIaeKordi._.z_iae_S6_S3 "Umrechnung fuer Messgroesse cIaeKordi::z_iae" TAB_VERB "%4.0" "" COMPU_TAB_REF Conv.cIaeKordi._.z_iae_S6_S3 /end COMPU_METHOD
/begin COMPU_METHOD Conv.cIaeKordi._.z_iae_temp_S6_S3 "Umrechnung fuer Messgroesse cIaeKordi::z_iae_temp" TAB_VERB "%4.0" "" COMPU_TAB_REF Conv.cIaeKordi._.z_iae_temp_S6_S3 /end COMPU_METHOD
/begin COMPU_METHOD Conv.cIaeKordi._.flag_zu_gewesen_iae_S6_S3 "Umrechnung fuer Messgroesse cIaeKordi::flag_zu_gewesen_iae" TAB_VERB "%4.0" "" COMPU_TAB_REF Conv.cIaeKordi._.flag_zu_gewesen_iae_S6_S3 /end COMPU_METHOD
/begin COMPU_METHOD Conv.cIaeKordi._.kup_status_iae_S6_S3 "Umrechnung fuer Messgroesse cIaeKordi::kup_status_iae" TAB_VERB "%4.0" "" COMPU_TAB_REF Conv.cIaeKordi._.kup_status_iae_S6_S3 /end COMPU_METHOD
/begin COMPU_METHOD Conv.cIaeAdauf._.zielgang_start_uefiae_S6_S3 "Umrechnung fuer Messgroesse cIaeAdauf::zielgang_start_uefiae" TAB_VERB "%4.0" "" COMPU_TAB_REF Conv.cIaeAdauf._.zielgang_start_uefiae_S6_S3 /end COMPU_METHOD
/begin COMPU_METHOD Conv.cIaeAdauf._.kfl_ziel_start_uefiea_S6_S3 "Umrechnung fuer Messgroesse cIaeAdauf::kfl_ziel_start_uefiea" TAB_VERB "%4.0" "" COMPU_TAB_REF Conv.cIaeAdauf._.kfl_ziel_start_uefiea_S6_S3 /end COMPU_METHOD
/begin COMPU_METHOD Conv.cIaeAdauf._.z_ada_uefiae_S6_S3 "Umrechnung fuer Messgroesse cIaeAdauf::z_ada_uefiae" TAB_VERB "%4.0" "" COMPU_TAB_REF Conv.cIaeAdauf._.z_ada_uefiae_S6_S3 /end COMPU_METHOD
/begin COMPU_METHOD Conv.cIaeDraus._.z_hyskomp_iae_S6_S3 "Umrechnung fuer Messgroesse cIaeDraus::z_hyskomp_iae" TAB_VERB "%4.0" "" COMPU_TAB_REF Conv.cIaeDraus._.z_hyskomp_iae_S6_S3 /end COMPU_METHOD
/begin COMPU_METHOD Conv.cIaeDraus._.flag_p_stell_max_iae_S6_S3 "Umrechnung fuer Messgroesse cIaeDraus::flag_p_stell_max_iae" TAB_VERB "%4.0" "" COMPU_TAB_REF Conv.cIaeDraus._.flag_p_stell_max_iae_S6_S3 /end COMPU_METHOD
/begin COMPU_METHOD Conv.cIaeDraus._.f_hysschleife_aktiv_iae_S6_S3 "Umrechnung fuer Messgroesse cIaeDraus::f_hysschleife_aktiv_iae" TAB_VERB "%4.0" "" COMPU_TAB_REF Conv.cIaeDraus._.f_hysschleife_aktiv_iae_S6_S3 /end COMPU_METHOD
/begin COMPU_METHOD Conv.cIaeDraus._.f_hysschleife_moeglich_iae_S6_S3 "Umrechnung fuer Messgroesse cIaeDraus::f_hysschleife_moeglich_iae" TAB_VERB "%4.0" "" COMPU_TAB_REF Conv.cIaeDraus._.f_hysschleife_moeglich_iae_S6_S3 /end COMPU_METHOD
/begin COMPU_METHOD Conv.cIaeDraus._.flag_po_dyn_aktiv_iae_S6_S3 "Umrechnung fuer Messgroesse cIaeDraus::flag_po_dyn_aktiv_iae" TAB_VERB "%4.0" "" COMPU_TAB_REF Conv.cIaeDraus._.flag_po_dyn_aktiv_iae_S6_S3 /end COMPU_METHOD
/begin COMPU_METHOD Conv.cIaeDraus._.flag_m_max_alt_S6_S3 "Umrechnung fuer Messgroesse cIaeDraus::flag_m_max_alt" TAB_VERB "%4.0" "" COMPU_TAB_REF Conv.cIaeDraus._.flag_m_max_alt_S6_S3 /end COMPU_METHOD
/begin COMPU_METHOD Conv.cIaeDraus._.flag_init_ausinaktiv_iae_S6_S3 "Umrechnung fuer Messgroesse cIaeDraus::flag_init_ausinaktiv_iae" TAB_VERB "%4.0" "" COMPU_TAB_REF Conv.cIaeDraus._.flag_init_ausinaktiv_iae_S6_S3 /end COMPU_METHOD
/begin COMPU_METHOD Conv.cIaeSigna._.asr_regelt_iae_S6_S3 "Umrechnung fuer Messgroesse cIaeSigna::asr_regelt_iae" TAB_VERB "%4.0" "" COMPU_TAB_REF Conv.cIaeSigna._.asr_regelt_iae_S6_S3 /end COMPU_METHOD
/begin COMPU_METHOD Conv.cIaeSigna._.flag_init_signa_iae_S6_S3 "Umrechnung fuer Messgroesse cIaeSigna::flag_init_signa_iae" TAB_VERB "%4.0" "" COMPU_TAB_REF Conv.cIaeSigna._.flag_init_signa_iae_S6_S3 /end COMPU_METHOD
/begin COMPU_METHOD Conv.cIaeSigna._.flag_mreibzumstell_iae_S6_S3 "Umrechnung fuer Messgroesse cIaeSigna::flag_mreibzumstell_iae" TAB_VERB "%4.0" "" COMPU_TAB_REF Conv.cIaeSigna._.flag_mreibzumstell_iae_S6_S3 /end COMPU_METHOD
/begin COMPU_METHOD Conv.cIaeSigna._.fas_aktiv_iae_S6_S3 "Umrechnung fuer Messgroesse cIaeSigna::fas_aktiv_iae" TAB_VERB "%4.0" "" COMPU_TAB_REF Conv.cIaeSigna._.fas_aktiv_iae_S6_S3 /end COMPU_METHOD
/begin COMPU_METHOD Conv.cIaeSigna._.f_brems_angelegt_iae_S6_S3 "Umrechnung fuer Messgroesse cIaeSigna::f_brems_angelegt_iae" TAB_VERB "%4.0" "" COMPU_TAB_REF Conv.cIaeSigna._.f_brems_angelegt_iae_S6_S3 /end COMPU_METHOD
/begin COMPU_METHOD Conv.cIaeSigna._.f_angelegt_iae_S6_S3 "Umrechnung fuer Messgroesse cIaeSigna::f_angelegt_iae" TAB_VERB "%4.0" "" COMPU_TAB_REF Conv.cIaeSigna._.f_angelegt_iae_S6_S3 /end COMPU_METHOD
/begin COMPU_METHOD Conv.cIaeSigna._.kfl_sollneutral_iae_S6_S3 "Umrechnung fuer Messgroesse cIaeSigna::kfl_sollneutral_iae" TAB_VERB "%4.0" "" COMPU_TAB_REF Conv.cIaeSigna._.kfl_sollneutral_iae_S6_S3 /end COMPU_METHOD
/begin COMPU_METHOD Conv.cIaeSigna._.n_ab_dir_iae_S6_S3 "Umrechnung fuer Messgroesse cIaeSigna::n_ab_dir_iae" TAB_VERB "%4.0" "" COMPU_TAB_REF Conv.cIaeSigna._.n_ab_dir_iae_S6_S3 /end COMPU_METHOD
/begin COMPU_METHOD Conv.cIaeSigna._.z_nmotll_aktiv_iae_S6_S3 "Umrechnung fuer Messgroesse cIaeSigna::z_nmotll_aktiv_iae" TAB_VERB "%4.0" "" COMPU_TAB_REF Conv.cIaeSigna._.z_nmotll_aktiv_iae_S6_S3 /end COMPU_METHOD
/begin COMPU_METHOD Conv.cIaeMomen._.flag_ueflaeuft_iae_S6_S3 "Umrechnung fuer Messgroesse cIaeMomen::flag_ueflaeuft_iae" TAB_VERB "%4.0" "" COMPU_TAB_REF Conv.cIaeMomen._.flag_ueflaeuft_iae_S6_S3 /end COMPU_METHOD
/begin COMPU_METHOD Conv.cIaeMomen._.flag_initsoll_einmal_iae_S6_S3 "Umrechnung fuer Messgroesse cIaeMomen::flag_initsoll_einmal_iae" TAB_VERB "%4.0" "" COMPU_TAB_REF Conv.cIaeMomen._.flag_initsoll_einmal_iae_S6_S3 /end COMPU_METHOD
/begin COMPU_METHOD Conv.cIaeMomen._.flag_initsollanfahr_iae_S6_S3 "Umrechnung fuer Messgroesse cIaeMomen::flag_initsollanfahr_iae" TAB_VERB "%4.0" "" COMPU_TAB_REF Conv.cIaeMomen._.flag_initsollanfahr_iae_S6_S3 /end COMPU_METHOD
/begin COMPU_METHOD Conv.cIaeMomen._.flag_t_ueffix_iae_S6_S3 "Umrechnung fuer Messgroesse cIaeMomen::flag_t_ueffix_iae" TAB_VERB "%4.0" "" COMPU_TAB_REF Conv.cIaeMomen._.flag_t_ueffix_iae_S6_S3 /end COMPU_METHOD
/begin COMPU_METHOD Conv.cIaeMomen._.flag_kaltanfahren_aktiv_iae_S6_S3 "Umrechnung fuer Messgroesse cIaeMomen::flag_kaltanfahren_aktiv_iae" TAB_VERB "%4.0" "" COMPU_TAB_REF Conv.cIaeMomen._.flag_kaltanfahren_aktiv_iae_S6_S3 /end COMPU_METHOD
/begin COMPU_METHOD Conv.cIaeMomen._.flag_stall_anfahr_iae_S6_S3 "Umrechnung fuer Messgroesse cIaeMomen::flag_stall_anfahr_iae" TAB_VERB "%4.0" "" COMPU_TAB_REF Conv.cIaeMomen._.flag_stall_anfahr_iae_S6_S3 /end COMPU_METHOD
/begin COMPU_METHOD Conv.cIaeMomen._.flag_schrittschaltung_merk_iae_S6_S3 "Umrechnung fuer Messgroesse cIaeMomen::flag_schrittschaltung_merk_iae" TAB_VERB "%4.0" "" COMPU_TAB_REF Conv.cIaeMomen._.flag_schrittschaltung_merk_iae_S6_S3 /end COMPU_METHOD
/begin COMPU_METHOD Conv.cIaeMomen._.flag_f_m_basis_anfahrt_init_S6_S3 "Umrechnung fuer Messgroesse cIaeMomen::flag_f_m_basis_anfahrt_init" TAB_VERB "%4.0" "" COMPU_TAB_REF Conv.cIaeMomen._.flag_f_m_basis_anfahrt_init_S6_S3 /end COMPU_METHOD
/begin COMPU_METHOD Conv.cIaeMomen._.flag_miaeauf_keinkfl_iae_S6_S3 "Umrechnung fuer Messgroesse cIaeMomen::flag_miaeauf_keinkfl_iae" TAB_VERB "%4.0" "" COMPU_TAB_REF Conv.cIaeMomen._.flag_miaeauf_keinkfl_iae_S6_S3 /end COMPU_METHOD
/begin COMPU_METHOD Conv.cIaeMomen._.z_rampe_miaeauf_S6_S3 "Umrechnung fuer Messgroesse cIaeMomen::z_rampe_miaeauf" TAB_VERB "%4.0" "" COMPU_TAB_REF Conv.cIaeMomen._.z_rampe_miaeauf_S6_S3 /end COMPU_METHOD
/begin COMPU_METHOD Conv.cIaeMomen._.typ_uef_m_S6_S3 "Umrechnung fuer Messgroesse cIaeMomen::typ_uef_m" TAB_VERB "%4.0" "" COMPU_TAB_REF Conv.cIaeMomen._.typ_uef_m_S6_S3 /end COMPU_METHOD
/begin COMPU_METHOD Conv.cIaeMomen._.flag_regler_aktiv_S6_S3 "Umrechnung fuer Messgroesse cIaeMomen::flag_regler_aktiv" TAB_VERB "%4.0" "" COMPU_TAB_REF Conv.cIaeMomen._.flag_regler_aktiv_S6_S3 /end COMPU_METHOD
/begin COMPU_METHOD Conv.cIaeMomen._.flag_first_reglerinit_iae_S6_S3 "Umrechnung fuer Messgroesse cIaeMomen::flag_first_reglerinit_iae" TAB_VERB "%4.0" "" COMPU_TAB_REF Conv.cIaeMomen._.flag_first_reglerinit_iae_S6_S3 /end COMPU_METHOD
/begin COMPU_METHOD Conv.cIaeMomen._.z_mo_kriech_aktiv_iae_S6_S3 "Umrechnung fuer Messgroesse cIaeMomen::z_mo_kriech_aktiv_iae" TAB_VERB "%4.0" "" COMPU_TAB_REF Conv.cIaeMomen._.z_mo_kriech_aktiv_iae_S6_S3 /end COMPU_METHOD
/begin COMPU_METHOD Conv.cIaeMomen._.z_modusiae_temp_S6_S3 "Umrechnung fuer Messgroesse cIaeMomen::z_modusiae_temp" TAB_VERB "%4.0" "" COMPU_TAB_REF Conv.cIaeMomen._.z_modusiae_temp_S6_S3 /end COMPU_METHOD
/begin COMPU_METHOD Conv.cIaeMomen._.flag_zu_erreicht_iae_S6_S3 "Umrechnung fuer Messgroesse cIaeMomen::flag_zu_erreicht_iae" TAB_VERB "%4.0" "" COMPU_TAB_REF Conv.cIaeMomen._.flag_zu_erreicht_iae_S6_S3 /end COMPU_METHOD
/begin COMPU_METHOD Conv.cIaeMomen._.flag_nsmotmaxc_iae_S6_S3 "Umrechnung fuer Messgroesse cIaeMomen::flag_nsmotmaxc_iae" TAB_VERB "%4.0" "" COMPU_TAB_REF Conv.cIaeMomen._.flag_nsmotmaxc_iae_S6_S3 /end COMPU_METHOD
/begin COMPU_METHOD Conv.cIaeMomen._.flag_kriechmax_ramp_S6_S3 "Umrechnung fuer Messgroesse cIaeMomen::flag_kriechmax_ramp" TAB_VERB "%4.0" "" COMPU_TAB_REF Conv.cIaeMomen._.flag_kriechmax_ramp_S6_S3 /end COMPU_METHOD
/begin COMPU_METHOD Conv.cIaeMomen._.typ_uef_miaeaufanf_iae_S6_S3 "Umrechnung fuer Messgroesse cIaeMomen::typ_uef_miaeaufanf_iae" TAB_VERB "%4.0" "" COMPU_TAB_REF Conv.cIaeMomen._.typ_uef_miaeaufanf_iae_S6_S3 /end COMPU_METHOD
/begin COMPU_METHOD Conv.cIaeMomen._.flag_initmistvorst_iae_S6_S3 "Umrechnung fuer Messgroesse cIaeMomen::flag_initmistvorst_iae" TAB_VERB "%4.0" "" COMPU_TAB_REF Conv.cIaeMomen._.flag_initmistvorst_iae_S6_S3 /end COMPU_METHOD
/begin COMPU_METHOD Conv.cIaeMomen._.kfl_ziel_tmp_iae_S6_S3 "Umrechnung fuer Messgroesse cIaeMomen::kfl_ziel_tmp_iae" TAB_VERB "%4.0" "" COMPU_TAB_REF Conv.cIaeMomen._.kfl_ziel_tmp_iae_S6_S3 /end COMPU_METHOD
/begin COMPU_METHOD Conv.cIaeMomen._.flag_pulscue_aktiv_iae_S6_S3 "Umrechnung fuer Messgroesse cIaeMomen::flag_pulscue_aktiv_iae" TAB_VERB "%4.0" "" COMPU_TAB_REF Conv.cIaeMomen._.flag_pulscue_aktiv_iae_S6_S3 /end COMPU_METHOD
/begin COMPU_METHOD Conv.cIaeMomen._.flag_schaltung_aktiv_iae_S6_S3 "Umrechnung fuer Messgroesse cIaeMomen::flag_schaltung_aktiv_iae" TAB_VERB "%4.0" "" COMPU_TAB_REF Conv.cIaeMomen._.flag_schaltung_aktiv_iae_S6_S3 /end COMPU_METHOD
/begin COMPU_METHOD Conv.cIaeMomen._.flag_mvorberechnug_aktiv_iae_S6_S3 "Umrechnung fuer Messgroesse cIaeMomen::flag_mvorberechnug_aktiv_iae" TAB_VERB "%4.0" "" COMPU_TAB_REF Conv.cIaeMomen._.flag_mvorberechnug_aktiv_iae_S6_S3 /end COMPU_METHOD
/begin COMPU_METHOD Conv.cIaeMomen._.status_uef_zu_kriech_init_iae_S6_S3 "Umrechnung fuer Messgroesse cIaeMomen::status_uef_zu_kriech_init_iae" TAB_VERB "%4.0" "" COMPU_TAB_REF Conv.cIaeMomen._.status_uef_zu_kriech_init_iae_S6_S3 /end COMPU_METHOD
/begin COMPU_METHOD Conv.cIaeMomen._.st_anfagradbegrenz_iae_S6_S3 "Umrechnung fuer Messgroesse cIaeMomen::st_anfagradbegrenz_iae" TAB_VERB "%4.0" "" COMPU_TAB_REF Conv.cIaeMomen._.st_anfagradbegrenz_iae_S6_S3 /end COMPU_METHOD
/begin COMPU_METHOD Conv.cIaeDiagn._.flag_close_diagiae_S6_S3 "Umrechnung fuer Messgroesse cIaeDiagn::flag_close_diagiae" TAB_VERB "%4.0" "" COMPU_TAB_REF Conv.cIaeDiagn._.flag_close_diagiae_S6_S3 /end COMPU_METHOD
/begin COMPU_METHOD Conv.cIaeDiagn._.flag_noopen_diagiae_S6_S3 "Umrechnung fuer Messgroesse cIaeDiagn::flag_noopen_diagiae" TAB_VERB "%4.0" "" COMPU_TAB_REF Conv.cIaeDiagn._.flag_noopen_diagiae_S6_S3 /end COMPU_METHOD
/begin COMPU_METHOD Conv.cIaeDiagn._.flag_noclose_diagiae_S6_S3 "Umrechnung fuer Messgroesse cIaeDiagn::flag_noclose_diagiae" TAB_VERB "%4.0" "" COMPU_TAB_REF Conv.cIaeDiagn._.flag_noclose_diagiae_S6_S3 /end COMPU_METHOD
/begin COMPU_METHOD Conv.cIaeDiagn._.flag_hot_diagiae_S6_S3 "Umrechnung fuer Messgroesse cIaeDiagn::flag_hot_diagiae" TAB_VERB "%4.0" "" COMPU_TAB_REF Conv.cIaeDiagn._.flag_hot_diagiae_S6_S3 /end COMPU_METHOD
/begin COMPU_METHOD Conv.cIaeDiagn._.flag_timer_hot_diagiae_S6_S3 "Umrechnung fuer Messgroesse cIaeDiagn::flag_timer_hot_diagiae" TAB_VERB "%4.0" "" COMPU_TAB_REF Conv.cIaeDiagn._.flag_timer_hot_diagiae_S6_S3 /end COMPU_METHOD
/begin COMPU_METHOD Conv.cIaeDiagn._.flag_spassfahrt_diagiae_S6_S3 "Umrechnung fuer Messgroesse cIaeDiagn::flag_spassfahrt_diagiae" TAB_VERB "%4.0" "" COMPU_TAB_REF Conv.cIaeDiagn._.flag_spassfahrt_diagiae_S6_S3 /end COMPU_METHOD
/begin COMPU_METHOD Conv.cIaeDiagn._.flag_sammelbed_diagiae_S6_S3 "Umrechnung fuer Messgroesse cIaeDiagn::flag_sammelbed_diagiae" TAB_VERB "%4.0" "" COMPU_TAB_REF Conv.cIaeDiagn._.flag_sammelbed_diagiae_S6_S3 /end COMPU_METHOD
/begin COMPU_METHOD Conv.cIaeDiagn._.flag_max_p_haupt_diagiae_S6_S3 "Umrechnung fuer Messgroesse cIaeDiagn::flag_max_p_haupt_diagiae" TAB_VERB "%4.0" "" COMPU_TAB_REF Conv.cIaeDiagn._.flag_max_p_haupt_diagiae_S6_S3 /end COMPU_METHOD
/begin COMPU_METHOD Conv.cIaeDiagn._.flag_mmot_gespeichert_diagiae_S6_S3 "Umrechnung fuer Messgroesse cIaeDiagn::flag_mmot_gespeichert_diagiae" TAB_VERB "%4.0" "" COMPU_TAB_REF Conv.cIaeDiagn._.flag_mmot_gespeichert_diagiae_S6_S3 /end COMPU_METHOD
/begin COMPU_METHOD Conv.cIaeDiagn._.flag_rueckf_mmot_diagiae_S6_S3 "Umrechnung fuer Messgroesse cIaeDiagn::flag_rueckf_mmot_diagiae" TAB_VERB "%4.0" "" COMPU_TAB_REF Conv.cIaeDiagn._.flag_rueckf_mmot_diagiae_S6_S3 /end COMPU_METHOD
/begin COMPU_METHOD Conv.cIaeDiagn._.flag_rueckf_msollnmot_diagiae_S6_S3 "Umrechnung fuer Messgroesse cIaeDiagn::flag_rueckf_msollnmot_diagiae" TAB_VERB "%4.0" "" COMPU_TAB_REF Conv.cIaeDiagn._.flag_rueckf_msollnmot_diagiae_S6_S3 /end COMPU_METHOD
/begin COMPU_METHOD Conv.cIaeDiagn._.flag_noclose_hogez_diagiae_S6_S3 "Umrechnung fuer Messgroesse cIaeDiagn::flag_noclose_hogez_diagiae" TAB_VERB "%4.0" "" COMPU_TAB_REF Conv.cIaeDiagn._.flag_noclose_hogez_diagiae_S6_S3 /end COMPU_METHOD
/begin COMPU_METHOD Conv.cIaeDiagn._.flag_close_bew_aktiv_diagiae_S6_S3 "Umrechnung fuer Messgroesse cIaeDiagn::flag_close_bew_aktiv_diagiae" TAB_VERB "%4.0" "" COMPU_TAB_REF Conv.cIaeDiagn._.flag_close_bew_aktiv_diagiae_S6_S3 /end COMPU_METHOD
/begin COMPU_METHOD Conv.cIaeDiagn._.flag_noopen_bew_aktiv_diagiae_S6_S3 "Umrechnung fuer Messgroesse cIaeDiagn::flag_noopen_bew_aktiv_diagiae" TAB_VERB "%4.0" "" COMPU_TAB_REF Conv.cIaeDiagn._.flag_noopen_bew_aktiv_diagiae_S6_S3 /end COMPU_METHOD
/begin COMPU_METHOD Conv.cIaeDiagn._.flag_noclose_bew_aktiv_diagiae_S6_S3 "Umrechnung fuer Messgroesse cIaeDiagn::flag_noclose_bew_aktiv_diagiae" TAB_VERB "%4.0" "" COMPU_TAB_REF Conv.cIaeDiagn._.flag_noclose_bew_aktiv_diagiae_S6_S3 /end COMPU_METHOD
/begin COMPU_METHOD Conv.cIaeDiagn._.status_iae_hotinfo_S6_S3 "Umrechnung fuer Messgroesse cIaeDiagn::status_iae_hotinfo" TAB_VERB "%4.0" "" COMPU_TAB_REF Conv.cIaeDiagn._.status_iae_hotinfo_S6_S3 /end COMPU_METHOD
/begin COMPU_METHOD Conv.cIaeDiagn._.z_close_diagiae_S6_S3 "Umrechnung fuer Messgroesse cIaeDiagn::z_close_diagiae" TAB_VERB "%4.0" "" COMPU_TAB_REF Conv.cIaeDiagn._.z_close_diagiae_S6_S3 /end COMPU_METHOD
/begin COMPU_METHOD Conv.cIaeTempm._.z_temp_init_iae_S6_S3 "Umrechnung fuer Messgroesse cIaeTempm::z_temp_init_iae" TAB_VERB "%4.0" "" COMPU_TAB_REF Conv.cIaeTempm._.z_temp_init_iae_S6_S3 /end COMPU_METHOD
/begin COMPU_METHOD Conv.cIaeTempm._.flag_tempsperr_timerini_iae_S6_S3 "Umrechnung fuer Messgroesse cIaeTempm::flag_tempsperr_timerini_iae" TAB_VERB "%4.0" "" COMPU_TAB_REF Conv.cIaeTempm._.flag_tempsperr_timerini_iae_S6_S3 /end COMPU_METHOD
/begin COMPU_METHOD Conv.cIaeMotmx._.flag_stallspeed_iae_S6_S3 "Umrechnung fuer Messgroesse cIaeMotmx::flag_stallspeed_iae" TAB_VERB "%4.0" "" COMPU_TAB_REF Conv.cIaeMotmx._.flag_stallspeed_iae_S6_S3 /end COMPU_METHOD
/begin COMPU_METHOD Conv.cIaeMotmx._.flag_motmaxndiff_iae_S6_S3 "Umrechnung fuer Messgroesse cIaeMotmx::flag_motmaxndiff_iae" TAB_VERB "%4.0" "" COMPU_TAB_REF Conv.cIaeMotmx._.flag_motmaxndiff_iae_S6_S3 /end COMPU_METHOD
/begin COMPU_METHOD Conv.cIaeMotmx._.flag_motmaxregdiff_iae_S6_S3 "Umrechnung fuer Messgroesse cIaeMotmx::flag_motmaxregdiff_iae" TAB_VERB "%4.0" "" COMPU_TAB_REF Conv.cIaeMotmx._.flag_motmaxregdiff_iae_S6_S3 /end COMPU_METHOD
/begin COMPU_METHOD Conv.cIaeMotmx._.flag_motmaxstall_iae_S6_S3 "Umrechnung fuer Messgroesse cIaeMotmx::flag_motmaxstall_iae" TAB_VERB "%4.0" "" COMPU_TAB_REF Conv.cIaeMotmx._.flag_motmaxstall_iae_S6_S3 /end COMPU_METHOD
/begin COMPU_METHOD Conv.cIaeMotmx._.flag_motmaxtemp_iae_S6_S3 "Umrechnung fuer Messgroesse cIaeMotmx::flag_motmaxtemp_iae" TAB_VERB "%4.0" "" COMPU_TAB_REF Conv.cIaeMotmx._.flag_motmaxtemp_iae_S6_S3 /end COMPU_METHOD
/begin COMPU_METHOD Conv.cIaeMotmx._.flag_timermotmaxtemp_iae_S6_S3 "Umrechnung fuer Messgroesse cIaeMotmx::flag_timermotmaxtemp_iae" TAB_VERB "%4.0" "" COMPU_TAB_REF Conv.cIaeMotmx._.flag_timermotmaxtemp_iae_S6_S3 /end COMPU_METHOD
/begin COMPU_METHOD Conv.cSasAnGea._.gea_ablauf_aktiv_S6_S3 "Umrechnung fuer Messgroesse cSasAnGea::gea_ablauf_aktiv" TAB_VERB "%4.0" "" COMPU_TAB_REF Conv.cSasAnGea._.gea_ablauf_aktiv_S6_S3 /end COMPU_METHOD
/begin COMPU_METHOD Conv.cSasAnGea._.ra1_ge_gestartet_S6_S3 "Umrechnung fuer Messgroesse cSasAnGea::ra1_ge_gestartet" TAB_VERB "%4.0" "" COMPU_TAB_REF Conv.cSasAnGea._.ra1_ge_gestartet_S6_S3 /end COMPU_METHOD
/begin COMPU_METHOD Conv.cSasAnGea._.ra2_ge_gestartet_S6_S3 "Umrechnung fuer Messgroesse cSasAnGea::ra2_ge_gestartet" TAB_VERB "%4.0" "" COMPU_TAB_REF Conv.cSasAnGea._.ra2_ge_gestartet_S6_S3 /end COMPU_METHOD
/begin COMPU_METHOD Conv.cSasAnGea._.ra3_ge_gestartet_S6_S3 "Umrechnung fuer Messgroesse cSasAnGea::ra3_ge_gestartet" TAB_VERB "%4.0" "" COMPU_TAB_REF Conv.cSasAnGea._.ra3_ge_gestartet_S6_S3 /end COMPU_METHOD
/begin COMPU_METHOD Conv.cSasAnGea._.synchron_verboten_S6_S3 "Umrechnung fuer Messgroesse cSasAnGea::synchron_verboten" TAB_VERB "%4.0" "" COMPU_TAB_REF Conv.cSasAnGea._.synchron_verboten_S6_S3 /end COMPU_METHOD
/begin COMPU_METHOD Conv.cSasAnGea._.erste_schaltung_S6_S3 "Umrechnung fuer Messgroesse cSasAnGea::erste_schaltung" TAB_VERB "%4.0" "" COMPU_TAB_REF Conv.cSasAnGea._.erste_schaltung_S6_S3 /end COMPU_METHOD
/begin COMPU_METHOD Conv.cSasAnGea._.f_verb_ada_erste_bef_S6_S3 "Umrechnung fuer Messgroesse cSasAnGea::f_verb_ada_erste_bef" TAB_VERB "%4.0" "" COMPU_TAB_REF Conv.cSasAnGea._.f_verb_ada_erste_bef_S6_S3 /end COMPU_METHOD
/begin COMPU_METHOD Conv.cSasAnGea._.ende_kab_gestartet_S6_S3 "Umrechnung fuer Messgroesse cSasAnGea::ende_kab_gestartet" TAB_VERB "%4.0" "" COMPU_TAB_REF Conv.cSasAnGea._.ende_kab_gestartet_S6_S3 /end COMPU_METHOD
/begin COMPU_METHOD Conv.cSasAnGea._.fa_kzu_gestartet_S6_S3 "Umrechnung fuer Messgroesse cSasAnGea::fa_kzu_gestartet" TAB_VERB "%4.0" "" COMPU_TAB_REF Conv.cSasAnGea._.fa_kzu_gestartet_S6_S3 /end COMPU_METHOD
/begin COMPU_METHOD Conv.cSasAnGea._.schliessen_kup_in_n_gestartet_S6_S3 "Umrechnung fuer Messgroesse cSasAnGea::schliessen_kup_in_n_gestartet" TAB_VERB "%4.0" "" COMPU_TAB_REF Conv.cSasAnGea._.schliessen_kup_in_n_gestartet_S6_S3 /end COMPU_METHOD
/begin COMPU_METHOD Conv.cSasAnGea._.statisch_gea_S6_S3 "Umrechnung fuer Messgroesse cSasAnGea::statisch_gea" TAB_VERB "%4.0" "" COMPU_TAB_REF Conv.cSasAnGea._.statisch_gea_S6_S3 /end COMPU_METHOD
/begin COMPU_METHOD Conv.cSasAnGea._.z_gea_S6_S3 "Umrechnung fuer Messgroesse cSasAnGea::z_gea" TAB_VERB "%4.0" "" COMPU_TAB_REF Conv.cSasAnGea._.z_gea_S6_S3 /end COMPU_METHOD
/begin COMPU_METHOD Conv.cSasAnGea._.f_timeout_S6_S3 "Umrechnung fuer Messgroesse cSasAnGea::f_timeout" TAB_VERB "%4.0" "" COMPU_TAB_REF Conv.cSasAnGea._.f_timeout_S6_S3 /end COMPU_METHOD
/begin COMPU_METHOD Conv.cSasAnGea._.schalttyp_gea_S6_S3 "Umrechnung fuer Messgroesse cSasAnGea::schalttyp_gea" TAB_VERB "%4.0" "" COMPU_TAB_REF Conv.cSasAnGea._.schalttyp_gea_S6_S3 /end COMPU_METHOD
/begin COMPU_METHOD Conv.cSasAnGea._.schnellfuellung_beendet_S6_S3 "Umrechnung fuer Messgroesse cSasAnGea::schnellfuellung_beendet" TAB_VERB "%4.0" "" COMPU_TAB_REF Conv.cSasAnGea._.schnellfuellung_beendet_S6_S3 /end COMPU_METHOD
/begin COMPU_METHOD Conv.cSasAnGea._.f_schnellfuellung_gestartet_S6_S3 "Umrechnung fuer Messgroesse cSasAnGea::f_schnellfuellung_gestartet" TAB_VERB "%4.0" "" COMPU_TAB_REF Conv.cSasAnGea._.f_schnellfuellung_gestartet_S6_S3 /end COMPU_METHOD
/begin COMPU_METHOD Conv.cSasAnGea._.instanz_nr_S6_S3 "Umrechnung fuer Messgroesse cSasAnGea::instanz_nr" TAB_VERB "%4.0" "" COMPU_TAB_REF Conv.cSasAnGea._.instanz_nr_S6_S3 /end COMPU_METHOD
/begin COMPU_METHOD Conv.cSasAnGea._.kzu_voll_bei_start_S6_S3 "Umrechnung fuer Messgroesse cSasAnGea::kzu_voll_bei_start" TAB_VERB "%4.0" "" COMPU_TAB_REF Conv.cSasAnGea._.kzu_voll_bei_start_S6_S3 /end COMPU_METHOD
/begin COMPU_METHOD Conv.cSasAnGea._.f_pokzu_kfl_zuletzt_wechsel_S6_S3 "Umrechnung fuer Messgroesse cSasAnGea::f_pokzu_kfl_zuletzt_wechsel" TAB_VERB "%4.0" "" COMPU_TAB_REF Conv.cSasAnGea._.f_pokzu_kfl_zuletzt_wechsel_S6_S3 /end COMPU_METHOD
/begin COMPU_METHOD Conv.cSasAnGea._.f_pfmin_erreicht_S6_S3 "Umrechnung fuer Messgroesse cSasAnGea::f_pfmin_erreicht" TAB_VERB "%4.0" "" COMPU_TAB_REF Conv.cSasAnGea._.f_pfmin_erreicht_S6_S3 /end COMPU_METHOD
/begin COMPU_METHOD Conv.cSasAnGea._.kup_ge_S6_S3 "Umrechnung fuer Messgroesse cSasAnGea::kup_ge" TAB_VERB "%4.0" "" COMPU_TAB_REF Conv.cSasAnGea._.kup_ge_S6_S3 /end COMPU_METHOD
/begin COMPU_METHOD Conv.cSasAnGea._.kup_ga_S6_S3 "Umrechnung fuer Messgroesse cSasAnGea::kup_ga" TAB_VERB "%4.0" "" COMPU_TAB_REF Conv.cSasAnGea._.kup_ga_S6_S3 /end COMPU_METHOD
/begin COMPU_METHOD Conv.cSasAnGea._.po_fkzu_aktiv_S6_S3 "Umrechnung fuer Messgroesse cSasAnGea::po_fkzu_aktiv" TAB_VERB "%4.0" "" COMPU_TAB_REF Conv.cSasAnGea._.po_fkzu_aktiv_S6_S3 /end COMPU_METHOD
/begin COMPU_VTAB Conv.cKorGskup._.kup_gsk_S6_S3 "Umrechnung fuer Messgroesse cKorGskup::kup_gsk" TAB_VERB 6 0 "KEINE" 1 "K_A" 2 "K_B" 3 "K_C" 4 "K_D" 5 "K_E" /end COMPU_VTAB
/begin COMPU_VTAB Conv.cKorGskup._.gsk_funktion_S6_S3 "Umrechnung fuer Messgroesse cKorGskup::gsk_funktion" TAB_VERB 5 0 "GSKFKT_PASSIV" 1 "GSKFKT_SAD" 2 "GSKFKT_BYPASS" 3 "GSKFKT_CSC" 4 "GSKFKT_IAE" /end COMPU_VTAB
/begin COMPU_VTAB Conv.cKorGskup._.gsk_aktiv_S6_S3 "Umrechnung fuer Messgroesse cKorGskup::gsk_aktiv" TAB_VERB 2 0 "GSK nicht aktiv" 1 "GSK aktiv" /end COMPU_VTAB
/begin COMPU_VTAB Conv.cKorGskup._.f_kraftschl_kup_fa_S6_S3 "Umrechnung fuer Messgroesse cKorGskup::f_kraftschl_kup_fa" TAB_VERB 2 0 "noch nicht im FA" 1 "im FA oder schon weiter" /end COMPU_VTAB
/begin COMPU_VTAB Conv.cKorGskup._.fehler_gsk_regeln_verboten_S6_S3 "Umrechnung fuer Messgroesse cKorGskup::fehler_gsk_regeln_verboten" TAB_VERB 2 0 "Regeln der GSK nicht erlaubt" 1 "Regeln der GSK erlaubt" /end COMPU_VTAB
/begin COMPU_VTAB Conv.cKorGskup._.gsk_zustand_S6_S3 "Umrechnung fuer Messgroesse cKorGskup::gsk_zustand" TAB_VERB 7 0 "GSK_INAKTIV" 1 "GSK_STARTRAMPE" 2 "GSK_EINREGELN" 3 "SBC-Betrieb" 4 "AFU-Betrieb" 5 "LC=Rennstartautomatik" 6 "GSK_KPL_ZU" /end COMPU_VTAB
/begin COMPU_VTAB Conv.cKorGskup._.f_gsk_schlupft_S6_S3 "Umrechnung fuer Messgroesse cKorGskup::f_gsk_schlupft" TAB_VERB 2 0 "GSK nicht aktiv oder QuGskSchlupft wurde nicht abgefrag" 1 "GSK aktiv und QuGskSchlupft abgefragt" /end COMPU_VTAB
/begin COMPU_VTAB Conv.cKasEkopl._.z_entkoppeln_S6_S3 "Umrechnung fuer Messgroesse cKasEkopl::z_entkoppeln" TAB_VERB 4 0 "Entkoppeln PASSIV" 1 "Entkoppeln Oeffnen" 2 "Entkoppeln Entkoppeln" 3 "Entkoppeln Schliessen" /end COMPU_VTAB
/begin COMPU_VTAB Conv.cKasEkopl._.flag_mo_aktiv_entkoppl_S6_S3 "Umrechnung fuer Messgroesse cKasEkopl::flag_mo_aktiv_entkoppl" TAB_VERB 2 0 "FALSE" 1 "TRUE" /end COMPU_VTAB
/begin COMPU_VTAB Conv.cIaeKordi._.z_iae_S6_S3 "Umrechnung fuer Messgroesse cIaeKordi::z_iae" TAB_VERB 10 0 "IAE nicht definiert" 1 "IAE PASSIV" 2 "IAE Angelegt" 3 "IAE Kriechen" 4 "IAE H-Anfahren" 5 "IAE E-Anfahren" 6 "IAE E-Anfahren entkoppelt" 7 "IAE Synchronisieren" 8 "IAE Zu" 9 "IAE Entkoppelt" /end COMPU_VTAB
/begin COMPU_VTAB Conv.cIaeKordi._.z_iae_temp_S6_S3 "Umrechnung fuer Messgroesse cIaeKordi::z_iae_temp" TAB_VERB 10 0 "IAE nicht definiert" 1 "IAE PASSIV" 2 "IAE Angelegt" 3 "IAE Kriechen" 4 "IAE H-Anfahren" 5 "IAE E-Anfahren" 6 "IAE E-Anfahren entkoppelt" 7 "IAE Synchronisieren" 8 "IAE Zu" 9 "IAE Entkoppelt" /end COMPU_VTAB
/begin COMPU_VTAB Conv.cIaeKordi._.flag_zu_gewesen_iae_S6_S3 "Umrechnung fuer Messgroesse cIaeKordi::flag_zu_gewesen_iae" TAB_VERB 2 0 "FALSE" 1 "TRUE" /end COMPU_VTAB
/begin COMPU_VTAB Conv.cIaeKordi._.kup_status_iae_S6_S3 "Umrechnung fuer Messgroesse cIaeKordi::kup_status_iae" TAB_VERB 9 0 "Funktion hat kein zugriff auf IAE" 1 "IAE offen" 2 "IAE angelegt" 3 "IAE Schlupfend" 4 "IAE Schlupf während Schleppstart" 5 "IAE Schlupf während Schleppstart im Anfahren" 6 "IAE baut Restschlupf ab" 7 "IAE vollständig zu" 8 "IAE oeffnet" /end COMPU_VTAB
/begin COMPU_VTAB Conv.cIaeAdauf._.zielgang_start_uefiae_S6_S3 "Umrechnung fuer Messgroesse cIaeAdauf::zielgang_start_uefiae" TAB_VERB 10 -1 "GR1" 0 "KEIN_GANG" 1 "G1" 2 "G2" 3 "G3" 4 "G4" 5 "G5" 6 "G6" 7 "G7" 8 "G8" /end COMPU_VTAB
/begin COMPU_VTAB Conv.cIaeAdauf._.kfl_ziel_start_uefiea_S6_S3 "Umrechnung fuer Messgroesse cIaeAdauf::kfl_ziel_start_uefiea" TAB_VERB 3 0 "KEIN_KFL" 1 "KFL_VORWAERTS" 2 "KFL_RUECKWAERTS" /end COMPU_VTAB
/begin COMPU_VTAB Conv.cIaeAdauf._.z_ada_uefiae_S6_S3 "Umrechnung fuer Messgroesse cIaeAdauf::z_ada_uefiae" TAB_VERB 2 0 "Z_ADA_UEFIAE_PASSIV" 1 "Z_ADA_UEFIAE_BEOBACHTEN" /end COMPU_VTAB
/begin COMPU_VTAB Conv.cIaeDraus._.z_hyskomp_iae_S6_S3 "Umrechnung fuer Messgroesse cIaeDraus::z_hyskomp_iae" TAB_VERB 5 0 "inaktiv" 1 "abrampen" 2 "halten" 3 "rausfiltern" 4 "Warten auf Einstieg" /end COMPU_VTAB
/begin COMPU_VTAB Conv.cIaeDraus._.flag_p_stell_max_iae_S6_S3 "Umrechnung fuer Messgroesse cIaeDraus::flag_p_stell_max_iae" TAB_VERB 2 0 "FALSE" 1 "TRUE" /end COMPU_VTAB
/begin COMPU_VTAB Conv.cIaeDraus._.f_hysschleife_aktiv_iae_S6_S3 "Umrechnung fuer Messgroesse cIaeDraus::f_hysschleife_aktiv_iae" TAB_VERB 2 0 "FALSE" 1 "TRUE" /end COMPU_VTAB
/begin COMPU_VTAB Conv.cIaeDraus._.f_hysschleife_moeglich_iae_S6_S3 "Umrechnung fuer Messgroesse cIaeDraus::f_hysschleife_moeglich_iae" TAB_VERB 2 0 "FALSE" 1 "TRUE" /end COMPU_VTAB
/begin COMPU_VTAB Conv.cIaeDraus._.flag_po_dyn_aktiv_iae_S6_S3 "Umrechnung fuer Messgroesse cIaeDraus::flag_po_dyn_aktiv_iae" TAB_VERB 2 0 "FALSE" 1 "TRUE" /end COMPU_VTAB
/begin COMPU_VTAB Conv.cIaeDraus._.flag_m_max_alt_S6_S3 "Umrechnung fuer Messgroesse cIaeDraus::flag_m_max_alt" TAB_VERB 2 0 "FALSE" 1 "TRUE" /end COMPU_VTAB
/begin COMPU_VTAB Conv.cIaeDraus._.flag_init_ausinaktiv_iae_S6_S3 "Umrechnung fuer Messgroesse cIaeDraus::flag_init_ausinaktiv_iae" TAB_VERB 2 0 "FALSE" 1 "TRUE" /end COMPU_VTAB
/begin COMPU_VTAB Conv.cIaeSigna._.asr_regelt_iae_S6_S3 "Umrechnung fuer Messgroesse cIaeSigna::asr_regelt_iae" TAB_VERB 2 0 "FALSE" 1 "TRUE" /end COMPU_VTAB
/begin COMPU_VTAB Conv.cIaeSigna._.flag_init_signa_iae_S6_S3 "Umrechnung fuer Messgroesse cIaeSigna::flag_init_signa_iae" TAB_VERB 2 0 "FALSE" 1 "TRUE" /end COMPU_VTAB
/begin COMPU_VTAB Conv.cIaeSigna._.flag_mreibzumstell_iae_S6_S3 "Umrechnung fuer Messgroesse cIaeSigna::flag_mreibzumstell_iae" TAB_VERB 2 0 "FALSE" 1 "TRUE" /end COMPU_VTAB
/begin COMPU_VTAB Conv.cIaeSigna._.fas_aktiv_iae_S6_S3 "Umrechnung fuer Messgroesse cIaeSigna::fas_aktiv_iae" TAB_VERB 2 0 "FALSE" 1 "TRUE" /end COMPU_VTAB
/begin COMPU_VTAB Conv.cIaeSigna._.f_brems_angelegt_iae_S6_S3 "Umrechnung fuer Messgroesse cIaeSigna::f_brems_angelegt_iae" TAB_VERB 2 0 "FALSE" 1 "TRUE" /end COMPU_VTAB
/begin COMPU_VTAB Conv.cIaeSigna._.f_angelegt_iae_S6_S3 "Umrechnung fuer Messgroesse cIaeSigna::f_angelegt_iae" TAB_VERB 2 0 "FALSE" 1 "TRUE" /end COMPU_VTAB
/begin COMPU_VTAB Conv.cIaeSigna._.kfl_sollneutral_iae_S6_S3 "Umrechnung fuer Messgroesse cIaeSigna::kfl_sollneutral_iae" TAB_VERB 2 0 "FALSE" 1 "TRUE" /end COMPU_VTAB
/begin COMPU_VTAB Conv.cIaeSigna._.n_ab_dir_iae_S6_S3 "Umrechnung fuer Messgroesse cIaeSigna::n_ab_dir_iae" TAB_VERB 2 -1 "Drehrichtung entgegen dem Fahrbetrieb" 1 "Drehrichtung in Fahrbetriebsrichtung" /end COMPU_VTAB
/begin COMPU_VTAB Conv.cIaeSigna._.z_nmotll_aktiv_iae_S6_S3 "Umrechnung fuer Messgroesse cIaeSigna::z_nmotll_aktiv_iae" TAB_VERB 2 0 "nicht aktiv" 1 "aktiv" /end COMPU_VTAB
/begin COMPU_VTAB Conv.cIaeMomen._.flag_ueflaeuft_iae_S6_S3 "Umrechnung fuer Messgroesse cIaeMomen::flag_ueflaeuft_iae" TAB_VERB 2 0 "FALSE" 1 "TRUE" /end COMPU_VTAB
/begin COMPU_VTAB Conv.cIaeMomen._.flag_initsoll_einmal_iae_S6_S3 "Umrechnung fuer Messgroesse cIaeMomen::flag_initsoll_einmal_iae" TAB_VERB 2 0 "FALSE" 1 "TRUE" /end COMPU_VTAB
/begin COMPU_VTAB Conv.cIaeMomen._.flag_initsollanfahr_iae_S6_S3 "Umrechnung fuer Messgroesse cIaeMomen::flag_initsollanfahr_iae" TAB_VERB 2 0 "FALSE" 1 "TRUE" /end COMPU_VTAB
/begin COMPU_VTAB Conv.cIaeMomen._.flag_t_ueffix_iae_S6_S3 "Umrechnung fuer Messgroesse cIaeMomen::flag_t_ueffix_iae" TAB_VERB 2 0 "FALSE" 1 "TRUE" /end COMPU_VTAB
/begin COMPU_VTAB Conv.cIaeMomen._.flag_kaltanfahren_aktiv_iae_S6_S3 "Umrechnung fuer Messgroesse cIaeMomen::flag_kaltanfahren_aktiv_iae" TAB_VERB 2 0 "FALSE" 1 "TRUE" /end COMPU_VTAB
/begin COMPU_VTAB Conv.cIaeMomen._.flag_stall_anfahr_iae_S6_S3 "Umrechnung fuer Messgroesse cIaeMomen::flag_stall_anfahr_iae" TAB_VERB 2 0 "FALSE" 1 "TRUE" /end COMPU_VTAB
/begin COMPU_VTAB Conv.cIaeMomen._.flag_schrittschaltung_merk_iae_S6_S3 "Umrechnung fuer Messgroesse cIaeMomen::flag_schrittschaltung_merk_iae" TAB_VERB 2 0 "FALSE" 1 "TRUE" /end COMPU_VTAB
/begin COMPU_VTAB Conv.cIaeMomen._.flag_f_m_basis_anfahrt_init_S6_S3 "Umrechnung fuer Messgroesse cIaeMomen::flag_f_m_basis_anfahrt_init" TAB_VERB 2 0 "FALSE" 1 "TRUE" /end COMPU_VTAB
/begin COMPU_VTAB Conv.cIaeMomen._.flag_miaeauf_keinkfl_iae_S6_S3 "Umrechnung fuer Messgroesse cIaeMomen::flag_miaeauf_keinkfl_iae" TAB_VERB 2 0 "FALSE" 1 "TRUE" /end COMPU_VTAB
/begin COMPU_VTAB Conv.cIaeMomen._.z_rampe_miaeauf_S6_S3 "Umrechnung fuer Messgroesse cIaeMomen::z_rampe_miaeauf" TAB_VERB 3 0 "Rampe fertig" 1 "Rampe wird gestartet" 2 "Rampe rampt" /end COMPU_VTAB
/begin COMPU_VTAB Conv.cIaeMomen._.typ_uef_m_S6_S3 "Umrechnung fuer Messgroesse cIaeMomen::typ_uef_m" TAB_VERB 5 0 "undefinier" 1 "Sprung" 2 "Gerade" 3 "symmetrischer S-Schlag" 4 "asymmetrischer S-Schlag" /end COMPU_VTAB
/begin COMPU_VTAB Conv.cIaeMomen._.flag_regler_aktiv_S6_S3 "Umrechnung fuer Messgroesse cIaeMomen::flag_regler_aktiv" TAB_VERB 2 0 "FALSE" 1 "TRUE" /end COMPU_VTAB
/begin COMPU_VTAB Conv.cIaeMomen._.flag_first_reglerinit_iae_S6_S3 "Umrechnung fuer Messgroesse cIaeMomen::flag_first_reglerinit_iae" TAB_VERB 2 0 "FALSE" 1 "TRUE" /end COMPU_VTAB
/begin COMPU_VTAB Conv.cIaeMomen._.z_mo_kriech_aktiv_iae_S6_S3 "Umrechnung fuer Messgroesse cIaeMomen::z_mo_kriech_aktiv_iae" TAB_VERB 4 0 "Fahrzeug steht" 1 "mo_vorst wird aufgerampt" 2 "Fahrzeug fährt" 3 "mo_vorst wird abgerampt" /end COMPU_VTAB
/begin COMPU_VTAB Conv.cIaeMomen._.z_modusiae_temp_S6_S3 "Umrechnung fuer Messgroesse cIaeMomen::z_modusiae_temp" TAB_VERB 3 2 "Hybrid-Anfahren" 0 "E-Anfahren mit Schlupf" 1 "E-Anfahren geschlossen" /end COMPU_VTAB
/begin COMPU_VTAB Conv.cIaeMomen._.flag_zu_erreicht_iae_S6_S3 "Umrechnung fuer Messgroesse cIaeMomen::flag_zu_erreicht_iae" TAB_VERB 2 0 "FALSE" 1 "TRUE" /end COMPU_VTAB
/begin COMPU_VTAB Conv.cIaeMomen._.flag_nsmotmaxc_iae_S6_S3 "Umrechnung fuer Messgroesse cIaeMomen::flag_nsmotmaxc_iae" TAB_VERB 2 0 "FALSE" 1 "TRUE" /end COMPU_VTAB
/begin COMPU_VTAB Conv.cIaeMomen._.flag_kriechmax_ramp_S6_S3 "Umrechnung fuer Messgroesse cIaeMomen::flag_kriechmax_ramp" TAB_VERB 2 0 "FALSE" 1 "TRUE" /end COMPU_VTAB
/begin COMPU_VTAB Conv.cIaeMomen._.typ_uef_miaeaufanf_iae_S6_S3 "Umrechnung fuer Messgroesse cIaeMomen::typ_uef_miaeaufanf_iae" TAB_VERB 5 0 "undefinier" 1 "Sprung" 2 "Gerade" 3 "symmetrischer S-Schlag" 4 "asymmetrischer S-Schlag" /end COMPU_VTAB
/begin COMPU_VTAB Conv.cIaeMomen._.flag_initmistvorst_iae_S6_S3 "Umrechnung fuer Messgroesse cIaeMomen::flag_initmistvorst_iae" TAB_VERB 2 0 "FALSE" 1 "TRUE" /end COMPU_VTAB
/begin COMPU_VTAB Conv.cIaeMomen._.kfl_ziel_tmp_iae_S6_S3 "Umrechnung fuer Messgroesse cIaeMomen::kfl_ziel_tmp_iae" TAB_VERB 3 0 "KEIN_KFL" 1 "KFL_VORWAERTS" 2 "KFL_RUECKWAERTS" /end COMPU_VTAB
/begin COMPU_VTAB Conv.cIaeMomen._.flag_pulscue_aktiv_iae_S6_S3 "Umrechnung fuer Messgroesse cIaeMomen::flag_pulscue_aktiv_iae" TAB_VERB 2 0 "FALSE" 1 "TRUE" /end COMPU_VTAB
/begin COMPU_VTAB Conv.cIaeMomen._.flag_schaltung_aktiv_iae_S6_S3 "Umrechnung fuer Messgroesse cIaeMomen::flag_schaltung_aktiv_iae" TAB_VERB 2 0 "FALSE" 1 "TRUE" /end COMPU_VTAB
/begin COMPU_VTAB Conv.cIaeMomen._.flag_mvorberechnug_aktiv_iae_S6_S3 "Umrechnung fuer Messgroesse cIaeMomen::flag_mvorberechnug_aktiv_iae" TAB_VERB 2 0 "FALSE" 1 "TRUE" /end COMPU_VTAB
/begin COMPU_VTAB Conv.cIaeMomen._.status_uef_zu_kriech_init_iae_S6_S3 "Umrechnung fuer Messgroesse cIaeMomen::status_uef_zu_kriech_init_iae" TAB_VERB 3 0 "Init noch nicht erfolgt" 1 "Init jetzt" 2 "Init erfolgt" /end COMPU_VTAB
/begin COMPU_VTAB Conv.cIaeMomen._.st_anfagradbegrenz_iae_S6_S3 "Umrechnung fuer Messgroesse cIaeMomen::st_anfagradbegrenz_iae" TAB_VERB 3 0 "keine Stallspeed und keine Begrenzung" 1 "Stallspeed" 2 "Begrenzung nach Stallspeed" /end COMPU_VTAB
/begin COMPU_VTAB Conv.cIaeDiagn._.flag_close_diagiae_S6_S3 "Umrechnung fuer Messgroesse cIaeDiagn::flag_close_diagiae" TAB_VERB 2 0 "FALSE" 1 "TRUE" /end COMPU_VTAB
/begin COMPU_VTAB Conv.cIaeDiagn._.flag_noopen_diagiae_S6_S3 "Umrechnung fuer Messgroesse cIaeDiagn::flag_noopen_diagiae" TAB_VERB 2 0 "FALSE" 1 "TRUE" /end COMPU_VTAB
/begin COMPU_VTAB Conv.cIaeDiagn._.flag_noclose_diagiae_S6_S3 "Umrechnung fuer Messgroesse cIaeDiagn::flag_noclose_diagiae" TAB_VERB 2 0 "FALSE" 1 "TRUE" /end COMPU_VTAB
/begin COMPU_VTAB Conv.cIaeDiagn._.flag_hot_diagiae_S6_S3 "Umrechnung fuer Messgroesse cIaeDiagn::flag_hot_diagiae" TAB_VERB 2 0 "FALSE" 1 "TRUE" /end COMPU_VTAB
/begin COMPU_VTAB Conv.cIaeDiagn._.flag_timer_hot_diagiae_S6_S3 "Umrechnung fuer Messgroesse cIaeDiagn::flag_timer_hot_diagiae" TAB_VERB 2 0 "FALSE" 1 "TRUE" /end COMPU_VTAB
/begin COMPU_VTAB Conv.cIaeDiagn._.flag_spassfahrt_diagiae_S6_S3 "Umrechnung fuer Messgroesse cIaeDiagn::flag_spassfahrt_diagiae" TAB_VERB 2 0 "FALSE" 1 "TRUE" /end COMPU_VTAB
/begin COMPU_VTAB Conv.cIaeDiagn._.flag_sammelbed_diagiae_S6_S3 "Umrechnung fuer Messgroesse cIaeDiagn::flag_sammelbed_diagiae" TAB_VERB 2 0 "FALSE" 1 "TRUE" /end COMPU_VTAB
/begin COMPU_VTAB Conv.cIaeDiagn._.flag_max_p_haupt_diagiae_S6_S3 "Umrechnung fuer Messgroesse cIaeDiagn::flag_max_p_haupt_diagiae" TAB_VERB 2 0 "FALSE" 1 "TRUE" /end COMPU_VTAB
/begin COMPU_VTAB Conv.cIaeDiagn._.flag_mmot_gespeichert_diagiae_S6_S3 "Umrechnung fuer Messgroesse cIaeDiagn::flag_mmot_gespeichert_diagiae" TAB_VERB 2 0 "FALSE" 1 "TRUE" /end COMPU_VTAB
/begin COMPU_VTAB Conv.cIaeDiagn._.flag_rueckf_mmot_diagiae_S6_S3 "Umrechnung fuer Messgroesse cIaeDiagn::flag_rueckf_mmot_diagiae" TAB_VERB 2 0 "FALSE" 1 "TRUE" /end COMPU_VTAB
/begin COMPU_VTAB Conv.cIaeDiagn._.flag_rueckf_msollnmot_diagiae_S6_S3 "Umrechnung fuer Messgroesse cIaeDiagn::flag_rueckf_msollnmot_diagiae" TAB_VERB 2 0 "FALSE" 1 "TRUE" /end COMPU_VTAB
/begin COMPU_VTAB Conv.cIaeDiagn._.flag_noclose_hogez_diagiae_S6_S3 "Umrechnung fuer Messgroesse cIaeDiagn::flag_noclose_hogez_diagiae" TAB_VERB 2 0 "FALSE" 1 "TRUE" /end COMPU_VTAB
/begin COMPU_VTAB Conv.cIaeDiagn._.flag_close_bew_aktiv_diagiae_S6_S3 "Umrechnung fuer Messgroesse cIaeDiagn::flag_close_bew_aktiv_diagiae" TAB_VERB 2 0 "FALSE" 1 "TRUE" /end COMPU_VTAB
/begin COMPU_VTAB Conv.cIaeDiagn._.flag_noopen_bew_aktiv_diagiae_S6_S3 "Umrechnung fuer Messgroesse cIaeDiagn::flag_noopen_bew_aktiv_diagiae" TAB_VERB 2 0 "FALSE" 1 "TRUE" /end COMPU_VTAB
/begin COMPU_VTAB Conv.cIaeDiagn._.flag_noclose_bew_aktiv_diagiae_S6_S3 "Umrechnung fuer Messgroesse cIaeDiagn::flag_noclose_bew_aktiv_diagiae" TAB_VERB 2 0 "FALSE" 1 "TRUE" /end COMPU_VTAB
/begin COMPU_VTAB Conv.cIaeDiagn._.status_iae_hotinfo_S6_S3 "Umrechnung fuer Messgroesse cIaeDiagn::status_iae_hotinfo" TAB_VERB 3 0 "keine Meldung" 1 "Stufe I (IAE Pulsen)" 2 "Stufe II (IAE Öffnen)" /end COMPU_VTAB
/begin COMPU_VTAB Conv.cIaeDiagn._.z_close_diagiae_S6_S3 "Umrechnung fuer Messgroesse cIaeDiagn::z_close_diagiae" TAB_VERB 3 0 "Diagnose IAE_CLOSE nicht aktiv" 1 "Diagnose IAE_CLOSE aktiv" 2 "Diagnose IAE_CLOSE ng-Bedingung einmalig erfuellt  Timer-TSAX_CLOSE_DIAGIAE laeuft" /end COMPU_VTAB
/begin COMPU_VTAB Conv.cIaeTempm._.z_temp_init_iae_S6_S3 "Umrechnung fuer Messgroesse cIaeTempm::z_temp_init_iae" TAB_VERB 3 0 "Initialisierung noch nicht erfolgt" 1 "Vorab-Init mit c_iae aus EEPROM erfolgt" 2 "Initialisierung endgültig erfolgt" /end COMPU_VTAB
/begin COMPU_VTAB Conv.cIaeTempm._.flag_tempsperr_timerini_iae_S6_S3 "Umrechnung fuer Messgroesse cIaeTempm::flag_tempsperr_timerini_iae" TAB_VERB 2 0 "FALSE" 1 "TRUE" /end COMPU_VTAB
/begin COMPU_VTAB Conv.cIaeMotmx._.flag_stallspeed_iae_S6_S3 "Umrechnung fuer Messgroesse cIaeMotmx::flag_stallspeed_iae" TAB_VERB 2 0 "FALSE" 1 "TRUE" /end COMPU_VTAB
/begin COMPU_VTAB Conv.cIaeMotmx._.flag_motmaxndiff_iae_S6_S3 "Umrechnung fuer Messgroesse cIaeMotmx::flag_motmaxndiff_iae" TAB_VERB 2 0 "FALSE" 1 "TRUE" /end COMPU_VTAB
/begin COMPU_VTAB Conv.cIaeMotmx._.flag_motmaxregdiff_iae_S6_S3 "Umrechnung fuer Messgroesse cIaeMotmx::flag_motmaxregdiff_iae" TAB_VERB 2 0 "FALSE" 1 "TRUE" /end COMPU_VTAB
/begin COMPU_VTAB Conv.cIaeMotmx._.flag_motmaxstall_iae_S6_S3 "Umrechnung fuer Messgroesse cIaeMotmx::flag_motmaxstall_iae" TAB_VERB 2 0 "FALSE" 1 "TRUE" /end COMPU_VTAB
/begin COMPU_VTAB Conv.cIaeMotmx._.flag_motmaxtemp_iae_S6_S3 "Umrechnung fuer Messgroesse cIaeMotmx::flag_motmaxtemp_iae" TAB_VERB 2 0 "FALSE" 1 "TRUE" /end COMPU_VTAB
/begin COMPU_VTAB Conv.cIaeMotmx._.flag_timermotmaxtemp_iae_S6_S3 "Umrechnung fuer Messgroesse cIaeMotmx::flag_timermotmaxtemp_iae" TAB_VERB 2 0 "FALSE" 1 "TRUE" /end COMPU_VTAB
/begin COMPU_VTAB Conv.cSasAnGea._.gea_ablauf_aktiv_S6_S3 "Umrechnung fuer Messgroesse cSasAnGea::gea_ablauf_aktiv" TAB_VERB 2 0 "Gangein/-auslegen inaktiv" 1 "Gangein/-auslegen aktiv" /end COMPU_VTAB
/begin COMPU_VTAB Conv.cSasAnGea._.ra1_ge_gestartet_S6_S3 "Umrechnung fuer Messgroesse cSasAnGea::ra1_ge_gestartet" TAB_VERB 2 0 "Rampe 1 KZU inaktiv" 1 "Rampe 1 KZU gestartet" /end COMPU_VTAB
/begin COMPU_VTAB Conv.cSasAnGea._.ra2_ge_gestartet_S6_S3 "Umrechnung fuer Messgroesse cSasAnGea::ra2_ge_gestartet" TAB_VERB 2 0 "Rampe 2 KZU inaktiv" 1 "Rampe 2 KZU gestartet" /end COMPU_VTAB
/begin COMPU_VTAB Conv.cSasAnGea._.ra3_ge_gestartet_S6_S3 "Umrechnung fuer Messgroesse cSasAnGea::ra3_ge_gestartet" TAB_VERB 2 0 "Rampe 3 KZU inaktiv" 1 "Rampe 3 KZU gestartet" /end COMPU_VTAB
/begin COMPU_VTAB Conv.cSasAnGea._.synchron_verboten_S6_S3 "Umrechnung fuer Messgroesse cSasAnGea::synchron_verboten" TAB_VERB 2 0 "Synchron erreichen erlaubt" 1 "Synchron erreichen verboten" /end COMPU_VTAB
/begin COMPU_VTAB Conv.cSasAnGea._.erste_schaltung_S6_S3 "Umrechnung fuer Messgroesse cSasAnGea::erste_schaltung" TAB_VERB 2 0 "Kupplung wurde schon mal befuellt" 1 "Kupplung wurde noch nie befuellt" /end COMPU_VTAB
/begin COMPU_VTAB Conv.cSasAnGea._.f_verb_ada_erste_bef_S6_S3 "Umrechnung fuer Messgroesse cSasAnGea::f_verb_ada_erste_bef" TAB_VERB 2 0 "Ada nicht verboten" 1 "Adapiton verboten" /end COMPU_VTAB
/begin COMPU_VTAB Conv.cSasAnGea._.ende_kab_gestartet_S6_S3 "Umrechnung fuer Messgroesse cSasAnGea::ende_kab_gestartet" TAB_VERB 2 0 "Zustand Ende KAB inaktiv" 1 "Zustand Ende KAB gestartet" /end COMPU_VTAB
/begin COMPU_VTAB Conv.cSasAnGea._.fa_kzu_gestartet_S6_S3 "Umrechnung fuer Messgroesse cSasAnGea::fa_kzu_gestartet" TAB_VERB 2 0 "Fuellausgleich KZU inaktiv" 1 "Fuellausgleich KZU aktiv" /end COMPU_VTAB
/begin COMPU_VTAB Conv.cSasAnGea._.schliessen_kup_in_n_gestartet_S6_S3 "Umrechnung fuer Messgroesse cSasAnGea::schliessen_kup_in_n_gestartet" TAB_VERB 2 0 "Kupplungsansteuerung in Neutral nicht gestartet" 1 "Kupplungsansteuerung in Neutral gestartet" /end COMPU_VTAB
/begin COMPU_VTAB Conv.cSasAnGea._.statisch_gea_S6_S3 "Umrechnung fuer Messgroesse cSasAnGea::statisch_gea" TAB_VERB 2 0 "GE/GA-Kupplung arbeitet" 1 "GE/GA-Kupplung statisch" /end COMPU_VTAB
/begin COMPU_VTAB Conv.cSasAnGea._.z_gea_S6_S3 "Umrechnung fuer Messgroesse cSasAnGea::z_gea" TAB_VERB 25 0 "Initialisierungszustand" 1 "zuschaltende Kup : Verzoegern Start SF bei GE" 2 "zuschaltende Kup : Schnellfuellung bei GE" 3 "kraftschl. Kup : Verzoegern der Fuellausgleichsphase" 4 "zuschaltende Kup : Fuellausgleich bei GE" 5 "nicht genutzt" 6 "nicht genutzt" 7 "nicht genutzt" 8 "nicht genutzt" 9 "kraftschl. Kup : Rampe auf Schaltdruck" 10 "kraftschl. Kup : Schaltdruckphase" 11 "kraftschl. Kup : Schliessrampe" 12 "kraftschl. Kup : (Not-)Schliessrampe nach Zeit in synchron" 13 "nicht genutzt" 14 "Maximalzeit des GE erreicht" 15 "kraftschl. Kup: Warten auf SF der nichtkraftschl. Kupplungen" 16 "nichtkraftschl. Kup : Schliessrampe" 17 "2. nichtkraftschl. Kup. : Warten auf 1. nichtkraftschl. Kup." 18 "Warten abschaltende Kupplung bei Gangauslegen" 19 "Rampe Gangauslegen abschaltende Kupplung" 20 "Ende Gangauslegen abschaltende Kupplung" 21 "Einstieg Kab bei Sollneutral MSA" 22 "Haltephase Kab bei Sollneutral MSA" 23 "Ausstieg Kab bei Sollneutral MSA" 30 "GE/GA inaktiv" /end COMPU_VTAB
/begin COMPU_VTAB Conv.cSasAnGea._.f_timeout_S6_S3 "Umrechnung fuer Messgroesse cSasAnGea::f_timeout" TAB_VERB 2 0 "Timeout-Zeit noch nicht abgelaufen" 1 "Timeout-Zeit abgelaufen" /end COMPU_VTAB
/begin COMPU_VTAB Conv.cSasAnGea._.schalttyp_gea_S6_S3 "Umrechnung fuer Messgroesse cSasAnGea::schalttyp_gea" TAB_VERB 6 0 "Ablauf Kraftschliessende Kup." 1 "Ablauf 1. Nichtkraftschliessende Kup." 2 "Ablauf 2. Nichtkraftschliessende Kup." 3 "Ablauf Gangauslegen" 4 "Ablauf Gangauslegen der Kraftschliessenden bei Sollneutral MSA" 5 "Schalttyp unbestimmt" /end COMPU_VTAB
/begin COMPU_VTAB Conv.cSasAnGea._.schnellfuellung_beendet_S6_S3 "Umrechnung fuer Messgroesse cSasAnGea::schnellfuellung_beendet" TAB_VERB 2 0 "Schnellfuellung nicht beendet" 1 "Schnellfuellung beendet" /end COMPU_VTAB
/begin COMPU_VTAB Conv.cSasAnGea._.f_schnellfuellung_gestartet_S6_S3 "Umrechnung fuer Messgroesse cSasAnGea::f_schnellfuellung_gestartet" TAB_VERB 2 0 "Schnellfuellung noch nicht gestartet" 1 "Schnellfuellung gestartet" /end COMPU_VTAB
/begin COMPU_VTAB Conv.cSasAnGea._.instanz_nr_S6_S3 "Umrechnung fuer Messgroesse cSasAnGea::instanz_nr" TAB_VERB 3 2 "Instanz Kraftschliessende Kup." 3 "Instanz 1. Nichtkraftschliessende Kup." 4 "Instanz 2. Nichtkraftschliessende Kup." /end COMPU_VTAB
/begin COMPU_VTAB Conv.cSasAnGea._.kzu_voll_bei_start_S6_S3 "Umrechnung fuer Messgroesse cSasAnGea::kzu_voll_bei_start" TAB_VERB 2 0 "KZU war noch nicht befuellt" 1 "KZU war schon befuellt" /end COMPU_VTAB
/begin COMPU_VTAB Conv.cSasAnGea._.f_pokzu_kfl_zuletzt_wechsel_S6_S3 "Umrechnung fuer Messgroesse cSasAnGea::f_pokzu_kfl_zuletzt_wechsel" TAB_VERB 2 0 "Druckoffset nicht verwenden" 1 "Druckoffset verwenden" /end COMPU_VTAB
/begin COMPU_VTAB Conv.cSasAnGea._.f_pfmin_erreicht_S6_S3 "Umrechnung fuer Messgroesse cSasAnGea::f_pfmin_erreicht" TAB_VERB 2 0 "Kupplung hat p_fmin erreicht" 1 "Kupplung hat p_fmin noch nicht erreicht" /end COMPU_VTAB
/begin COMPU_VTAB Conv.cSasAnGea._.kup_ge_S6_S3 "Umrechnung fuer Messgroesse cSasAnGea::kup_ge" TAB_VERB 6 0 "KEINE" 1 "K_A" 2 "K_B" 3 "K_C" 4 "K_D" 5 "K_E" /end COMPU_VTAB
/begin COMPU_VTAB Conv.cSasAnGea._.kup_ga_S6_S3 "Umrechnung fuer Messgroesse cSasAnGea::kup_ga" TAB_VERB 6 0 "KEINE" 1 "K_A" 2 "K_B" 3 "K_C" 4 "K_D" 5 "K_E" /end COMPU_VTAB
/begin COMPU_VTAB Conv.cSasAnGea._.po_fkzu_aktiv_S6_S3 "Umrechnung fuer Messgroesse cSasAnGea::po_fkzu_aktiv" TAB_VERB 2 0 "FALSE" 1 "TRUE" /end COMPU_VTAB
/begin FUNCTION KAS_KOORDINATOR "IN KAS_KOORDINATOR sind die Koordinatorfunktionen zur Ansteuerung der Kupplung ausserhalb Schaltung enthalten"
 /begin LOC_MEASUREMENT iKorGskup.f_gsk_schlupft iKorGskup.f_kraftschl_kup_fa iKorGskup.fehler_gsk_regeln_verboten iKorGskup.gsk_aktiv iKorGskup.gsk_funktion iKorGskup.gsk_zustand iKorGskup.kup_gsk iKorGskup.m_motmax_gsk iKorGskup.me_gsk_abs_diff iKorGskup.p_gsk iKorGskup.p_gsk_wirk /end LOC_MEASUREMENT
/end FUNCTION
/begin FUNCTION KAS_BIBLIO "Allgemeine Bibliothek für KAS"
 /begin LOC_MEASUREMENT iKasEkopl.Pt1MoEntkoppl.x iKasEkopl.TimerSchlEkop.maxtime iKasEkopl.TimerSchlEkop.time iKasEkopl.TimerZEkopl.maxtime iKasEkopl.TimerZEkopl.time iKasEkopl.flag_mo_aktiv_entkoppl iKasEkopl.m_max_alter_has_entkopl iKasEkopl.m_max_has_entkoppeln iKasEkopl.m_mot_init iKasEkopl.m_regler_entkoppeln iKasEkopl.m_soll_entkoppeln_init iKasEkopl.m_vorsteuer_entkoppeln iKasEkopl.m_vorsteuer_entkoppeln_init iKasEkopl.mo_vorsteuer_entkoppeln iKasEkopl.mo_vorstschl_entkoppeln iKasEkopl.z_entkoppeln /end LOC_MEASUREMENT
/end FUNCTION
/begin FUNCTION IAE "In IAE sind die Funktionen zum integrierten Anfahrelement enthalten"
 /begin LOC_MEASUREMENT iIaeAdauf.iTLaufUefiae.timer iIaeAdauf.kfl_ziel_start_uefiea iIaeAdauf.m_motist_mw_uefiae iIaeAdauf.m_motist_start_uefiae iIaeAdauf.m_soll_mw_uefiae iIaeAdauf.m_soll_start_uefiae iIaeAdauf.m_stell_mw_uefiae iIaeAdauf.m_stell_start_uefiae iIaeAdauf.mue_adawert_lesen iIaeAdauf.mue_adawert_schreiben iIaeAdauf.mue_diff iIaeAdauf.mue_ist_uefiae iIaeAdauf.mue_kor_j_uefiae iIaeAdauf.mue_mw_uefiae iIaeAdauf.mue_start_uefiae iIaeAdauf.nd_mw_uefiae iIaeAdauf.nd_start_uefiae iIaeAdauf.ng_mot_mw_uefiae iIaeAdauf.ng_mot_start_uefiae iIaeAdauf.p_stell_start_uefiae iIaeAdauf.z_ada_uefiae iIaeAdauf.zielgang_start_uefiae iIaeDiagn.Pt1Axrefiae.x iIaeDiagn.Pt1Mdidiagiae.x iIaeDiagn.TimerCloseBewAktiv.maxtime iIaeDiagn.TimerCloseBewAktiv.time iIaeDiagn.TimerCloseNgab.maxtime iIaeDiagn.TimerCloseNgab.time iIaeDiagn.TimerCloseRueckF.maxtime iIaeDiagn.TimerCloseRueckF.time iIaeDiagn.TimerNoCloseDiagiae.maxtime iIaeDiagn.TimerNoCloseDiagiae.time iIaeDiagn.TimerNoOpenDiagiae.maxtime iIaeDiagn.TimerNoOpenDiagiae.time iIaeDiagn.TimerNocloseBewAktiv.maxtime iIaeDiagn.TimerNocloseBewAktiv.time iIaeDiagn.TimerNoopenBewAktiv.maxtime iIaeDiagn.TimerNoopenBewAktiv.time iIaeDiagn.TimerNoopenRueckF.maxtime iIaeDiagn.TimerNoopenRueckF.time iIaeDiagn.ax_integral_diagiae iIaeDiagn.ctr_hot_diagiae iIaeDiagn.flag_close_bew_aktiv_diagiae iIaeDiagn.flag_close_diagiae iIaeDiagn.flag_hot_diagiae iIaeDiagn.flag_max_p_haupt_diagiae iIaeDiagn.flag_mmot_gespeichert_diagiae iIaeDiagn.flag_noclose_bew_aktiv_diagiae iIaeDiagn.flag_noclose_diagiae iIaeDiagn.flag_noclose_hogez_diagiae iIaeDiagn.flag_noopen_bew_aktiv_diagiae iIaeDiagn.flag_noopen_diagiae iIaeDiagn.flag_rueckf_mmot_diagiae iIaeDiagn.flag_rueckf_msollnmot_diagiae iIaeDiagn.flag_sammelbed_diagiae iIaeDiagn.flag_spassfahrt_diagiae iIaeDiagn.flag_timer_hot_diagiae iIaeDiagn.index_mot_diagiae iIaeDiagn.m_motistoe_temp_diagiae iIaeDiagn.mdi_diagiae iIaeDiagn.n_stoer_noclose_diagiae iIaeDiagn.status_iae_hotinfo iIaeDiagn.z_close_diagiae iIaeDraus.Dt1PGStell.Pt1Si16.x iIaeDraus.Dt1PGStell.xp iIaeDraus.Pt1Mue.x iIaeDraus.Pt1PDStellHysS.x iIaeDraus.Pt1PStellbasis.x iIaeDraus.Pt1PoDyn.x iIaeDraus.Pt1PoHysKo.x iIaeDraus.Pt2PIst.x iIaeDraus.Pt2PIst.xp iIaeDraus.TimerHysSchl.maxtime iIaeDraus.TimerHysSchl.time iIaeDraus.TimerHyskompan.maxtime iIaeDraus.TimerHyskompan.time iIaeDraus.TimerPoDyn.maxtime iIaeDraus.TimerPoDyn.time iIaeDraus.f_hysschleife_aktiv_iae iIaeDraus.f_hysschleife_moeglich_iae iIaeDraus.flag_init_ausinaktiv_iae iIaeDraus.flag_m_max_alt iIaeDraus.flag_p_stell_max_iae iIaeDraus.flag_po_dyn_aktiv_iae iIaeDraus.mpt_po_dyn_iae iIaeDraus.mue_iae iIaeDraus.nd_iae_kf_mue iIaeDraus.p_ada_iae_ap_iea iIaeDraus.p_ada_iae_ap_iep iIaeDraus.p_ist_basis_iae iIaeDraus.p_stell_basis_iae iIaeDraus.p_stell_iae iIaeDraus.p_stell_init_iae iIaeDraus.p_stellalt_iae iIaeDraus.pd_hysschleife_iae iIaeDraus.po_dyn_iae iIaeDraus.po_hys_iae iIaeDraus.po_hyskomp_iae iIaeDraus.t_po_dyn_iae iIaeDraus.z_hyskomp_iae iIaeKordi.TimerZIae.maxtime iIaeKordi.TimerZIae.time iIaeKordi.flag_zu_gewesen_iae iIaeKordi.kup_status_iae iIaeKordi.t_angelegt_iae iIaeKordi.t_nds_zu_iae iIaeKordi.timer_z_iae iIaeKordi.z_iae iIaeKordi.z_iae_temp iIaeKuehl.Pt1VpKuehlKorr.x iIaeKuehl.Pt1Vpsoll.x iIaeKuehl.TimerZModusIae.maxtime iIaeKuehl.TimerZModusIae.time iIaeKuehl.f_min_em_kuehl_iae iIaeKuehl.flag_kuehlung_im_inaktiv iIaeKuehl.p_kuehl_soll_iae iIaeKuehl.vp_kuehl_korr_iae iIaeKuehl.vp_kuehl_max_iae iIaeKuehl.vp_kuehl_soll_iae iIaeKuehl.vp_kuehl_soll_roh_iae iIaeKuehl.vp_sek_k0_iae iIaeMomen.BibPIDIae.faktor_d iIaeMomen.BibPIDIae.faktor_i iIaeMomen.BibPIDIae.faktor_p iIaeMomen.BibPIDIae.faktor_t1 iIaeMomen.BibPIDIae.regel_diff_alt iIaeMomen.BibPIDIae.stell_max iIaeMomen.BibPIDIae.stell_min iIaeMomen.BibPIDIae.stellgr_alt iIaeMomen.BibPIDIae.stellgr_d_alt iIaeMomen.BibPIDIae.stellgr_i_alt iIaeMomen.BibPIDIae.stellgr_i_modulo iIaeMomen.Pt1FMBasisAnfahrtIae.x iIaeMomen.Pt1IStuetz.x iIaeMomen.Pt1NMotAnfah.x iIaeMomen.Pt2MIstVorstIae.x iIaeMomen.Pt2MIstVorstIae.xp iIaeMomen.Pt2NMotAnfahrt.x iIaeMomen.Pt2NMotAnfahrt.xp iIaeMomen.TimerKflMiaeauf.maxtime iIaeMomen.TimerKflMiaeauf.time iIaeMomen.TimerMiaeaufAnfahr.maxtime iIaeMomen.TimerMiaeaufAnfahr.time iIaeMomen.TimerNachMmaxHas.maxtime iIaeMomen.TimerNachMmaxHas.time iIaeMomen.TimerPulsCue.maxtime iIaeMomen.TimerPulsCue.time iIaeMomen.TimerPulsCueAktiv.maxtime iIaeMomen.TimerPulsCueAktiv.time iIaeMomen.TimerUefIstuetz.maxtime iIaeMomen.TimerUefIstuetz.time iIaeMomen.TimerUefKriechen.maxtime iIaeMomen.TimerUefKriechen.time iIaeMomen.TimerUefMVorKriechen.maxtime iIaeMomen.TimerUefMVorKriechen.time iIaeMomen.cd_iae iIaeMomen.ci_iae iIaeMomen.cp_iae iIaeMomen.ct1_iae iIaeMomen.dki_maxiae iIaeMomen.f_m_basis_anfahrt_iae iIaeMomen.f_miaeaufdki_iae iIaeMomen.f_mschlepp_iae iIaeMomen.f_nganfahrt_iae iIaeMomen.f_sign_puls_iae iIaeMomen.flag_f_m_basis_anfahrt_init iIaeMomen.flag_first_reglerinit_iae iIaeMomen.flag_initmistvorst_iae iIaeMomen.flag_initsoll_einmal_iae iIaeMomen.flag_initsollanfahr_iae iIaeMomen.flag_kaltanfahren_aktiv_iae iIaeMomen.flag_kriechmax_ramp iIaeMomen.flag_miaeauf_keinkfl_iae iIaeMomen.flag_mvorberechnug_aktiv_iae iIaeMomen.flag_nsmotmaxc_iae iIaeMomen.flag_pulscue_aktiv_iae iIaeMomen.flag_regler_aktiv iIaeMomen.flag_schaltung_aktiv_iae iIaeMomen.flag_schrittschaltung_merk_iae iIaeMomen.flag_stall_anfahr_iae iIaeMomen.flag_t_ueffix_iae iIaeMomen.flag_ueflaeuft_iae iIaeMomen.flag_zu_erreicht_iae iIaeMomen.i_stuetz_iae iIaeMomen.i_stuetzalt_iae iIaeMomen.i_stuetzziel_iae iIaeMomen.kd_iae iIaeMomen.kfl_ziel_tmp_iae iIaeMomen.ki_iae iIaeMomen.kp_iae iIaeMomen.m_alt_iae iIaeMomen.m_anfahrt_min_iae iIaeMomen.m_basis_anfahrt_iae iIaeMomen.m_basis_anfahrt_korr_iae iIaeMomen.m_basis_anfahrt_min_iae iIaeMomen.m_iaeauf iIaeMomen.m_iaeauf_alt iIaeMomen.m_iaeauf_frozen iIaeMomen.m_iaeauf_max_iae iIaeMomen.m_iaeauf_ramp iIaeMomen.m_ist_iae iIaeMomen.m_ist_vorst_alt_iae iIaeMomen.m_ist_vorst_iae iIaeMomen.m_ist_vorst_iae_froz iIaeMomen.m_ist_vorst_max_anfahr_iae iIaeMomen.m_kriech_max_iae iIaeMomen.m_kriech_max_ziel_iae iIaeMomen.m_kriech_min_iae iIaeMomen.m_kriechmax_ramp iIaeMomen.m_motistoe_iae_init iIaeMomen.m_puls_cueber_iae iIaeMomen.m_puls_cueber_roh_iae iIaeMomen.m_regler_d_iae iIaeMomen.m_regler_i_iae iIaeMomen.m_regler_iae iIaeMomen.m_regler_p_iae iIaeMomen.m_schlepp_auf_iae iIaeMomen.m_schlepp_getr_iae iIaeMomen.m_schlepp_iae iIaeMomen.m_soll_iae iIaeMomen.m_soll_iae_init iIaeMomen.m_soll_still_iae iIaeMomen.m_stell_iae iIaeMomen.m_vorkriechziel_iae iIaeMomen.m_vorsteuer_iae iIaeMomen.m_ziel_iae iIaeMomen.mo_soll_iae iIaeMomen.mo_vorstkreichen_iae iIaeMomen.ms_motanfahrinit_iae iIaeMomen.n_emknick_iae iIaeMomen.n_grenzentk_iae iIaeMomen.n_motanfahr_dki_iae iIaeMomen.n_motanfahr_gef_iae iIaeMomen.n_motanfahr_grad_iae iIaeMomen.n_motsollanfahr_iae iIaeMomen.n_motsollanfahr_roh_iae iIaeMomen.nd_kriechsoll_iae iIaeMomen.nd_kriechstart_iae iIaeMomen.nd_kriechziel_iae iIaeMomen.nd_motentkoppeln_init_iae iIaeMomen.nd_motsollanfahr_iae iIaeMomen.ng_motanfahr_gef_iae iIaeMomen.ns_motanfahrinit_iae iIaeMomen.sig_rampe_miaeauf iIaeMomen.st_anfagradbegrenz_iae iIaeMomen.status_uef_zu_kriech_init_iae iIaeMomen.t_dauer_iuef_hs_iae iIaeMomen.t_pt2_anfahrt_iae iIaeMomen.t_syn_temp_iae iIaeMomen.t_uef_m_iae iIaeMomen.t_uef_m_zu_kriech_iae iIaeMomen.t_uef_miaeaufanf_iae iIaeMomen.t_uef_nd_iae iIaeMomen.typ_uef_m iIaeMomen.typ_uef_miaeaufanf_iae iIaeMomen.xd_iae iIaeMomen.z_mo_kriech_aktiv_iae iIaeMomen.z_modusiae_temp iIaeMomen.z_rampe_miaeauf iIaeMotmx.Pt1MMotmax.x iIaeMotmx.TimerMotMaxTempIae.maxtime iIaeMotmx.TimerMotMaxTempIae.time iIaeMotmx.TimerStallIae.maxtime iIaeMotmx.TimerStallIae.time iIaeMotmx.flag_motmaxndiff_iae iIaeMotmx.flag_motmaxregdiff_iae iIaeMotmx.flag_motmaxstall_iae iIaeMotmx.flag_motmaxtemp_iae iIaeMotmx.flag_stallspeed_iae iIaeMotmx.flag_timermotmaxtemp_iae iIaeMotmx.m_motmax100_iae iIaeMotmx.m_motmax_iae iIaeMotmx.m_motmax_max_iae iIaeMotmx.m_motmax_roh_iae iIaeMotmx.m_motmaxmax100_iae iIaeMotmx.m_motmaxndiff100_iae iIaeMotmx.m_motmaxndiff_iae iIaeMotmx.m_motmaxregdiff100_iae iIaeMotmx.m_motmaxregdiff_iae iIaeMotmx.m_motmaxstall100_iae iIaeMotmx.m_motmaxstall_iae iIaeMotmx.m_motmaxtemp100_iae iIaeMotmx.m_motmaxtemp_iae iIaeMotmx.timer_mot_max_temp_iae iIaeMotmx.timer_stallspeed_iae iIaeSigna.DelayMMotgem.write_index iIaeSigna.DelayMMotist.write_index iIaeSigna.DelayMMotistoe.write_index iIaeSigna.DelayMMotsolloe.write_index iIaeSigna.DelayNab.write_index iIaeSigna.DelayNt.write_index iIaeSigna.Dt1Dkig.Pt1Si16.x iIaeSigna.Dt1Dkig.xp iIaeSigna.Dt1MgMotist.Pt1Si16.x iIaeSigna.Dt1MgMotist.xp iIaeSigna.Dt1NdgIae.Pt1Si16.x iIaeSigna.Dt1NdgIae.xp iIaeSigna.Dt1NgAb.Pt1Si16.x iIaeSigna.Dt1NgAb.xp iIaeSigna.Dt1NgGetrein.Pt1Si16.x iIaeSigna.Dt1NgGetrein.xp iIaeSigna.Dt1NgMot.Pt1Si16.x iIaeSigna.Dt1NgMot.xp iIaeSigna.Dt1Pbremsg.Pt1Si16.x iIaeSigna.Dt1Pbremsg.xp iIaeSigna.Pt1AxrefIae.x iIaeSigna.Pt1Dki.x iIaeSigna.Pt1JAnfahrtIae.x iIaeSigna.Pt1MMotgem.x iIaeSigna.Pt1MMotist.x iIaeSigna.Pt1MMotistoe.x iIaeSigna.Pt1MMotsolloe.x iIaeSigna.Pt1NAb.x iIaeSigna.Pt1NMot.x iIaeSigna.Pt1NT.x iIaeSigna.Pt1NdGetrein.x iIaeSigna.Pt1NdIae.x iIaeSigna.Pt1NdMot.x iIaeSigna.Pt1Nue.x iIaeSigna.Pt1PBrems.x iIaeSigna.Pt2NeigungIae.x iIaeSigna.Pt2NeigungIae.xp iIaeSigna.asr_regelt_iae iIaeSigna.ax_ref_filt_diagiae iIaeSigna.dki_iae iIaeSigna.dkig_iae iIaeSigna.f_angelegt_iae iIaeSigna.f_brems_angelegt_iae iIaeSigna.fas_aktiv_iae iIaeSigna.flag_init_signa_iae iIaeSigna.flag_mreibzumstell_iae iIaeSigna.j_anfahrt_iae iIaeSigna.kfl_sollneutral_iae iIaeSigna.m_motgem_iae iIaeSigna.m_motist_iae iIaeSigna.m_motistoe_iae iIaeSigna.m_motsolloe_iae iIaeSigna.m_reib_iae iIaeSigna.mg_motist_iae iIaeSigna.mot_last_iae iIaeSigna.mot_stress_iae iIaeSigna.n_ab_dir_iae iIaeSigna.n_ab_iae iIaeSigna.n_getrein_iae iIaeSigna.n_mot_iae iIaeSigna.n_motanfahr_basis_iae iIaeSigna.n_motsoll_ll_iae iIaeSigna.n_motsollmax_iae iIaeSigna.n_t_iae iIaeSigna.nd_getrein_basis_ll_iae iIaeSigna.nd_getrein_iae iIaeSigna.nd_iae iIaeSigna.nd_iae_betrag iIaeSigna.nd_iae_kf iIaeSigna.nd_mot_iae iIaeSigna.ndg_iae iIaeSigna.neigung_iae iIaeSigna.neigung_nmin_iae iIaeSigna.ng_ab_iae iIaeSigna.ng_getrein_iae iIaeSigna.ng_mot_iae iIaeSigna.ns_getrein_oeffnen_iae iIaeSigna.ns_getrein_schliess_iae iIaeSigna.nue_iae iIaeSigna.p_brems_iae iIaeSigna.p_brems_roh_iae iIaeSigna.pg_brems_iae iIaeSigna.ps_brems_angelegt_iae iIaeSigna.pw_reib_iae iIaeSigna.x_kf_ns_sync_iae iIaeSigna.z_nmotll_aktiv_iae iIaeTempm.TimerVzInit.maxtime iIaeTempm.TimerVzInit.time iIaeTempm.alpha_iae iIaeTempm.c_iae iIaeTempm.c_iae_fl iIaeTempm.c_kuehl_iae iIaeTempm.flag_tempsperr_timerini_iae iIaeTempm.q_ab_iae iIaeTempm.z_temp_init_iae /end LOC_MEASUREMENT
/end FUNCTION
/begin FUNCTION SAS "Das Paket SAS enthält alle Klassen und Funktionalitäten, welche zur Koordination des Schaltablaufs notwendig sind."
 /begin SUB_FUNCTION SAS_GEA SAS_GLS SAS_ZENTRAL SAS_SYSTEMDRUCK SAS_TCI SAS_KOORDINATOR SAS_SONDERFKT SAS_MOTOREINGRIFF /end SUB_FUNCTION
/end FUNCTION
/begin FUNCTION SAS_GEA "Sub-Paket GEA"
 /begin LOC_MEASUREMENT iGeaKordi.timer_ga iGeaKordi.timer_gega_laeuft iSasAnGeaKraftschl.dauer_ra1_ge_kzu iSasAnGeaKraftschl.ende_kab_gestartet iSasAnGeaKraftschl.erste_schaltung iSasAnGeaKraftschl.f_pfmin_erreicht iSasAnGeaKraftschl.f_pokzu_kfl_zuletzt_wechsel iSasAnGeaKraftschl.f_schnellfuellung_gestartet iSasAnGeaKraftschl.f_timeout iSasAnGeaKraftschl.f_verb_ada_erste_bef iSasAnGeaKraftschl.fa_kzu_gestartet iSasAnGeaKraftschl.gea_ablauf_aktiv iSasAnGeaKraftschl.instanz_nr iSasAnGeaKraftschl.kup_ga iSasAnGeaKraftschl.kup_ge iSasAnGeaKraftschl.kzu_voll_bei_start iSasAnGeaKraftschl.nd_nmotnt_init_ga iSasAnGeaKraftschl.p_0stgea iSasAnGeaKraftschl.p_adaptgea iSasAnGeaKraftschl.p_gea iSasAnGeaKraftschl.p_offgea iSasAnGeaKraftschl.p_stgea iSasAnGeaKraftschl.pgo_gea_rampe.cBibRampeGradSi16._.letzter_ms_timer iSasAnGeaKraftschl.pgo_gea_rampe.cBibRampeGradSi16._.letzter_wert iSasAnGeaKraftschl.pgo_gea_rampe.cBibRampeGradSi16._.maximum iSasAnGeaKraftschl.pgo_gea_rampe.cBibRampeGradSi16._.minimum iSasAnGeaKraftschl.pgo_nabgea iSasAnGeaKraftschl.po_fkzu_aktiv iSasAnGeaKraftschl.po_mtgea iSasAnGeaKraftschl.ra1_ge_gestartet iSasAnGeaKraftschl.ra2_ge_gestartet iSasAnGeaKraftschl.ra3_ge_gestartet iSasAnGeaKraftschl.schalttyp_gea iSasAnGeaKraftschl.schliessen_kup_in_n_gestartet iSasAnGeaKraftschl.schnellfuellung_beendet iSasAnGeaKraftschl.statisch_gea iSasAnGeaKraftschl.synchron_verboten iSasAnGeaKraftschl.t_0kzu_gea iSasAnGeaKraftschl.t_maxgea iSasAnGeaKraftschl.t_timeout iSasAnGeaKraftschl.t_zgea iSasAnGeaKraftschl.timer16_ra1_ge iSasAnGeaKraftschl.timer_start_fa_kzu iSasAnGeaKraftschl.timer_zgea iSasAnGeaKraftschl.to_sf_kflwe iSasAnGeaKraftschl.z_gea iSasAnGeaKraftschl.zaehler_zgea iSasAnGeaNichtKraftschl1.dauer_ra1_ge_kzu iSasAnGeaNichtKraftschl1.ende_kab_gestartet iSasAnGeaNichtKraftschl1.erste_schaltung iSasAnGeaNichtKraftschl1.f_pfmin_erreicht iSasAnGeaNichtKraftschl1.f_pokzu_kfl_zuletzt_wechsel iSasAnGeaNichtKraftschl1.f_schnellfuellung_gestartet iSasAnGeaNichtKraftschl1.f_timeout iSasAnGeaNichtKraftschl1.f_verb_ada_erste_bef iSasAnGeaNichtKraftschl1.fa_kzu_gestartet iSasAnGeaNichtKraftschl1.gea_ablauf_aktiv iSasAnGeaNichtKraftschl1.instanz_nr iSasAnGeaNichtKraftschl1.kup_ga iSasAnGeaNichtKraftschl1.kup_ge iSasAnGeaNichtKraftschl1.kzu_voll_bei_start iSasAnGeaNichtKraftschl1.nd_nmotnt_init_ga iSasAnGeaNichtKraftschl1.p_0stgea iSasAnGeaNichtKraftschl1.p_adaptgea iSasAnGeaNichtKraftschl1.p_gea iSasAnGeaNichtKraftschl1.p_offgea iSasAnGeaNichtKraftschl1.p_stgea iSasAnGeaNichtKraftschl1.pgo_gea_rampe.cBibRampeGradSi16._.letzter_ms_timer iSasAnGeaNichtKraftschl1.pgo_gea_rampe.cBibRampeGradSi16._.letzter_wert iSasAnGeaNichtKraftschl1.pgo_gea_rampe.cBibRampeGradSi16._.maximum iSasAnGeaNichtKraftschl1.pgo_gea_rampe.cBibRampeGradSi16._.minimum iSasAnGeaNichtKraftschl1.pgo_nabgea iSasAnGeaNichtKraftschl1.po_fkzu_aktiv iSasAnGeaNichtKraftschl1.po_mtgea iSasAnGeaNichtKraftschl1.ra1_ge_gestartet iSasAnGeaNichtKraftschl1.ra2_ge_gestartet iSasAnGeaNichtKraftschl1.ra3_ge_gestartet iSasAnGeaNichtKraftschl1.schalttyp_gea iSasAnGeaNichtKraftschl1.schliessen_kup_in_n_gestartet iSasAnGeaNichtKraftschl1.schnellfuellung_beendet iSasAnGeaNichtKraftschl1.statisch_gea iSasAnGeaNichtKraftschl1.synchron_verboten iSasAnGeaNichtKraftschl1.t_0kzu_gea iSasAnGeaNichtKraftschl1.t_maxgea iSasAnGeaNichtKraftschl1.t_timeout iSasAnGeaNichtKraftschl1.t_zgea iSasAnGeaNichtKraftschl1.timer16_ra1_ge iSasAnGeaNichtKraftschl1.timer_start_fa_kzu iSasAnGeaNichtKraftschl1.timer_zgea iSasAnGeaNichtKraftschl1.to_sf_kflwe iSasAnGeaNichtKraftschl1.z_gea iSasAnGeaNichtKraftschl1.zaehler_zgea iSasAnGeaNichtKraftschl2.dauer_ra1_ge_kzu iSasAnGeaNichtKraftschl2.ende_kab_gestartet iSasAnGeaNichtKraftschl2.erste_schaltung iSasAnGeaNichtKraftschl2.f_pfmin_erreicht iSasAnGeaNichtKraftschl2.f_pokzu_kfl_zuletzt_wechsel iSasAnGeaNichtKraftschl2.f_schnellfuellung_gestartet iSasAnGeaNichtKraftschl2.f_timeout iSasAnGeaNichtKraftschl2.f_verb_ada_erste_bef iSasAnGeaNichtKraftschl2.fa_kzu_gestartet iSasAnGeaNichtKraftschl2.gea_ablauf_aktiv iSasAnGeaNichtKraftschl2.instanz_nr iSasAnGeaNichtKraftschl2.kup_ga iSasAnGeaNichtKraftschl2.kup_ge iSasAnGeaNichtKraftschl2.kzu_voll_bei_start iSasAnGeaNichtKraftschl2.nd_nmotnt_init_ga iSasAnGeaNichtKraftschl2.p_0stgea iSasAnGeaNichtKraftschl2.p_adaptgea iSasAnGeaNichtKraftschl2.p_gea iSasAnGeaNichtKraftschl2.p_offgea iSasAnGeaNichtKraftschl2.p_stgea iSasAnGeaNichtKraftschl2.pgo_gea_rampe.cBibRampeGradSi16._.letzter_ms_timer iSasAnGeaNichtKraftschl2.pgo_gea_rampe.cBibRampeGradSi16._.letzter_wert iSasAnGeaNichtKraftschl2.pgo_gea_rampe.cBibRampeGradSi16._.maximum iSasAnGeaNichtKraftschl2.pgo_gea_rampe.cBibRampeGradSi16._.minimum iSasAnGeaNichtKraftschl2.pgo_nabgea iSasAnGeaNichtKraftschl2.po_fkzu_aktiv iSasAnGeaNichtKraftschl2.po_mtgea iSasAnGeaNichtKraftschl2.ra1_ge_gestartet iSasAnGeaNichtKraftschl2.ra2_ge_gestartet iSasAnGeaNichtKraftschl2.ra3_ge_gestartet iSasAnGeaNichtKraftschl2.schalttyp_gea iSasAnGeaNichtKraftschl2.schliessen_kup_in_n_gestartet iSasAnGeaNichtKraftschl2.schnellfuellung_beendet iSasAnGeaNichtKraftschl2.statisch_gea iSasAnGeaNichtKraftschl2.synchron_verboten iSasAnGeaNichtKraftschl2.t_0kzu_gea iSasAnGeaNichtKraftschl2.t_maxgea iSasAnGeaNichtKraftschl2.t_timeout iSasAnGeaNichtKraftschl2.t_zgea iSasAnGeaNichtKraftschl2.timer16_ra1_ge iSasAnGeaNichtKraftschl2.timer_start_fa_kzu iSasAnGeaNichtKraftschl2.timer_zgea iSasAnGeaNichtKraftschl2.to_sf_kflwe iSasAnGeaNichtKraftschl2.z_gea iSasAnGeaNichtKraftschl2.zaehler_zgea /end LOC_MEASUREMENT
/end FUNCTION
/end MODULE
/end PROJECT
