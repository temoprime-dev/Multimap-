ASAP2_VERSION 1 51
/begin PROJECT _929_929 "Gen2_BMW_System_Supplier_Lib"
/begin HEADER "" VERSION "C_03_03" PROJECT_NO _929_929 /end HEADER
/begin MODULE DIM ""
/begin MOD_COMMON "" BYTE_ORDER MSB_FIRST ALIGNMENT_BYTE 1 ALIGNMENT_WORD 2 ALIGNMENT_LONG 4 ALIGNMENT_FLOAT32_IEEE 4 /end MOD_COMMON
/begin MEASUREMENT iKupHysA.iDt1PAbssoll.Pt1Fl32.x "Filterwert" FLOAT32_IEEE UMR___1_1_0_S6_S3 1 100 -1000000000 1000000000 FORMAT "%4.2" DISPLAY_IDENTIFIER Pt1Fl32.iDt1PAbssoll.iKupHysA ECU_ADDRESS 0xFFF8EDEC /end MEASUREMENT
/begin MEASUREMENT iKupHysA.iDt1PAbssoll.xp "Ableitung vom Eingangswert" FLOAT32_IEEE UMR___1_1_0_S6_S3 1 100 -32768 32767 FORMAT "%4.2" DISPLAY_IDENTIFIER iDt1PAbssoll.iKupHysA ECU_ADDRESS 0xFFF8EDE8 /end MEASUREMENT
/begin MEASUREMENT iKupHysA.iPt2MoKomp.x "Filterwert" FLOAT32_IEEE UMR___1_1_0_S6_S3 1 100 -2147483648 2147483647 FORMAT "%4.2" DISPLAY_IDENTIFIER x.iPt2MoKomp.iKupHysA ECU_ADDRESS 0xFFF8EDF0 /end MEASUREMENT
/begin MEASUREMENT iKupHysA.iPt2MoKomp.xp "Ableitung vom Eingangswert" FLOAT32_IEEE UMR__SEC_1_1_0_S6_S3 1 100 -2147483648 2147483647 FORMAT "%4.2" DISPLAY_IDENTIFIER xp.iPt2MoKomp.iKupHysA ECU_ADDRESS 0xFFF8EDF4 /end MEASUREMENT
/begin MEASUREMENT iKupHysA.iDt1IEds.Pt1Si16.x "Filterwert" SLONG UMR___1_300_0_S6_S3 1 100 -7158278.82667 7158278.82333 DISPLAY_IDENTIFIER Pt1Si16.iDt1IEds.iKupHysA ECU_ADDRESS 0xFFF8EDFC /end MEASUREMENT
/begin MEASUREMENT iKupHysA.iDt1IEds.xp "Ableitung vom Eingangswert" SWORD UMR___1_1_0_S6_S3 1 100 -32768 32767 DISPLAY_IDENTIFIER iDt1IEds.iKupHysA ECU_ADDRESS 0xFFF8EDF8 /end MEASUREMENT
/begin MEASUREMENT iKupHysA.iPt2IoKomp.x "Filterwert" FLOAT32_IEEE UMR___1_1_0_S6_S3 1 100 -2147483648 2147483647 FORMAT "%4.2" DISPLAY_IDENTIFIER x.iPt2IoKomp.iKupHysA ECU_ADDRESS 0xFFF8EE00 /end MEASUREMENT
/begin MEASUREMENT iKupHysA.iPt2IoKomp.xp "Ableitung vom Eingangswert" FLOAT32_IEEE UMR__SEC_1_1_0_S6_S3 1 100 -2147483648 2147483647 FORMAT "%4.2" DISPLAY_IDENTIFIER xp.iPt2IoKomp.iKupHysA ECU_ADDRESS 0xFFF8EE04 /end MEASUREMENT
/begin MEASUREMENT iKupHysA.iDt1Verz.Pt1Fl32.x "Filterwert" FLOAT32_IEEE UMR___1_1_0_S6_S3 1 100 -1000000000 1000000000 FORMAT "%4.2" DISPLAY_IDENTIFIER Pt1Fl32.iDt1Verz.iKupHysA ECU_ADDRESS 0xFFF8EE0C /end MEASUREMENT
/begin MEASUREMENT iKupHysA.iDt1Verz.xp "Ableitung vom Eingangswert" FLOAT32_IEEE UMR___1_1_0_S6_S3 1 100 -32768 32767 FORMAT "%4.2" DISPLAY_IDENTIFIER iDt1Verz.iKupHysA ECU_ADDRESS 0xFFF8EE08 /end MEASUREMENT
/begin MEASUREMENT iKupHysA.p_abssoll "Solldruck der Kupplung" UWORD UMR_BAR__1_1000_0_S6_S3 1 100 0 20 DISPLAY_IDENTIFIER p_abssoll_A ECU_ADDRESS 0xFFF8EDAC /end MEASUREMENT
/begin MEASUREMENT iKupHysA.p_umkehr "Druckumkehrpunkt des Solldrucks" UWORD UMR_BAR__1_1000_0_S6_S3 1 100 0 20 DISPLAY_IDENTIFIER p_umkehr_A ECU_ADDRESS 0xFFF8EDAE /end MEASUREMENT
/begin MEASUREMENT iKupHysA.p_umkehr_alt "Druckumkehrpunkt bei Gradientenwechsel des Solldrucks" UWORD UMR_BAR__1_1000_0_S6_S3 1 100 0 20 DISPLAY_IDENTIFIER p_umkehr_alt_A ECU_ADDRESS 0xFFF8EDB0 /end MEASUREMENT
/begin MEASUREMENT iKupHysA.pg_abssoll "Druckgradient Solldruck" SWORD UMR_BAR_SEC_1_1000_0_S6_S3 1 100 -32.768 32.767 DISPLAY_IDENTIFIER pg_abssoll_A ECU_ADDRESS 0xFFF8EDB2 /end MEASUREMENT
/begin MEASUREMENT iKupHysA.f_pg_abssoll "Flag Gradientenrichtung" UBYTE Conv.cModHysKo._.f_pg_abssoll_S6_S3 1 100 0 1 BIT_MASK 0x1 DISPLAY_IDENTIFIER f_pg_abssoll_A ECU_ADDRESS 0xFFF8EDB4 /end MEASUREMENT
/begin MEASUREMENT iKupHysA.trajekfort_kpl "Trajektorienfortschritt Kupplung" UBYTE UMR_PROZENT__1_1_0_S6_S3 1 100 0 100 DISPLAY_IDENTIFIER trajekfort_kpl_A ECU_ADDRESS 0xFFF8EDB5 /end MEASUREMENT
/begin MEASUREMENT iKupHysA.mo_kpl "Kompensation Momentenoffset Kupplung" SWORD UMR_NM__1_1_0_S6_S3 1 100 -32768 32767 DISPLAY_IDENTIFIER mo_kpl_A ECU_ADDRESS 0xFFF8EDB6 /end MEASUREMENT
/begin MEASUREMENT iKupHysA.po_kpl "Kompensation Druckoffset Kupplung" SWORD UMR_BAR__1_1000_0_S6_S3 1 100 -32.768 32.767 DISPLAY_IDENTIFIER po_kpl_A ECU_ADDRESS 0xFFF8EDB8 /end MEASUREMENT
/begin MEASUREMENT iKupHysA.pg_wechsel_erkannt "Wechsel der Gradientenrichtung erkannt" UBYTE Conv.cModHysKo._.pg_wechsel_erkannt_S6_S3 1 100 0 1 BIT_MASK 0x1 DISPLAY_IDENTIFIER pg_wechsel_erkannt_A ECU_ADDRESS 0xFFF8EDBA /end MEASUREMENT
/begin MEASUREMENT iKupHysA.i_eds "Sollstrom des Schaltelements" UWORD UMR_MA__1_10_0_S6_S3 1 100 0 6553.5 DISPLAY_IDENTIFIER i_eds_A ECU_ADDRESS 0xFFF8EDBC /end MEASUREMENT
/begin MEASUREMENT iKupHysA.i_umkehr "Umkehrpunkt des Sollstroms" UWORD UMR_MA__1_10_0_S6_S3 1 100 0 6553.5 DISPLAY_IDENTIFIER i_umkehr_A ECU_ADDRESS 0xFFF8EDBE /end MEASUREMENT
/begin MEASUREMENT iKupHysA.i_umkehr_alt "Umkehrpunkt bei Gradientenwechsel des Sollstroms" UWORD UMR_MA__1_10_0_S6_S3 1 100 0 6553.5 DISPLAY_IDENTIFIER i_umkehr_alt_A ECU_ADDRESS 0xFFF8EDC0 /end MEASUREMENT
/begin MEASUREMENT iKupHysA.ig_eds "Gradient Sollstrom" SWORD UMR_MA_SEC_1_1_0_S6_S3 1 100 -32768 32767 DISPLAY_IDENTIFIER ig_eds_A ECU_ADDRESS 0xFFF8EDC2 /end MEASUREMENT
/begin MEASUREMENT iKupHysA.f_ig_eds "Flag Gradientenrichtung Strom" UBYTE Conv.cModHysKo._.f_ig_eds_S6_S3 1 100 0 1 BIT_MASK 0x1 DISPLAY_IDENTIFIER f_ig_eds_A ECU_ADDRESS 0xFFF8EDC4 /end MEASUREMENT
/begin MEASUREMENT iKupHysA.trajekfort_stg "Trajektorienfortschritt Steuerung" UBYTE UMR_PROZENT__1_1_0_S6_S3 1 100 0 100 DISPLAY_IDENTIFIER trajekfort_stg_A ECU_ADDRESS 0xFFF8EDC5 /end MEASUREMENT
/begin MEASUREMENT iKupHysA.io_stg "Kompensation Stromoffset" SWORD UMR_MA__1_10_0_S6_S3 1 100 -3276.8 3276.7 DISPLAY_IDENTIFIER io_stg_A ECU_ADDRESS 0xFFF8EDC6 /end MEASUREMENT
/begin MEASUREMENT iKupHysA.ig_wechsel_erkannt "Wechsel der Gradientenrichtung erkannt" UBYTE Conv.cModHysKo._.ig_wechsel_erkannt_S6_S3 1 100 0 1 BIT_MASK 0x1 DISPLAY_IDENTIFIER ig_wechsel_erkannt_A ECU_ADDRESS 0xFFF8EDC8 /end MEASUREMENT
/begin MEASUREMENT iKupHysA.po_wirk "Druckoffset Verzugskompensation" SWORD UMR_BAR__1_1000_0_S6_S3 1 100 0 20 DISPLAY_IDENTIFIER po_wirk_A ECU_ADDRESS 0xFFF8EDCA /end MEASUREMENT
/begin MEASUREMENT iKupHysA.pg_wirk "Druckgradient Wirkdruck" SWORD UMR_BAR_SEC_1_10_0_S6_S3 1 100 -3276.8 3276.7 DISPLAY_IDENTIFIER pg_wirk_A ECU_ADDRESS 0xFFF8EDCC /end MEASUREMENT
/begin MEASUREMENT iKupHysA.k_kf_out "Faktor aus Kennfeld" SWORD UMR___1_1000_0_S6_S3 1 100 0 32.767 DISPLAY_IDENTIFIER k_kf_out_A ECU_ADDRESS 0xFFF8EDCE /end MEASUREMENT
/begin MEASUREMENT iKupHysA.k_rampe_out "Faktor aus Rampe" SWORD UMR___1_1000_0_S6_S3 1 100 0 32.767 DISPLAY_IDENTIFIER k_rampe_out_A ECU_ADDRESS 0xFFF8EDD0 /end MEASUREMENT
/begin MEASUREMENT iKupHysA.po_vhyskomp "Druckoffset Verzugskompensation" SWORD UMR_BAR__1_1000_0_S6_S3 1 100 -32.768 32.767 DISPLAY_IDENTIFIER po_vhyskomp_A ECU_ADDRESS 0xFFF8EDD2 /end MEASUREMENT
/begin MEASUREMENT iKupHysA.z_rampe "Der Zustand" UBYTE Conv.cModHysKo._.z_rampe_S6_S3 1 100 0 3 DISPLAY_IDENTIFIER z_rampe_A ECU_ADDRESS 0xFFF8EDD4 /end MEASUREMENT
/begin MEASUREMENT iKupHysB.iDt1PAbssoll.Pt1Fl32.x "Filterwert" FLOAT32_IEEE UMR___1_1_0_S6_S3 1 100 -1000000000 1000000000 FORMAT "%4.2" DISPLAY_IDENTIFIER Pt1Fl32.iDt1PAbssoll.iKupHysB ECU_ADDRESS 0xFFF8EE50 /end MEASUREMENT
/begin MEASUREMENT iKupHysB.iDt1PAbssoll.xp "Ableitung vom Eingangswert" FLOAT32_IEEE UMR___1_1_0_S6_S3 1 100 -32768 32767 FORMAT "%4.2" DISPLAY_IDENTIFIER iDt1PAbssoll.iKupHysB ECU_ADDRESS 0xFFF8EE4C /end MEASUREMENT
/begin MEASUREMENT iKupHysB.iPt2MoKomp.x "Filterwert" FLOAT32_IEEE UMR___1_1_0_S6_S3 1 100 -2147483648 2147483647 FORMAT "%4.2" DISPLAY_IDENTIFIER x.iPt2MoKomp.iKupHysB ECU_ADDRESS 0xFFF8EE54 /end MEASUREMENT
/begin MEASUREMENT iKupHysB.iPt2MoKomp.xp "Ableitung vom Eingangswert" FLOAT32_IEEE UMR__SEC_1_1_0_S6_S3 1 100 -2147483648 2147483647 FORMAT "%4.2" DISPLAY_IDENTIFIER xp.iPt2MoKomp.iKupHysB ECU_ADDRESS 0xFFF8EE58 /end MEASUREMENT
/begin MEASUREMENT iKupHysB.iDt1IEds.Pt1Si16.x "Filterwert" SLONG UMR___1_300_0_S6_S3 1 100 -7158278.82667 7158278.82333 DISPLAY_IDENTIFIER Pt1Si16.iDt1IEds.iKupHysB ECU_ADDRESS 0xFFF8EE60 /end MEASUREMENT
/begin MEASUREMENT iKupHysB.iDt1IEds.xp "Ableitung vom Eingangswert" SWORD UMR___1_1_0_S6_S3 1 100 -32768 32767 DISPLAY_IDENTIFIER iDt1IEds.iKupHysB ECU_ADDRESS 0xFFF8EE5C /end MEASUREMENT
/begin MEASUREMENT iKupHysB.iPt2IoKomp.x "Filterwert" FLOAT32_IEEE UMR___1_1_0_S6_S3 1 100 -2147483648 2147483647 FORMAT "%4.2" DISPLAY_IDENTIFIER x.iPt2IoKomp.iKupHysB ECU_ADDRESS 0xFFF8EE64 /end MEASUREMENT
/begin MEASUREMENT iKupHysB.iPt2IoKomp.xp "Ableitung vom Eingangswert" FLOAT32_IEEE UMR__SEC_1_1_0_S6_S3 1 100 -2147483648 2147483647 FORMAT "%4.2" DISPLAY_IDENTIFIER xp.iPt2IoKomp.iKupHysB ECU_ADDRESS 0xFFF8EE68 /end MEASUREMENT
/begin MEASUREMENT iKupHysB.iDt1Verz.Pt1Fl32.x "Filterwert" FLOAT32_IEEE UMR___1_1_0_S6_S3 1 100 -1000000000 1000000000 FORMAT "%4.2" DISPLAY_IDENTIFIER Pt1Fl32.iDt1Verz.iKupHysB ECU_ADDRESS 0xFFF8EE70 /end MEASUREMENT
/begin MEASUREMENT iKupHysB.iDt1Verz.xp "Ableitung vom Eingangswert" FLOAT32_IEEE UMR___1_1_0_S6_S3 1 100 -32768 32767 FORMAT "%4.2" DISPLAY_IDENTIFIER iDt1Verz.iKupHysB ECU_ADDRESS 0xFFF8EE6C /end MEASUREMENT
/begin MEASUREMENT iKupHysB.p_abssoll "Solldruck der Kupplung" UWORD UMR_BAR__1_1000_0_S6_S3 1 100 0 20 DISPLAY_IDENTIFIER p_abssoll_B ECU_ADDRESS 0xFFF8EE10 /end MEASUREMENT
/begin MEASUREMENT iKupHysB.p_umkehr "Druckumkehrpunkt des Solldrucks" UWORD UMR_BAR__1_1000_0_S6_S3 1 100 0 20 DISPLAY_IDENTIFIER p_umkehr_B ECU_ADDRESS 0xFFF8EE12 /end MEASUREMENT
/begin MEASUREMENT iKupHysB.p_umkehr_alt "Druckumkehrpunkt bei Gradientenwechsel des Solldrucks" UWORD UMR_BAR__1_1000_0_S6_S3 1 100 0 20 DISPLAY_IDENTIFIER p_umkehr_alt_B ECU_ADDRESS 0xFFF8EE14 /end MEASUREMENT
/begin MEASUREMENT iKupHysB.pg_abssoll "Druckgradient Solldruck" SWORD UMR_BAR_SEC_1_1000_0_S6_S3 1 100 -32.768 32.767 DISPLAY_IDENTIFIER pg_abssoll_B ECU_ADDRESS 0xFFF8EE16 /end MEASUREMENT
/begin MEASUREMENT iKupHysB.f_pg_abssoll "Flag Gradientenrichtung" UBYTE Conv.cModHysKo._.f_pg_abssoll_S6_S3 1 100 0 1 BIT_MASK 0x1 DISPLAY_IDENTIFIER f_pg_abssoll_B ECU_ADDRESS 0xFFF8EE18 /end MEASUREMENT
/begin MEASUREMENT iKupHysB.trajekfort_kpl "Trajektorienfortschritt Kupplung" UBYTE UMR_PROZENT__1_1_0_S6_S3 1 100 0 100 DISPLAY_IDENTIFIER trajekfort_kpl_B ECU_ADDRESS 0xFFF8EE19 /end MEASUREMENT
/begin MEASUREMENT iKupHysB.mo_kpl "Kompensation Momentenoffset Kupplung" SWORD UMR_NM__1_1_0_S6_S3 1 100 -32768 32767 DISPLAY_IDENTIFIER mo_kpl_B ECU_ADDRESS 0xFFF8EE1A /end MEASUREMENT
/begin MEASUREMENT iKupHysB.po_kpl "Kompensation Druckoffset Kupplung" SWORD UMR_BAR__1_1000_0_S6_S3 1 100 -32.768 32.767 DISPLAY_IDENTIFIER po_kpl_B ECU_ADDRESS 0xFFF8EE1C /end MEASUREMENT
/begin MEASUREMENT iKupHysB.pg_wechsel_erkannt "Wechsel der Gradientenrichtung erkannt" UBYTE Conv.cModHysKo._.pg_wechsel_erkannt_S6_S3 1 100 0 1 BIT_MASK 0x1 DISPLAY_IDENTIFIER pg_wechsel_erkannt_B ECU_ADDRESS 0xFFF8EE1E /end MEASUREMENT
/begin MEASUREMENT iKupHysB.i_eds "Sollstrom des Schaltelements" UWORD UMR_MA__1_10_0_S6_S3 1 100 0 6553.5 DISPLAY_IDENTIFIER i_eds_B ECU_ADDRESS 0xFFF8EE20 /end MEASUREMENT
/begin MEASUREMENT iKupHysB.i_umkehr "Umkehrpunkt des Sollstroms" UWORD UMR_MA__1_10_0_S6_S3 1 100 0 6553.5 DISPLAY_IDENTIFIER i_umkehr_B ECU_ADDRESS 0xFFF8EE22 /end MEASUREMENT
/begin MEASUREMENT iKupHysB.i_umkehr_alt "Umkehrpunkt bei Gradientenwechsel des Sollstroms" UWORD UMR_MA__1_10_0_S6_S3 1 100 0 6553.5 DISPLAY_IDENTIFIER i_umkehr_alt_B ECU_ADDRESS 0xFFF8EE24 /end MEASUREMENT
/begin MEASUREMENT iKupHysB.ig_eds "Gradient Sollstrom" SWORD UMR_MA_SEC_1_1_0_S6_S3 1 100 -32768 32767 DISPLAY_IDENTIFIER ig_eds_B ECU_ADDRESS 0xFFF8EE26 /end MEASUREMENT
/begin MEASUREMENT iKupHysB.f_ig_eds "Flag Gradientenrichtung Strom" UBYTE Conv.cModHysKo._.f_ig_eds_S6_S3 1 100 0 1 BIT_MASK 0x1 DISPLAY_IDENTIFIER f_ig_eds_B ECU_ADDRESS 0xFFF8EE28 /end MEASUREMENT
/begin MEASUREMENT iKupHysB.trajekfort_stg "Trajektorienfortschritt Steuerung" UBYTE UMR_PROZENT__1_1_0_S6_S3 1 100 0 100 DISPLAY_IDENTIFIER trajekfort_stg_B ECU_ADDRESS 0xFFF8EE29 /end MEASUREMENT
/begin MEASUREMENT iKupHysB.io_stg "Kompensation Stromoffset" SWORD UMR_MA__1_10_0_S6_S3 1 100 -3276.8 3276.7 DISPLAY_IDENTIFIER io_stg_B ECU_ADDRESS 0xFFF8EE2A /end MEASUREMENT
/begin MEASUREMENT iKupHysB.ig_wechsel_erkannt "Wechsel der Gradientenrichtung erkannt" UBYTE Conv.cModHysKo._.ig_wechsel_erkannt_S6_S3 1 100 0 1 BIT_MASK 0x1 DISPLAY_IDENTIFIER ig_wechsel_erkannt_B ECU_ADDRESS 0xFFF8EE2C /end MEASUREMENT
/begin MEASUREMENT iKupHysB.po_wirk "Druckoffset Verzugskompensation" SWORD UMR_BAR__1_1000_0_S6_S3 1 100 0 20 DISPLAY_IDENTIFIER po_wirk_B ECU_ADDRESS 0xFFF8EE2E /end MEASUREMENT
/begin MEASUREMENT iKupHysB.pg_wirk "Druckgradient Wirkdruck" SWORD UMR_BAR_SEC_1_10_0_S6_S3 1 100 -3276.8 3276.7 DISPLAY_IDENTIFIER pg_wirk_B ECU_ADDRESS 0xFFF8EE30 /end MEASUREMENT
/begin MEASUREMENT iKupHysB.k_kf_out "Faktor aus Kennfeld" SWORD UMR___1_1000_0_S6_S3 1 100 0 32.767 DISPLAY_IDENTIFIER k_kf_out_B ECU_ADDRESS 0xFFF8EE32 /end MEASUREMENT
/begin MEASUREMENT iKupHysB.k_rampe_out "Faktor aus Rampe" SWORD UMR___1_1000_0_S6_S3 1 100 0 32.767 DISPLAY_IDENTIFIER k_rampe_out_B ECU_ADDRESS 0xFFF8EE34 /end MEASUREMENT
/begin MEASUREMENT iKupHysB.po_vhyskomp "Druckoffset Verzugskompensation" SWORD UMR_BAR__1_1000_0_S6_S3 1 100 -32.768 32.767 DISPLAY_IDENTIFIER po_vhyskomp_B ECU_ADDRESS 0xFFF8EE36 /end MEASUREMENT
/begin MEASUREMENT iKupHysB.z_rampe "Der Zustand" UBYTE Conv.cModHysKo._.z_rampe_S6_S3 1 100 0 3 DISPLAY_IDENTIFIER z_rampe_B ECU_ADDRESS 0xFFF8EE38 /end MEASUREMENT
/begin MEASUREMENT iKupHysC.iDt1PAbssoll.Pt1Fl32.x "Filterwert" FLOAT32_IEEE UMR___1_1_0_S6_S3 1 100 -1000000000 1000000000 FORMAT "%4.2" DISPLAY_IDENTIFIER Pt1Fl32.iDt1PAbssoll.iKupHysC ECU_ADDRESS 0xFFF8EEB4 /end MEASUREMENT
/begin MEASUREMENT iKupHysC.iDt1PAbssoll.xp "Ableitung vom Eingangswert" FLOAT32_IEEE UMR___1_1_0_S6_S3 1 100 -32768 32767 FORMAT "%4.2" DISPLAY_IDENTIFIER iDt1PAbssoll.iKupHysC ECU_ADDRESS 0xFFF8EEB0 /end MEASUREMENT
/begin MEASUREMENT iKupHysC.iPt2MoKomp.x "Filterwert" FLOAT32_IEEE UMR___1_1_0_S6_S3 1 100 -2147483648 2147483647 FORMAT "%4.2" DISPLAY_IDENTIFIER x.iPt2MoKomp.iKupHysC ECU_ADDRESS 0xFFF8EEB8 /end MEASUREMENT
/begin MEASUREMENT iKupHysC.iPt2MoKomp.xp "Ableitung vom Eingangswert" FLOAT32_IEEE UMR__SEC_1_1_0_S6_S3 1 100 -2147483648 2147483647 FORMAT "%4.2" DISPLAY_IDENTIFIER xp.iPt2MoKomp.iKupHysC ECU_ADDRESS 0xFFF8EEBC /end MEASUREMENT
/begin MEASUREMENT iKupHysC.iDt1IEds.Pt1Si16.x "Filterwert" SLONG UMR___1_300_0_S6_S3 1 100 -7158278.82667 7158278.82333 DISPLAY_IDENTIFIER Pt1Si16.iDt1IEds.iKupHysC ECU_ADDRESS 0xFFF8EEC4 /end MEASUREMENT
/begin MEASUREMENT iKupHysC.iDt1IEds.xp "Ableitung vom Eingangswert" SWORD UMR___1_1_0_S6_S3 1 100 -32768 32767 DISPLAY_IDENTIFIER iDt1IEds.iKupHysC ECU_ADDRESS 0xFFF8EEC0 /end MEASUREMENT
/begin MEASUREMENT iKupHysC.iPt2IoKomp.x "Filterwert" FLOAT32_IEEE UMR___1_1_0_S6_S3 1 100 -2147483648 2147483647 FORMAT "%4.2" DISPLAY_IDENTIFIER x.iPt2IoKomp.iKupHysC ECU_ADDRESS 0xFFF8EEC8 /end MEASUREMENT
/begin MEASUREMENT iKupHysC.iPt2IoKomp.xp "Ableitung vom Eingangswert" FLOAT32_IEEE UMR__SEC_1_1_0_S6_S3 1 100 -2147483648 2147483647 FORMAT "%4.2" DISPLAY_IDENTIFIER xp.iPt2IoKomp.iKupHysC ECU_ADDRESS 0xFFF8EECC /end MEASUREMENT
/begin MEASUREMENT iKupHysC.iDt1Verz.Pt1Fl32.x "Filterwert" FLOAT32_IEEE UMR___1_1_0_S6_S3 1 100 -1000000000 1000000000 FORMAT "%4.2" DISPLAY_IDENTIFIER Pt1Fl32.iDt1Verz.iKupHysC ECU_ADDRESS 0xFFF8EED4 /end MEASUREMENT
/begin MEASUREMENT iKupHysC.iDt1Verz.xp "Ableitung vom Eingangswert" FLOAT32_IEEE UMR___1_1_0_S6_S3 1 100 -32768 32767 FORMAT "%4.2" DISPLAY_IDENTIFIER iDt1Verz.iKupHysC ECU_ADDRESS 0xFFF8EED0 /end MEASUREMENT
/begin MEASUREMENT iKupHysC.p_abssoll "Solldruck der Kupplung" UWORD UMR_BAR__1_1000_0_S6_S3 1 100 0 20 DISPLAY_IDENTIFIER p_abssoll_C ECU_ADDRESS 0xFFF8EE74 /end MEASUREMENT
/begin MEASUREMENT iKupHysC.p_umkehr "Druckumkehrpunkt des Solldrucks" UWORD UMR_BAR__1_1000_0_S6_S3 1 100 0 20 DISPLAY_IDENTIFIER p_umkehr_C ECU_ADDRESS 0xFFF8EE76 /end MEASUREMENT
/begin MEASUREMENT iKupHysC.p_umkehr_alt "Druckumkehrpunkt bei Gradientenwechsel des Solldrucks" UWORD UMR_BAR__1_1000_0_S6_S3 1 100 0 20 DISPLAY_IDENTIFIER p_umkehr_alt_C ECU_ADDRESS 0xFFF8EE78 /end MEASUREMENT
/begin MEASUREMENT iKupHysC.pg_abssoll "Druckgradient Solldruck" SWORD UMR_BAR_SEC_1_1000_0_S6_S3 1 100 -32.768 32.767 DISPLAY_IDENTIFIER pg_abssoll_C ECU_ADDRESS 0xFFF8EE7A /end MEASUREMENT
/begin MEASUREMENT iKupHysC.f_pg_abssoll "Flag Gradientenrichtung" UBYTE Conv.cModHysKo._.f_pg_abssoll_S6_S3 1 100 0 1 BIT_MASK 0x1 DISPLAY_IDENTIFIER f_pg_abssoll_C ECU_ADDRESS 0xFFF8EE7C /end MEASUREMENT
/begin MEASUREMENT iKupHysC.trajekfort_kpl "Trajektorienfortschritt Kupplung" UBYTE UMR_PROZENT__1_1_0_S6_S3 1 100 0 100 DISPLAY_IDENTIFIER trajekfort_kpl_C ECU_ADDRESS 0xFFF8EE7D /end MEASUREMENT
/begin MEASUREMENT iKupHysC.mo_kpl "Kompensation Momentenoffset Kupplung" SWORD UMR_NM__1_1_0_S6_S3 1 100 -32768 32767 DISPLAY_IDENTIFIER mo_kpl_C ECU_ADDRESS 0xFFF8EE7E /end MEASUREMENT
/begin MEASUREMENT iKupHysC.po_kpl "Kompensation Druckoffset Kupplung" SWORD UMR_BAR__1_1000_0_S6_S3 1 100 -32.768 32.767 DISPLAY_IDENTIFIER po_kpl_C ECU_ADDRESS 0xFFF8EE80 /end MEASUREMENT
/begin MEASUREMENT iKupHysC.pg_wechsel_erkannt "Wechsel der Gradientenrichtung erkannt" UBYTE Conv.cModHysKo._.pg_wechsel_erkannt_S6_S3 1 100 0 1 BIT_MASK 0x1 DISPLAY_IDENTIFIER pg_wechsel_erkannt_C ECU_ADDRESS 0xFFF8EE82 /end MEASUREMENT
/begin MEASUREMENT iKupHysC.i_eds "Sollstrom des Schaltelements" UWORD UMR_MA__1_10_0_S6_S3 1 100 0 6553.5 DISPLAY_IDENTIFIER i_eds_C ECU_ADDRESS 0xFFF8EE84 /end MEASUREMENT
/begin MEASUREMENT iKupHysC.i_umkehr "Umkehrpunkt des Sollstroms" UWORD UMR_MA__1_10_0_S6_S3 1 100 0 6553.5 DISPLAY_IDENTIFIER i_umkehr_C ECU_ADDRESS 0xFFF8EE86 /end MEASUREMENT
/begin MEASUREMENT iKupHysC.i_umkehr_alt "Umkehrpunkt bei Gradientenwechsel des Sollstroms" UWORD UMR_MA__1_10_0_S6_S3 1 100 0 6553.5 DISPLAY_IDENTIFIER i_umkehr_alt_C ECU_ADDRESS 0xFFF8EE88 /end MEASUREMENT
/begin MEASUREMENT iKupHysC.ig_eds "Gradient Sollstrom" SWORD UMR_MA_SEC_1_1_0_S6_S3 1 100 -32768 32767 DISPLAY_IDENTIFIER ig_eds_C ECU_ADDRESS 0xFFF8EE8A /end MEASUREMENT
/begin MEASUREMENT iKupHysC.f_ig_eds "Flag Gradientenrichtung Strom" UBYTE Conv.cModHysKo._.f_ig_eds_S6_S3 1 100 0 1 BIT_MASK 0x1 DISPLAY_IDENTIFIER f_ig_eds_C ECU_ADDRESS 0xFFF8EE8C /end MEASUREMENT
/begin MEASUREMENT iKupHysC.trajekfort_stg "Trajektorienfortschritt Steuerung" UBYTE UMR_PROZENT__1_1_0_S6_S3 1 100 0 100 DISPLAY_IDENTIFIER trajekfort_stg_C ECU_ADDRESS 0xFFF8EE8D /end MEASUREMENT
/begin MEASUREMENT iKupHysC.io_stg "Kompensation Stromoffset" SWORD UMR_MA__1_10_0_S6_S3 1 100 -3276.8 3276.7 DISPLAY_IDENTIFIER io_stg_C ECU_ADDRESS 0xFFF8EE8E /end MEASUREMENT
/begin MEASUREMENT iKupHysC.ig_wechsel_erkannt "Wechsel der Gradientenrichtung erkannt" UBYTE Conv.cModHysKo._.ig_wechsel_erkannt_S6_S3 1 100 0 1 BIT_MASK 0x1 DISPLAY_IDENTIFIER ig_wechsel_erkannt_C ECU_ADDRESS 0xFFF8EE90 /end MEASUREMENT
/begin MEASUREMENT iKupHysC.po_wirk "Druckoffset Verzugskompensation" SWORD UMR_BAR__1_1000_0_S6_S3 1 100 0 20 DISPLAY_IDENTIFIER po_wirk_C ECU_ADDRESS 0xFFF8EE92 /end MEASUREMENT
/begin MEASUREMENT iKupHysC.pg_wirk "Druckgradient Wirkdruck" SWORD UMR_BAR_SEC_1_10_0_S6_S3 1 100 -3276.8 3276.7 DISPLAY_IDENTIFIER pg_wirk_C ECU_ADDRESS 0xFFF8EE94 /end MEASUREMENT
/begin MEASUREMENT iKupHysC.k_kf_out "Faktor aus Kennfeld" SWORD UMR___1_1000_0_S6_S3 1 100 0 32.767 DISPLAY_IDENTIFIER k_kf_out_C ECU_ADDRESS 0xFFF8EE96 /end MEASUREMENT
/begin MEASUREMENT iKupHysC.k_rampe_out "Faktor aus Rampe" SWORD UMR___1_1000_0_S6_S3 1 100 0 32.767 DISPLAY_IDENTIFIER k_rampe_out_C ECU_ADDRESS 0xFFF8EE98 /end MEASUREMENT
/begin MEASUREMENT iKupHysC.po_vhyskomp "Druckoffset Verzugskompensation" SWORD UMR_BAR__1_1000_0_S6_S3 1 100 -32.768 32.767 DISPLAY_IDENTIFIER po_vhyskomp_C ECU_ADDRESS 0xFFF8EE9A /end MEASUREMENT
/begin MEASUREMENT iKupHysC.z_rampe "Der Zustand" UBYTE Conv.cModHysKo._.z_rampe_S6_S3 1 100 0 3 DISPLAY_IDENTIFIER z_rampe_C ECU_ADDRESS 0xFFF8EE9C /end MEASUREMENT
/begin MEASUREMENT iKupHysD.iDt1PAbssoll.Pt1Fl32.x "Filterwert" FLOAT32_IEEE UMR___1_1_0_S6_S3 1 100 -1000000000 1000000000 FORMAT "%4.2" DISPLAY_IDENTIFIER Pt1Fl32.iDt1PAbssoll.iKupHysD ECU_ADDRESS 0xFFF8EF18 /end MEASUREMENT
/begin MEASUREMENT iKupHysD.iDt1PAbssoll.xp "Ableitung vom Eingangswert" FLOAT32_IEEE UMR___1_1_0_S6_S3 1 100 -32768 32767 FORMAT "%4.2" DISPLAY_IDENTIFIER iDt1PAbssoll.iKupHysD ECU_ADDRESS 0xFFF8EF14 /end MEASUREMENT
/begin MEASUREMENT iKupHysD.iPt2MoKomp.x "Filterwert" FLOAT32_IEEE UMR___1_1_0_S6_S3 1 100 -2147483648 2147483647 FORMAT "%4.2" DISPLAY_IDENTIFIER x.iPt2MoKomp.iKupHysD ECU_ADDRESS 0xFFF8EF1C /end MEASUREMENT
/begin MEASUREMENT iKupHysD.iPt2MoKomp.xp "Ableitung vom Eingangswert" FLOAT32_IEEE UMR__SEC_1_1_0_S6_S3 1 100 -2147483648 2147483647 FORMAT "%4.2" DISPLAY_IDENTIFIER xp.iPt2MoKomp.iKupHysD ECU_ADDRESS 0xFFF8EF20 /end MEASUREMENT
/begin MEASUREMENT iKupHysD.iDt1IEds.Pt1Si16.x "Filterwert" SLONG UMR___1_300_0_S6_S3 1 100 -7158278.82667 7158278.82333 DISPLAY_IDENTIFIER Pt1Si16.iDt1IEds.iKupHysD ECU_ADDRESS 0xFFF8EF28 /end MEASUREMENT
/begin MEASUREMENT iKupHysD.iDt1IEds.xp "Ableitung vom Eingangswert" SWORD UMR___1_1_0_S6_S3 1 100 -32768 32767 DISPLAY_IDENTIFIER iDt1IEds.iKupHysD ECU_ADDRESS 0xFFF8EF24 /end MEASUREMENT
/begin MEASUREMENT iKupHysD.iPt2IoKomp.x "Filterwert" FLOAT32_IEEE UMR___1_1_0_S6_S3 1 100 -2147483648 2147483647 FORMAT "%4.2" DISPLAY_IDENTIFIER x.iPt2IoKomp.iKupHysD ECU_ADDRESS 0xFFF8EF2C /end MEASUREMENT
/begin MEASUREMENT iKupHysD.iPt2IoKomp.xp "Ableitung vom Eingangswert" FLOAT32_IEEE UMR__SEC_1_1_0_S6_S3 1 100 -2147483648 2147483647 FORMAT "%4.2" DISPLAY_IDENTIFIER xp.iPt2IoKomp.iKupHysD ECU_ADDRESS 0xFFF8EF30 /end MEASUREMENT
/begin MEASUREMENT iKupHysD.iDt1Verz.Pt1Fl32.x "Filterwert" FLOAT32_IEEE UMR___1_1_0_S6_S3 1 100 -1000000000 1000000000 FORMAT "%4.2" DISPLAY_IDENTIFIER Pt1Fl32.iDt1Verz.iKupHysD ECU_ADDRESS 0xFFF8EF38 /end MEASUREMENT
/begin MEASUREMENT iKupHysD.iDt1Verz.xp "Ableitung vom Eingangswert" FLOAT32_IEEE UMR___1_1_0_S6_S3 1 100 -32768 32767 FORMAT "%4.2" DISPLAY_IDENTIFIER iDt1Verz.iKupHysD ECU_ADDRESS 0xFFF8EF34 /end MEASUREMENT
/begin MEASUREMENT iKupHysD.p_abssoll "Solldruck der Kupplung" UWORD UMR_BAR__1_1000_0_S6_S3 1 100 0 20 DISPLAY_IDENTIFIER p_abssoll_D ECU_ADDRESS 0xFFF8EED8 /end MEASUREMENT
/begin MEASUREMENT iKupHysD.p_umkehr "Druckumkehrpunkt des Solldrucks" UWORD UMR_BAR__1_1000_0_S6_S3 1 100 0 20 DISPLAY_IDENTIFIER p_umkehr_D ECU_ADDRESS 0xFFF8EEDA /end MEASUREMENT
/begin MEASUREMENT iKupHysD.p_umkehr_alt "Druckumkehrpunkt bei Gradientenwechsel des Solldrucks" UWORD UMR_BAR__1_1000_0_S6_S3 1 100 0 20 DISPLAY_IDENTIFIER p_umkehr_alt_D ECU_ADDRESS 0xFFF8EEDC /end MEASUREMENT
/begin MEASUREMENT iKupHysD.pg_abssoll "Druckgradient Solldruck" SWORD UMR_BAR_SEC_1_1000_0_S6_S3 1 100 -32.768 32.767 DISPLAY_IDENTIFIER pg_abssoll_D ECU_ADDRESS 0xFFF8EEDE /end MEASUREMENT
/begin MEASUREMENT iKupHysD.f_pg_abssoll "Flag Gradientenrichtung" UBYTE Conv.cModHysKo._.f_pg_abssoll_S6_S3 1 100 0 1 BIT_MASK 0x1 DISPLAY_IDENTIFIER f_pg_abssoll_D ECU_ADDRESS 0xFFF8EEE0 /end MEASUREMENT
/begin MEASUREMENT iKupHysD.trajekfort_kpl "Trajektorienfortschritt Kupplung" UBYTE UMR_PROZENT__1_1_0_S6_S3 1 100 0 100 DISPLAY_IDENTIFIER trajekfort_kpl_D ECU_ADDRESS 0xFFF8EEE1 /end MEASUREMENT
/begin MEASUREMENT iKupHysD.mo_kpl "Kompensation Momentenoffset Kupplung" SWORD UMR_NM__1_1_0_S6_S3 1 100 -32768 32767 DISPLAY_IDENTIFIER mo_kpl_D ECU_ADDRESS 0xFFF8EEE2 /end MEASUREMENT
/begin MEASUREMENT iKupHysD.po_kpl "Kompensation Druckoffset Kupplung" SWORD UMR_BAR__1_1000_0_S6_S3 1 100 -32.768 32.767 DISPLAY_IDENTIFIER po_kpl_D ECU_ADDRESS 0xFFF8EEE4 /end MEASUREMENT
/begin MEASUREMENT iKupHysD.pg_wechsel_erkannt "Wechsel der Gradientenrichtung erkannt" UBYTE Conv.cModHysKo._.pg_wechsel_erkannt_S6_S3 1 100 0 1 BIT_MASK 0x1 DISPLAY_IDENTIFIER pg_wechsel_erkannt_D ECU_ADDRESS 0xFFF8EEE6 /end MEASUREMENT
/begin MEASUREMENT iKupHysD.i_eds "Sollstrom des Schaltelements" UWORD UMR_MA__1_10_0_S6_S3 1 100 0 6553.5 DISPLAY_IDENTIFIER i_eds_D ECU_ADDRESS 0xFFF8EEE8 /end MEASUREMENT
/begin MEASUREMENT iKupHysD.i_umkehr "Umkehrpunkt des Sollstroms" UWORD UMR_MA__1_10_0_S6_S3 1 100 0 6553.5 DISPLAY_IDENTIFIER i_umkehr_D ECU_ADDRESS 0xFFF8EEEA /end MEASUREMENT
/begin MEASUREMENT iKupHysD.i_umkehr_alt "Umkehrpunkt bei Gradientenwechsel des Sollstroms" UWORD UMR_MA__1_10_0_S6_S3 1 100 0 6553.5 DISPLAY_IDENTIFIER i_umkehr_alt_D ECU_ADDRESS 0xFFF8EEEC /end MEASUREMENT
/begin MEASUREMENT iKupHysD.ig_eds "Gradient Sollstrom" SWORD UMR_MA_SEC_1_1_0_S6_S3 1 100 -32768 32767 DISPLAY_IDENTIFIER ig_eds_D ECU_ADDRESS 0xFFF8EEEE /end MEASUREMENT
/begin MEASUREMENT iKupHysD.f_ig_eds "Flag Gradientenrichtung Strom" UBYTE Conv.cModHysKo._.f_ig_eds_S6_S3 1 100 0 1 BIT_MASK 0x1 DISPLAY_IDENTIFIER f_ig_eds_D ECU_ADDRESS 0xFFF8EEF0 /end MEASUREMENT
/begin MEASUREMENT iKupHysD.trajekfort_stg "Trajektorienfortschritt Steuerung" UBYTE UMR_PROZENT__1_1_0_S6_S3 1 100 0 100 DISPLAY_IDENTIFIER trajekfort_stg_D ECU_ADDRESS 0xFFF8EEF1 /end MEASUREMENT
/begin MEASUREMENT iKupHysD.io_stg "Kompensation Stromoffset" SWORD UMR_MA__1_10_0_S6_S3 1 100 -3276.8 3276.7 DISPLAY_IDENTIFIER io_stg_D ECU_ADDRESS 0xFFF8EEF2 /end MEASUREMENT
/begin MEASUREMENT iKupHysD.ig_wechsel_erkannt "Wechsel der Gradientenrichtung erkannt" UBYTE Conv.cModHysKo._.ig_wechsel_erkannt_S6_S3 1 100 0 1 BIT_MASK 0x1 DISPLAY_IDENTIFIER ig_wechsel_erkannt_D ECU_ADDRESS 0xFFF8EEF4 /end MEASUREMENT
/begin MEASUREMENT iKupHysD.po_wirk "Druckoffset Verzugskompensation" SWORD UMR_BAR__1_1000_0_S6_S3 1 100 0 20 DISPLAY_IDENTIFIER po_wirk_D ECU_ADDRESS 0xFFF8EEF6 /end MEASUREMENT
/begin MEASUREMENT iKupHysD.pg_wirk "Druckgradient Wirkdruck" SWORD UMR_BAR_SEC_1_10_0_S6_S3 1 100 -3276.8 3276.7 DISPLAY_IDENTIFIER pg_wirk_D ECU_ADDRESS 0xFFF8EEF8 /end MEASUREMENT
/begin MEASUREMENT iKupHysD.k_kf_out "Faktor aus Kennfeld" SWORD UMR___1_1000_0_S6_S3 1 100 0 32.767 DISPLAY_IDENTIFIER k_kf_out_D ECU_ADDRESS 0xFFF8EEFA /end MEASUREMENT
/begin MEASUREMENT iKupHysD.k_rampe_out "Faktor aus Rampe" SWORD UMR___1_1000_0_S6_S3 1 100 0 32.767 DISPLAY_IDENTIFIER k_rampe_out_D ECU_ADDRESS 0xFFF8EEFC /end MEASUREMENT
/begin MEASUREMENT iKupHysD.po_vhyskomp "Druckoffset Verzugskompensation" SWORD UMR_BAR__1_1000_0_S6_S3 1 100 -32.768 32.767 DISPLAY_IDENTIFIER po_vhyskomp_D ECU_ADDRESS 0xFFF8EEFE /end MEASUREMENT
/begin MEASUREMENT iKupHysD.z_rampe "Der Zustand" UBYTE Conv.cModHysKo._.z_rampe_S6_S3 1 100 0 3 DISPLAY_IDENTIFIER z_rampe_D ECU_ADDRESS 0xFFF8EF00 /end MEASUREMENT
/begin MEASUREMENT iKupHysE.iDt1PAbssoll.Pt1Fl32.x "Filterwert" FLOAT32_IEEE UMR___1_1_0_S6_S3 1 100 -1000000000 1000000000 FORMAT "%4.2" DISPLAY_IDENTIFIER Pt1Fl32.iDt1PAbssoll.iKupHysE ECU_ADDRESS 0xFFF8EF7C /end MEASUREMENT
/begin MEASUREMENT iKupHysE.iDt1PAbssoll.xp "Ableitung vom Eingangswert" FLOAT32_IEEE UMR___1_1_0_S6_S3 1 100 -32768 32767 FORMAT "%4.2" DISPLAY_IDENTIFIER iDt1PAbssoll.iKupHysE ECU_ADDRESS 0xFFF8EF78 /end MEASUREMENT
/begin MEASUREMENT iKupHysE.iPt2MoKomp.x "Filterwert" FLOAT32_IEEE UMR___1_1_0_S6_S3 1 100 -2147483648 2147483647 FORMAT "%4.2" DISPLAY_IDENTIFIER x.iPt2MoKomp.iKupHysE ECU_ADDRESS 0xFFF8EF80 /end MEASUREMENT
/begin MEASUREMENT iKupHysE.iPt2MoKomp.xp "Ableitung vom Eingangswert" FLOAT32_IEEE UMR__SEC_1_1_0_S6_S3 1 100 -2147483648 2147483647 FORMAT "%4.2" DISPLAY_IDENTIFIER xp.iPt2MoKomp.iKupHysE ECU_ADDRESS 0xFFF8EF84 /end MEASUREMENT
/begin MEASUREMENT iKupHysE.iDt1IEds.Pt1Si16.x "Filterwert" SLONG UMR___1_300_0_S6_S3 1 100 -7158278.82667 7158278.82333 DISPLAY_IDENTIFIER Pt1Si16.iDt1IEds.iKupHysE ECU_ADDRESS 0xFFF8EF8C /end MEASUREMENT
/begin MEASUREMENT iKupHysE.iDt1IEds.xp "Ableitung vom Eingangswert" SWORD UMR___1_1_0_S6_S3 1 100 -32768 32767 DISPLAY_IDENTIFIER iDt1IEds.iKupHysE ECU_ADDRESS 0xFFF8EF88 /end MEASUREMENT
/begin MEASUREMENT iKupHysE.iPt2IoKomp.x "Filterwert" FLOAT32_IEEE UMR___1_1_0_S6_S3 1 100 -2147483648 2147483647 FORMAT "%4.2" DISPLAY_IDENTIFIER x.iPt2IoKomp.iKupHysE ECU_ADDRESS 0xFFF8EF90 /end MEASUREMENT
/begin MEASUREMENT iKupHysE.iPt2IoKomp.xp "Ableitung vom Eingangswert" FLOAT32_IEEE UMR__SEC_1_1_0_S6_S3 1 100 -2147483648 2147483647 FORMAT "%4.2" DISPLAY_IDENTIFIER xp.iPt2IoKomp.iKupHysE ECU_ADDRESS 0xFFF8EF94 /end MEASUREMENT
/begin MEASUREMENT iKupHysE.iDt1Verz.Pt1Fl32.x "Filterwert" FLOAT32_IEEE UMR___1_1_0_S6_S3 1 100 -1000000000 1000000000 FORMAT "%4.2" DISPLAY_IDENTIFIER Pt1Fl32.iDt1Verz.iKupHysE ECU_ADDRESS 0xFFF8EF9C /end MEASUREMENT
/begin MEASUREMENT iKupHysE.iDt1Verz.xp "Ableitung vom Eingangswert" FLOAT32_IEEE UMR___1_1_0_S6_S3 1 100 -32768 32767 FORMAT "%4.2" DISPLAY_IDENTIFIER iDt1Verz.iKupHysE ECU_ADDRESS 0xFFF8EF98 /end MEASUREMENT
/begin MEASUREMENT iKupHysE.p_abssoll "Solldruck der Kupplung" UWORD UMR_BAR__1_1000_0_S6_S3 1 100 0 20 DISPLAY_IDENTIFIER p_abssoll_E ECU_ADDRESS 0xFFF8EF3C /end MEASUREMENT
/begin MEASUREMENT iKupHysE.p_umkehr "Druckumkehrpunkt des Solldrucks" UWORD UMR_BAR__1_1000_0_S6_S3 1 100 0 20 DISPLAY_IDENTIFIER p_umkehr_E ECU_ADDRESS 0xFFF8EF3E /end MEASUREMENT
/begin MEASUREMENT iKupHysE.p_umkehr_alt "Druckumkehrpunkt bei Gradientenwechsel des Solldrucks" UWORD UMR_BAR__1_1000_0_S6_S3 1 100 0 20 DISPLAY_IDENTIFIER p_umkehr_alt_E ECU_ADDRESS 0xFFF8EF40 /end MEASUREMENT
/begin MEASUREMENT iKupHysE.pg_abssoll "Druckgradient Solldruck" SWORD UMR_BAR_SEC_1_1000_0_S6_S3 1 100 -32.768 32.767 DISPLAY_IDENTIFIER pg_abssoll_E ECU_ADDRESS 0xFFF8EF42 /end MEASUREMENT
/begin MEASUREMENT iKupHysE.f_pg_abssoll "Flag Gradientenrichtung" UBYTE Conv.cModHysKo._.f_pg_abssoll_S6_S3 1 100 0 1 BIT_MASK 0x1 DISPLAY_IDENTIFIER f_pg_abssoll_E ECU_ADDRESS 0xFFF8EF44 /end MEASUREMENT
/begin MEASUREMENT iKupHysE.trajekfort_kpl "Trajektorienfortschritt Kupplung" UBYTE UMR_PROZENT__1_1_0_S6_S3 1 100 0 100 DISPLAY_IDENTIFIER trajekfort_kpl_E ECU_ADDRESS 0xFFF8EF45 /end MEASUREMENT
/begin MEASUREMENT iKupHysE.mo_kpl "Kompensation Momentenoffset Kupplung" SWORD UMR_NM__1_1_0_S6_S3 1 100 -32768 32767 DISPLAY_IDENTIFIER mo_kpl_E ECU_ADDRESS 0xFFF8EF46 /end MEASUREMENT
/begin MEASUREMENT iKupHysE.po_kpl "Kompensation Druckoffset Kupplung" SWORD UMR_BAR__1_1000_0_S6_S3 1 100 -32.768 32.767 DISPLAY_IDENTIFIER po_kpl_E ECU_ADDRESS 0xFFF8EF48 /end MEASUREMENT
/begin MEASUREMENT iKupHysE.pg_wechsel_erkannt "Wechsel der Gradientenrichtung erkannt" UBYTE Conv.cModHysKo._.pg_wechsel_erkannt_S6_S3 1 100 0 1 BIT_MASK 0x1 DISPLAY_IDENTIFIER pg_wechsel_erkannt_E ECU_ADDRESS 0xFFF8EF4A /end MEASUREMENT
/begin MEASUREMENT iKupHysE.i_eds "Sollstrom des Schaltelements" UWORD UMR_MA__1_10_0_S6_S3 1 100 0 6553.5 DISPLAY_IDENTIFIER i_eds_E ECU_ADDRESS 0xFFF8EF4C /end MEASUREMENT
/begin MEASUREMENT iKupHysE.i_umkehr "Umkehrpunkt des Sollstroms" UWORD UMR_MA__1_10_0_S6_S3 1 100 0 6553.5 DISPLAY_IDENTIFIER i_umkehr_E ECU_ADDRESS 0xFFF8EF4E /end MEASUREMENT
/begin MEASUREMENT iKupHysE.i_umkehr_alt "Umkehrpunkt bei Gradientenwechsel des Sollstroms" UWORD UMR_MA__1_10_0_S6_S3 1 100 0 6553.5 DISPLAY_IDENTIFIER i_umkehr_alt_E ECU_ADDRESS 0xFFF8EF50 /end MEASUREMENT
/begin MEASUREMENT iKupHysE.ig_eds "Gradient Sollstrom" SWORD UMR_MA_SEC_1_1_0_S6_S3 1 100 -32768 32767 DISPLAY_IDENTIFIER ig_eds_E ECU_ADDRESS 0xFFF8EF52 /end MEASUREMENT
/begin MEASUREMENT iKupHysE.f_ig_eds "Flag Gradientenrichtung Strom" UBYTE Conv.cModHysKo._.f_ig_eds_S6_S3 1 100 0 1 BIT_MASK 0x1 DISPLAY_IDENTIFIER f_ig_eds_E ECU_ADDRESS 0xFFF8EF54 /end MEASUREMENT
/begin MEASUREMENT iKupHysE.trajekfort_stg "Trajektorienfortschritt Steuerung" UBYTE UMR_PROZENT__1_1_0_S6_S3 1 100 0 100 DISPLAY_IDENTIFIER trajekfort_stg_E ECU_ADDRESS 0xFFF8EF55 /end MEASUREMENT
/begin MEASUREMENT iKupHysE.io_stg "Kompensation Stromoffset" SWORD UMR_MA__1_10_0_S6_S3 1 100 -3276.8 3276.7 DISPLAY_IDENTIFIER io_stg_E ECU_ADDRESS 0xFFF8EF56 /end MEASUREMENT
/begin MEASUREMENT iKupHysE.ig_wechsel_erkannt "Wechsel der Gradientenrichtung erkannt" UBYTE Conv.cModHysKo._.ig_wechsel_erkannt_S6_S3 1 100 0 1 BIT_MASK 0x1 DISPLAY_IDENTIFIER ig_wechsel_erkannt_E ECU_ADDRESS 0xFFF8EF58 /end MEASUREMENT
/begin MEASUREMENT iKupHysE.po_wirk "Druckoffset Verzugskompensation" SWORD UMR_BAR__1_1000_0_S6_S3 1 100 0 20 DISPLAY_IDENTIFIER po_wirk_E ECU_ADDRESS 0xFFF8EF5A /end MEASUREMENT
/begin MEASUREMENT iKupHysE.pg_wirk "Druckgradient Wirkdruck" SWORD UMR_BAR_SEC_1_10_0_S6_S3 1 100 -3276.8 3276.7 DISPLAY_IDENTIFIER pg_wirk_E ECU_ADDRESS 0xFFF8EF5C /end MEASUREMENT
/begin MEASUREMENT iKupHysE.k_kf_out "Faktor aus Kennfeld" SWORD UMR___1_1000_0_S6_S3 1 100 0 32.767 DISPLAY_IDENTIFIER k_kf_out_E ECU_ADDRESS 0xFFF8EF5E /end MEASUREMENT
/begin MEASUREMENT iKupHysE.k_rampe_out "Faktor aus Rampe" SWORD UMR___1_1000_0_S6_S3 1 100 0 32.767 DISPLAY_IDENTIFIER k_rampe_out_E ECU_ADDRESS 0xFFF8EF60 /end MEASUREMENT
/begin MEASUREMENT iKupHysE.po_vhyskomp "Druckoffset Verzugskompensation" SWORD UMR_BAR__1_1000_0_S6_S3 1 100 -32.768 32.767 DISPLAY_IDENTIFIER po_vhyskomp_E ECU_ADDRESS 0xFFF8EF62 /end MEASUREMENT
/begin MEASUREMENT iKupHysE.z_rampe "Der Zustand" UBYTE Conv.cModHysKo._.z_rampe_S6_S3 1 100 0 3 DISPLAY_IDENTIFIER z_rampe_E ECU_ADDRESS 0xFFF8EF64 /end MEASUREMENT
/begin MEASUREMENT iKupHysK0.iDt1PAbssoll.Pt1Fl32.x "Filterwert" FLOAT32_IEEE UMR___1_1_0_S6_S3 1 100 -1000000000 1000000000 FORMAT "%4.2" DISPLAY_IDENTIFIER Pt1Fl32.iDt1PAbssoll.iKupHysK0 ECU_ADDRESS 0xFFF8EFE0 /end MEASUREMENT
/begin MEASUREMENT iKupHysK0.iDt1PAbssoll.xp "Ableitung vom Eingangswert" FLOAT32_IEEE UMR___1_1_0_S6_S3 1 100 -32768 32767 FORMAT "%4.2" DISPLAY_IDENTIFIER iDt1PAbssoll.iKupHysK0 ECU_ADDRESS 0xFFF8EFDC /end MEASUREMENT
/begin MEASUREMENT iKupHysK0.iPt2MoKomp.x "Filterwert" FLOAT32_IEEE UMR___1_1_0_S6_S3 1 100 -2147483648 2147483647 FORMAT "%4.2" DISPLAY_IDENTIFIER x.iPt2MoKomp.iKupHysK0 ECU_ADDRESS 0xFFF8EFE4 /end MEASUREMENT
/begin MEASUREMENT iKupHysK0.iPt2MoKomp.xp "Ableitung vom Eingangswert" FLOAT32_IEEE UMR__SEC_1_1_0_S6_S3 1 100 -2147483648 2147483647 FORMAT "%4.2" DISPLAY_IDENTIFIER xp.iPt2MoKomp.iKupHysK0 ECU_ADDRESS 0xFFF8EFE8 /end MEASUREMENT
/begin MEASUREMENT iKupHysK0.iDt1IEds.Pt1Si16.x "Filterwert" SLONG UMR___1_300_0_S6_S3 1 100 -7158278.82667 7158278.82333 DISPLAY_IDENTIFIER Pt1Si16.iDt1IEds.iKupHysK0 ECU_ADDRESS 0xFFF8EFF0 /end MEASUREMENT
/begin MEASUREMENT iKupHysK0.iDt1IEds.xp "Ableitung vom Eingangswert" SWORD UMR___1_1_0_S6_S3 1 100 -32768 32767 DISPLAY_IDENTIFIER iDt1IEds.iKupHysK0 ECU_ADDRESS 0xFFF8EFEC /end MEASUREMENT
/begin MEASUREMENT iKupHysK0.iPt2IoKomp.x "Filterwert" FLOAT32_IEEE UMR___1_1_0_S6_S3 1 100 -2147483648 2147483647 FORMAT "%4.2" DISPLAY_IDENTIFIER x.iPt2IoKomp.iKupHysK0 ECU_ADDRESS 0xFFF8EFF4 /end MEASUREMENT
/begin MEASUREMENT iKupHysK0.iPt2IoKomp.xp "Ableitung vom Eingangswert" FLOAT32_IEEE UMR__SEC_1_1_0_S6_S3 1 100 -2147483648 2147483647 FORMAT "%4.2" DISPLAY_IDENTIFIER xp.iPt2IoKomp.iKupHysK0 ECU_ADDRESS 0xFFF8EFF8 /end MEASUREMENT
/begin MEASUREMENT iKupHysK0.iDt1Verz.Pt1Fl32.x "Filterwert" FLOAT32_IEEE UMR___1_1_0_S6_S3 1 100 -1000000000 1000000000 FORMAT "%4.2" DISPLAY_IDENTIFIER Pt1Fl32.iDt1Verz.iKupHysK0 ECU_ADDRESS 0xFFF8F000 /end MEASUREMENT
/begin MEASUREMENT iKupHysK0.iDt1Verz.xp "Ableitung vom Eingangswert" FLOAT32_IEEE UMR___1_1_0_S6_S3 1 100 -32768 32767 FORMAT "%4.2" DISPLAY_IDENTIFIER iDt1Verz.iKupHysK0 ECU_ADDRESS 0xFFF8EFFC /end MEASUREMENT
/begin MEASUREMENT iKupHysK0.p_abssoll "Solldruck der Kupplung" UWORD UMR_BAR__1_1000_0_S6_S3 1 100 0 20 DISPLAY_IDENTIFIER p_abssoll_0 ECU_ADDRESS 0xFFF8EFA0 /end MEASUREMENT
/begin MEASUREMENT iKupHysK0.p_umkehr "Druckumkehrpunkt des Solldrucks" UWORD UMR_BAR__1_1000_0_S6_S3 1 100 0 20 DISPLAY_IDENTIFIER p_umkehr_0 ECU_ADDRESS 0xFFF8EFA2 /end MEASUREMENT
/begin MEASUREMENT iKupHysK0.p_umkehr_alt "Druckumkehrpunkt bei Gradientenwechsel des Solldrucks" UWORD UMR_BAR__1_1000_0_S6_S3 1 100 0 20 DISPLAY_IDENTIFIER p_umkehr_alt_0 ECU_ADDRESS 0xFFF8EFA4 /end MEASUREMENT
/begin MEASUREMENT iKupHysK0.pg_abssoll "Druckgradient Solldruck" SWORD UMR_BAR_SEC_1_1000_0_S6_S3 1 100 -32.768 32.767 DISPLAY_IDENTIFIER pg_abssoll_0 ECU_ADDRESS 0xFFF8EFA6 /end MEASUREMENT
/begin MEASUREMENT iKupHysK0.f_pg_abssoll "Flag Gradientenrichtung" UBYTE Conv.cModHysKo._.f_pg_abssoll_S6_S3 1 100 0 1 BIT_MASK 0x1 DISPLAY_IDENTIFIER f_pg_abssoll_0 ECU_ADDRESS 0xFFF8EFA8 /end MEASUREMENT
/begin MEASUREMENT iKupHysK0.trajekfort_kpl "Trajektorienfortschritt Kupplung" UBYTE UMR_PROZENT__1_1_0_S6_S3 1 100 0 100 DISPLAY_IDENTIFIER trajekfort_kpl_0 ECU_ADDRESS 0xFFF8EFA9 /end MEASUREMENT
/begin MEASUREMENT iKupHysK0.mo_kpl "Kompensation Momentenoffset Kupplung" SWORD UMR_NM__1_1_0_S6_S3 1 100 -32768 32767 DISPLAY_IDENTIFIER mo_kpl_0 ECU_ADDRESS 0xFFF8EFAA /end MEASUREMENT
/begin MEASUREMENT iKupHysK0.po_kpl "Kompensation Druckoffset Kupplung" SWORD UMR_BAR__1_1000_0_S6_S3 1 100 -32.768 32.767 DISPLAY_IDENTIFIER po_kpl_0 ECU_ADDRESS 0xFFF8EFAC /end MEASUREMENT
/begin MEASUREMENT iKupHysK0.pg_wechsel_erkannt "Wechsel der Gradientenrichtung erkannt" UBYTE Conv.cModHysKo._.pg_wechsel_erkannt_S6_S3 1 100 0 1 BIT_MASK 0x1 DISPLAY_IDENTIFIER pg_wechsel_erkannt_0 ECU_ADDRESS 0xFFF8EFAE /end MEASUREMENT
/begin MEASUREMENT iKupHysK0.i_eds "Sollstrom des Schaltelements" UWORD UMR_MA__1_10_0_S6_S3 1 100 0 6553.5 DISPLAY_IDENTIFIER i_eds_0 ECU_ADDRESS 0xFFF8EFB0 /end MEASUREMENT
/begin MEASUREMENT iKupHysK0.i_umkehr "Umkehrpunkt des Sollstroms" UWORD UMR_MA__1_10_0_S6_S3 1 100 0 6553.5 DISPLAY_IDENTIFIER i_umkehr_0 ECU_ADDRESS 0xFFF8EFB2 /end MEASUREMENT
/begin MEASUREMENT iKupHysK0.i_umkehr_alt "Umkehrpunkt bei Gradientenwechsel des Sollstroms" UWORD UMR_MA__1_10_0_S6_S3 1 100 0 6553.5 DISPLAY_IDENTIFIER i_umkehr_alt_0 ECU_ADDRESS 0xFFF8EFB4 /end MEASUREMENT
/begin MEASUREMENT iKupHysK0.ig_eds "Gradient Sollstrom" SWORD UMR_MA_SEC_1_1_0_S6_S3 1 100 -32768 32767 DISPLAY_IDENTIFIER ig_eds_0 ECU_ADDRESS 0xFFF8EFB6 /end MEASUREMENT
/begin MEASUREMENT iKupHysK0.f_ig_eds "Flag Gradientenrichtung Strom" UBYTE Conv.cModHysKo._.f_ig_eds_S6_S3 1 100 0 1 BIT_MASK 0x1 DISPLAY_IDENTIFIER f_ig_eds_0 ECU_ADDRESS 0xFFF8EFB8 /end MEASUREMENT
/begin MEASUREMENT iKupHysK0.trajekfort_stg "Trajektorienfortschritt Steuerung" UBYTE UMR_PROZENT__1_1_0_S6_S3 1 100 0 100 DISPLAY_IDENTIFIER trajekfort_stg_0 ECU_ADDRESS 0xFFF8EFB9 /end MEASUREMENT
/begin MEASUREMENT iKupHysK0.io_stg "Kompensation Stromoffset" SWORD UMR_MA__1_10_0_S6_S3 1 100 -3276.8 3276.7 DISPLAY_IDENTIFIER io_stg_0 ECU_ADDRESS 0xFFF8EFBA /end MEASUREMENT
/begin MEASUREMENT iKupHysK0.ig_wechsel_erkannt "Wechsel der Gradientenrichtung erkannt" UBYTE Conv.cModHysKo._.ig_wechsel_erkannt_S6_S3 1 100 0 1 BIT_MASK 0x1 DISPLAY_IDENTIFIER ig_wechsel_erkannt_0 ECU_ADDRESS 0xFFF8EFBC /end MEASUREMENT
/begin MEASUREMENT iKupHysK0.po_wirk "Druckoffset Verzugskompensation" SWORD UMR_BAR__1_1000_0_S6_S3 1 100 0 20 DISPLAY_IDENTIFIER po_wirk_0 ECU_ADDRESS 0xFFF8EFBE /end MEASUREMENT
/begin MEASUREMENT iKupHysK0.pg_wirk "Druckgradient Wirkdruck" SWORD UMR_BAR_SEC_1_10_0_S6_S3 1 100 -3276.8 3276.7 DISPLAY_IDENTIFIER pg_wirk_0 ECU_ADDRESS 0xFFF8EFC0 /end MEASUREMENT
/begin MEASUREMENT iKupHysK0.k_kf_out "Faktor aus Kennfeld" SWORD UMR___1_1000_0_S6_S3 1 100 0 32.767 DISPLAY_IDENTIFIER k_kf_out_0 ECU_ADDRESS 0xFFF8EFC2 /end MEASUREMENT
/begin MEASUREMENT iKupHysK0.k_rampe_out "Faktor aus Rampe" SWORD UMR___1_1000_0_S6_S3 1 100 0 32.767 DISPLAY_IDENTIFIER k_rampe_out_0 ECU_ADDRESS 0xFFF8EFC4 /end MEASUREMENT
/begin MEASUREMENT iKupHysK0.po_vhyskomp "Druckoffset Verzugskompensation" SWORD UMR_BAR__1_1000_0_S6_S3 1 100 -32.768 32.767 DISPLAY_IDENTIFIER po_vhyskomp_0 ECU_ADDRESS 0xFFF8EFC6 /end MEASUREMENT
/begin MEASUREMENT iKupHysK0.z_rampe "Der Zustand" UBYTE Conv.cModHysKo._.z_rampe_S6_S3 1 100 0 3 DISPLAY_IDENTIFIER z_rampe_0 ECU_ADDRESS 0xFFF8EFC8 /end MEASUREMENT
/begin MEASUREMENT iPSystem.p_vorgabe "Solldruck der Kupplung" UWORD UMR_BAR__1_1000_0_S6_S3 1 100 0 20 DISPLAY_IDENTIFIER p_vorgabe_System ECU_ADDRESS 0xFFF8D4D8 /end MEASUREMENT
/begin MEASUREMENT iPSystem.p_abssoll "Solldruck der Kupplung" UWORD UMR_BAR__1_1000_0_S6_S3 1 100 0 20 DISPLAY_IDENTIFIER p_abssoll_System ECU_ADDRESS 0xFFF8D4DA /end MEASUREMENT
/begin MEASUREMENT iPSystem.p_abssoll_sys "Solldruck der Kupplung, begrentzt auf Systemdruck" UWORD UMR_BAR__1_1000_0_S6_S3 1 100 0 20 DISPLAY_IDENTIFIER p_abssoll_sys_System ECU_ADDRESS 0xFFF8D4DC /end MEASUREMENT
/begin MEASUREMENT iPSystem.f_druck_vorgegeben "Flag, ob Druck an dieses Element in diesem Zyklus schon vorgegeben wurde" UBYTE Conv.cModPVorg._.f_druck_vorgegeben_S6_S3 1 100 0 1 BIT_MASK 0x1 DISPLAY_IDENTIFIER f_druck_vorgegeben_System ECU_ADDRESS 0xFFF8D4DE /end MEASUREMENT
/begin MEASUREMENT iPSystem.f_anst_statisch "Flag für die statische Ansteuerung" UBYTE Conv.cModPVorg._.f_anst_statisch_S6_S3 1 100 0 1 BIT_MASK 0x1 DISPLAY_IDENTIFIER f_anst_statisch_System ECU_ADDRESS 0xFFF8D4DF /end MEASUREMENT
/begin MEASUREMENT iPSystem.fktn_druckvorgabe "Die ansteuernde Funktion" UBYTE Conv.cModPVorg._.fktn_druckvorgabe_S6_S3 1 100 0 41 DISPLAY_IDENTIFIER fktn_druckvorgabe_System ECU_ADDRESS 0xFFF8D4E0 /end MEASUREMENT
/begin MEASUREMENT iPSystem.typ_druckvorgabe "Der Typ des angesteuerten Druckes" UBYTE Conv.cModPVorg._.typ_druckvorgabe_S6_S3 1 100 0 4 DISPLAY_IDENTIFIER typ_druckvorgabe_System ECU_ADDRESS 0xFFF8D4E1 /end MEASUREMENT
/begin MEASUREMENT iPWk.p_vorgabe "Solldruck der Kupplung" UWORD UMR_BAR__1_1000_0_S6_S3 1 100 0 20 DISPLAY_IDENTIFIER p_vorgabe_Wk ECU_ADDRESS 0xFFF8D4EC /end MEASUREMENT
/begin MEASUREMENT iPWk.p_abssoll "Solldruck der Kupplung" UWORD UMR_BAR__1_1000_0_S6_S3 1 100 0 20 DISPLAY_IDENTIFIER p_abssoll_Wk ECU_ADDRESS 0xFFF8D4EE /end MEASUREMENT
/begin MEASUREMENT iPWk.p_abssoll_sys "Solldruck der Kupplung, begrentzt auf Systemdruck" UWORD UMR_BAR__1_1000_0_S6_S3 1 100 0 20 DISPLAY_IDENTIFIER p_abssoll_sys_Wk ECU_ADDRESS 0xFFF8D4F0 /end MEASUREMENT
/begin MEASUREMENT iPWk.f_druck_vorgegeben "Flag, ob Druck an dieses Element in diesem Zyklus schon vorgegeben wurde" UBYTE Conv.cModPVorg._.f_druck_vorgegeben_S6_S3 1 100 0 1 BIT_MASK 0x1 DISPLAY_IDENTIFIER f_druck_vorgegeben_Wk ECU_ADDRESS 0xFFF8D4F2 /end MEASUREMENT
/begin MEASUREMENT iPWk.f_anst_statisch "Flag für die statische Ansteuerung" UBYTE Conv.cModPVorg._.f_anst_statisch_S6_S3 1 100 0 1 BIT_MASK 0x1 DISPLAY_IDENTIFIER f_anst_statisch_Wk ECU_ADDRESS 0xFFF8D4F3 /end MEASUREMENT
/begin MEASUREMENT iPWk.fktn_druckvorgabe "Die ansteuernde Funktion" UBYTE Conv.cModPVorg._.fktn_druckvorgabe_S6_S3 1 100 0 41 DISPLAY_IDENTIFIER fktn_druckvorgabe_Wk ECU_ADDRESS 0xFFF8D4F4 /end MEASUREMENT
/begin MEASUREMENT iPWk.typ_druckvorgabe "Der Typ des angesteuerten Druckes" UBYTE Conv.cModPVorg._.typ_druckvorgabe_S6_S3 1 100 0 4 DISPLAY_IDENTIFIER typ_druckvorgabe_Wk ECU_ADDRESS 0xFFF8D4F5 /end MEASUREMENT
/begin MEASUREMENT iPAnzeige.befuellung_schaltelement_aktiv "Flag für aktive Befüllung (SF bzw. Füllausgleich)" UBYTE Conv.cPAnzeige._.befuellung_schaltelement_aktiv_S6_S3 1 100 0 1 BIT_MASK 0x1 DISPLAY_IDENTIFIER befuellung_schaltelement_aktiv ECU_ADDRESS 0xFFF8A144 /end MEASUREMENT
/begin MEASUREMENT iPAnzeige.p_abs_kzu_puls "Absoluter Solldruck Kupplung KZU bzw. Kupplung Pulsada" UWORD UMR_BAR__1_1000_0_S6_S3 1 100 0 20 DISPLAY_IDENTIFIER p_abs_kzu_puls ECU_ADDRESS 0xFFF8A146 /end MEASUREMENT
/begin MEASUREMENT iPAnzeige.p_abs_kab "Absoluter Solldruck Kupplung KAB" UWORD UMR_BAR__1_1000_0_S6_S3 1 100 0 20 DISPLAY_IDENTIFIER p_abs_kab ECU_ADDRESS 0xFFF8A148 /end MEASUREMENT
/begin MEASUREMENT iPAnzeige.p_abs_vkzu "Absoluter Solldruck Kupplung vorbereitende KZU" UWORD UMR_BAR__1_1000_0_S6_S3 1 100 0 20 DISPLAY_IDENTIFIER p_abs_vkzu ECU_ADDRESS 0xFFF8A14A /end MEASUREMENT
/begin MEASUREMENT iPAnzeige.p_abs_vkab "Absoluter Solldruck Kupplung vorbereitenden KAB" UWORD UMR_BAR__1_1000_0_S6_S3 1 100 0 20 DISPLAY_IDENTIFIER p_abs_vkab ECU_ADDRESS 0xFFF8A14C /end MEASUREMENT
/begin MEASUREMENT iPAnzeige.p_abs_v2kzu "Absoluter Solldruck Kupplung 2. vorbereitende KZU" UWORD UMR_BAR__1_1000_0_S6_S3 1 100 0 20 DISPLAY_IDENTIFIER p_abs_v2kzu ECU_ADDRESS 0xFFF8A14E /end MEASUREMENT
/begin MEASUREMENT iPAnzeige.p_abs_v2kab "Absoluter Solldruck Kupplung 2. vorbereitenden KAB" UWORD UMR_BAR__1_1000_0_S6_S3 1 100 0 20 DISPLAY_IDENTIFIER p_abs_v2kab ECU_ADDRESS 0xFFF8A150 /end MEASUREMENT
/begin MEASUREMENT iPAnzeige.p_abs_gsk "Absoluter Solldruck GSK" UWORD UMR_BAR__1_1000_0_S6_S3 1 100 0 20 DISPLAY_IDENTIFIER p_abs_gsk ECU_ADDRESS 0xFFF8A152 /end MEASUREMENT
/begin MEASUREMENT iPAnzeige.kzu_beob_kup_ada "Kupplung zu to_sfkup_ada und po_fkup_ada" UBYTE Conv.cPAnzeige._.kzu_beob_kup_ada_S6_S3 1 100 0 6 DISPLAY_IDENTIFIER kzu_beob_kup_ada ECU_ADDRESS 0xFFF8A154 /end MEASUREMENT
/begin MEASUREMENT iPAnzeige.po_fkup_ada "Adaptionswert kupplungsbez. PF-Adaption zu kzu_beob_kup_ada" SWORD UMR_BAR__1_1000_0_S6_S3 1 100 -6 6 DISPLAY_IDENTIFIER po_fkup_ada ECU_ADDRESS 0xFFF8A156 /end MEASUREMENT
/begin MEASUREMENT iPAnzeige.to_sfkup_ada "Adaptionswert kupplungsbez. SF-Adaption zu kzu_beob_kup_ada" SWORD UMR_MSEC__1_1_0_S6_S3 1 100 -1000 1000 DISPLAY_IDENTIFIER to_sfkup_ada ECU_ADDRESS 0xFFF8A158 /end MEASUREMENT
/begin MEASUREMENT iKupA.cModPVorg._.p_vorgabe "Solldruck der Kupplung" UWORD UMR_BAR__1_1000_0_S6_S3 1 100 0 20 DISPLAY_IDENTIFIER p_vorgabe_A ECU_ADDRESS 0xFFF8D280 /end MEASUREMENT
/begin MEASUREMENT iKupA.cModPVorg._.p_abssoll "Solldruck der Kupplung" UWORD UMR_BAR__1_1000_0_S6_S3 1 100 0 20 DISPLAY_IDENTIFIER p_abssoll_A ECU_ADDRESS 0xFFF8D282 /end MEASUREMENT
/begin MEASUREMENT iKupA.cModPVorg._.p_abssoll_sys "Solldruck der Kupplung, begrentzt auf Systemdruck" UWORD UMR_BAR__1_1000_0_S6_S3 1 100 0 20 DISPLAY_IDENTIFIER p_abssoll_sys_A ECU_ADDRESS 0xFFF8D284 /end MEASUREMENT
/begin MEASUREMENT iKupA.cModPVorg._.f_druck_vorgegeben "Flag, ob Druck an dieses Element in diesem Zyklus schon vorgegeben wurde" UBYTE Conv.cModPVorg._.f_druck_vorgegeben_S6_S3 1 100 0 1 BIT_MASK 0x1 DISPLAY_IDENTIFIER f_druck_vorgegeben_A ECU_ADDRESS 0xFFF8D286 /end MEASUREMENT
/begin MEASUREMENT iKupA.cModPVorg._.f_anst_statisch "Flag für die statische Ansteuerung" UBYTE Conv.cModPVorg._.f_anst_statisch_S6_S3 1 100 0 1 BIT_MASK 0x1 DISPLAY_IDENTIFIER f_anst_statisch_A ECU_ADDRESS 0xFFF8D287 /end MEASUREMENT
/begin MEASUREMENT iKupA.cModPVorg._.fktn_druckvorgabe "Die ansteuernde Funktion" UBYTE Conv.cModPVorg._.fktn_druckvorgabe_S6_S3 1 100 0 41 DISPLAY_IDENTIFIER fktn_druckvorgabe_A ECU_ADDRESS 0xFFF8D288 /end MEASUREMENT
/begin MEASUREMENT iKupA.cModPVorg._.typ_druckvorgabe "Der Typ des angesteuerten Druckes" UBYTE Conv.cModPVorg._.typ_druckvorgabe_S6_S3 1 100 0 4 DISPLAY_IDENTIFIER typ_druckvorgabe_A ECU_ADDRESS 0xFFF8D289 /end MEASUREMENT
/begin MEASUREMENT iKupA.t_kpl_aktiv.timer "Der aktuelle Timerwert" ULONG UMR_MSEC__10_1_0_S6_S3 1 100 0 42949672950 DISPLAY_IDENTIFIER t_kpl_aktiv.iKupA ECU_ADDRESS 0xFFF8D294 /end MEASUREMENT
/begin MEASUREMENT iKupA.t_kpl_inaktiv.timer "Der aktuelle Timerwert" ULONG UMR_MSEC__10_1_0_S6_S3 1 100 0 42949672950 DISPLAY_IDENTIFIER t_kpl_inaktiv.iKupA ECU_ADDRESS 0xFFF8D298 /end MEASUREMENT
/begin MEASUREMENT iKupA.p_filter.fl_filter.x "Filterwert" FLOAT32_IEEE UMR___1_1_0_S6_S3 1 100 -1000000000 1000000000 FORMAT "%4.2" DISPLAY_IDENTIFIER fl_filter.p_filter.iKupA ECU_ADDRESS 0xFFF8D2A8 /end MEASUREMENT
/begin MEASUREMENT iKupA.p_filter.letzter_ms_timer "letzter BS-Timer" UWORD UMR_MSEC__1_1_0_S6_S3 1 100 0 65535 DISPLAY_IDENTIFIER letzter_ms_timer.p_filter.iKupA ECU_ADDRESS 0xFFF8D2A4 /end MEASUREMENT
/begin MEASUREMENT iKupA.zustandstimer.timer "Der aktuelle Timerwert" UWORD UMR_MSEC__1_1_0_S6_S3 1 100 0 65535 DISPLAY_IDENTIFIER zustandstimer.iKupA ECU_ADDRESS 0xFFF8D2AC /end MEASUREMENT
/begin MEASUREMENT iKupA.totzeit_abgelaufen.timer "Der aktuelle Timerwert" UWORD UMR_MSEC__1_1_0_S6_S3 1 100 0 65535 DISPLAY_IDENTIFIER totzeit_abgelaufen.iKupA ECU_ADDRESS 0xFFF8D2AE /end MEASUREMENT
/begin MEASUREMENT iKupA.timer_sas_ende_mit_pmax.timer "Der aktuelle Timerwert" UBYTE UMR_MSEC__10_1_0_S6_S3 1 100 0 2550 DISPLAY_IDENTIFIER timer_sas_ende_mit_pmax.iKupA ECU_ADDRESS 0xFFF8D2B0 /end MEASUREMENT
/begin MEASUREMENT iKupA.zustand "Der Zustand" UBYTE Conv.cModKuppl._.zustand_S6_S3 1 100 0 5 DISPLAY_IDENTIFIER zustand_A ECU_ADDRESS 0xFFF8D2B3 /end MEASUREMENT
/begin MEASUREMENT iKupA.timer_kolbenpos_kor "Timer fuer Korrekturfaktor Kolbenpos" UBYTE UMR_MSEC__10_1_0_S6_S3 1 100 0 2550 DISPLAY_IDENTIFIER timer_kolbenpos_kor_A ECU_ADDRESS 0xFFF8D2B4 /end MEASUREMENT
/begin MEASUREMENT iKupA.t0_sf "Gesamtschnellfüllzeit" UWORD UMR_MSEC__1_1_0_S6_S3 1 100 0 20000 DISPLAY_IDENTIFIER t0_sf_A ECU_ADDRESS 0xFFF8D2B6 /end MEASUREMENT
/begin MEASUREMENT iKupA.to_sf_ada "Schnellfüllzeit Adaption" SWORD UMR_MSEC__1_1_0_S6_S3 1 100 -32768 32767 DISPLAY_IDENTIFIER to_sf_ada_A ECU_ADDRESS 0xFFF8D2B8 /end MEASUREMENT
/begin MEASUREMENT iKupA.totzeit "Die Totzeit" UWORD UMR_MSEC__1_1_0_S6_S3 1 100 0 2000 DISPLAY_IDENTIFIER totzeit_A ECU_ADDRESS 0xFFF8D2BA /end MEASUREMENT
/begin MEASUREMENT iKupA.t_lauf_fuell "Kolbenlaufzeit beim füllen" UWORD UMR_MSEC__1_1_0_S6_S3 1 100 0 20000 DISPLAY_IDENTIFIER t_lauf_fuell_A ECU_ADDRESS 0xFFF8D2BC /end MEASUREMENT
/begin MEASUREMENT iKupA.t_lauf_entleer "Kolbenlaufzeit beim leeren" UWORD UMR_MSEC__1_1_0_S6_S3 1 100 0 20000 DISPLAY_IDENTIFIER t_lauf_entleer_A ECU_ADDRESS 0xFFF8D2BE /end MEASUREMENT
/begin MEASUREMENT iKupA.p_absist "Istdruck der Kupplung" UWORD UMR_BAR__1_1000_0_S6_S3 1 100 0 20 DISPLAY_IDENTIFIER p_absist_A ECU_ADDRESS 0xFFF8D2C0 /end MEASUREMENT
/begin MEASUREMENT iKupA.p_fmin "minimale Fülldruck der Kupplung" UWORD UMR_BAR__1_1000_0_S6_S3 1 100 0 20 DISPLAY_IDENTIFIER p_fmin_A ECU_ADDRESS 0xFFF8D2C2 /end MEASUREMENT
/begin MEASUREMENT iKupA.p_bedarf "Druckwert fuer bedarfsgerechte Bestromung" UWORD UMR_BAR__1_1000_0_S6_S3 1 100 0 20 DISPLAY_IDENTIFIER p_bedarf_A ECU_ADDRESS 0xFFF8D2C4 /end MEASUREMENT
/begin MEASUREMENT iKupA.n_kup_zbeg "Die Kupplungsdrehzahl zu beginn des Zustandes" UWORD UMR_U_MIN_1_1_0_S6_S3 1 100 0 8160 DISPLAY_IDENTIFIER n_kup_zbeg_A ECU_ADDRESS 0xFFF8D2C6 /end MEASUREMENT
/begin MEASUREMENT iKupA.kolben_pos "Die aktuelle Kolbenposition" UWORD UMR_PROZENT__1_100_0_S6_S3 1 100 0 100 DISPLAY_IDENTIFIER kolben_pos_A ECU_ADDRESS 0xFFF8D2C8 /end MEASUREMENT
/begin MEASUREMENT iKupA.kolben_posbas "Position, bei der der Kolben gestartet ist" UWORD UMR_PROZENT__1_100_0_S6_S3 1 100 0 100 DISPLAY_IDENTIFIER kolben_posbas_A ECU_ADDRESS 0xFFF8D2CA /end MEASUREMENT
/begin MEASUREMENT iKupA.kv_nummer "Die Kupplungsventilnummer" UBYTE UMR___1_1_0_S6_S3 1 100 0 9 DISPLAY_IDENTIFIER kv_nummer_A ECU_ADDRESS 0xFFF8D2CC /end MEASUREMENT
/begin MEASUREMENT iKupA.kup_schaltart_sas "Die Schaltart dieser Kupplung (für Bestimmung offset auf SF-Zeit)" UBYTE Conv.cModKuppl._.kup_schaltart_sas_S6_S3 1 100 0 5 DISPLAY_IDENTIFIER kup_schaltart_sas_A ECU_ADDRESS 0xFFF8D2CD /end MEASUREMENT
/begin MEASUREMENT iKupA.kup_index_spsas "Der Spontanitaetsindex dieser Kupplung" UBYTE Conv.cModKuppl._.kup_index_spsas_S6_S3 1 100 0 2 DISPLAY_IDENTIFIER kup_index_spsas_A ECU_ADDRESS 0xFFF8D2CE /end MEASUREMENT
/begin MEASUREMENT iKupA.f_sf_ausgabe_aktiv "Flag für Schnellfüllung" UBYTE Conv.cModKuppl._.f_sf_ausgabe_aktiv_S6_S3 1 100 0 1 BIT_MASK 0x1 DISPLAY_IDENTIFIER f_sf_ausgabe_aktiv_A ECU_ADDRESS 0xFFF8D2CF /end MEASUREMENT
/begin MEASUREMENT iKupA.f_deakt_dither_sf "Deaktivierung Dither durch Schnellfüllung" UBYTE Conv.cModKuppl._.f_deakt_dither_sf_S6_S3 1 100 0 1 BIT_MASK 0x1 DISPLAY_IDENTIFIER f_deakt_dither_sf_A ECU_ADDRESS 0xFFF8D2D0 /end MEASUREMENT
/begin MEASUREMENT iKupA.f_sf_vorhanden "Flag für ausgegebene SF" UBYTE Conv.cModKuppl._.f_sf_vorhanden_S6_S3 1 100 0 1 BIT_MASK 0x1 DISPLAY_IDENTIFIER f_sf_vorhanden_A ECU_ADDRESS 0xFFF8D2D1 /end MEASUREMENT
/begin MEASUREMENT iKupA.kpl_inaktiv "Flag, ob Kupplung inaktiv ist" UBYTE Conv.cModKuppl._.kpl_inaktiv_S6_S3 1 100 0 1 BIT_MASK 0x1 DISPLAY_IDENTIFIER kpl_inaktiv_A ECU_ADDRESS 0xFFF8D2D2 /end MEASUREMENT
/begin MEASUREMENT iKupA.f_fuellred "Flag für reduzierte Befüllung" UBYTE Conv.cModKuppl._.f_fuellred_S6_S3 1 100 0 1 BIT_MASK 0x1 DISPLAY_IDENTIFIER f_fuellred_A ECU_ADDRESS 0xFFF8D2D3 /end MEASUREMENT
/begin MEASUREMENT iKupA.f_fuellopt "Flag für optimierte Befüllung" UBYTE Conv.cModKuppl._.f_fuellopt_S6_S3 1 100 0 1 BIT_MASK 0x1 DISPLAY_IDENTIFIER f_fuellopt_A ECU_ADDRESS 0xFFF8D2D4 /end MEASUREMENT
/begin MEASUREMENT iKupA.f_kolben_anlegen "Flag für Kolben anlegen" UBYTE Conv.cModKuppl._.f_kolben_anlegen_S6_S3 1 100 0 1 BIT_MASK 0x1 DISPLAY_IDENTIFIER f_kolben_anlegen_A ECU_ADDRESS 0xFFF8D2D5 /end MEASUREMENT
/begin MEASUREMENT iKupA.f_geschlossen "Flag für Kupplung geschlossen" UBYTE Conv.cModKuppl._.f_geschlossen_S6_S3 1 100 0 1 BIT_MASK 0x1 DISPLAY_IDENTIFIER f_geschlossen_A ECU_ADDRESS 0xFFF8D2D6 /end MEASUREMENT
/begin MEASUREMENT iKupA.f_erste_bef "Flag für erste Befüllung" UBYTE Conv.cModKuppl._.f_erste_bef_S6_S3 1 100 0 1 BIT_MASK 0x1 DISPLAY_IDENTIFIER f_erste_bef_A ECU_ADDRESS 0xFFF8D2D7 /end MEASUREMENT
/begin MEASUREMENT iKupA.f_erste_bef_aus_sb "Flag für erste Befüllung aus standby" UBYTE Conv.cModKuppl._.f_erste_bef_aus_sb_S6_S3 1 100 0 1 BIT_MASK 0x1 DISPLAY_IDENTIFIER f_erste_bef_aus_sb_A ECU_ADDRESS 0xFFF8D2D8 /end MEASUREMENT
/begin MEASUREMENT iKupA.f_strom_pre_puls_erf "Flag für Stromprepuls" UBYTE Conv.cModKuppl._.f_strom_pre_puls_erf_S6_S3 1 100 0 1 BIT_MASK 0x1 DISPLAY_IDENTIFIER f_strom_pre_puls_erf_A ECU_ADDRESS 0xFFF8D2D9 /end MEASUREMENT
/begin MEASUREMENT iKupA.f_stromschl_angefordert "Flag zum ausführen der Stromschleife" UBYTE Conv.cModKuppl._.f_stromschl_angefordert_S6_S3 1 100 0 1 BIT_MASK 0x1 DISPLAY_IDENTIFIER f_stromschl_angefordert_A ECU_ADDRESS 0xFFF8D2DA /end MEASUREMENT
/begin MEASUREMENT iKupA.f_stromrampe_kab "Flag Anforderung Stromrampe KAB" UBYTE Conv.cModKuppl._.f_stromrampe_kab_S6_S3 1 100 0 1 BIT_MASK 0x1 DISPLAY_IDENTIFIER f_stromrampe_kab_A ECU_ADDRESS 0xFFF8D2DB /end MEASUREMENT
/begin MEASUREMENT iKupA.drehzahl "Die Kupplungsdrehzahl" UWORD UMR_U_MIN_1_1_0_S6_S3 1 100 0 8160 DISPLAY_IDENTIFIER drehzahl_A ECU_ADDRESS 0xFFF8D2DC /end MEASUREMENT
/begin MEASUREMENT iKupA.f_pfmin_ga_aktiv "Sonderfunktion p_fmin waehrend GA oder Reversieren aktiv" UBYTE Conv.cModKuppl._.f_pfmin_ga_aktiv_S6_S3 1 100 0 1 BIT_MASK 0x1 DISPLAY_IDENTIFIER f_pfmin_ga_aktiv_A ECU_ADDRESS 0xFFF8D2DE /end MEASUREMENT
/begin MEASUREMENT iKupA.z_pfad_cgt_adaklasse "Bereich temperaturabheangig Fuelldruckadaption" UBYTE Conv.cModKuppl._.z_pfad_cgt_adaklasse_S6_S3 1 100 0 6 DISPLAY_IDENTIFIER z_pfad_cgt_adaklasse_A ECU_ADDRESS 0xFFF8D2DF /end MEASUREMENT
/begin MEASUREMENT iKupB.cModPVorg._.p_vorgabe "Solldruck der Kupplung" UWORD UMR_BAR__1_1000_0_S6_S3 1 100 0 20 DISPLAY_IDENTIFIER p_vorgabe_B ECU_ADDRESS 0xFFF8D2E4 /end MEASUREMENT
/begin MEASUREMENT iKupB.cModPVorg._.p_abssoll "Solldruck der Kupplung" UWORD UMR_BAR__1_1000_0_S6_S3 1 100 0 20 DISPLAY_IDENTIFIER p_abssoll_B ECU_ADDRESS 0xFFF8D2E6 /end MEASUREMENT
/begin MEASUREMENT iKupB.cModPVorg._.p_abssoll_sys "Solldruck der Kupplung, begrentzt auf Systemdruck" UWORD UMR_BAR__1_1000_0_S6_S3 1 100 0 20 DISPLAY_IDENTIFIER p_abssoll_sys_B ECU_ADDRESS 0xFFF8D2E8 /end MEASUREMENT
/begin MEASUREMENT iKupB.cModPVorg._.f_druck_vorgegeben "Flag, ob Druck an dieses Element in diesem Zyklus schon vorgegeben wurde" UBYTE Conv.cModPVorg._.f_druck_vorgegeben_S6_S3 1 100 0 1 BIT_MASK 0x1 DISPLAY_IDENTIFIER f_druck_vorgegeben_B ECU_ADDRESS 0xFFF8D2EA /end MEASUREMENT
/begin MEASUREMENT iKupB.cModPVorg._.f_anst_statisch "Flag für die statische Ansteuerung" UBYTE Conv.cModPVorg._.f_anst_statisch_S6_S3 1 100 0 1 BIT_MASK 0x1 DISPLAY_IDENTIFIER f_anst_statisch_B ECU_ADDRESS 0xFFF8D2EB /end MEASUREMENT
/begin MEASUREMENT iKupB.cModPVorg._.fktn_druckvorgabe "Die ansteuernde Funktion" UBYTE Conv.cModPVorg._.fktn_druckvorgabe_S6_S3 1 100 0 41 DISPLAY_IDENTIFIER fktn_druckvorgabe_B ECU_ADDRESS 0xFFF8D2EC /end MEASUREMENT
/begin MEASUREMENT iKupB.cModPVorg._.typ_druckvorgabe "Der Typ des angesteuerten Druckes" UBYTE Conv.cModPVorg._.typ_druckvorgabe_S6_S3 1 100 0 4 DISPLAY_IDENTIFIER typ_druckvorgabe_B ECU_ADDRESS 0xFFF8D2ED /end MEASUREMENT
/begin MEASUREMENT iKupB.t_kpl_aktiv.timer "Der aktuelle Timerwert" ULONG UMR_MSEC__10_1_0_S6_S3 1 100 0 42949672950 DISPLAY_IDENTIFIER t_kpl_aktiv.iKupB ECU_ADDRESS 0xFFF8D2F8 /end MEASUREMENT
/begin MEASUREMENT iKupB.t_kpl_inaktiv.timer "Der aktuelle Timerwert" ULONG UMR_MSEC__10_1_0_S6_S3 1 100 0 42949672950 DISPLAY_IDENTIFIER t_kpl_inaktiv.iKupB ECU_ADDRESS 0xFFF8D2FC /end MEASUREMENT
/begin MEASUREMENT iKupB.p_filter.fl_filter.x "Filterwert" FLOAT32_IEEE UMR___1_1_0_S6_S3 1 100 -1000000000 1000000000 FORMAT "%4.2" DISPLAY_IDENTIFIER fl_filter.p_filter.iKupB ECU_ADDRESS 0xFFF8D30C /end MEASUREMENT
/begin MEASUREMENT iKupB.p_filter.letzter_ms_timer "letzter BS-Timer" UWORD UMR_MSEC__1_1_0_S6_S3 1 100 0 65535 DISPLAY_IDENTIFIER letzter_ms_timer.p_filter.iKupB ECU_ADDRESS 0xFFF8D308 /end MEASUREMENT
/begin MEASUREMENT iKupB.zustandstimer.timer "Der aktuelle Timerwert" UWORD UMR_MSEC__1_1_0_S6_S3 1 100 0 65535 DISPLAY_IDENTIFIER zustandstimer.iKupB ECU_ADDRESS 0xFFF8D310 /end MEASUREMENT
/begin MEASUREMENT iKupB.totzeit_abgelaufen.timer "Der aktuelle Timerwert" UWORD UMR_MSEC__1_1_0_S6_S3 1 100 0 65535 DISPLAY_IDENTIFIER totzeit_abgelaufen.iKupB ECU_ADDRESS 0xFFF8D312 /end MEASUREMENT
/begin MEASUREMENT iKupB.timer_sas_ende_mit_pmax.timer "Der aktuelle Timerwert" UBYTE UMR_MSEC__10_1_0_S6_S3 1 100 0 2550 DISPLAY_IDENTIFIER timer_sas_ende_mit_pmax.iKupB ECU_ADDRESS 0xFFF8D314 /end MEASUREMENT
/begin MEASUREMENT iKupB.zustand "Der Zustand" UBYTE Conv.cModKuppl._.zustand_S6_S3 1 100 0 5 DISPLAY_IDENTIFIER zustand_B ECU_ADDRESS 0xFFF8D317 /end MEASUREMENT
/begin MEASUREMENT iKupB.timer_kolbenpos_kor "Timer fuer Korrekturfaktor Kolbenpos" UBYTE UMR_MSEC__10_1_0_S6_S3 1 100 0 2550 DISPLAY_IDENTIFIER timer_kolbenpos_kor_B ECU_ADDRESS 0xFFF8D318 /end MEASUREMENT
/begin MEASUREMENT iKupB.t0_sf "Gesamtschnellfüllzeit" UWORD UMR_MSEC__1_1_0_S6_S3 1 100 0 20000 DISPLAY_IDENTIFIER t0_sf_B ECU_ADDRESS 0xFFF8D31A /end MEASUREMENT
/begin MEASUREMENT iKupB.to_sf_ada "Schnellfüllzeit Adaption" SWORD UMR_MSEC__1_1_0_S6_S3 1 100 -32768 32767 DISPLAY_IDENTIFIER to_sf_ada_B ECU_ADDRESS 0xFFF8D31C /end MEASUREMENT
/begin MEASUREMENT iKupB.totzeit "Die Totzeit" UWORD UMR_MSEC__1_1_0_S6_S3 1 100 0 2000 DISPLAY_IDENTIFIER totzeit_B ECU_ADDRESS 0xFFF8D31E /end MEASUREMENT
/begin MEASUREMENT iKupB.t_lauf_fuell "Kolbenlaufzeit beim füllen" UWORD UMR_MSEC__1_1_0_S6_S3 1 100 0 20000 DISPLAY_IDENTIFIER t_lauf_fuell_B ECU_ADDRESS 0xFFF8D320 /end MEASUREMENT
/begin MEASUREMENT iKupB.t_lauf_entleer "Kolbenlaufzeit beim leeren" UWORD UMR_MSEC__1_1_0_S6_S3 1 100 0 20000 DISPLAY_IDENTIFIER t_lauf_entleer_B ECU_ADDRESS 0xFFF8D322 /end MEASUREMENT
/begin MEASUREMENT iKupB.p_absist "Istdruck der Kupplung" UWORD UMR_BAR__1_1000_0_S6_S3 1 100 0 20 DISPLAY_IDENTIFIER p_absist_B ECU_ADDRESS 0xFFF8D324 /end MEASUREMENT
/begin MEASUREMENT iKupB.p_fmin "minimale Fülldruck der Kupplung" UWORD UMR_BAR__1_1000_0_S6_S3 1 100 0 20 DISPLAY_IDENTIFIER p_fmin_B ECU_ADDRESS 0xFFF8D326 /end MEASUREMENT
/begin MEASUREMENT iKupB.p_bedarf "Druckwert fuer bedarfsgerechte Bestromung" UWORD UMR_BAR__1_1000_0_S6_S3 1 100 0 20 DISPLAY_IDENTIFIER p_bedarf_B ECU_ADDRESS 0xFFF8D328 /end MEASUREMENT
/begin MEASUREMENT iKupB.n_kup_zbeg "Die Kupplungsdrehzahl zu beginn des Zustandes" UWORD UMR_U_MIN_1_1_0_S6_S3 1 100 0 8160 DISPLAY_IDENTIFIER n_kup_zbeg_B ECU_ADDRESS 0xFFF8D32A /end MEASUREMENT
/begin MEASUREMENT iKupB.kolben_pos "Die aktuelle Kolbenposition" UWORD UMR_PROZENT__1_100_0_S6_S3 1 100 0 100 DISPLAY_IDENTIFIER kolben_pos_B ECU_ADDRESS 0xFFF8D32C /end MEASUREMENT
/begin MEASUREMENT iKupB.kolben_posbas "Position, bei der der Kolben gestartet ist" UWORD UMR_PROZENT__1_100_0_S6_S3 1 100 0 100 DISPLAY_IDENTIFIER kolben_posbas_B ECU_ADDRESS 0xFFF8D32E /end MEASUREMENT
/begin MEASUREMENT iKupB.kv_nummer "Die Kupplungsventilnummer" UBYTE UMR___1_1_0_S6_S3 1 100 0 9 DISPLAY_IDENTIFIER kv_nummer_B ECU_ADDRESS 0xFFF8D330 /end MEASUREMENT
/begin MEASUREMENT iKupB.kup_schaltart_sas "Die Schaltart dieser Kupplung (für Bestimmung offset auf SF-Zeit)" UBYTE Conv.cModKuppl._.kup_schaltart_sas_S6_S3 1 100 0 5 DISPLAY_IDENTIFIER kup_schaltart_sas_B ECU_ADDRESS 0xFFF8D331 /end MEASUREMENT
/begin MEASUREMENT iKupB.kup_index_spsas "Der Spontanitaetsindex dieser Kupplung" UBYTE Conv.cModKuppl._.kup_index_spsas_S6_S3 1 100 0 2 DISPLAY_IDENTIFIER kup_index_spsas_B ECU_ADDRESS 0xFFF8D332 /end MEASUREMENT
/begin MEASUREMENT iKupB.f_sf_ausgabe_aktiv "Flag für Schnellfüllung" UBYTE Conv.cModKuppl._.f_sf_ausgabe_aktiv_S6_S3 1 100 0 1 BIT_MASK 0x1 DISPLAY_IDENTIFIER f_sf_ausgabe_aktiv_B ECU_ADDRESS 0xFFF8D333 /end MEASUREMENT
/begin MEASUREMENT iKupB.f_deakt_dither_sf "Deaktivierung Dither durch Schnellfüllung" UBYTE Conv.cModKuppl._.f_deakt_dither_sf_S6_S3 1 100 0 1 BIT_MASK 0x1 DISPLAY_IDENTIFIER f_deakt_dither_sf_B ECU_ADDRESS 0xFFF8D334 /end MEASUREMENT
/begin MEASUREMENT iKupB.f_sf_vorhanden "Flag für ausgegebene SF" UBYTE Conv.cModKuppl._.f_sf_vorhanden_S6_S3 1 100 0 1 BIT_MASK 0x1 DISPLAY_IDENTIFIER f_sf_vorhanden_B ECU_ADDRESS 0xFFF8D335 /end MEASUREMENT
/begin MEASUREMENT iKupB.kpl_inaktiv "Flag, ob Kupplung inaktiv ist" UBYTE Conv.cModKuppl._.kpl_inaktiv_S6_S3 1 100 0 1 BIT_MASK 0x1 DISPLAY_IDENTIFIER kpl_inaktiv_B ECU_ADDRESS 0xFFF8D336 /end MEASUREMENT
/begin MEASUREMENT iKupB.f_fuellred "Flag für reduzierte Befüllung" UBYTE Conv.cModKuppl._.f_fuellred_S6_S3 1 100 0 1 BIT_MASK 0x1 DISPLAY_IDENTIFIER f_fuellred_B ECU_ADDRESS 0xFFF8D337 /end MEASUREMENT
/begin MEASUREMENT iKupB.f_fuellopt "Flag für optimierte Befüllung" UBYTE Conv.cModKuppl._.f_fuellopt_S6_S3 1 100 0 1 BIT_MASK 0x1 DISPLAY_IDENTIFIER f_fuellopt_B ECU_ADDRESS 0xFFF8D338 /end MEASUREMENT
/begin MEASUREMENT iKupB.f_kolben_anlegen "Flag für Kolben anlegen" UBYTE Conv.cModKuppl._.f_kolben_anlegen_S6_S3 1 100 0 1 BIT_MASK 0x1 DISPLAY_IDENTIFIER f_kolben_anlegen_B ECU_ADDRESS 0xFFF8D339 /end MEASUREMENT
/begin MEASUREMENT iKupB.f_geschlossen "Flag für Kupplung geschlossen" UBYTE Conv.cModKuppl._.f_geschlossen_S6_S3 1 100 0 1 BIT_MASK 0x1 DISPLAY_IDENTIFIER f_geschlossen_B ECU_ADDRESS 0xFFF8D33A /end MEASUREMENT
/begin MEASUREMENT iKupB.f_erste_bef "Flag für erste Befüllung" UBYTE Conv.cModKuppl._.f_erste_bef_S6_S3 1 100 0 1 BIT_MASK 0x1 DISPLAY_IDENTIFIER f_erste_bef_B ECU_ADDRESS 0xFFF8D33B /end MEASUREMENT
/begin MEASUREMENT iKupB.f_erste_bef_aus_sb "Flag für erste Befüllung aus standby" UBYTE Conv.cModKuppl._.f_erste_bef_aus_sb_S6_S3 1 100 0 1 BIT_MASK 0x1 DISPLAY_IDENTIFIER f_erste_bef_aus_sb_B ECU_ADDRESS 0xFFF8D33C /end MEASUREMENT
/begin MEASUREMENT iKupB.f_strom_pre_puls_erf "Flag für Stromprepuls" UBYTE Conv.cModKuppl._.f_strom_pre_puls_erf_S6_S3 1 100 0 1 BIT_MASK 0x1 DISPLAY_IDENTIFIER f_strom_pre_puls_erf_B ECU_ADDRESS 0xFFF8D33D /end MEASUREMENT
/begin MEASUREMENT iKupB.f_stromschl_angefordert "Flag zum ausführen der Stromschleife" UBYTE Conv.cModKuppl._.f_stromschl_angefordert_S6_S3 1 100 0 1 BIT_MASK 0x1 DISPLAY_IDENTIFIER f_stromschl_angefordert_B ECU_ADDRESS 0xFFF8D33E /end MEASUREMENT
/begin MEASUREMENT iKupB.f_stromrampe_kab "Flag Anforderung Stromrampe KAB" UBYTE Conv.cModKuppl._.f_stromrampe_kab_S6_S3 1 100 0 1 BIT_MASK 0x1 DISPLAY_IDENTIFIER f_stromrampe_kab_B ECU_ADDRESS 0xFFF8D33F /end MEASUREMENT
/begin MEASUREMENT iKupB.drehzahl "Die Kupplungsdrehzahl" UWORD UMR_U_MIN_1_1_0_S6_S3 1 100 0 8160 DISPLAY_IDENTIFIER drehzahl_B ECU_ADDRESS 0xFFF8D340 /end MEASUREMENT
/begin MEASUREMENT iKupB.f_pfmin_ga_aktiv "Sonderfunktion p_fmin waehrend GA oder Reversieren aktiv" UBYTE Conv.cModKuppl._.f_pfmin_ga_aktiv_S6_S3 1 100 0 1 BIT_MASK 0x1 DISPLAY_IDENTIFIER f_pfmin_ga_aktiv_B ECU_ADDRESS 0xFFF8D342 /end MEASUREMENT
/begin MEASUREMENT iKupB.z_pfad_cgt_adaklasse "Bereich temperaturabheangig Fuelldruckadaption" UBYTE Conv.cModKuppl._.z_pfad_cgt_adaklasse_S6_S3 1 100 0 6 DISPLAY_IDENTIFIER z_pfad_cgt_adaklasse_B ECU_ADDRESS 0xFFF8D343 /end MEASUREMENT
/begin MEASUREMENT iKupC.cModPVorg._.p_vorgabe "Solldruck der Kupplung" UWORD UMR_BAR__1_1000_0_S6_S3 1 100 0 20 DISPLAY_IDENTIFIER p_vorgabe_C ECU_ADDRESS 0xFFF8D348 /end MEASUREMENT
/begin MEASUREMENT iKupC.cModPVorg._.p_abssoll "Solldruck der Kupplung" UWORD UMR_BAR__1_1000_0_S6_S3 1 100 0 20 DISPLAY_IDENTIFIER p_abssoll_C ECU_ADDRESS 0xFFF8D34A /end MEASUREMENT
/begin MEASUREMENT iKupC.cModPVorg._.p_abssoll_sys "Solldruck der Kupplung, begrentzt auf Systemdruck" UWORD UMR_BAR__1_1000_0_S6_S3 1 100 0 20 DISPLAY_IDENTIFIER p_abssoll_sys_C ECU_ADDRESS 0xFFF8D34C /end MEASUREMENT
/begin MEASUREMENT iKupC.cModPVorg._.f_druck_vorgegeben "Flag, ob Druck an dieses Element in diesem Zyklus schon vorgegeben wurde" UBYTE Conv.cModPVorg._.f_druck_vorgegeben_S6_S3 1 100 0 1 BIT_MASK 0x1 DISPLAY_IDENTIFIER f_druck_vorgegeben_C ECU_ADDRESS 0xFFF8D34E /end MEASUREMENT
/begin MEASUREMENT iKupC.cModPVorg._.f_anst_statisch "Flag für die statische Ansteuerung" UBYTE Conv.cModPVorg._.f_anst_statisch_S6_S3 1 100 0 1 BIT_MASK 0x1 DISPLAY_IDENTIFIER f_anst_statisch_C ECU_ADDRESS 0xFFF8D34F /end MEASUREMENT
/begin MEASUREMENT iKupC.cModPVorg._.fktn_druckvorgabe "Die ansteuernde Funktion" UBYTE Conv.cModPVorg._.fktn_druckvorgabe_S6_S3 1 100 0 41 DISPLAY_IDENTIFIER fktn_druckvorgabe_C ECU_ADDRESS 0xFFF8D350 /end MEASUREMENT
/begin MEASUREMENT iKupC.cModPVorg._.typ_druckvorgabe "Der Typ des angesteuerten Druckes" UBYTE Conv.cModPVorg._.typ_druckvorgabe_S6_S3 1 100 0 4 DISPLAY_IDENTIFIER typ_druckvorgabe_C ECU_ADDRESS 0xFFF8D351 /end MEASUREMENT
/begin MEASUREMENT iKupC.t_kpl_aktiv.timer "Der aktuelle Timerwert" ULONG UMR_MSEC__10_1_0_S6_S3 1 100 0 42949672950 DISPLAY_IDENTIFIER t_kpl_aktiv.iKupC ECU_ADDRESS 0xFFF8D35C /end MEASUREMENT
/begin MEASUREMENT iKupC.t_kpl_inaktiv.timer "Der aktuelle Timerwert" ULONG UMR_MSEC__10_1_0_S6_S3 1 100 0 42949672950 DISPLAY_IDENTIFIER t_kpl_inaktiv.iKupC ECU_ADDRESS 0xFFF8D360 /end MEASUREMENT
/begin MEASUREMENT iKupC.p_filter.fl_filter.x "Filterwert" FLOAT32_IEEE UMR___1_1_0_S6_S3 1 100 -1000000000 1000000000 FORMAT "%4.2" DISPLAY_IDENTIFIER fl_filter.p_filter.iKupC ECU_ADDRESS 0xFFF8D370 /end MEASUREMENT
/begin MEASUREMENT iKupC.p_filter.letzter_ms_timer "letzter BS-Timer" UWORD UMR_MSEC__1_1_0_S6_S3 1 100 0 65535 DISPLAY_IDENTIFIER letzter_ms_timer.p_filter.iKupC ECU_ADDRESS 0xFFF8D36C /end MEASUREMENT
/begin MEASUREMENT iKupC.zustandstimer.timer "Der aktuelle Timerwert" UWORD UMR_MSEC__1_1_0_S6_S3 1 100 0 65535 DISPLAY_IDENTIFIER zustandstimer.iKupC ECU_ADDRESS 0xFFF8D374 /end MEASUREMENT
/begin MEASUREMENT iKupC.totzeit_abgelaufen.timer "Der aktuelle Timerwert" UWORD UMR_MSEC__1_1_0_S6_S3 1 100 0 65535 DISPLAY_IDENTIFIER totzeit_abgelaufen.iKupC ECU_ADDRESS 0xFFF8D376 /end MEASUREMENT
/begin MEASUREMENT iKupC.timer_sas_ende_mit_pmax.timer "Der aktuelle Timerwert" UBYTE UMR_MSEC__10_1_0_S6_S3 1 100 0 2550 DISPLAY_IDENTIFIER timer_sas_ende_mit_pmax.iKupC ECU_ADDRESS 0xFFF8D378 /end MEASUREMENT
/begin MEASUREMENT iKupC.zustand "Der Zustand" UBYTE Conv.cModKuppl._.zustand_S6_S3 1 100 0 5 DISPLAY_IDENTIFIER zustand_C ECU_ADDRESS 0xFFF8D37B /end MEASUREMENT
/begin MEASUREMENT iKupC.timer_kolbenpos_kor "Timer fuer Korrekturfaktor Kolbenpos" UBYTE UMR_MSEC__10_1_0_S6_S3 1 100 0 2550 DISPLAY_IDENTIFIER timer_kolbenpos_kor_C ECU_ADDRESS 0xFFF8D37C /end MEASUREMENT
/begin MEASUREMENT iKupC.t0_sf "Gesamtschnellfüllzeit" UWORD UMR_MSEC__1_1_0_S6_S3 1 100 0 20000 DISPLAY_IDENTIFIER t0_sf_C ECU_ADDRESS 0xFFF8D37E /end MEASUREMENT
/begin MEASUREMENT iKupC.to_sf_ada "Schnellfüllzeit Adaption" SWORD UMR_MSEC__1_1_0_S6_S3 1 100 -32768 32767 DISPLAY_IDENTIFIER to_sf_ada_C ECU_ADDRESS 0xFFF8D380 /end MEASUREMENT
/begin MEASUREMENT iKupC.totzeit "Die Totzeit" UWORD UMR_MSEC__1_1_0_S6_S3 1 100 0 2000 DISPLAY_IDENTIFIER totzeit_C ECU_ADDRESS 0xFFF8D382 /end MEASUREMENT
/begin MEASUREMENT iKupC.t_lauf_fuell "Kolbenlaufzeit beim füllen" UWORD UMR_MSEC__1_1_0_S6_S3 1 100 0 20000 DISPLAY_IDENTIFIER t_lauf_fuell_C ECU_ADDRESS 0xFFF8D384 /end MEASUREMENT
/begin MEASUREMENT iKupC.t_lauf_entleer "Kolbenlaufzeit beim leeren" UWORD UMR_MSEC__1_1_0_S6_S3 1 100 0 20000 DISPLAY_IDENTIFIER t_lauf_entleer_C ECU_ADDRESS 0xFFF8D386 /end MEASUREMENT
/begin MEASUREMENT iKupC.p_absist "Istdruck der Kupplung" UWORD UMR_BAR__1_1000_0_S6_S3 1 100 0 20 DISPLAY_IDENTIFIER p_absist_C ECU_ADDRESS 0xFFF8D388 /end MEASUREMENT
/begin MEASUREMENT iKupC.p_fmin "minimale Fülldruck der Kupplung" UWORD UMR_BAR__1_1000_0_S6_S3 1 100 0 20 DISPLAY_IDENTIFIER p_fmin_C ECU_ADDRESS 0xFFF8D38A /end MEASUREMENT
/begin MEASUREMENT iKupC.p_bedarf "Druckwert fuer bedarfsgerechte Bestromung" UWORD UMR_BAR__1_1000_0_S6_S3 1 100 0 20 DISPLAY_IDENTIFIER p_bedarf_C ECU_ADDRESS 0xFFF8D38C /end MEASUREMENT
/begin MEASUREMENT iKupC.n_kup_zbeg "Die Kupplungsdrehzahl zu beginn des Zustandes" UWORD UMR_U_MIN_1_1_0_S6_S3 1 100 0 8160 DISPLAY_IDENTIFIER n_kup_zbeg_C ECU_ADDRESS 0xFFF8D38E /end MEASUREMENT
/begin MEASUREMENT iKupC.kolben_pos "Die aktuelle Kolbenposition" UWORD UMR_PROZENT__1_100_0_S6_S3 1 100 0 100 DISPLAY_IDENTIFIER kolben_pos_C ECU_ADDRESS 0xFFF8D390 /end MEASUREMENT
/begin MEASUREMENT iKupC.kolben_posbas "Position, bei der der Kolben gestartet ist" UWORD UMR_PROZENT__1_100_0_S6_S3 1 100 0 100 DISPLAY_IDENTIFIER kolben_posbas_C ECU_ADDRESS 0xFFF8D392 /end MEASUREMENT
/begin MEASUREMENT iKupC.kv_nummer "Die Kupplungsventilnummer" UBYTE UMR___1_1_0_S6_S3 1 100 0 9 DISPLAY_IDENTIFIER kv_nummer_C ECU_ADDRESS 0xFFF8D394 /end MEASUREMENT
/begin MEASUREMENT iKupC.kup_schaltart_sas "Die Schaltart dieser Kupplung (für Bestimmung offset auf SF-Zeit)" UBYTE Conv.cModKuppl._.kup_schaltart_sas_S6_S3 1 100 0 5 DISPLAY_IDENTIFIER kup_schaltart_sas_C ECU_ADDRESS 0xFFF8D395 /end MEASUREMENT
/begin MEASUREMENT iKupC.kup_index_spsas "Der Spontanitaetsindex dieser Kupplung" UBYTE Conv.cModKuppl._.kup_index_spsas_S6_S3 1 100 0 2 DISPLAY_IDENTIFIER kup_index_spsas_C ECU_ADDRESS 0xFFF8D396 /end MEASUREMENT
/begin MEASUREMENT iKupC.f_sf_ausgabe_aktiv "Flag für Schnellfüllung" UBYTE Conv.cModKuppl._.f_sf_ausgabe_aktiv_S6_S3 1 100 0 1 BIT_MASK 0x1 DISPLAY_IDENTIFIER f_sf_ausgabe_aktiv_C ECU_ADDRESS 0xFFF8D397 /end MEASUREMENT
/begin MEASUREMENT iKupC.f_deakt_dither_sf "Deaktivierung Dither durch Schnellfüllung" UBYTE Conv.cModKuppl._.f_deakt_dither_sf_S6_S3 1 100 0 1 BIT_MASK 0x1 DISPLAY_IDENTIFIER f_deakt_dither_sf_C ECU_ADDRESS 0xFFF8D398 /end MEASUREMENT
/begin MEASUREMENT iKupC.f_sf_vorhanden "Flag für ausgegebene SF" UBYTE Conv.cModKuppl._.f_sf_vorhanden_S6_S3 1 100 0 1 BIT_MASK 0x1 DISPLAY_IDENTIFIER f_sf_vorhanden_C ECU_ADDRESS 0xFFF8D399 /end MEASUREMENT
/begin MEASUREMENT iKupC.kpl_inaktiv "Flag, ob Kupplung inaktiv ist" UBYTE Conv.cModKuppl._.kpl_inaktiv_S6_S3 1 100 0 1 BIT_MASK 0x1 DISPLAY_IDENTIFIER kpl_inaktiv_C ECU_ADDRESS 0xFFF8D39A /end MEASUREMENT
/begin MEASUREMENT iKupC.f_fuellred "Flag für reduzierte Befüllung" UBYTE Conv.cModKuppl._.f_fuellred_S6_S3 1 100 0 1 BIT_MASK 0x1 DISPLAY_IDENTIFIER f_fuellred_C ECU_ADDRESS 0xFFF8D39B /end MEASUREMENT
/begin MEASUREMENT iKupC.f_fuellopt "Flag für optimierte Befüllung" UBYTE Conv.cModKuppl._.f_fuellopt_S6_S3 1 100 0 1 BIT_MASK 0x1 DISPLAY_IDENTIFIER f_fuellopt_C ECU_ADDRESS 0xFFF8D39C /end MEASUREMENT
/begin MEASUREMENT iKupC.f_kolben_anlegen "Flag für Kolben anlegen" UBYTE Conv.cModKuppl._.f_kolben_anlegen_S6_S3 1 100 0 1 BIT_MASK 0x1 DISPLAY_IDENTIFIER f_kolben_anlegen_C ECU_ADDRESS 0xFFF8D39D /end MEASUREMENT
/begin MEASUREMENT iKupC.f_geschlossen "Flag für Kupplung geschlossen" UBYTE Conv.cModKuppl._.f_geschlossen_S6_S3 1 100 0 1 BIT_MASK 0x1 DISPLAY_IDENTIFIER f_geschlossen_C ECU_ADDRESS 0xFFF8D39E /end MEASUREMENT
/begin MEASUREMENT iKupC.f_erste_bef "Flag für erste Befüllung" UBYTE Conv.cModKuppl._.f_erste_bef_S6_S3 1 100 0 1 BIT_MASK 0x1 DISPLAY_IDENTIFIER f_erste_bef_C ECU_ADDRESS 0xFFF8D39F /end MEASUREMENT
/begin MEASUREMENT iKupC.f_erste_bef_aus_sb "Flag für erste Befüllung aus standby" UBYTE Conv.cModKuppl._.f_erste_bef_aus_sb_S6_S3 1 100 0 1 BIT_MASK 0x1 DISPLAY_IDENTIFIER f_erste_bef_aus_sb_C ECU_ADDRESS 0xFFF8D3A0 /end MEASUREMENT
/begin MEASUREMENT iKupC.f_strom_pre_puls_erf "Flag für Stromprepuls" UBYTE Conv.cModKuppl._.f_strom_pre_puls_erf_S6_S3 1 100 0 1 BIT_MASK 0x1 DISPLAY_IDENTIFIER f_strom_pre_puls_erf_C ECU_ADDRESS 0xFFF8D3A1 /end MEASUREMENT
/begin MEASUREMENT iKupC.f_stromschl_angefordert "Flag zum ausführen der Stromschleife" UBYTE Conv.cModKuppl._.f_stromschl_angefordert_S6_S3 1 100 0 1 BIT_MASK 0x1 DISPLAY_IDENTIFIER f_stromschl_angefordert_C ECU_ADDRESS 0xFFF8D3A2 /end MEASUREMENT
/begin MEASUREMENT iKupC.f_stromrampe_kab "Flag Anforderung Stromrampe KAB" UBYTE Conv.cModKuppl._.f_stromrampe_kab_S6_S3 1 100 0 1 BIT_MASK 0x1 DISPLAY_IDENTIFIER f_stromrampe_kab_C ECU_ADDRESS 0xFFF8D3A3 /end MEASUREMENT
/begin MEASUREMENT iKupC.drehzahl "Die Kupplungsdrehzahl" UWORD UMR_U_MIN_1_1_0_S6_S3 1 100 0 8160 DISPLAY_IDENTIFIER drehzahl_C ECU_ADDRESS 0xFFF8D3A4 /end MEASUREMENT
/begin MEASUREMENT iKupC.f_pfmin_ga_aktiv "Sonderfunktion p_fmin waehrend GA oder Reversieren aktiv" UBYTE Conv.cModKuppl._.f_pfmin_ga_aktiv_S6_S3 1 100 0 1 BIT_MASK 0x1 DISPLAY_IDENTIFIER f_pfmin_ga_aktiv_C ECU_ADDRESS 0xFFF8D3A6 /end MEASUREMENT
/begin MEASUREMENT iKupC.z_pfad_cgt_adaklasse "Bereich temperaturabheangig Fuelldruckadaption" UBYTE Conv.cModKuppl._.z_pfad_cgt_adaklasse_S6_S3 1 100 0 6 DISPLAY_IDENTIFIER z_pfad_cgt_adaklasse_C ECU_ADDRESS 0xFFF8D3A7 /end MEASUREMENT
/begin MEASUREMENT iKupD.cModPVorg._.p_vorgabe "Solldruck der Kupplung" UWORD UMR_BAR__1_1000_0_S6_S3 1 100 0 20 DISPLAY_IDENTIFIER p_vorgabe_D ECU_ADDRESS 0xFFF8D3AC /end MEASUREMENT
/begin MEASUREMENT iKupD.cModPVorg._.p_abssoll "Solldruck der Kupplung" UWORD UMR_BAR__1_1000_0_S6_S3 1 100 0 20 DISPLAY_IDENTIFIER p_abssoll_D ECU_ADDRESS 0xFFF8D3AE /end MEASUREMENT
/begin MEASUREMENT iKupD.cModPVorg._.p_abssoll_sys "Solldruck der Kupplung, begrentzt auf Systemdruck" UWORD UMR_BAR__1_1000_0_S6_S3 1 100 0 20 DISPLAY_IDENTIFIER p_abssoll_sys_D ECU_ADDRESS 0xFFF8D3B0 /end MEASUREMENT
/begin MEASUREMENT iKupD.cModPVorg._.f_druck_vorgegeben "Flag, ob Druck an dieses Element in diesem Zyklus schon vorgegeben wurde" UBYTE Conv.cModPVorg._.f_druck_vorgegeben_S6_S3 1 100 0 1 BIT_MASK 0x1 DISPLAY_IDENTIFIER f_druck_vorgegeben_D ECU_ADDRESS 0xFFF8D3B2 /end MEASUREMENT
/begin MEASUREMENT iKupD.cModPVorg._.f_anst_statisch "Flag für die statische Ansteuerung" UBYTE Conv.cModPVorg._.f_anst_statisch_S6_S3 1 100 0 1 BIT_MASK 0x1 DISPLAY_IDENTIFIER f_anst_statisch_D ECU_ADDRESS 0xFFF8D3B3 /end MEASUREMENT
/begin MEASUREMENT iKupD.cModPVorg._.fktn_druckvorgabe "Die ansteuernde Funktion" UBYTE Conv.cModPVorg._.fktn_druckvorgabe_S6_S3 1 100 0 41 DISPLAY_IDENTIFIER fktn_druckvorgabe_D ECU_ADDRESS 0xFFF8D3B4 /end MEASUREMENT
/begin MEASUREMENT iKupD.cModPVorg._.typ_druckvorgabe "Der Typ des angesteuerten Druckes" UBYTE Conv.cModPVorg._.typ_druckvorgabe_S6_S3 1 100 0 4 DISPLAY_IDENTIFIER typ_druckvorgabe_D ECU_ADDRESS 0xFFF8D3B5 /end MEASUREMENT
/begin MEASUREMENT iKupD.t_kpl_aktiv.timer "Der aktuelle Timerwert" ULONG UMR_MSEC__10_1_0_S6_S3 1 100 0 42949672950 DISPLAY_IDENTIFIER t_kpl_aktiv.iKupD ECU_ADDRESS 0xFFF8D3C0 /end MEASUREMENT
/begin MEASUREMENT iKupD.t_kpl_inaktiv.timer "Der aktuelle Timerwert" ULONG UMR_MSEC__10_1_0_S6_S3 1 100 0 42949672950 DISPLAY_IDENTIFIER t_kpl_inaktiv.iKupD ECU_ADDRESS 0xFFF8D3C4 /end MEASUREMENT
/begin MEASUREMENT iKupD.p_filter.fl_filter.x "Filterwert" FLOAT32_IEEE UMR___1_1_0_S6_S3 1 100 -1000000000 1000000000 FORMAT "%4.2" DISPLAY_IDENTIFIER fl_filter.p_filter.iKupD ECU_ADDRESS 0xFFF8D3D4 /end MEASUREMENT
/begin MEASUREMENT iKupD.p_filter.letzter_ms_timer "letzter BS-Timer" UWORD UMR_MSEC__1_1_0_S6_S3 1 100 0 65535 DISPLAY_IDENTIFIER letzter_ms_timer.p_filter.iKupD ECU_ADDRESS 0xFFF8D3D0 /end MEASUREMENT
/begin MEASUREMENT iKupD.zustandstimer.timer "Der aktuelle Timerwert" UWORD UMR_MSEC__1_1_0_S6_S3 1 100 0 65535 DISPLAY_IDENTIFIER zustandstimer.iKupD ECU_ADDRESS 0xFFF8D3D8 /end MEASUREMENT
/begin MEASUREMENT iKupD.totzeit_abgelaufen.timer "Der aktuelle Timerwert" UWORD UMR_MSEC__1_1_0_S6_S3 1 100 0 65535 DISPLAY_IDENTIFIER totzeit_abgelaufen.iKupD ECU_ADDRESS 0xFFF8D3DA /end MEASUREMENT
/begin MEASUREMENT iKupD.timer_sas_ende_mit_pmax.timer "Der aktuelle Timerwert" UBYTE UMR_MSEC__10_1_0_S6_S3 1 100 0 2550 DISPLAY_IDENTIFIER timer_sas_ende_mit_pmax.iKupD ECU_ADDRESS 0xFFF8D3DC /end MEASUREMENT
/begin MEASUREMENT iKupD.zustand "Der Zustand" UBYTE Conv.cModKuppl._.zustand_S6_S3 1 100 0 5 DISPLAY_IDENTIFIER zustand_D ECU_ADDRESS 0xFFF8D3DF /end MEASUREMENT
/begin MEASUREMENT iKupD.timer_kolbenpos_kor "Timer fuer Korrekturfaktor Kolbenpos" UBYTE UMR_MSEC__10_1_0_S6_S3 1 100 0 2550 DISPLAY_IDENTIFIER timer_kolbenpos_kor_D ECU_ADDRESS 0xFFF8D3E0 /end MEASUREMENT
/begin MEASUREMENT iKupD.t0_sf "Gesamtschnellfüllzeit" UWORD UMR_MSEC__1_1_0_S6_S3 1 100 0 20000 DISPLAY_IDENTIFIER t0_sf_D ECU_ADDRESS 0xFFF8D3E2 /end MEASUREMENT
/begin MEASUREMENT iKupD.to_sf_ada "Schnellfüllzeit Adaption" SWORD UMR_MSEC__1_1_0_S6_S3 1 100 -32768 32767 DISPLAY_IDENTIFIER to_sf_ada_D ECU_ADDRESS 0xFFF8D3E4 /end MEASUREMENT
/begin MEASUREMENT iKupD.totzeit "Die Totzeit" UWORD UMR_MSEC__1_1_0_S6_S3 1 100 0 2000 DISPLAY_IDENTIFIER totzeit_D ECU_ADDRESS 0xFFF8D3E6 /end MEASUREMENT
/begin MEASUREMENT iKupD.t_lauf_fuell "Kolbenlaufzeit beim füllen" UWORD UMR_MSEC__1_1_0_S6_S3 1 100 0 20000 DISPLAY_IDENTIFIER t_lauf_fuell_D ECU_ADDRESS 0xFFF8D3E8 /end MEASUREMENT
/begin MEASUREMENT iKupD.t_lauf_entleer "Kolbenlaufzeit beim leeren" UWORD UMR_MSEC__1_1_0_S6_S3 1 100 0 20000 DISPLAY_IDENTIFIER t_lauf_entleer_D ECU_ADDRESS 0xFFF8D3EA /end MEASUREMENT
/begin MEASUREMENT iKupD.p_absist "Istdruck der Kupplung" UWORD UMR_BAR__1_1000_0_S6_S3 1 100 0 20 DISPLAY_IDENTIFIER p_absist_D ECU_ADDRESS 0xFFF8D3EC /end MEASUREMENT
/begin MEASUREMENT iKupD.p_fmin "minimale Fülldruck der Kupplung" UWORD UMR_BAR__1_1000_0_S6_S3 1 100 0 20 DISPLAY_IDENTIFIER p_fmin_D ECU_ADDRESS 0xFFF8D3EE /end MEASUREMENT
/begin MEASUREMENT iKupD.p_bedarf "Druckwert fuer bedarfsgerechte Bestromung" UWORD UMR_BAR__1_1000_0_S6_S3 1 100 0 20 DISPLAY_IDENTIFIER p_bedarf_D ECU_ADDRESS 0xFFF8D3F0 /end MEASUREMENT
/begin MEASUREMENT iKupD.n_kup_zbeg "Die Kupplungsdrehzahl zu beginn des Zustandes" UWORD UMR_U_MIN_1_1_0_S6_S3 1 100 0 8160 DISPLAY_IDENTIFIER n_kup_zbeg_D ECU_ADDRESS 0xFFF8D3F2 /end MEASUREMENT
/begin MEASUREMENT iKupD.kolben_pos "Die aktuelle Kolbenposition" UWORD UMR_PROZENT__1_100_0_S6_S3 1 100 0 100 DISPLAY_IDENTIFIER kolben_pos_D ECU_ADDRESS 0xFFF8D3F4 /end MEASUREMENT
/begin MEASUREMENT iKupD.kolben_posbas "Position, bei der der Kolben gestartet ist" UWORD UMR_PROZENT__1_100_0_S6_S3 1 100 0 100 DISPLAY_IDENTIFIER kolben_posbas_D ECU_ADDRESS 0xFFF8D3F6 /end MEASUREMENT
/begin MEASUREMENT iKupD.kv_nummer "Die Kupplungsventilnummer" UBYTE UMR___1_1_0_S6_S3 1 100 0 9 DISPLAY_IDENTIFIER kv_nummer_D ECU_ADDRESS 0xFFF8D3F8 /end MEASUREMENT
/begin MEASUREMENT iKupD.kup_schaltart_sas "Die Schaltart dieser Kupplung (für Bestimmung offset auf SF-Zeit)" UBYTE Conv.cModKuppl._.kup_schaltart_sas_S6_S3 1 100 0 5 DISPLAY_IDENTIFIER kup_schaltart_sas_D ECU_ADDRESS 0xFFF8D3F9 /end MEASUREMENT
/begin MEASUREMENT iKupD.kup_index_spsas "Der Spontanitaetsindex dieser Kupplung" UBYTE Conv.cModKuppl._.kup_index_spsas_S6_S3 1 100 0 2 DISPLAY_IDENTIFIER kup_index_spsas_D ECU_ADDRESS 0xFFF8D3FA /end MEASUREMENT
/begin MEASUREMENT iKupD.f_sf_ausgabe_aktiv "Flag für Schnellfüllung" UBYTE Conv.cModKuppl._.f_sf_ausgabe_aktiv_S6_S3 1 100 0 1 BIT_MASK 0x1 DISPLAY_IDENTIFIER f_sf_ausgabe_aktiv_D ECU_ADDRESS 0xFFF8D3FB /end MEASUREMENT
/begin MEASUREMENT iKupD.f_deakt_dither_sf "Deaktivierung Dither durch Schnellfüllung" UBYTE Conv.cModKuppl._.f_deakt_dither_sf_S6_S3 1 100 0 1 BIT_MASK 0x1 DISPLAY_IDENTIFIER f_deakt_dither_sf_D ECU_ADDRESS 0xFFF8D3FC /end MEASUREMENT
/begin MEASUREMENT iKupD.f_sf_vorhanden "Flag für ausgegebene SF" UBYTE Conv.cModKuppl._.f_sf_vorhanden_S6_S3 1 100 0 1 BIT_MASK 0x1 DISPLAY_IDENTIFIER f_sf_vorhanden_D ECU_ADDRESS 0xFFF8D3FD /end MEASUREMENT
/begin MEASUREMENT iKupD.kpl_inaktiv "Flag, ob Kupplung inaktiv ist" UBYTE Conv.cModKuppl._.kpl_inaktiv_S6_S3 1 100 0 1 BIT_MASK 0x1 DISPLAY_IDENTIFIER kpl_inaktiv_D ECU_ADDRESS 0xFFF8D3FE /end MEASUREMENT
/begin MEASUREMENT iKupD.f_fuellred "Flag für reduzierte Befüllung" UBYTE Conv.cModKuppl._.f_fuellred_S6_S3 1 100 0 1 BIT_MASK 0x1 DISPLAY_IDENTIFIER f_fuellred_D ECU_ADDRESS 0xFFF8D3FF /end MEASUREMENT
/begin MEASUREMENT iKupD.f_fuellopt "Flag für optimierte Befüllung" UBYTE Conv.cModKuppl._.f_fuellopt_S6_S3 1 100 0 1 BIT_MASK 0x1 DISPLAY_IDENTIFIER f_fuellopt_D ECU_ADDRESS 0xFFF8D400 /end MEASUREMENT
/begin MEASUREMENT iKupD.f_kolben_anlegen "Flag für Kolben anlegen" UBYTE Conv.cModKuppl._.f_kolben_anlegen_S6_S3 1 100 0 1 BIT_MASK 0x1 DISPLAY_IDENTIFIER f_kolben_anlegen_D ECU_ADDRESS 0xFFF8D401 /end MEASUREMENT
/begin MEASUREMENT iKupD.f_geschlossen "Flag für Kupplung geschlossen" UBYTE Conv.cModKuppl._.f_geschlossen_S6_S3 1 100 0 1 BIT_MASK 0x1 DISPLAY_IDENTIFIER f_geschlossen_D ECU_ADDRESS 0xFFF8D402 /end MEASUREMENT
/begin MEASUREMENT iKupD.f_erste_bef "Flag für erste Befüllung" UBYTE Conv.cModKuppl._.f_erste_bef_S6_S3 1 100 0 1 BIT_MASK 0x1 DISPLAY_IDENTIFIER f_erste_bef_D ECU_ADDRESS 0xFFF8D403 /end MEASUREMENT
/begin MEASUREMENT iKupD.f_erste_bef_aus_sb "Flag für erste Befüllung aus standby" UBYTE Conv.cModKuppl._.f_erste_bef_aus_sb_S6_S3 1 100 0 1 BIT_MASK 0x1 DISPLAY_IDENTIFIER f_erste_bef_aus_sb_D ECU_ADDRESS 0xFFF8D404 /end MEASUREMENT
/begin MEASUREMENT iKupD.f_strom_pre_puls_erf "Flag für Stromprepuls" UBYTE Conv.cModKuppl._.f_strom_pre_puls_erf_S6_S3 1 100 0 1 BIT_MASK 0x1 DISPLAY_IDENTIFIER f_strom_pre_puls_erf_D ECU_ADDRESS 0xFFF8D405 /end MEASUREMENT
/begin MEASUREMENT iKupD.f_stromschl_angefordert "Flag zum ausführen der Stromschleife" UBYTE Conv.cModKuppl._.f_stromschl_angefordert_S6_S3 1 100 0 1 BIT_MASK 0x1 DISPLAY_IDENTIFIER f_stromschl_angefordert_D ECU_ADDRESS 0xFFF8D406 /end MEASUREMENT
/begin MEASUREMENT iKupD.f_stromrampe_kab "Flag Anforderung Stromrampe KAB" UBYTE Conv.cModKuppl._.f_stromrampe_kab_S6_S3 1 100 0 1 BIT_MASK 0x1 DISPLAY_IDENTIFIER f_stromrampe_kab_D ECU_ADDRESS 0xFFF8D407 /end MEASUREMENT
/begin MEASUREMENT iKupD.drehzahl "Die Kupplungsdrehzahl" UWORD UMR_U_MIN_1_1_0_S6_S3 1 100 0 8160 DISPLAY_IDENTIFIER drehzahl_D ECU_ADDRESS 0xFFF8D408 /end MEASUREMENT
/begin MEASUREMENT iKupD.f_pfmin_ga_aktiv "Sonderfunktion p_fmin waehrend GA oder Reversieren aktiv" UBYTE Conv.cModKuppl._.f_pfmin_ga_aktiv_S6_S3 1 100 0 1 BIT_MASK 0x1 DISPLAY_IDENTIFIER f_pfmin_ga_aktiv_D ECU_ADDRESS 0xFFF8D40A /end MEASUREMENT
/begin MEASUREMENT iKupD.z_pfad_cgt_adaklasse "Bereich temperaturabheangig Fuelldruckadaption" UBYTE Conv.cModKuppl._.z_pfad_cgt_adaklasse_S6_S3 1 100 0 6 DISPLAY_IDENTIFIER z_pfad_cgt_adaklasse_D ECU_ADDRESS 0xFFF8D40B /end MEASUREMENT
/begin MEASUREMENT iKupE.cModPVorg._.p_vorgabe "Solldruck der Kupplung" UWORD UMR_BAR__1_1000_0_S6_S3 1 100 0 20 DISPLAY_IDENTIFIER p_vorgabe_E ECU_ADDRESS 0xFFF8D410 /end MEASUREMENT
/begin MEASUREMENT iKupE.cModPVorg._.p_abssoll "Solldruck der Kupplung" UWORD UMR_BAR__1_1000_0_S6_S3 1 100 0 20 DISPLAY_IDENTIFIER p_abssoll_E ECU_ADDRESS 0xFFF8D412 /end MEASUREMENT
/begin MEASUREMENT iKupE.cModPVorg._.p_abssoll_sys "Solldruck der Kupplung, begrentzt auf Systemdruck" UWORD UMR_BAR__1_1000_0_S6_S3 1 100 0 20 DISPLAY_IDENTIFIER p_abssoll_sys_E ECU_ADDRESS 0xFFF8D414 /end MEASUREMENT
/begin MEASUREMENT iKupE.cModPVorg._.f_druck_vorgegeben "Flag, ob Druck an dieses Element in diesem Zyklus schon vorgegeben wurde" UBYTE Conv.cModPVorg._.f_druck_vorgegeben_S6_S3 1 100 0 1 BIT_MASK 0x1 DISPLAY_IDENTIFIER f_druck_vorgegeben_E ECU_ADDRESS 0xFFF8D416 /end MEASUREMENT
/begin MEASUREMENT iKupE.cModPVorg._.f_anst_statisch "Flag für die statische Ansteuerung" UBYTE Conv.cModPVorg._.f_anst_statisch_S6_S3 1 100 0 1 BIT_MASK 0x1 DISPLAY_IDENTIFIER f_anst_statisch_E ECU_ADDRESS 0xFFF8D417 /end MEASUREMENT
/begin MEASUREMENT iKupE.cModPVorg._.fktn_druckvorgabe "Die ansteuernde Funktion" UBYTE Conv.cModPVorg._.fktn_druckvorgabe_S6_S3 1 100 0 41 DISPLAY_IDENTIFIER fktn_druckvorgabe_E ECU_ADDRESS 0xFFF8D418 /end MEASUREMENT
/begin MEASUREMENT iKupE.cModPVorg._.typ_druckvorgabe "Der Typ des angesteuerten Druckes" UBYTE Conv.cModPVorg._.typ_druckvorgabe_S6_S3 1 100 0 4 DISPLAY_IDENTIFIER typ_druckvorgabe_E ECU_ADDRESS 0xFFF8D419 /end MEASUREMENT
/begin MEASUREMENT iKupE.t_kpl_aktiv.timer "Der aktuelle Timerwert" ULONG UMR_MSEC__10_1_0_S6_S3 1 100 0 42949672950 DISPLAY_IDENTIFIER t_kpl_aktiv.iKupE ECU_ADDRESS 0xFFF8D424 /end MEASUREMENT
/begin MEASUREMENT iKupE.t_kpl_inaktiv.timer "Der aktuelle Timerwert" ULONG UMR_MSEC__10_1_0_S6_S3 1 100 0 42949672950 DISPLAY_IDENTIFIER t_kpl_inaktiv.iKupE ECU_ADDRESS 0xFFF8D428 /end MEASUREMENT
/begin MEASUREMENT iKupE.p_filter.fl_filter.x "Filterwert" FLOAT32_IEEE UMR___1_1_0_S6_S3 1 100 -1000000000 1000000000 FORMAT "%4.2" DISPLAY_IDENTIFIER fl_filter.p_filter.iKupE ECU_ADDRESS 0xFFF8D438 /end MEASUREMENT
/begin MEASUREMENT iKupE.p_filter.letzter_ms_timer "letzter BS-Timer" UWORD UMR_MSEC__1_1_0_S6_S3 1 100 0 65535 DISPLAY_IDENTIFIER letzter_ms_timer.p_filter.iKupE ECU_ADDRESS 0xFFF8D434 /end MEASUREMENT
/begin MEASUREMENT iKupE.zustandstimer.timer "Der aktuelle Timerwert" UWORD UMR_MSEC__1_1_0_S6_S3 1 100 0 65535 DISPLAY_IDENTIFIER zustandstimer.iKupE ECU_ADDRESS 0xFFF8D43C /end MEASUREMENT
/begin MEASUREMENT iKupE.totzeit_abgelaufen.timer "Der aktuelle Timerwert" UWORD UMR_MSEC__1_1_0_S6_S3 1 100 0 65535 DISPLAY_IDENTIFIER totzeit_abgelaufen.iKupE ECU_ADDRESS 0xFFF8D43E /end MEASUREMENT
/begin MEASUREMENT iKupE.timer_sas_ende_mit_pmax.timer "Der aktuelle Timerwert" UBYTE UMR_MSEC__10_1_0_S6_S3 1 100 0 2550 DISPLAY_IDENTIFIER timer_sas_ende_mit_pmax.iKupE ECU_ADDRESS 0xFFF8D440 /end MEASUREMENT
/begin MEASUREMENT iKupE.zustand "Der Zustand" UBYTE Conv.cModKuppl._.zustand_S6_S3 1 100 0 5 DISPLAY_IDENTIFIER zustand_E ECU_ADDRESS 0xFFF8D443 /end MEASUREMENT
/begin MEASUREMENT iKupE.timer_kolbenpos_kor "Timer fuer Korrekturfaktor Kolbenpos" UBYTE UMR_MSEC__10_1_0_S6_S3 1 100 0 2550 DISPLAY_IDENTIFIER timer_kolbenpos_kor_E ECU_ADDRESS 0xFFF8D444 /end MEASUREMENT
/begin MEASUREMENT iKupE.t0_sf "Gesamtschnellfüllzeit" UWORD UMR_MSEC__1_1_0_S6_S3 1 100 0 20000 DISPLAY_IDENTIFIER t0_sf_E ECU_ADDRESS 0xFFF8D446 /end MEASUREMENT
/begin MEASUREMENT iKupE.to_sf_ada "Schnellfüllzeit Adaption" SWORD UMR_MSEC__1_1_0_S6_S3 1 100 -32768 32767 DISPLAY_IDENTIFIER to_sf_ada_E ECU_ADDRESS 0xFFF8D448 /end MEASUREMENT
/begin MEASUREMENT iKupE.totzeit "Die Totzeit" UWORD UMR_MSEC__1_1_0_S6_S3 1 100 0 2000 DISPLAY_IDENTIFIER totzeit_E ECU_ADDRESS 0xFFF8D44A /end MEASUREMENT
/begin MEASUREMENT iKupE.t_lauf_fuell "Kolbenlaufzeit beim füllen" UWORD UMR_MSEC__1_1_0_S6_S3 1 100 0 20000 DISPLAY_IDENTIFIER t_lauf_fuell_E ECU_ADDRESS 0xFFF8D44C /end MEASUREMENT
/begin MEASUREMENT iKupE.t_lauf_entleer "Kolbenlaufzeit beim leeren" UWORD UMR_MSEC__1_1_0_S6_S3 1 100 0 20000 DISPLAY_IDENTIFIER t_lauf_entleer_E ECU_ADDRESS 0xFFF8D44E /end MEASUREMENT
/begin MEASUREMENT iKupE.p_absist "Istdruck der Kupplung" UWORD UMR_BAR__1_1000_0_S6_S3 1 100 0 20 DISPLAY_IDENTIFIER p_absist_E ECU_ADDRESS 0xFFF8D450 /end MEASUREMENT
/begin MEASUREMENT iKupE.p_fmin "minimale Fülldruck der Kupplung" UWORD UMR_BAR__1_1000_0_S6_S3 1 100 0 20 DISPLAY_IDENTIFIER p_fmin_E ECU_ADDRESS 0xFFF8D452 /end MEASUREMENT
/begin MEASUREMENT iKupE.p_bedarf "Druckwert fuer bedarfsgerechte Bestromung" UWORD UMR_BAR__1_1000_0_S6_S3 1 100 0 20 DISPLAY_IDENTIFIER p_bedarf_E ECU_ADDRESS 0xFFF8D454 /end MEASUREMENT
/begin MEASUREMENT iKupE.n_kup_zbeg "Die Kupplungsdrehzahl zu beginn des Zustandes" UWORD UMR_U_MIN_1_1_0_S6_S3 1 100 0 8160 DISPLAY_IDENTIFIER n_kup_zbeg_E ECU_ADDRESS 0xFFF8D456 /end MEASUREMENT
/begin MEASUREMENT iKupE.kolben_pos "Die aktuelle Kolbenposition" UWORD UMR_PROZENT__1_100_0_S6_S3 1 100 0 100 DISPLAY_IDENTIFIER kolben_pos_E ECU_ADDRESS 0xFFF8D458 /end MEASUREMENT
/begin MEASUREMENT iKupE.kolben_posbas "Position, bei der der Kolben gestartet ist" UWORD UMR_PROZENT__1_100_0_S6_S3 1 100 0 100 DISPLAY_IDENTIFIER kolben_posbas_E ECU_ADDRESS 0xFFF8D45A /end MEASUREMENT
/begin MEASUREMENT iKupE.kv_nummer "Die Kupplungsventilnummer" UBYTE UMR___1_1_0_S6_S3 1 100 0 9 DISPLAY_IDENTIFIER kv_nummer_E ECU_ADDRESS 0xFFF8D45C /end MEASUREMENT
/begin MEASUREMENT iKupE.kup_schaltart_sas "Die Schaltart dieser Kupplung (für Bestimmung offset auf SF-Zeit)" UBYTE Conv.cModKuppl._.kup_schaltart_sas_S6_S3 1 100 0 5 DISPLAY_IDENTIFIER kup_schaltart_sas_E ECU_ADDRESS 0xFFF8D45D /end MEASUREMENT
/begin MEASUREMENT iKupE.kup_index_spsas "Der Spontanitaetsindex dieser Kupplung" UBYTE Conv.cModKuppl._.kup_index_spsas_S6_S3 1 100 0 2 DISPLAY_IDENTIFIER kup_index_spsas_E ECU_ADDRESS 0xFFF8D45E /end MEASUREMENT
/begin MEASUREMENT iKupE.f_sf_ausgabe_aktiv "Flag für Schnellfüllung" UBYTE Conv.cModKuppl._.f_sf_ausgabe_aktiv_S6_S3 1 100 0 1 BIT_MASK 0x1 DISPLAY_IDENTIFIER f_sf_ausgabe_aktiv_E ECU_ADDRESS 0xFFF8D45F /end MEASUREMENT
/begin MEASUREMENT iKupE.f_deakt_dither_sf "Deaktivierung Dither durch Schnellfüllung" UBYTE Conv.cModKuppl._.f_deakt_dither_sf_S6_S3 1 100 0 1 BIT_MASK 0x1 DISPLAY_IDENTIFIER f_deakt_dither_sf_E ECU_ADDRESS 0xFFF8D460 /end MEASUREMENT
/begin MEASUREMENT iKupE.f_sf_vorhanden "Flag für ausgegebene SF" UBYTE Conv.cModKuppl._.f_sf_vorhanden_S6_S3 1 100 0 1 BIT_MASK 0x1 DISPLAY_IDENTIFIER f_sf_vorhanden_E ECU_ADDRESS 0xFFF8D461 /end MEASUREMENT
/begin MEASUREMENT iKupE.kpl_inaktiv "Flag, ob Kupplung inaktiv ist" UBYTE Conv.cModKuppl._.kpl_inaktiv_S6_S3 1 100 0 1 BIT_MASK 0x1 DISPLAY_IDENTIFIER kpl_inaktiv_E ECU_ADDRESS 0xFFF8D462 /end MEASUREMENT
/begin MEASUREMENT iKupE.f_fuellred "Flag für reduzierte Befüllung" UBYTE Conv.cModKuppl._.f_fuellred_S6_S3 1 100 0 1 BIT_MASK 0x1 DISPLAY_IDENTIFIER f_fuellred_E ECU_ADDRESS 0xFFF8D463 /end MEASUREMENT
/begin MEASUREMENT iKupE.f_fuellopt "Flag für optimierte Befüllung" UBYTE Conv.cModKuppl._.f_fuellopt_S6_S3 1 100 0 1 BIT_MASK 0x1 DISPLAY_IDENTIFIER f_fuellopt_E ECU_ADDRESS 0xFFF8D464 /end MEASUREMENT
/begin MEASUREMENT iKupE.f_kolben_anlegen "Flag für Kolben anlegen" UBYTE Conv.cModKuppl._.f_kolben_anlegen_S6_S3 1 100 0 1 BIT_MASK 0x1 DISPLAY_IDENTIFIER f_kolben_anlegen_E ECU_ADDRESS 0xFFF8D465 /end MEASUREMENT
/begin MEASUREMENT iKupE.f_geschlossen "Flag für Kupplung geschlossen" UBYTE Conv.cModKuppl._.f_geschlossen_S6_S3 1 100 0 1 BIT_MASK 0x1 DISPLAY_IDENTIFIER f_geschlossen_E ECU_ADDRESS 0xFFF8D466 /end MEASUREMENT
/begin MEASUREMENT iKupE.f_erste_bef "Flag für erste Befüllung" UBYTE Conv.cModKuppl._.f_erste_bef_S6_S3 1 100 0 1 BIT_MASK 0x1 DISPLAY_IDENTIFIER f_erste_bef_E ECU_ADDRESS 0xFFF8D467 /end MEASUREMENT
/begin MEASUREMENT iKupE.f_erste_bef_aus_sb "Flag für erste Befüllung aus standby" UBYTE Conv.cModKuppl._.f_erste_bef_aus_sb_S6_S3 1 100 0 1 BIT_MASK 0x1 DISPLAY_IDENTIFIER f_erste_bef_aus_sb_E ECU_ADDRESS 0xFFF8D468 /end MEASUREMENT
/begin MEASUREMENT iKupE.f_strom_pre_puls_erf "Flag für Stromprepuls" UBYTE Conv.cModKuppl._.f_strom_pre_puls_erf_S6_S3 1 100 0 1 BIT_MASK 0x1 DISPLAY_IDENTIFIER f_strom_pre_puls_erf_E ECU_ADDRESS 0xFFF8D469 /end MEASUREMENT
/begin MEASUREMENT iKupE.f_stromschl_angefordert "Flag zum ausführen der Stromschleife" UBYTE Conv.cModKuppl._.f_stromschl_angefordert_S6_S3 1 100 0 1 BIT_MASK 0x1 DISPLAY_IDENTIFIER f_stromschl_angefordert_E ECU_ADDRESS 0xFFF8D46A /end MEASUREMENT
/begin MEASUREMENT iKupE.f_stromrampe_kab "Flag Anforderung Stromrampe KAB" UBYTE Conv.cModKuppl._.f_stromrampe_kab_S6_S3 1 100 0 1 BIT_MASK 0x1 DISPLAY_IDENTIFIER f_stromrampe_kab_E ECU_ADDRESS 0xFFF8D46B /end MEASUREMENT
/begin MEASUREMENT iKupE.drehzahl "Die Kupplungsdrehzahl" UWORD UMR_U_MIN_1_1_0_S6_S3 1 100 0 8160 DISPLAY_IDENTIFIER drehzahl_E ECU_ADDRESS 0xFFF8D46C /end MEASUREMENT
/begin MEASUREMENT iKupE.f_pfmin_ga_aktiv "Sonderfunktion p_fmin waehrend GA oder Reversieren aktiv" UBYTE Conv.cModKuppl._.f_pfmin_ga_aktiv_S6_S3 1 100 0 1 BIT_MASK 0x1 DISPLAY_IDENTIFIER f_pfmin_ga_aktiv_E ECU_ADDRESS 0xFFF8D46E /end MEASUREMENT
/begin MEASUREMENT iKupE.z_pfad_cgt_adaklasse "Bereich temperaturabheangig Fuelldruckadaption" UBYTE Conv.cModKuppl._.z_pfad_cgt_adaklasse_S6_S3 1 100 0 6 DISPLAY_IDENTIFIER z_pfad_cgt_adaklasse_E ECU_ADDRESS 0xFFF8D46F /end MEASUREMENT
/begin MEASUREMENT iKupK0.cModPVorg._.p_vorgabe "Solldruck der Kupplung" UWORD UMR_BAR__1_1000_0_S6_S3 1 100 0 20 DISPLAY_IDENTIFIER p_vorgabe_K0 ECU_ADDRESS 0xFFF8D474 /end MEASUREMENT
/begin MEASUREMENT iKupK0.cModPVorg._.p_abssoll "Solldruck der Kupplung" UWORD UMR_BAR__1_1000_0_S6_S3 1 100 0 20 DISPLAY_IDENTIFIER p_abssoll_K0 ECU_ADDRESS 0xFFF8D476 /end MEASUREMENT
/begin MEASUREMENT iKupK0.cModPVorg._.p_abssoll_sys "Solldruck der Kupplung, begrentzt auf Systemdruck" UWORD UMR_BAR__1_1000_0_S6_S3 1 100 0 20 DISPLAY_IDENTIFIER p_abssoll_sys_K0 ECU_ADDRESS 0xFFF8D478 /end MEASUREMENT
/begin MEASUREMENT iKupK0.cModPVorg._.f_druck_vorgegeben "Flag, ob Druck an dieses Element in diesem Zyklus schon vorgegeben wurde" UBYTE Conv.cModPVorg._.f_druck_vorgegeben_S6_S3 1 100 0 1 BIT_MASK 0x1 DISPLAY_IDENTIFIER f_druck_vorgegeben_K0 ECU_ADDRESS 0xFFF8D47A /end MEASUREMENT
/begin MEASUREMENT iKupK0.cModPVorg._.f_anst_statisch "Flag für die statische Ansteuerung" UBYTE Conv.cModPVorg._.f_anst_statisch_S6_S3 1 100 0 1 BIT_MASK 0x1 DISPLAY_IDENTIFIER f_anst_statisch_K0 ECU_ADDRESS 0xFFF8D47B /end MEASUREMENT
/begin MEASUREMENT iKupK0.cModPVorg._.fktn_druckvorgabe "Die ansteuernde Funktion" UBYTE Conv.cModPVorg._.fktn_druckvorgabe_S6_S3 1 100 0 41 DISPLAY_IDENTIFIER fktn_druckvorgabe_K0 ECU_ADDRESS 0xFFF8D47C /end MEASUREMENT
/begin MEASUREMENT iKupK0.cModPVorg._.typ_druckvorgabe "Der Typ des angesteuerten Druckes" UBYTE Conv.cModPVorg._.typ_druckvorgabe_S6_S3 1 100 0 4 DISPLAY_IDENTIFIER typ_druckvorgabe_K0 ECU_ADDRESS 0xFFF8D47D /end MEASUREMENT
/begin MEASUREMENT iKupK0.t_kpl_aktiv.timer "Der aktuelle Timerwert" ULONG UMR_MSEC__10_1_0_S6_S3 1 100 0 42949672950 DISPLAY_IDENTIFIER t_kpl_aktiv.iKupK0 ECU_ADDRESS 0xFFF8D488 /end MEASUREMENT
/begin MEASUREMENT iKupK0.t_kpl_inaktiv.timer "Der aktuelle Timerwert" ULONG UMR_MSEC__10_1_0_S6_S3 1 100 0 42949672950 DISPLAY_IDENTIFIER t_kpl_inaktiv.iKupK0 ECU_ADDRESS 0xFFF8D48C /end MEASUREMENT
/begin MEASUREMENT iKupK0.p_filter.fl_filter.x "Filterwert" FLOAT32_IEEE UMR___1_1_0_S6_S3 1 100 -1000000000 1000000000 FORMAT "%4.2" DISPLAY_IDENTIFIER fl_filter.p_filter.iKupK0 ECU_ADDRESS 0xFFF8D49C /end MEASUREMENT
/begin MEASUREMENT iKupK0.p_filter.letzter_ms_timer "letzter BS-Timer" UWORD UMR_MSEC__1_1_0_S6_S3 1 100 0 65535 DISPLAY_IDENTIFIER letzter_ms_timer.p_filter.iKupK0 ECU_ADDRESS 0xFFF8D498 /end MEASUREMENT
/begin MEASUREMENT iKupK0.zustandstimer.timer "Der aktuelle Timerwert" UWORD UMR_MSEC__1_1_0_S6_S3 1 100 0 65535 DISPLAY_IDENTIFIER zustandstimer.iKupK0 ECU_ADDRESS 0xFFF8D4A0 /end MEASUREMENT
/begin MEASUREMENT iKupK0.totzeit_abgelaufen.timer "Der aktuelle Timerwert" UWORD UMR_MSEC__1_1_0_S6_S3 1 100 0 65535 DISPLAY_IDENTIFIER totzeit_abgelaufen.iKupK0 ECU_ADDRESS 0xFFF8D4A2 /end MEASUREMENT
/begin MEASUREMENT iKupK0.timer_sas_ende_mit_pmax.timer "Der aktuelle Timerwert" UBYTE UMR_MSEC__10_1_0_S6_S3 1 100 0 2550 DISPLAY_IDENTIFIER timer_sas_ende_mit_pmax.iKupK0 ECU_ADDRESS 0xFFF8D4A4 /end MEASUREMENT
/begin MEASUREMENT iKupK0.zustand "Der Zustand" UBYTE Conv.cModKuppl._.zustand_S6_S3 1 100 0 5 DISPLAY_IDENTIFIER zustand_0 ECU_ADDRESS 0xFFF8D4A7 /end MEASUREMENT
/begin MEASUREMENT iKupK0.timer_kolbenpos_kor "Timer fuer Korrekturfaktor Kolbenpos" UBYTE UMR_MSEC__10_1_0_S6_S3 1 100 0 2550 DISPLAY_IDENTIFIER timer_kolbenpos_kor_0 ECU_ADDRESS 0xFFF8D4A8 /end MEASUREMENT
/begin MEASUREMENT iKupK0.t0_sf "Gesamtschnellfüllzeit" UWORD UMR_MSEC__1_1_0_S6_S3 1 100 0 20000 DISPLAY_IDENTIFIER t0_sf_0 ECU_ADDRESS 0xFFF8D4AA /end MEASUREMENT
/begin MEASUREMENT iKupK0.to_sf_ada "Schnellfüllzeit Adaption" SWORD UMR_MSEC__1_1_0_S6_S3 1 100 -32768 32767 DISPLAY_IDENTIFIER to_sf_ada_0 ECU_ADDRESS 0xFFF8D4AC /end MEASUREMENT
/begin MEASUREMENT iKupK0.totzeit "Die Totzeit" UWORD UMR_MSEC__1_1_0_S6_S3 1 100 0 2000 DISPLAY_IDENTIFIER totzeit_0 ECU_ADDRESS 0xFFF8D4AE /end MEASUREMENT
/begin MEASUREMENT iKupK0.t_lauf_fuell "Kolbenlaufzeit beim füllen" UWORD UMR_MSEC__1_1_0_S6_S3 1 100 0 20000 DISPLAY_IDENTIFIER t_lauf_fuell_0 ECU_ADDRESS 0xFFF8D4B0 /end MEASUREMENT
/begin MEASUREMENT iKupK0.t_lauf_entleer "Kolbenlaufzeit beim leeren" UWORD UMR_MSEC__1_1_0_S6_S3 1 100 0 20000 DISPLAY_IDENTIFIER t_lauf_entleer_0 ECU_ADDRESS 0xFFF8D4B2 /end MEASUREMENT
/begin MEASUREMENT iKupK0.p_absist "Istdruck der Kupplung" UWORD UMR_BAR__1_1000_0_S6_S3 1 100 0 20 DISPLAY_IDENTIFIER p_absist_0 ECU_ADDRESS 0xFFF8D4B4 /end MEASUREMENT
/begin MEASUREMENT iKupK0.p_fmin "minimale Fülldruck der Kupplung" UWORD UMR_BAR__1_1000_0_S6_S3 1 100 0 20 DISPLAY_IDENTIFIER p_fmin_0 ECU_ADDRESS 0xFFF8D4B6 /end MEASUREMENT
/begin MEASUREMENT iKupK0.p_bedarf "Druckwert fuer bedarfsgerechte Bestromung" UWORD UMR_BAR__1_1000_0_S6_S3 1 100 0 20 DISPLAY_IDENTIFIER p_bedarf_0 ECU_ADDRESS 0xFFF8D4B8 /end MEASUREMENT
/begin MEASUREMENT iKupK0.n_kup_zbeg "Die Kupplungsdrehzahl zu beginn des Zustandes" UWORD UMR_U_MIN_1_1_0_S6_S3 1 100 0 8160 DISPLAY_IDENTIFIER n_kup_zbeg_0 ECU_ADDRESS 0xFFF8D4BA /end MEASUREMENT
/begin MEASUREMENT iKupK0.kolben_pos "Die aktuelle Kolbenposition" UWORD UMR_PROZENT__1_100_0_S6_S3 1 100 0 100 DISPLAY_IDENTIFIER kolben_pos_0 ECU_ADDRESS 0xFFF8D4BC /end MEASUREMENT
/begin MEASUREMENT iKupK0.kolben_posbas "Position, bei der der Kolben gestartet ist" UWORD UMR_PROZENT__1_100_0_S6_S3 1 100 0 100 DISPLAY_IDENTIFIER kolben_posbas_0 ECU_ADDRESS 0xFFF8D4BE /end MEASUREMENT
/begin MEASUREMENT iKupK0.kv_nummer "Die Kupplungsventilnummer" UBYTE UMR___1_1_0_S6_S3 1 100 0 9 DISPLAY_IDENTIFIER kv_nummer_0 ECU_ADDRESS 0xFFF8D4C0 /end MEASUREMENT
/begin MEASUREMENT iKupK0.kup_schaltart_sas "Die Schaltart dieser Kupplung (für Bestimmung offset auf SF-Zeit)" UBYTE Conv.cModKuppl._.kup_schaltart_sas_S6_S3 1 100 0 5 DISPLAY_IDENTIFIER kup_schaltart_sas_0 ECU_ADDRESS 0xFFF8D4C1 /end MEASUREMENT
/begin MEASUREMENT iKupK0.kup_index_spsas "Der Spontanitaetsindex dieser Kupplung" UBYTE Conv.cModKuppl._.kup_index_spsas_S6_S3 1 100 0 2 DISPLAY_IDENTIFIER kup_index_spsas_0 ECU_ADDRESS 0xFFF8D4C2 /end MEASUREMENT
/begin MEASUREMENT iKupK0.f_sf_ausgabe_aktiv "Flag für Schnellfüllung" UBYTE Conv.cModKuppl._.f_sf_ausgabe_aktiv_S6_S3 1 100 0 1 BIT_MASK 0x1 DISPLAY_IDENTIFIER f_sf_ausgabe_aktiv_0 ECU_ADDRESS 0xFFF8D4C3 /end MEASUREMENT
/begin MEASUREMENT iKupK0.f_deakt_dither_sf "Deaktivierung Dither durch Schnellfüllung" UBYTE Conv.cModKuppl._.f_deakt_dither_sf_S6_S3 1 100 0 1 BIT_MASK 0x1 DISPLAY_IDENTIFIER f_deakt_dither_sf_0 ECU_ADDRESS 0xFFF8D4C4 /end MEASUREMENT
/begin MEASUREMENT iKupK0.f_sf_vorhanden "Flag für ausgegebene SF" UBYTE Conv.cModKuppl._.f_sf_vorhanden_S6_S3 1 100 0 1 BIT_MASK 0x1 DISPLAY_IDENTIFIER f_sf_vorhanden_0 ECU_ADDRESS 0xFFF8D4C5 /end MEASUREMENT
/begin MEASUREMENT iKupK0.kpl_inaktiv "Flag, ob Kupplung inaktiv ist" UBYTE Conv.cModKuppl._.kpl_inaktiv_S6_S3 1 100 0 1 BIT_MASK 0x1 DISPLAY_IDENTIFIER kpl_inaktiv_0 ECU_ADDRESS 0xFFF8D4C6 /end MEASUREMENT
/begin MEASUREMENT iKupK0.f_fuellred "Flag für reduzierte Befüllung" UBYTE Conv.cModKuppl._.f_fuellred_S6_S3 1 100 0 1 BIT_MASK 0x1 DISPLAY_IDENTIFIER f_fuellred_0 ECU_ADDRESS 0xFFF8D4C7 /end MEASUREMENT
/begin MEASUREMENT iKupK0.f_fuellopt "Flag für optimierte Befüllung" UBYTE Conv.cModKuppl._.f_fuellopt_S6_S3 1 100 0 1 BIT_MASK 0x1 DISPLAY_IDENTIFIER f_fuellopt_0 ECU_ADDRESS 0xFFF8D4C8 /end MEASUREMENT
/begin MEASUREMENT iKupK0.f_kolben_anlegen "Flag für Kolben anlegen" UBYTE Conv.cModKuppl._.f_kolben_anlegen_S6_S3 1 100 0 1 BIT_MASK 0x1 DISPLAY_IDENTIFIER f_kolben_anlegen_0 ECU_ADDRESS 0xFFF8D4C9 /end MEASUREMENT
/begin MEASUREMENT iKupK0.f_geschlossen "Flag für Kupplung geschlossen" UBYTE Conv.cModKuppl._.f_geschlossen_S6_S3 1 100 0 1 BIT_MASK 0x1 DISPLAY_IDENTIFIER f_geschlossen_0 ECU_ADDRESS 0xFFF8D4CA /end MEASUREMENT
/begin MEASUREMENT iKupK0.f_erste_bef "Flag für erste Befüllung" UBYTE Conv.cModKuppl._.f_erste_bef_S6_S3 1 100 0 1 BIT_MASK 0x1 DISPLAY_IDENTIFIER f_erste_bef_0 ECU_ADDRESS 0xFFF8D4CB /end MEASUREMENT
/begin MEASUREMENT iKupK0.f_erste_bef_aus_sb "Flag für erste Befüllung aus standby" UBYTE Conv.cModKuppl._.f_erste_bef_aus_sb_S6_S3 1 100 0 1 BIT_MASK 0x1 DISPLAY_IDENTIFIER f_erste_bef_aus_sb_0 ECU_ADDRESS 0xFFF8D4CC /end MEASUREMENT
/begin MEASUREMENT iKupK0.f_strom_pre_puls_erf "Flag für Stromprepuls" UBYTE Conv.cModKuppl._.f_strom_pre_puls_erf_S6_S3 1 100 0 1 BIT_MASK 0x1 DISPLAY_IDENTIFIER f_strom_pre_puls_erf_0 ECU_ADDRESS 0xFFF8D4CD /end MEASUREMENT
/begin MEASUREMENT iKupK0.f_stromschl_angefordert "Flag zum ausführen der Stromschleife" UBYTE Conv.cModKuppl._.f_stromschl_angefordert_S6_S3 1 100 0 1 BIT_MASK 0x1 DISPLAY_IDENTIFIER f_stromschl_angefordert_0 ECU_ADDRESS 0xFFF8D4CE /end MEASUREMENT
/begin MEASUREMENT iKupK0.f_stromrampe_kab "Flag Anforderung Stromrampe KAB" UBYTE Conv.cModKuppl._.f_stromrampe_kab_S6_S3 1 100 0 1 BIT_MASK 0x1 DISPLAY_IDENTIFIER f_stromrampe_kab_0 ECU_ADDRESS 0xFFF8D4CF /end MEASUREMENT
/begin MEASUREMENT iKupK0.drehzahl "Die Kupplungsdrehzahl" UWORD UMR_U_MIN_1_1_0_S6_S3 1 100 0 8160 DISPLAY_IDENTIFIER drehzahl_0 ECU_ADDRESS 0xFFF8D4D0 /end MEASUREMENT
/begin MEASUREMENT iKupK0.f_pfmin_ga_aktiv "Sonderfunktion p_fmin waehrend GA oder Reversieren aktiv" UBYTE Conv.cModKuppl._.f_pfmin_ga_aktiv_S6_S3 1 100 0 1 BIT_MASK 0x1 DISPLAY_IDENTIFIER f_pfmin_ga_aktiv_0 ECU_ADDRESS 0xFFF8D4D2 /end MEASUREMENT
/begin MEASUREMENT iKupK0.z_pfad_cgt_adaklasse "Bereich temperaturabheangig Fuelldruckadaption" UBYTE Conv.cModKuppl._.z_pfad_cgt_adaklasse_S6_S3 1 100 0 6 DISPLAY_IDENTIFIER z_pfad_cgt_adaklasse_0 ECU_ADDRESS 0xFFF8D4D3 /end MEASUREMENT
/begin MEASUREMENT iModKupSfktK0.pgo_sf_rampe.cBibRampeGradSi16._.letzter_wert "Speichert den letzten Eingangswert" FLOAT32_IEEE UMR___1_1_0_S6_S3 1 100 -1E+037 1E+037 FORMAT "%4.2" DISPLAY_IDENTIFIER letzter_wert._.cBibRampeGradSi16.pgo_sf_rampe.iModKupSfktK0 ECU_ADDRESS 0xFFF8F008 /end MEASUREMENT
/begin MEASUREMENT iModKupSfktK0.pgo_sf_rampe.cBibRampeGradSi16._.letzter_ms_timer "Speichert den letzten BS-Timer" UWORD UMR_MSEC__1_1_0_S6_S3 1 100 0 65535 DISPLAY_IDENTIFIER letzter_ms_timer._.cBibRampeGradSi16.pgo_sf_rampe.iModKupSfktK0 ECU_ADDRESS 0xFFF8F00C /end MEASUREMENT
/begin MEASUREMENT iModKupSfktK0.pgo_sf_rampe.cBibRampeGradSi16._.minimum "Minimum Begrenzung" FLOAT32_IEEE UMR___1_1_0_S6_S3 1 100 -1E+037 1E+037 FORMAT "%4.2" DISPLAY_IDENTIFIER minimum._.cBibRampeGradSi16.pgo_sf_rampe.iModKupSfktK0 ECU_ADDRESS 0xFFF8F010 /end MEASUREMENT
/begin MEASUREMENT iModKupSfktK0.pgo_sf_rampe.cBibRampeGradSi16._.maximum "Maximum Begrenzung" FLOAT32_IEEE UMR___1_1_0_S6_S3 1 100 -1E+037 1E+037 FORMAT "%4.2" DISPLAY_IDENTIFIER maximum._.cBibRampeGradSi16.pgo_sf_rampe.iModKupSfktK0 ECU_ADDRESS 0xFFF8F014 /end MEASUREMENT
/begin MEASUREMENT iModKupSfktK0.befuellgrad_k0 "Befuellgrad der Kupplung K0" SWORD UMR_PROZENT__1_100_0_S6_S3 1 100 0 100 DISPLAY_IDENTIFIER befuellgrad_k0.iModKupSfktK0 ECU_ADDRESS 0xFFF8F004 /end MEASUREMENT
/begin MEASUREMENT iModHydlg.status_pruef_abgldat "Pruefergebnis Abgleichdaten im KD-Boot" UBYTE Conv.cModHydlg._.status_pruef_abgldat_S6_S3 1 100 0 1 BIT_MASK 0x1 DISPLAY_IDENTIFIER status_pruef_abgldat.iModHydlg ECU_ADDRESS 0xFFF8D270 /end MEASUREMENT
/begin MEASUREMENT iModHydlg.zugriff_abgleichdaten "Zugriff Abgleichdaten" UBYTE Conv.cModHydlg._.zugriff_abgleichdaten_S6_S3 1 100 0 255 DISPLAY_IDENTIFIER zugriff_abgleichdaten.iModHydlg ECU_ADDRESS 0xFFF8D271 /end MEASUREMENT
/begin MEASUREMENT iModHydlg.err_v_nr_abgldat "Fehler der Versionnummer der Abgleichdaten im KD-Boot" UBYTE Conv.cModHydlg._.err_v_nr_abgldat_S6_S3 1 100 0 1 BIT_MASK 0x1 DISPLAY_IDENTIFIER err_v_nr_abgldat.iModHydlg ECU_ADDRESS 0xFFF8D272 /end MEASUREMENT
/begin MEASUREMENT iModHydlg.version_abgleichdaten "Von der Software erwartete Versionsnummer der Abgleichdaten" ULONG Conv.cModHydlg._.version_abgleichdaten_S6_S3 1 100 0 255 DISPLAY_IDENTIFIER version_abgleichdaten.iModHydlg ECU_ADDRESS 0xFFF8D274 /end MEASUREMENT
/begin MEASUREMENT iModHydlg.vnr_abgldat_im_boot "Im Boot enthaltene Versionsnummer der Abgleichdaten" ULONG Conv.cModHydlg._.vnr_abgldat_im_boot_S6_S3 1 100 0 255 DISPLAY_IDENTIFIER vnr_abgldat_im_boot.iModHydlg ECU_ADDRESS 0xFFF8D278 /end MEASUREMENT
/begin MEASUREMENT iAdaGloku.kup_beeinfluss_d_ada_wert "delta-Wert, der mit Faktor versehen in BE-ADAs eingeht" SWORD UMR_BAR__1_1000_0_S6_S3 1 100 -32.768 32.767 DISPLAY_IDENTIFIER kup_beeinfluss_d_ada_wert.iAdaGloku ECU_ADDRESS 0xFFF8A054 /end MEASUREMENT
/begin MEASUREMENT iAdaGloku.puls_lock "Abbruch der Puls-Ada (K0) wegen Urluft-Lock" UBYTE Conv.cAdaGloku._.puls_lock_S6_S3 1 100 0 1 BIT_MASK 0x1 DISPLAY_IDENTIFIER puls_lock.iAdaGloku ECU_ADDRESS 0xFFF8A056 /end MEASUREMENT
/begin MEASUREMENT iAdaGloku.kup_beeinfluss_ada_delta_wert "interne Groesse fuer Beeinflussungsadaption" SWORD UMR___1_1_0_S6_S3 1 100 -32768 32767 DISPLAY_IDENTIFIER kup_beeinfluss_ada_delta_wert.iAdaGloku ECU_ADDRESS 0xFFF8A058 /end MEASUREMENT
/begin MEASUREMENT iAdaGloku.kup_beeinfluss_ada_typ "interne Groesse fuer Beeinflussungsadaption" UBYTE UMR___1_1_0_S6_S3 1 100 0 255 DISPLAY_IDENTIFIER kup_beeinfluss_ada_typ.iAdaGloku ECU_ADDRESS 0xFFF8A05A /end MEASUREMENT
/begin MEASUREMENT iAdaGloku.pre_timer_lock "Vorzaehler fuer Lock-Timer im EEPROM" UBYTE UMR_MSEC__10_1_0_S6_S3 1 100 0 1000 DISPLAY_IDENTIFIER pre_timer_lock.iAdaGloku ECU_ADDRESS 0xFFF8A05B /end MEASUREMENT
/begin MEASUREMENT iAdaGloku.pre_timer_max_lock "Vorzaehler fuer Max-Lock-Timer im EEPROM" UBYTE UMR_MSEC__10_1_0_S6_S3 1 100 0 1000 DISPLAY_IDENTIFIER pre_timer_max_lock.iAdaGloku ECU_ADDRESS 0xFFF8A05C /end MEASUREMENT
/begin MEASUREMENT iAdaGloku.index_startada_pf "Y-Index zur Matrix TAB_SWI_KUPADA_START_PF" UBYTE Conv.cAdaGloku._.index_startada_pf_S6_S3 1 100 1 6 DISPLAY_IDENTIFIER index_startada_pf.iAdaGloku ECU_ADDRESS 0xFFF8A05D /end MEASUREMENT
/begin MEASUREMENT iAdaPulzs.iHsv.iAbbruch.timer "Der aktuelle Timerwert" UWORD UMR_MSEC__10_1_0_S6_S3 1 100 0 655350 DISPLAY_IDENTIFIER iAbbruch.iHsv.iAdaPulzs ECU_ADDRESS 0xFFF8C128 /end MEASUREMENT
/begin MEASUREMENT iAdaPulzs.iHsv.zustand "Zustand der Hochschaltverhinderung" UBYTE Conv.cAdaPulhv._.zustand_S6_S3 1 100 0 2 DISPLAY_IDENTIFIER zustand.iHsv.iAdaPulzs ECU_ADDRESS 0xFFF8C12A /end MEASUREMENT
/begin MEASUREMENT iAdaPulzs.iHsv.t_bis_puls "Zeit bis Puls startet" UWORD UMR_MSEC__10_1_0_S6_S3 1 100 0 65000 DISPLAY_IDENTIFIER t_bis_puls.iHsv.iAdaPulzs ECU_ADDRESS 0xFFF8C12C /end MEASUREMENT
/begin MEASUREMENT iAdaPulzs.iHsv.hs_verzoegerung "Es soll eine verzögerung angefordert werden." UBYTE Conv.cAdaPulhv._.hs_verzoegerung_S6_S3 1 100 0 2 DISPLAY_IDENTIFIER hs_verzoegerung.iHsv.iAdaPulzs ECU_ADDRESS 0xFFF8C12E /end MEASUREMENT
/begin MEASUREMENT iAdaPulzs.iBew.iFensterNeg.iTimerStarten.timer "Der aktuelle Timerwert" UBYTE UMR_MSEC__10_1_0_S6_S3 1 100 0 2550 DISPLAY_IDENTIFIER iTimerStarten.iFensterNeg.iBew.iAdaPulzs ECU_ADDRESS 0xFFF8C134 /end MEASUREMENT
/begin MEASUREMENT iAdaPulzs.iBew.iFensterNeg.iTimerBeenden.timer "Der aktuelle Timerwert" UBYTE UMR_MSEC__10_1_0_S6_S3 1 100 0 2550 DISPLAY_IDENTIFIER iTimerBeenden.iFensterNeg.iBew.iAdaPulzs ECU_ADDRESS 0xFFF8C135 /end MEASUREMENT
/begin MEASUREMENT iAdaPulzs.iBew.iFensterNeg.f_aktiv "Zustand des Fensters" UBYTE Conv.cAdaPulbwFenster._.f_aktiv_S6_S3 1 100 0 1 BIT_MASK 0x1 DISPLAY_IDENTIFIER f_aktiv_Neg ECU_ADDRESS 0xFFF8C136 /end MEASUREMENT
/begin MEASUREMENT iAdaPulzs.iBew.iFensterNeg.f_starten "Fenster soll aktiviert werden" UBYTE Conv.cAdaPulbwFenster._.f_starten_S6_S3 1 100 0 1 BIT_MASK 0x1 DISPLAY_IDENTIFIER f_starten_Neg ECU_ADDRESS 0xFFF8C137 /end MEASUREMENT
/begin MEASUREMENT iAdaPulzs.iBew.iFensterNeg.f_beenden "Fenster soll beendet werden" UBYTE Conv.cAdaPulbwFenster._.f_beenden_S6_S3 1 100 0 1 BIT_MASK 0x1 DISPLAY_IDENTIFIER f_beenden_Neg ECU_ADDRESS 0xFFF8C138 /end MEASUREMENT
/begin MEASUREMENT iAdaPulzs.iBew.iFensterPos.iTimerStarten.timer "Der aktuelle Timerwert" UBYTE UMR_MSEC__10_1_0_S6_S3 1 100 0 2550 DISPLAY_IDENTIFIER iTimerStarten.iFensterPos.iBew.iAdaPulzs ECU_ADDRESS 0xFFF8C139 /end MEASUREMENT
/begin MEASUREMENT iAdaPulzs.iBew.iFensterPos.iTimerBeenden.timer "Der aktuelle Timerwert" UBYTE UMR_MSEC__10_1_0_S6_S3 1 100 0 2550 DISPLAY_IDENTIFIER iTimerBeenden.iFensterPos.iBew.iAdaPulzs ECU_ADDRESS 0xFFF8C13A /end MEASUREMENT
/begin MEASUREMENT iAdaPulzs.iBew.iFensterPos.f_aktiv "Zustand des Fensters" UBYTE Conv.cAdaPulbwFenster._.f_aktiv_S6_S3 1 100 0 1 BIT_MASK 0x1 DISPLAY_IDENTIFIER f_aktiv_Pos ECU_ADDRESS 0xFFF8C13B /end MEASUREMENT
/begin MEASUREMENT iAdaPulzs.iBew.iFensterPos.f_starten "Fenster soll aktiviert werden" UBYTE Conv.cAdaPulbwFenster._.f_starten_S6_S3 1 100 0 1 BIT_MASK 0x1 DISPLAY_IDENTIFIER f_starten_Pos ECU_ADDRESS 0xFFF8C13C /end MEASUREMENT
/begin MEASUREMENT iAdaPulzs.iBew.iFensterPos.f_beenden "Fenster soll beendet werden" UBYTE Conv.cAdaPulbwFenster._.f_beenden_S6_S3 1 100 0 1 BIT_MASK 0x1 DISPLAY_IDENTIFIER f_beenden_Pos ECU_ADDRESS 0xFFF8C13D /end MEASUREMENT
/begin MEASUREMENT iAdaPulzs.iBew.iTimerAmp.timer "Der aktuelle Timerwert" UBYTE UMR_MSEC__10_1_0_S6_S3 1 100 0 2550 DISPLAY_IDENTIFIER iTimerAmp.iBew.iAdaPulzs ECU_ADDRESS 0xFFF8C13E /end MEASUREMENT
/begin MEASUREMENT iAdaPulzs.iBew.zustand "Zustand Bewertung des Bewertungsablaufes" UBYTE Conv.cAdaPulbw._.zustand_S6_S3 1 100 0 10 DISPLAY_IDENTIFIER zustand.iBew.iAdaPulzs ECU_ADDRESS 0xFFF8C13F /end MEASUREMENT
/begin MEASUREMENT iAdaPulzs.iBew.testresultat "Testresultat Befuellpruefung" UBYTE Conv.cAdaPulbw._.testresultat_S6_S3 1 100 0 4 DISPLAY_IDENTIFIER testresultat.iBew.iAdaPulzs ECU_ADDRESS 0xFFF8C140 /end MEASUREMENT
/begin MEASUREMENT iAdaPulzs.iBew.nd_pulszwneg "Schwelle TAB_ND_PULSZWNEG..." SWORD UMR_U_MIN_1_1_0_S6_S3 1 100 0 1000 DISPLAY_IDENTIFIER nd_pulszwneg.iBew.iAdaPulzs ECU_ADDRESS 0xFFF8C142 /end MEASUREMENT
/begin MEASUREMENT iAdaPulzs.iBew.nd_pulszwpos "Schwelle TAB_ND_PULSZWPOS..." SWORD UMR_U_MIN_1_1_0_S6_S3 1 100 0 1000 DISPLAY_IDENTIFIER nd_pulszwpos.iBew.iAdaPulzs ECU_ADDRESS 0xFFF8C144 /end MEASUREMENT
/begin MEASUREMENT iAdaPulzs.iBew.nd_pulsamp "Schwelle TAB_ND_PULSAMP..." SWORD UMR_U_MIN_1_1_0_S6_S3 1 100 0 1000 DISPLAY_IDENTIFIER nd_pulsamp.iBew.iAdaPulzs ECU_ADDRESS 0xFFF8C146 /end MEASUREMENT
/begin MEASUREMENT iAdaPulzs.iBew.nd_pulsneg "Schwelle TAB_ND_PULSNEG..." SWORD UMR_U_MIN_1_1_0_S6_S3 1 100 0 1000 DISPLAY_IDENTIFIER nd_pulsneg.iBew.iAdaPulzs ECU_ADDRESS 0xFFF8C148 /end MEASUREMENT
/begin MEASUREMENT iAdaPulzs.iBew.nd_pulspos "Schwelle TAB_ND_PULSPOS..." SWORD UMR_U_MIN_1_1_0_S6_S3 1 100 0 1000 DISPLAY_IDENTIFIER nd_pulspos.iBew.iAdaPulzs ECU_ADDRESS 0xFFF8C14A /end MEASUREMENT
/begin MEASUREMENT iAdaPulzs.iBew.neg_rea "ND-Reaktion auf PF- oder SF-Puls" UBYTE Conv.cAdaPulbw._.neg_rea_S6_S3 1 100 0 2 DISPLAY_IDENTIFIER neg_rea.iBew.iAdaPulzs ECU_ADDRESS 0xFFF8C14C /end MEASUREMENT
/begin MEASUREMENT iAdaPulzs.iBew.pos_rea "ND-Reaktion nach PF- oder SF-Puls" UBYTE Conv.cAdaPulbw._.pos_rea_S6_S3 1 100 0 2 DISPLAY_IDENTIFIER pos_rea.iBew.iAdaPulzs ECU_ADDRESS 0xFFF8C14D /end MEASUREMENT
/begin MEASUREMENT iAdaPulzs.iBew.rea_amplitude "ND-Reaktion nach Puls als Amplitude spitze-spitze" UBYTE Conv.cAdaPulbw._.rea_amplitude_S6_S3 1 100 0 1 DISPLAY_IDENTIFIER rea_amplitude.iBew.iAdaPulzs ECU_ADDRESS 0xFFF8C14E /end MEASUREMENT
/begin MEASUREMENT iAdaPulzs.iBew.f_start_t_sperrt_nach_reak "Flag, ob Reaktion auf Puls 1 erkannt wurde." UBYTE Conv.cAdaPulbw._.f_start_t_sperrt_nach_reak_S6_S3 1 100 0 1 BIT_MASK 0x1 DISPLAY_IDENTIFIER f_start_t_sperrt_nach_reak.iBew.iAdaPulzs ECU_ADDRESS 0xFFF8C14F /end MEASUREMENT
/begin MEASUREMENT iAdaPulzs.iBew.n_guete_min "Minimum der Drehzahlsignalguete f. Amplitudenbest." SWORD UMR_U_MIN_1_1_0_S6_S3 1 100 -2048 2048 DISPLAY_IDENTIFIER n_guete_min.iBew.iAdaPulzs ECU_ADDRESS 0xFFF8C150 /end MEASUREMENT
/begin MEASUREMENT iAdaPulzs.iBew.amplitude_ss "Drehzahlwert f.Amplitude spitze-spitze" SWORD UMR_U_MIN_1_1_0_S6_S3 1 100 -100 100 DISPLAY_IDENTIFIER amplitude_ss.iBew.iAdaPulzs ECU_ADDRESS 0xFFF8C152 /end MEASUREMENT
/begin MEASUREMENT iAdaPulzs.iBew.max_adawert "Der Maximale Adaptionswert" SWORD UMR___1_1_0_S6_S3 1 100 -32768 32767 DISPLAY_IDENTIFIER max_adawert.iBew.iAdaPulzs ECU_ADDRESS 0xFFF8C158 /end MEASUREMENT
/begin MEASUREMENT iAdaPulzs.iBew.zeit_erk_amp "Die Zeit für die Erkennung der Amplitude" UBYTE UMR_MSEC__10_1_0_S6_S3 1 100 0 2500 DISPLAY_IDENTIFIER zeit_erk_amp.iBew.iAdaPulzs ECU_ADDRESS 0xFFF8C15A /end MEASUREMENT
/begin MEASUREMENT iAdaPulzs.iTSf.zustand "Zustand Schnellfuellpruefung" UBYTE Conv.cAdaPulsf._.zustand_S6_S3 1 100 0 8 DISPLAY_IDENTIFIER zustand.iTSf.iAdaPulzs ECU_ADDRESS 0xFFF8C160 /end MEASUREMENT
/begin MEASUREMENT iAdaPulzs.iPf.iZustandstimer.timer "Der aktuelle Timerwert" UWORD UMR_MSEC__10_1_0_S6_S3 1 100 0 655350 DISPLAY_IDENTIFIER iZustandstimer.iPf.iAdaPulzs ECU_ADDRESS 0xFFF8C168 /end MEASUREMENT
/begin MEASUREMENT iAdaPulzs.iPf.zustand "Zustand Fuelldruckpruefung" UBYTE Conv.cAdaPulpf._.zustand_S6_S3 1 100 0 9 DISPLAY_IDENTIFIER zustand.iPf.iAdaPulzs ECU_ADDRESS 0xFFF8C16A /end MEASUREMENT
/begin MEASUREMENT iAdaPulzs.iPf.t_fenster_nach_sf "Verbotszeit fuer die Abfrage ND_ADABBR nach SF" UWORD UMR_MSEC__10_1_0_S6_S3 1 100 0 2500 DISPLAY_IDENTIFIER t_fenster_nach_sf.iPf.iAdaPulzs ECU_ADDRESS 0xFFF8C16C /end MEASUREMENT
/begin MEASUREMENT iAdaPulzs.iPf.fenster_nach_sf "Flag fuer Verbot auf Abfrage ND_ADABBR nach SF" UBYTE Conv.cAdaPulpf._.fenster_nach_sf_S6_S3 1 100 0 1 BIT_MASK 0x1 DISPLAY_IDENTIFIER fenster_nach_sf.iPf.iAdaPulzs ECU_ADDRESS 0xFFF8C16E /end MEASUREMENT
/begin MEASUREMENT iAdaPulzs.iPf.f_deakt_dither_ada "Bitcodirtes Signal zur Deaktivierung der Dither Funktion Bit0:nicht belegt Bit1:KupA Bit2:KupB ..." UBYTE UMR___1_1_0_S6_S3 1 100 0 255 DISPLAY_IDENTIFIER f_deakt_dither_ada.iPf.iAdaPulzs ECU_ADDRESS 0xFFF8C16F /end MEASUREMENT
/begin MEASUREMENT iAdaPulzs.iZustandstimer.timer "Der aktuelle Timerwert" UWORD UMR_MSEC__10_1_0_S6_S3 1 100 0 655350 DISPLAY_IDENTIFIER iZustandstimer.iAdaPulzs ECU_ADDRESS 0xFFF8C170 /end MEASUREMENT
/begin MEASUREMENT iAdaPulzs.iTimerSpzNRea.timer "Der aktuelle Timerwert" UWORD UMR_MSEC__10_1_0_S6_S3 1 100 0 655350 DISPLAY_IDENTIFIER iTimerSpzNRea.iAdaPulzs ECU_ADDRESS 0xFFF8C172 /end MEASUREMENT
/begin MEASUREMENT iAdaPulzs.iTimerDeakDaempfer.timer "Der aktuelle Timerwert" UWORD UMR_MSEC__10_1_0_S6_S3 1 100 0 655350 DISPLAY_IDENTIFIER iTimerDeakDaempfer.iAdaPulzs ECU_ADDRESS 0xFFF8C174 /end MEASUREMENT
/begin MEASUREMENT iAdaPulzs.iVerbotRedBef_tsfa.puls_verb_redbef "Reduzierte Bef. verbietet Adaption Bitcodiert: xxxxxxx1x = Kup A wurde Verboten xxxxxx1xx = Kup B wurde Verboten xxxxx1xxx = Kup C wurde Verboten ..." UBYTE UMR___1_1_0_S6_S3 1 100 0 255 DISPLAY_IDENTIFIER puls_verb_redbef_tsfa ECU_ADDRESS 0xFFF8C176 /end MEASUREMENT
/begin MEASUREMENT iAdaPulzs.iVerbotRedBef_pfa.puls_verb_redbef "Reduzierte Bef. verbietet Adaption Bitcodiert: xxxxxxx1x = Kup A wurde Verboten xxxxxx1xx = Kup B wurde Verboten xxxxx1xxx = Kup C wurde Verboten ..." UBYTE UMR___1_1_0_S6_S3 1 100 0 255 DISPLAY_IDENTIFIER puls_verb_redbef_pfa ECU_ADDRESS 0xFFF8C177 /end MEASUREMENT
/begin MEASUREMENT iAdaPulzs.zustand "Zustand des Pruefpulsablaufes" UBYTE Conv.cAdaPulzs._.zustand_S6_S3 1 100 0 11 DISPLAY_IDENTIFIER zustand.iAdaPulzs ECU_ADDRESS 0xFFF8C178 /end MEASUREMENT
/begin MEASUREMENT iAdaPulzs.prueftyp "aktiver Prueftyp der Pulsadaption" UBYTE Conv.cAdaPulzs._.prueftyp_S6_S3 1 100 0 10 DISPLAY_IDENTIFIER prueftyp.iAdaPulzs ECU_ADDRESS 0xFFF8C179 /end MEASUREMENT
/begin MEASUREMENT iAdaPulzs.prueftyp_alt "Prueftyp des letzten Pulses" UBYTE Conv.cAdaPulzs._.prueftyp_alt_S6_S3 1 100 0 10 DISPLAY_IDENTIFIER prueftyp_alt.iAdaPulzs ECU_ADDRESS 0xFFF8C17A /end MEASUREMENT
/begin MEASUREMENT iAdaPulzs.pulsid "Der aktuelle Pruefpuls (Nummer)" UBYTE Conv.cAdaPulzs._.pulsid_S6_S3 1 100 0 4 DISPLAY_IDENTIFIER pulsid.iAdaPulzs ECU_ADDRESS 0xFFF8C17B /end MEASUREMENT
/begin MEASUREMENT iAdaPulzs.n_pruefzyklen "Zaehler fuer momentanen Pulspruefzyklus einer Kupplung" UBYTE UMR___1_1_0_S6_S3 1 100 0 255 DISPLAY_IDENTIFIER n_pruefzyklen.iAdaPulzs ECU_ADDRESS 0xFFF8C17C /end MEASUREMENT
/begin MEASUREMENT iAdaPulzs.n_pulsgrenz "Zaehler f. Anzahl Pulse einer Kupplung" UBYTE UMR___1_1_0_S6_S3 1 100 0 255 DISPLAY_IDENTIFIER n_pulsgrenz.iAdaPulzs ECU_ADDRESS 0xFFF8C17D /end MEASUREMENT
/begin MEASUREMENT iAdaPulzs.n_pruefschleife "Zaehler f. erkannte Drehzahlreaktion bei Puls3/Puls4" UBYTE UMR___1_1_0_S6_S3 1 100 0 2 DISPLAY_IDENTIFIER n_pruefschleife.iAdaPulzs ECU_ADDRESS 0xFFF8C17E /end MEASUREMENT
/begin MEASUREMENT iAdaPulzs.zwsp_tsf "Zwischenspeicherwert SF-Zeit kupplungsbez. Adaption" SWORD UMR_MSEC__1_1_0_S6_S3 1 100 -2000 2000 DISPLAY_IDENTIFIER zwsp_tsf.iAdaPulzs ECU_ADDRESS 0xFFF8C180 /end MEASUREMENT
/begin MEASUREMENT iAdaPulzs.zwsp_pf "Zwischenspeicherwert PF-Druck KPAD" SWORD UMR_BAR__1_1000_0_S6_S3 1 100 -5 5 DISPLAY_IDENTIFIER zwsp_pf.iAdaPulzs ECU_ADDRESS 0xFFF8C182 /end MEASUREMENT
/begin MEASUREMENT iAdaPulzs.kup_puls "Kupplung die aktuell geprueft wird" UBYTE Conv.cAdaPulzs._.kup_puls_S6_S3 1 100 0 6 DISPLAY_IDENTIFIER kup_puls.iAdaPulzs ECU_ADDRESS 0xFFF8C184 /end MEASUREMENT
/begin MEASUREMENT iAdaPulzs.z_pfad_cgt_adkl_kup_puls "Temperaturabheangige Adaptionsklasse der zu peruefenden Kupplung bei Kupplungsauswahl." UBYTE Conv.cAdaPulzs._.z_pfad_cgt_adkl_kup_puls_S6_S3 1 100 0 6 DISPLAY_IDENTIFIER z_pfad_cgt_adkl_kup_puls.iAdaPulzs ECU_ADDRESS 0xFFF8C185 /end MEASUREMENT
/begin MEASUREMENT iAdaPulzs.zeit_sf_1ms "Die Schnellfuellzeit der Pulsadaption in 1ms" UWORD UMR_MSEC__1_1_0_S6_S3 1 100 0 1000 DISPLAY_IDENTIFIER zeit_sf_1ms.iAdaPulzs ECU_ADDRESS 0xFFF8C186 /end MEASUREMENT
/begin MEASUREMENT iAdaPulzs.p_pulsausgabe "Druck Pruefpuls (Offset auf minimalen FD)" SWORD UMR_BAR__1_1000_0_S6_S3 1 100 -3 3 DISPLAY_IDENTIFIER p_pulsausgabe.iAdaPulzs ECU_ADDRESS 0xFFF8C188 /end MEASUREMENT
/begin MEASUREMENT iAdaPulzs.timer_fenster "Timer fue die Ueberwachungsfenster neg./pos." UWORD UMR_MSEC__10_1_0_S6_S3 1 100 0 5000 DISPLAY_IDENTIFIER timer_fenster.iAdaPulzs ECU_ADDRESS 0xFFF8C18A /end MEASUREMENT
/begin MEASUREMENT iAdaPulzs.f_in_gang_fertig "Flag Pulsadaptionen in diesem Gang fertig" UBYTE Conv.cAdaPulzs._.f_in_gang_fertig_S6_S3 1 100 0 1 BIT_MASK 0x1 DISPLAY_IDENTIFIER f_in_gang_fertig.iAdaPulzs ECU_ADDRESS 0xFFF8C18C /end MEASUREMENT
/begin MEASUREMENT iAdaPulzs.f_startpuls_nguete "Flag für Einstiegsbedingung außer n_guete erfüllt und Puls notwendig" UBYTE Conv.cAdaPulzs._.f_startpuls_nguete_S6_S3 1 100 0 1 BIT_MASK 0x1 DISPLAY_IDENTIFIER f_startpuls_nguete.iAdaPulzs ECU_ADDRESS 0xFFF8C18D /end MEASUREMENT
/begin MEASUREMENT iAdaPulzs.f_ndabbr_verletzt "Flag für Verletzung von n_guete" UBYTE Conv.cAdaPulzs._.f_ndabbr_verletzt_S6_S3 1 100 0 1 BIT_MASK 0x1 DISPLAY_IDENTIFIER f_ndabbr_verletzt.iAdaPulzs ECU_ADDRESS 0xFFF8C18E /end MEASUREMENT
/begin MEASUREMENT iAdaPulzs.f_startpruefung_aktiv "Flag für Umschaltung Applikationsparameter waehrend Beginn der Getriebelaufzeit" UBYTE Conv.cAdaPulzs._.f_startpruefung_aktiv_S6_S3 1 100 0 1 BIT_MASK 0x1 DISPLAY_IDENTIFIER f_startpruefung_aktiv.iAdaPulzs ECU_ADDRESS 0xFFF8C18F /end MEASUREMENT
/begin MEASUREMENT iAdaPulzs.f_schubabschaltung_aktiv_start "Schubabschaltungsflag zu Beginn des Pulses" UBYTE Conv.cAdaPulzs._.f_schubabschaltung_aktiv_start_S6_S3 1 100 0 1 BIT_MASK 0x1 DISPLAY_IDENTIFIER f_schubabschaltung_aktiv_start.iAdaPulzs ECU_ADDRESS 0xFFF8C190 /end MEASUREMENT
/begin MEASUREMENT iAdaPulzs.f_deak_daempfer "Flag für Deaktivierung der Schwingungsdämpfungsfunktion während einer Pulsprüfung" UBYTE Conv.cAdaPulzs._.f_deak_daempfer_S6_S3 1 100 0 1 BIT_MASK 0x1 DISPLAY_IDENTIFIER f_deak_daempfer.iAdaPulzs ECU_ADDRESS 0xFFF8C191 /end MEASUREMENT
/begin MEASUREMENT iAdaPulzs.f_deak_daempfer_alt "für Flankenerkennung f_deak_daempfer" UBYTE Conv.cAdaPulzs._.f_deak_daempfer_alt_S6_S3 1 100 0 1 BIT_MASK 0x1 DISPLAY_IDENTIFIER f_deak_daempfer_alt.iAdaPulzs ECU_ADDRESS 0xFFF8C192 /end MEASUREMENT
/begin MEASUREMENT iAdaPulzs.f_red_bef_kup "Flag aktiviert verwendung der Prarmetern der red. Bef. bei Puls" UBYTE Conv.cAdaPulzs._.f_red_bef_kup_S6_S3 1 100 0 1 BIT_MASK 0x1 DISPLAY_IDENTIFIER f_red_bef_kup.iAdaPulzs ECU_ADDRESS 0xFFF8C193 /end MEASUREMENT
/begin MEASUREMENT iAdaPulzs.m_t_start "m_t-Wert zu Beginn des Pulses" SWORD UMR_NM__1_1_0_S6_S3 1 100 -400 1640 DISPLAY_IDENTIFIER m_t_start.iAdaPulzs ECU_ADDRESS 0xFFF8C194 /end MEASUREMENT
/begin MEASUREMENT iAdaPulzs.dki_start "dki-Wert zu Beginn des Pulses" UBYTE UMR_PROZENT__20_51_0_S6_S3 1 100 0 100 DISPLAY_IDENTIFIER dki_start.iAdaPulzs ECU_ADDRESS 0xFFF8C196 /end MEASUREMENT
/begin MEASUREMENT iAdaPulzs.pruefung_kup_fertig "Flag Pruefzyklus (PF/TSF) abgeschlossen" UBYTE Conv.cAdaPulzs._.pruefung_kup_fertig_S6_S3 1 100 0 1 BIT_MASK 0x1 DISPLAY_IDENTIFIER pruefung_kup_fertig.iAdaPulzs ECU_ADDRESS 0xFFF8C197 /end MEASUREMENT
/begin MEASUREMENT iAdaPulzs.schnellfuellung_aktiv "Flag Schnellfuellung aktiv" UBYTE Conv.cAdaPulzs._.schnellfuellung_aktiv_S6_S3 1 100 0 1 BIT_MASK 0x1 DISPLAY_IDENTIFIER schnellfuellung_aktiv.iAdaPulzs ECU_ADDRESS 0xFFF8C198 /end MEASUREMENT
/begin MEASUREMENT iAdaPulzs.druck_statisch "Flag für statische Druckausgabe" UBYTE Conv.cAdaPulzs._.druck_statisch_S6_S3 1 100 0 1 BIT_MASK 0x1 DISPLAY_IDENTIFIER druck_statisch.iAdaPulzs ECU_ADDRESS 0xFFF8C199 /end MEASUREMENT
/begin MEASUREMENT iAdaPulzs.pulszyklus_beenden "Flag, ob Pulszyklus beendet werden soll" UBYTE Conv.cAdaPulzs._.pulszyklus_beenden_S6_S3 1 100 0 3 DISPLAY_IDENTIFIER pulszyklus_beenden.iAdaPulzs ECU_ADDRESS 0xFFF8C19A /end MEASUREMENT
/begin MEASUREMENT iAdaPulzs.f_nmotsoll_em "anforderung E- Maschienenmindestdrehzahl durch Adaption" UBYTE Conv.cAdaPulzs._.f_nmotsoll_em_S6_S3 1 100 0 1 BIT_MASK 0x1 DISPLAY_IDENTIFIER f_nmotsoll_em.iAdaPulzs ECU_ADDRESS 0xFFF8C19B /end MEASUREMENT
/begin MEASUREMENT iAdaPulzs.kup_puls_alt "Die zuletzt gepulste Kupplung" UBYTE Conv.cAdaPulzs._.kup_puls_alt_S6_S3 1 100 0 6 DISPLAY_IDENTIFIER kup_puls_alt.iAdaPulzs ECU_ADDRESS 0xFFF8C19C /end MEASUREMENT
/begin MEASUREMENT iAdaPulzs.kup_puls_neu "Die demnächst zu pulsende Kupplung" UBYTE Conv.cAdaPulzs._.kup_puls_neu_S6_S3 1 100 0 6 DISPLAY_IDENTIFIER kup_puls_neu.iAdaPulzs ECU_ADDRESS 0xFFF8C19D /end MEASUREMENT
/begin MEASUREMENT iAdaPulzs.startinfo_index "Der interne Index der zu startenden Kupplung" UBYTE Conv.cAdaPulzs._.startinfo_index_S6_S3 1 100 0 6 DISPLAY_IDENTIFIER startinfo_index.iAdaPulzs ECU_ADDRESS 0xFFF8C19E /end MEASUREMENT
/begin MEASUREMENT iAdaPulzs.anz_kup_puls "Kupplung deren Werte angezeigt werden" UBYTE Conv.cAdaPulzs._.anz_kup_puls_S6_S3 1 100 0 6 DISPLAY_IDENTIFIER anz_kup_puls.iAdaPulzs ECU_ADDRESS 0xFFF8C19F /end MEASUREMENT
/begin MEASUREMENT iAdaPulzs.anz_kup_kalt "Kalt Zwischenspeicher wird verwendet" UBYTE Conv.cAdaPulzs._.anz_kup_kalt_S6_S3 1 100 0 1 BIT_MASK 0x1 DISPLAY_IDENTIFIER anz_kup_kalt.iAdaPulzs ECU_ADDRESS 0xFFF8C1A0 /end MEASUREMENT
/begin MEASUREMENT iAdaPulzs.anz_prueftyp "Momentaner Adaptionstyp der Pulsadaption von kup_puls" UBYTE Conv.cAdaPulzs._.anz_prueftyp_S6_S3 1 100 0 2 DISPLAY_IDENTIFIER anz_prueftyp.iAdaPulzs ECU_ADDRESS 0xFFF8C1A1 /end MEASUREMENT
/begin MEASUREMENT iAdaPulzs.anz_pulsid "Momentan ausgefuehrter Puls von TSF/PF-Pruefung von kup_puls" UBYTE Conv.cAdaPulzs._.anz_pulsid_S6_S3 1 100 0 4 DISPLAY_IDENTIFIER anz_pulsid.iAdaPulzs ECU_ADDRESS 0xFFF8C1A2 /end MEASUREMENT
/begin MEASUREMENT iAdaPulzs.anz_n_pruefzyklen "Anzahl der Zyklen (Puls 1-4) von kup_puls" UBYTE UMR___1_1_0_S6_S3 1 100 0 10 DISPLAY_IDENTIFIER anz_n_pruefzyklen.iAdaPulzs ECU_ADDRESS 0xFFF8C1A3 /end MEASUREMENT
/begin MEASUREMENT iAdaPulzs.anz_n_pulsgrenz "Anzahl Pulse auf Kupplung in diesem Pruefzyklus von kup_puls" UBYTE UMR___1_1_0_S6_S3 1 100 0 255 DISPLAY_IDENTIFIER anz_n_pulsgrenz.iAdaPulzs ECU_ADDRESS 0xFFF8C1A4 /end MEASUREMENT
/begin MEASUREMENT iAdaPulzs.anz_n_pruefschleife "Anzahl der Schleifendurchlaeufe bei Puls 3 /4 von kup_puls" UBYTE UMR___1_1_0_S6_S3 1 100 0 10 DISPLAY_IDENTIFIER anz_n_pruefschleife.iAdaPulzs ECU_ADDRESS 0xFFF8C1A5 /end MEASUREMENT
/begin MEASUREMENT iAdaPulzs.anz_zwsp_tsf "TSF-Zwischenspeicherwert Pulsada von kup_puls" SWORD UMR_MSEC__1_1_0_S6_S3 1 100 -2000 2000 DISPLAY_IDENTIFIER anz_zwsp_tsf.iAdaPulzs ECU_ADDRESS 0xFFF8C1A6 /end MEASUREMENT
/begin MEASUREMENT iAdaPulzs.anz_zwsp_pf "PF-Zwischenspeicherwert Pulsada von kup_puls" SWORD UMR_BAR__1_1000_0_S6_S3 1 100 -5 5 DISPLAY_IDENTIFIER anz_zwsp_pf.iAdaPulzs ECU_ADDRESS 0xFFF8C1A8 /end MEASUREMENT
/begin MEASUREMENT iAdaPulzs.anz_tsf_adawert "Adaptionswert kupplungsbez. TSF-Adaption von kup_puls" SWORD UMR_MSEC__1_1_0_S6_S3 1 100 -2000 2000 DISPLAY_IDENTIFIER anz_tsf_adawert.iAdaPulzs ECU_ADDRESS 0xFFF8C1AA /end MEASUREMENT
/begin MEASUREMENT iAdaPulzs.anz_pf_adawert "Adaptionswert kupplungsbez. PF-Adaption von kup_puls" SWORD UMR_BAR__1_1000_0_S6_S3 1 100 -5 5 DISPLAY_IDENTIFIER anz_pf_adawert.iAdaPulzs ECU_ADDRESS 0xFFF8C1AC /end MEASUREMENT
/begin MEASUREMENT iAdaPulzs.ada_starttyp_pf "ID Aktiever Adaptionstyp" UBYTE Conv.cAdaPulzs._.ada_starttyp_pf_S6_S3 1 100 0 4 DISPLAY_IDENTIFIER ada_starttyp_pf.iAdaPulzs ECU_ADDRESS 0xFFF8C1AE /end MEASUREMENT
/begin MEASUREMENT iAdaPulKr.i_pulse_stop_req "Aktiviteatsflag fuer Stromplausibilisierung" UBYTE Conv.cAdaPulKr._.i_pulse_stop_req_S6_S3 1 100 0 3 DISPLAY_IDENTIFIER i_pulse_stop_req.iAdaPulKr ECU_ADDRESS 0xFFF8A391 /end MEASUREMENT
/begin MEASUREMENT iAdaPstzs.iVerbotRedBef_stada.puls_verb_redbef "Reduzierte Bef. verbietet Adaption Bitcodiert: xxxxxxx1x = Kup A wurde Verboten xxxxxx1xx = Kup B wurde Verboten xxxxx1xxx = Kup C wurde Verboten ..." UBYTE UMR___1_1_0_S6_S3 1 100 0 255 DISPLAY_IDENTIFIER puls_verb_redbef_stada ECU_ADDRESS 0xFFF8C0B0 /end MEASUREMENT
/begin MEASUREMENT iEdsKupA.cHydEdsBase._.i_eds "Sollstrom des Schaltelements" UWORD UMR_MA__1_10_0_S6_S3 1 100 0 1200 DISPLAY_IDENTIFIER i_eds._.cHydEdsBase.iEdsKupA ECU_ADDRESS 0xFFF8CDA2 /end MEASUREMENT
/begin MEASUREMENT iEdsKupA.cHydEdsBase._.i_eds_komp "Komplement Sollstrom des Schaltelements" UWORD UMR_MA__1_10_0_S6_S3 1 100 0 6553.5 DISPLAY_IDENTIFIER i_eds_komp._.cHydEdsBase.iEdsKupA ECU_ADDRESS 0xFFF8CDA4 /end MEASUREMENT
/begin MEASUREMENT iEdsKupA.iTimerZRampe.timer "Der aktuelle Timerwert" UWORD UMR_MSEC__10_1_0_S6_S3 1 100 0 655350 DISPLAY_IDENTIFIER iTimerZRampe.iEdsKupA ECU_ADDRESS 0xFFF8CDC4 /end MEASUREMENT
/begin MEASUREMENT iEdsKupA.z_rampe_kab "Zustand Rampe bei KAB" UBYTE Conv.cHydEdsBfm._.z_rampe_kab_S6_S3 1 100 0 2 DISPLAY_IDENTIFIER z_rampe_kab.iEdsKupA ECU_ADDRESS 0xFFF8CDB0 /end MEASUREMENT
/begin MEASUREMENT iEdsKupB.cHydEdsBase._.i_eds "Sollstrom des Schaltelements" UWORD UMR_MA__1_10_0_S6_S3 1 100 0 1200 DISPLAY_IDENTIFIER i_eds._.cHydEdsBase.iEdsKupB ECU_ADDRESS 0xFFF8CDCA /end MEASUREMENT
/begin MEASUREMENT iEdsKupB.cHydEdsBase._.i_eds_komp "Komplement Sollstrom des Schaltelements" UWORD UMR_MA__1_10_0_S6_S3 1 100 0 6553.5 DISPLAY_IDENTIFIER i_eds_komp._.cHydEdsBase.iEdsKupB ECU_ADDRESS 0xFFF8CDCC /end MEASUREMENT
/begin MEASUREMENT iEdsKupB.iTimerZRampe.timer "Der aktuelle Timerwert" UWORD UMR_MSEC__10_1_0_S6_S3 1 100 0 655350 DISPLAY_IDENTIFIER iTimerZRampe.iEdsKupB ECU_ADDRESS 0xFFF8CDEC /end MEASUREMENT
/begin MEASUREMENT iEdsKupB.z_rampe_kab "Zustand Rampe bei KAB" UBYTE Conv.cHydEdsBfm._.z_rampe_kab_S6_S3 1 100 0 2 DISPLAY_IDENTIFIER z_rampe_kab.iEdsKupB ECU_ADDRESS 0xFFF8CDD8 /end MEASUREMENT
/begin MEASUREMENT iEdsKupC.cHydEdsBase._.i_eds "Sollstrom des Schaltelements" UWORD UMR_MA__1_10_0_S6_S3 1 100 0 1200 DISPLAY_IDENTIFIER i_eds._.cHydEdsBase.iEdsKupC ECU_ADDRESS 0xFFF8CDF2 /end MEASUREMENT
/begin MEASUREMENT iEdsKupC.cHydEdsBase._.i_eds_komp "Komplement Sollstrom des Schaltelements" UWORD UMR_MA__1_10_0_S6_S3 1 100 0 6553.5 DISPLAY_IDENTIFIER i_eds_komp._.cHydEdsBase.iEdsKupC ECU_ADDRESS 0xFFF8CDF4 /end MEASUREMENT
/begin MEASUREMENT iEdsKupC.iTimerZRampe.timer "Der aktuelle Timerwert" UWORD UMR_MSEC__10_1_0_S6_S3 1 100 0 655350 DISPLAY_IDENTIFIER iTimerZRampe.iEdsKupC ECU_ADDRESS 0xFFF8CE14 /end MEASUREMENT
/begin MEASUREMENT iEdsKupC.z_rampe_kab "Zustand Rampe bei KAB" UBYTE Conv.cHydEdsBfm._.z_rampe_kab_S6_S3 1 100 0 2 DISPLAY_IDENTIFIER z_rampe_kab.iEdsKupC ECU_ADDRESS 0xFFF8CE00 /end MEASUREMENT
/begin MEASUREMENT iEdsKupD.cHydEdsBase._.i_eds "Sollstrom des Schaltelements" UWORD UMR_MA__1_10_0_S6_S3 1 100 0 1200 DISPLAY_IDENTIFIER i_eds._.cHydEdsBase.iEdsKupD ECU_ADDRESS 0xFFF8CE1A /end MEASUREMENT
/begin MEASUREMENT iEdsKupD.cHydEdsBase._.i_eds_komp "Komplement Sollstrom des Schaltelements" UWORD UMR_MA__1_10_0_S6_S3 1 100 0 6553.5 DISPLAY_IDENTIFIER i_eds_komp._.cHydEdsBase.iEdsKupD ECU_ADDRESS 0xFFF8CE1C /end MEASUREMENT
/begin MEASUREMENT iEdsKupD.iTimerZRampe.timer "Der aktuelle Timerwert" UWORD UMR_MSEC__10_1_0_S6_S3 1 100 0 655350 DISPLAY_IDENTIFIER iTimerZRampe.iEdsKupD ECU_ADDRESS 0xFFF8CE3C /end MEASUREMENT
/begin MEASUREMENT iEdsKupD.z_rampe_kab "Zustand Rampe bei KAB" UBYTE Conv.cHydEdsBfm._.z_rampe_kab_S6_S3 1 100 0 2 DISPLAY_IDENTIFIER z_rampe_kab.iEdsKupD ECU_ADDRESS 0xFFF8CE28 /end MEASUREMENT
/begin MEASUREMENT iEdsKupE.cHydEdsBase._.i_eds "Sollstrom des Schaltelements" UWORD UMR_MA__1_10_0_S6_S3 1 100 0 1200 DISPLAY_IDENTIFIER i_eds._.cHydEdsBase.iEdsKupE ECU_ADDRESS 0xFFF8CE42 /end MEASUREMENT
/begin MEASUREMENT iEdsKupE.cHydEdsBase._.i_eds_komp "Komplement Sollstrom des Schaltelements" UWORD UMR_MA__1_10_0_S6_S3 1 100 0 6553.5 DISPLAY_IDENTIFIER i_eds_komp._.cHydEdsBase.iEdsKupE ECU_ADDRESS 0xFFF8CE44 /end MEASUREMENT
/begin MEASUREMENT iEdsKupE.iTimerZRampe.timer "Der aktuelle Timerwert" UWORD UMR_MSEC__10_1_0_S6_S3 1 100 0 655350 DISPLAY_IDENTIFIER iTimerZRampe.iEdsKupE ECU_ADDRESS 0xFFF8CE64 /end MEASUREMENT
/begin MEASUREMENT iEdsKupE.z_rampe_kab "Zustand Rampe bei KAB" UBYTE Conv.cHydEdsBfm._.z_rampe_kab_S6_S3 1 100 0 2 DISPLAY_IDENTIFIER z_rampe_kab.iEdsKupE ECU_ADDRESS 0xFFF8CE50 /end MEASUREMENT
/begin MEASUREMENT iEdsK0.cHydEdsBase._.i_eds "Sollstrom des Schaltelements" UWORD UMR_MA__1_10_0_S6_S3 1 100 0 1200 DISPLAY_IDENTIFIER i_eds._.cHydEdsBase.iEdsK0 ECU_ADDRESS 0xFFF8CE6A /end MEASUREMENT
/begin MEASUREMENT iEdsK0.cHydEdsBase._.i_eds_komp "Komplement Sollstrom des Schaltelements" UWORD UMR_MA__1_10_0_S6_S3 1 100 0 6553.5 DISPLAY_IDENTIFIER i_eds_komp._.cHydEdsBase.iEdsK0 ECU_ADDRESS 0xFFF8CE6C /end MEASUREMENT
/begin MEASUREMENT iEdsK0.iTimerZRampe.timer "Der aktuelle Timerwert" UWORD UMR_MSEC__10_1_0_S6_S3 1 100 0 655350 DISPLAY_IDENTIFIER iTimerZRampe.iEdsK0 ECU_ADDRESS 0xFFF8CE8C /end MEASUREMENT
/begin MEASUREMENT iEdsK0.z_rampe_kab "Zustand Rampe bei KAB" UBYTE Conv.cHydEdsBfm._.z_rampe_kab_S6_S3 1 100 0 2 DISPLAY_IDENTIFIER z_rampe_kab.iEdsK0 ECU_ADDRESS 0xFFF8CE78 /end MEASUREMENT
/begin MEASUREMENT iEdsPSys.cHydEdsBase._.i_eds "Sollstrom des Schaltelements" UWORD UMR_MA__1_10_0_S6_S3 1 100 0 1200 DISPLAY_IDENTIFIER i_eds._.cHydEdsBase.iEdsPSys ECU_ADDRESS 0xFFF8CE92 /end MEASUREMENT
/begin MEASUREMENT iEdsPSys.cHydEdsBase._.i_eds_komp "Komplement Sollstrom des Schaltelements" UWORD UMR_MA__1_10_0_S6_S3 1 100 0 6553.5 DISPLAY_IDENTIFIER i_eds_komp._.cHydEdsBase.iEdsPSys ECU_ADDRESS 0xFFF8CE94 /end MEASUREMENT
/begin MEASUREMENT iEdsPos.cHydEdsBase._.i_eds "Sollstrom des Schaltelements" UWORD UMR_MA__1_10_0_S6_S3 1 100 0 1200 DISPLAY_IDENTIFIER i_eds._.cHydEdsBase.iEdsPos ECU_ADDRESS 0xFFF8CEA2 /end MEASUREMENT
/begin MEASUREMENT iEdsPos.cHydEdsBase._.i_eds_komp "Komplement Sollstrom des Schaltelements" UWORD UMR_MA__1_10_0_S6_S3 1 100 0 6553.5 DISPLAY_IDENTIFIER i_eds_komp._.cHydEdsBase.iEdsPos ECU_ADDRESS 0xFFF8CEA4 /end MEASUREMENT
/begin MEASUREMENT iEdsPos.timer_iedsofpsv.timer "Der aktuelle Timerwert" UBYTE UMR_MSEC__10_1_0_S6_S3 1 100 0 2550 DISPLAY_IDENTIFIER timer_iedsofpsv.iEdsPos ECU_ADDRESS 0xFFF8CEAE /end MEASUREMENT
/begin MEASUREMENT iEdsPos.typ_ansteuerung "Typ der Ansteuerung" UBYTE Conv.cHydEdsKombi._.typ_ansteuerung_S6_S3 1 100 0 2 DISPLAY_IDENTIFIER typ_ansteuerung.iEdsPos ECU_ADDRESS 0xFFF8CEAD /end MEASUREMENT
/begin MEASUREMENT iEdsMvPZyl.cHydEdsBase._.i_eds "Sollstrom des Schaltelements" UWORD UMR_MA__1_10_0_S6_S3 1 100 0 1200 DISPLAY_IDENTIFIER i_eds._.cHydEdsBase.iEdsMvPZyl ECU_ADDRESS 0xFFF8CEB2 /end MEASUREMENT
/begin MEASUREMENT iEdsMvPZyl.cHydEdsBase._.i_eds_komp "Komplement Sollstrom des Schaltelements" UWORD UMR_MA__1_10_0_S6_S3 1 100 0 6553.5 DISPLAY_IDENTIFIER i_eds_komp._.cHydEdsBase.iEdsMvPZyl ECU_ADDRESS 0xFFF8CEB4 /end MEASUREMENT
/begin COMPU_METHOD SBW_TIMER_STD_S1_S3 "int = ((phys * 1) / 1) - (0) ms" RAT_FUNC "%2.0" "ms" COEFFS 0 1 -0 0 0 1 /end COMPU_METHOD
/begin COMPU_METHOD UMR___1_1000_0_S6_S3 "int = ((phys * 1000) / 1) - (0) [-]" RAT_FUNC "%5.3" "[-]" COEFFS 0 1000 -0 0 0 1 /end COMPU_METHOD
/begin COMPU_METHOD UMR___1_300_0_S6_S3 "int = ((phys * 300) / 1) - (0) [-]" RAT_FUNC "%7.5" "[-]" COEFFS 0 300 -0 0 0 1 /end COMPU_METHOD
/begin COMPU_METHOD UMR___1_1_0_S6_S3 "int = ((phys * 1) / 1) - (0) [-]" RAT_FUNC "%2.0" "[-]" COEFFS 0 1 -0 0 0 1 /end COMPU_METHOD
/begin COMPU_METHOD UMR_MA__1_10_0_S6_S3 "int = ((phys * 10) / 1) - (0) [mA]" RAT_FUNC "%3.1" "[mA]" COEFFS 0 10 -0 0 0 1 /end COMPU_METHOD
/begin COMPU_METHOD UMR_MA_SEC_1_1_0_S6_S3 "int = ((phys * 1) / 1) - (0) [mA/s]" RAT_FUNC "%2.0" "[mA/s]" COEFFS 0 1 -0 0 0 1 /end COMPU_METHOD
/begin COMPU_METHOD UMR_NM__1_1_0_S6_S3 "int = ((phys * 1) / 1) - (0) [Nm]" RAT_FUNC "%2.0" "[Nm]" COEFFS 0 1 -0 0 0 1 /end COMPU_METHOD
/begin COMPU_METHOD UMR_BAR__1_1000_0_S6_S3 "int = ((phys * 1000) / 1) - (0) [bar]" RAT_FUNC "%5.3" "[bar]" COEFFS 0 1000 -0 0 0 1 /end COMPU_METHOD
/begin COMPU_METHOD UMR_BAR_SEC_1_10_0_S6_S3 "int = ((phys * 10) / 1) - (0) [bar/s]" RAT_FUNC "%3.1" "[bar/s]" COEFFS 0 10 -0 0 0 1 /end COMPU_METHOD
/begin COMPU_METHOD UMR_BAR_SEC_1_1000_0_S6_S3 "int = ((phys * 1000) / 1) - (0) [bar/s]" RAT_FUNC "%6.4" "[bar/s]" COEFFS 0 1000 -0 0 0 1 /end COMPU_METHOD
/begin COMPU_METHOD UMR_U_MIN_1_1_0_S6_S3 "int = ((phys * 1) / 1) - (0) [U/min]" RAT_FUNC "%2.0" "[U/min]" COEFFS 0 1 -0 0 0 1 /end COMPU_METHOD
/begin COMPU_METHOD UMR_MSEC__1_1_0_S6_S3 "int = ((phys * 1) / 1) - (0) [ms]" RAT_FUNC "%2.0" "[ms]" COEFFS 0 1 -0 0 0 1 /end COMPU_METHOD
/begin COMPU_METHOD UMR_MSEC__10_1_0_S6_S3 "int = ((phys * 1) / 10) - (0) [ms]" RAT_FUNC "%2.0" "[ms]" COEFFS 0 1 -0 0 0 10 /end COMPU_METHOD
/begin COMPU_METHOD UMR__SEC_1_1_0_S6_S3 "int = ((phys * 1) / 1) - (0) [1/s]" RAT_FUNC "%2.0" "[1/s]" COEFFS 0 1 -0 0 0 1 /end COMPU_METHOD
/begin COMPU_METHOD UMR_PROZENT__1_100_0_S6_S3 "int = ((phys * 100) / 1) - (0) [%]" RAT_FUNC "%4.2" "[%]" COEFFS 0 100 -0 0 0 1 /end COMPU_METHOD
/begin COMPU_METHOD UMR_PROZENT__20_51_0_S6_S3 "int = ((phys * 51) / 20) - (0) [%]" RAT_FUNC "%6.4" "[%]" COEFFS 0 51 -0 0 0 20 /end COMPU_METHOD
/begin COMPU_METHOD UMR_PROZENT__1_1_0_S6_S3 "int = ((phys * 1) / 1) - (0) [%]" RAT_FUNC "%2.0" "[%]" COEFFS 0 1 -0 0 0 1 /end COMPU_METHOD
/begin COMPU_METHOD Conv.cModHysKo._.f_pg_abssoll_S6_S3 "Umrechnung fuer Messgroesse cModHysKo::f_pg_abssoll" TAB_VERB "%4.0" "" COMPU_TAB_REF Conv.cModHysKo._.f_pg_abssoll_S6_S3 /end COMPU_METHOD
/begin COMPU_METHOD Conv.cModHysKo._.pg_wechsel_erkannt_S6_S3 "Umrechnung fuer Messgroesse cModHysKo::pg_wechsel_erkannt" TAB_VERB "%4.0" "" COMPU_TAB_REF Conv.cModHysKo._.pg_wechsel_erkannt_S6_S3 /end COMPU_METHOD
/begin COMPU_METHOD Conv.cModHysKo._.f_ig_eds_S6_S3 "Umrechnung fuer Messgroesse cModHysKo::f_ig_eds" TAB_VERB "%4.0" "" COMPU_TAB_REF Conv.cModHysKo._.f_ig_eds_S6_S3 /end COMPU_METHOD
/begin COMPU_METHOD Conv.cModHysKo._.ig_wechsel_erkannt_S6_S3 "Umrechnung fuer Messgroesse cModHysKo::ig_wechsel_erkannt" TAB_VERB "%4.0" "" COMPU_TAB_REF Conv.cModHysKo._.ig_wechsel_erkannt_S6_S3 /end COMPU_METHOD
/begin COMPU_METHOD Conv.cModHysKo._.z_rampe_S6_S3 "Umrechnung fuer Messgroesse cModHysKo::z_rampe" TAB_VERB "%4.0" "" COMPU_TAB_REF Conv.cModHysKo._.z_rampe_S6_S3 /end COMPU_METHOD
/begin COMPU_METHOD Conv.cModPVorg._.f_druck_vorgegeben_S6_S3 "Umrechnung fuer Messgroesse cModPVorg::f_druck_vorgegeben" TAB_VERB "%4.0" "" COMPU_TAB_REF Conv.cModPVorg._.f_druck_vorgegeben_S6_S3 /end COMPU_METHOD
/begin COMPU_METHOD Conv.cModPVorg._.f_anst_statisch_S6_S3 "Umrechnung fuer Messgroesse cModPVorg::f_anst_statisch" TAB_VERB "%4.0" "" COMPU_TAB_REF Conv.cModPVorg._.f_anst_statisch_S6_S3 /end COMPU_METHOD
/begin COMPU_METHOD Conv.cModPVorg._.fktn_druckvorgabe_S6_S3 "Umrechnung fuer Messgroesse cModPVorg::fktn_druckvorgabe" TAB_VERB "%4.0" "" COMPU_TAB_REF Conv.cModPVorg._.fktn_druckvorgabe_S6_S3 /end COMPU_METHOD
/begin COMPU_METHOD Conv.cModPVorg._.typ_druckvorgabe_S6_S3 "Umrechnung fuer Messgroesse cModPVorg::typ_druckvorgabe" TAB_VERB "%4.0" "" COMPU_TAB_REF Conv.cModPVorg._.typ_druckvorgabe_S6_S3 /end COMPU_METHOD
/begin COMPU_METHOD Conv.cPAnzeige._.befuellung_schaltelement_aktiv_S6_S3 "Umrechnung fuer Messgroesse cPAnzeige::befuellung_schaltelement_aktiv" TAB_VERB "%4.0" "" COMPU_TAB_REF Conv.cPAnzeige._.befuellung_schaltelement_aktiv_S6_S3 /end COMPU_METHOD
/begin COMPU_METHOD Conv.cPAnzeige._.kzu_beob_kup_ada_S6_S3 "Umrechnung fuer Messgroesse cPAnzeige::kzu_beob_kup_ada" TAB_VERB "%4.0" "" COMPU_TAB_REF Conv.cPAnzeige._.kzu_beob_kup_ada_S6_S3 /end COMPU_METHOD
/begin COMPU_METHOD Conv.cModKuppl._.zustand_S6_S3 "Umrechnung fuer Messgroesse cModKuppl::zustand" TAB_VERB "%4.0" "" COMPU_TAB_REF Conv.cModKuppl._.zustand_S6_S3 /end COMPU_METHOD
/begin COMPU_METHOD Conv.cModKuppl._.kup_schaltart_sas_S6_S3 "Umrechnung fuer Messgroesse cModKuppl::kup_schaltart_sas" TAB_VERB "%4.0" "" COMPU_TAB_REF Conv.cModKuppl._.kup_schaltart_sas_S6_S3 /end COMPU_METHOD
/begin COMPU_METHOD Conv.cModKuppl._.kup_index_spsas_S6_S3 "Umrechnung fuer Messgroesse cModKuppl::kup_index_spsas" TAB_VERB "%4.0" "" COMPU_TAB_REF Conv.cModKuppl._.kup_index_spsas_S6_S3 /end COMPU_METHOD
/begin COMPU_METHOD Conv.cModKuppl._.f_sf_ausgabe_aktiv_S6_S3 "Umrechnung fuer Messgroesse cModKuppl::f_sf_ausgabe_aktiv" TAB_VERB "%4.0" "" COMPU_TAB_REF Conv.cModKuppl._.f_sf_ausgabe_aktiv_S6_S3 /end COMPU_METHOD
/begin COMPU_METHOD Conv.cModKuppl._.f_deakt_dither_sf_S6_S3 "Umrechnung fuer Messgroesse cModKuppl::f_deakt_dither_sf" TAB_VERB "%4.0" "" COMPU_TAB_REF Conv.cModKuppl._.f_deakt_dither_sf_S6_S3 /end COMPU_METHOD
/begin COMPU_METHOD Conv.cModKuppl._.f_sf_vorhanden_S6_S3 "Umrechnung fuer Messgroesse cModKuppl::f_sf_vorhanden" TAB_VERB "%4.0" "" COMPU_TAB_REF Conv.cModKuppl._.f_sf_vorhanden_S6_S3 /end COMPU_METHOD
/begin COMPU_METHOD Conv.cModKuppl._.kpl_inaktiv_S6_S3 "Umrechnung fuer Messgroesse cModKuppl::kpl_inaktiv" TAB_VERB "%4.0" "" COMPU_TAB_REF Conv.cModKuppl._.kpl_inaktiv_S6_S3 /end COMPU_METHOD
/begin COMPU_METHOD Conv.cModKuppl._.f_fuellred_S6_S3 "Umrechnung fuer Messgroesse cModKuppl::f_fuellred" TAB_VERB "%4.0" "" COMPU_TAB_REF Conv.cModKuppl._.f_fuellred_S6_S3 /end COMPU_METHOD
/begin COMPU_METHOD Conv.cModKuppl._.f_fuellopt_S6_S3 "Umrechnung fuer Messgroesse cModKuppl::f_fuellopt" TAB_VERB "%4.0" "" COMPU_TAB_REF Conv.cModKuppl._.f_fuellopt_S6_S3 /end COMPU_METHOD
/begin COMPU_METHOD Conv.cModKuppl._.f_kolben_anlegen_S6_S3 "Umrechnung fuer Messgroesse cModKuppl::f_kolben_anlegen" TAB_VERB "%4.0" "" COMPU_TAB_REF Conv.cModKuppl._.f_kolben_anlegen_S6_S3 /end COMPU_METHOD
/begin COMPU_METHOD Conv.cModKuppl._.f_geschlossen_S6_S3 "Umrechnung fuer Messgroesse cModKuppl::f_geschlossen" TAB_VERB "%4.0" "" COMPU_TAB_REF Conv.cModKuppl._.f_geschlossen_S6_S3 /end COMPU_METHOD
/begin COMPU_METHOD Conv.cModKuppl._.f_erste_bef_S6_S3 "Umrechnung fuer Messgroesse cModKuppl::f_erste_bef" TAB_VERB "%4.0" "" COMPU_TAB_REF Conv.cModKuppl._.f_erste_bef_S6_S3 /end COMPU_METHOD
/begin COMPU_METHOD Conv.cModKuppl._.f_erste_bef_aus_sb_S6_S3 "Umrechnung fuer Messgroesse cModKuppl::f_erste_bef_aus_sb" TAB_VERB "%4.0" "" COMPU_TAB_REF Conv.cModKuppl._.f_erste_bef_aus_sb_S6_S3 /end COMPU_METHOD
/begin COMPU_METHOD Conv.cModKuppl._.f_strom_pre_puls_erf_S6_S3 "Umrechnung fuer Messgroesse cModKuppl::f_strom_pre_puls_erf" TAB_VERB "%4.0" "" COMPU_TAB_REF Conv.cModKuppl._.f_strom_pre_puls_erf_S6_S3 /end COMPU_METHOD
/begin COMPU_METHOD Conv.cModKuppl._.f_stromschl_angefordert_S6_S3 "Umrechnung fuer Messgroesse cModKuppl::f_stromschl_angefordert" TAB_VERB "%4.0" "" COMPU_TAB_REF Conv.cModKuppl._.f_stromschl_angefordert_S6_S3 /end COMPU_METHOD
/begin COMPU_METHOD Conv.cModKuppl._.f_stromrampe_kab_S6_S3 "Umrechnung fuer Messgroesse cModKuppl::f_stromrampe_kab" TAB_VERB "%4.0" "" COMPU_TAB_REF Conv.cModKuppl._.f_stromrampe_kab_S6_S3 /end COMPU_METHOD
/begin COMPU_METHOD Conv.cModKuppl._.f_pfmin_ga_aktiv_S6_S3 "Umrechnung fuer Messgroesse cModKuppl::f_pfmin_ga_aktiv" TAB_VERB "%4.0" "" COMPU_TAB_REF Conv.cModKuppl._.f_pfmin_ga_aktiv_S6_S3 /end COMPU_METHOD
/begin COMPU_METHOD Conv.cModKuppl._.z_pfad_cgt_adaklasse_S6_S3 "Umrechnung fuer Messgroesse cModKuppl::z_pfad_cgt_adaklasse" TAB_VERB "%4.0" "" COMPU_TAB_REF Conv.cModKuppl._.z_pfad_cgt_adaklasse_S6_S3 /end COMPU_METHOD
/begin COMPU_METHOD Conv.cModHydlg._.status_pruef_abgldat_S6_S3 "Umrechnung fuer Messgroesse cModHydlg::status_pruef_abgldat" TAB_VERB "%4.0" "" COMPU_TAB_REF Conv.cModHydlg._.status_pruef_abgldat_S6_S3 /end COMPU_METHOD
/begin COMPU_METHOD Conv.cModHydlg._.zugriff_abgleichdaten_S6_S3 "Umrechnung fuer Messgroesse cModHydlg::zugriff_abgleichdaten" TAB_VERB "%4.0" "" COMPU_TAB_REF Conv.cModHydlg._.zugriff_abgleichdaten_S6_S3 /end COMPU_METHOD
/begin COMPU_METHOD Conv.cModHydlg._.err_v_nr_abgldat_S6_S3 "Umrechnung fuer Messgroesse cModHydlg::err_v_nr_abgldat" TAB_VERB "%4.0" "" COMPU_TAB_REF Conv.cModHydlg._.err_v_nr_abgldat_S6_S3 /end COMPU_METHOD
/begin COMPU_METHOD Conv.cModHydlg._.version_abgleichdaten_S6_S3 "Umrechnung fuer Messgroesse cModHydlg::version_abgleichdaten" TAB_VERB "%4.0" "" COMPU_TAB_REF Conv.cModHydlg._.version_abgleichdaten_S6_S3 /end COMPU_METHOD
/begin COMPU_METHOD Conv.cModHydlg._.vnr_abgldat_im_boot_S6_S3 "Umrechnung fuer Messgroesse cModHydlg::vnr_abgldat_im_boot" TAB_VERB "%4.0" "" COMPU_TAB_REF Conv.cModHydlg._.vnr_abgldat_im_boot_S6_S3 /end COMPU_METHOD
/begin COMPU_METHOD Conv.cHydEdsKombi._.typ_ansteuerung_S6_S3 "Umrechnung fuer Messgroesse cHydEdsKombi::typ_ansteuerung" TAB_VERB "%4.0" "" COMPU_TAB_REF Conv.cHydEdsKombi._.typ_ansteuerung_S6_S3 /end COMPU_METHOD
/begin COMPU_METHOD Conv.cHydEdsBfm._.z_rampe_kab_S6_S3 "Umrechnung fuer Messgroesse cHydEdsBfm::z_rampe_kab" TAB_VERB "%4.0" "" COMPU_TAB_REF Conv.cHydEdsBfm._.z_rampe_kab_S6_S3 /end COMPU_METHOD
/begin COMPU_METHOD Conv.cAdaGloku._.puls_lock_S6_S3 "Umrechnung fuer Messgroesse cAdaGloku::puls_lock" TAB_VERB "%4.0" "" COMPU_TAB_REF Conv.cAdaGloku._.puls_lock_S6_S3 /end COMPU_METHOD
/begin COMPU_METHOD Conv.cAdaGloku._.index_startada_pf_S6_S3 "Umrechnung fuer Messgroesse cAdaGloku::index_startada_pf" TAB_VERB "%4.0" "" COMPU_TAB_REF Conv.cAdaGloku._.index_startada_pf_S6_S3 /end COMPU_METHOD
/begin COMPU_METHOD Conv.cAdaPulbwFenster._.f_aktiv_S6_S3 "Umrechnung fuer Messgroesse cAdaPulbwFenster::f_aktiv" TAB_VERB "%4.0" "" COMPU_TAB_REF Conv.cAdaPulbwFenster._.f_aktiv_S6_S3 /end COMPU_METHOD
/begin COMPU_METHOD Conv.cAdaPulbwFenster._.f_starten_S6_S3 "Umrechnung fuer Messgroesse cAdaPulbwFenster::f_starten" TAB_VERB "%4.0" "" COMPU_TAB_REF Conv.cAdaPulbwFenster._.f_starten_S6_S3 /end COMPU_METHOD
/begin COMPU_METHOD Conv.cAdaPulbwFenster._.f_beenden_S6_S3 "Umrechnung fuer Messgroesse cAdaPulbwFenster::f_beenden" TAB_VERB "%4.0" "" COMPU_TAB_REF Conv.cAdaPulbwFenster._.f_beenden_S6_S3 /end COMPU_METHOD
/begin COMPU_METHOD Conv.cAdaPulbw._.zustand_S6_S3 "Umrechnung fuer Messgroesse cAdaPulbw::zustand" TAB_VERB "%4.0" "" COMPU_TAB_REF Conv.cAdaPulbw._.zustand_S6_S3 /end COMPU_METHOD
/begin COMPU_METHOD Conv.cAdaPulbw._.testresultat_S6_S3 "Umrechnung fuer Messgroesse cAdaPulbw::testresultat" TAB_VERB "%4.0" "" COMPU_TAB_REF Conv.cAdaPulbw._.testresultat_S6_S3 /end COMPU_METHOD
/begin COMPU_METHOD Conv.cAdaPulbw._.neg_rea_S6_S3 "Umrechnung fuer Messgroesse cAdaPulbw::neg_rea" TAB_VERB "%4.0" "" COMPU_TAB_REF Conv.cAdaPulbw._.neg_rea_S6_S3 /end COMPU_METHOD
/begin COMPU_METHOD Conv.cAdaPulbw._.pos_rea_S6_S3 "Umrechnung fuer Messgroesse cAdaPulbw::pos_rea" TAB_VERB "%4.0" "" COMPU_TAB_REF Conv.cAdaPulbw._.pos_rea_S6_S3 /end COMPU_METHOD
/begin COMPU_METHOD Conv.cAdaPulbw._.rea_amplitude_S6_S3 "Umrechnung fuer Messgroesse cAdaPulbw::rea_amplitude" TAB_VERB "%4.0" "" COMPU_TAB_REF Conv.cAdaPulbw._.rea_amplitude_S6_S3 /end COMPU_METHOD
/begin COMPU_METHOD Conv.cAdaPulbw._.f_start_t_sperrt_nach_reak_S6_S3 "Umrechnung fuer Messgroesse cAdaPulbw::f_start_t_sperrt_nach_reak" TAB_VERB "%4.0" "" COMPU_TAB_REF Conv.cAdaPulbw._.f_start_t_sperrt_nach_reak_S6_S3 /end COMPU_METHOD
/begin COMPU_METHOD Conv.cAdaPulpf._.zustand_S6_S3 "Umrechnung fuer Messgroesse cAdaPulpf::zustand" TAB_VERB "%4.0" "" COMPU_TAB_REF Conv.cAdaPulpf._.zustand_S6_S3 /end COMPU_METHOD
/begin COMPU_METHOD Conv.cAdaPulpf._.fenster_nach_sf_S6_S3 "Umrechnung fuer Messgroesse cAdaPulpf::fenster_nach_sf" TAB_VERB "%4.0" "" COMPU_TAB_REF Conv.cAdaPulpf._.fenster_nach_sf_S6_S3 /end COMPU_METHOD
/begin COMPU_METHOD Conv.cAdaPulsf._.zustand_S6_S3 "Umrechnung fuer Messgroesse cAdaPulsf::zustand" TAB_VERB "%4.0" "" COMPU_TAB_REF Conv.cAdaPulsf._.zustand_S6_S3 /end COMPU_METHOD
/begin COMPU_METHOD Conv.cAdaPulhv._.zustand_S6_S3 "Umrechnung fuer Messgroesse cAdaPulhv::zustand" TAB_VERB "%4.0" "" COMPU_TAB_REF Conv.cAdaPulhv._.zustand_S6_S3 /end COMPU_METHOD
/begin COMPU_METHOD Conv.cAdaPulhv._.hs_verzoegerung_S6_S3 "Umrechnung fuer Messgroesse cAdaPulhv::hs_verzoegerung" TAB_VERB "%4.0" "" COMPU_TAB_REF Conv.cAdaPulhv._.hs_verzoegerung_S6_S3 /end COMPU_METHOD
/begin COMPU_METHOD Conv.cAdaPulzs._.zustand_S6_S3 "Umrechnung fuer Messgroesse cAdaPulzs::zustand" TAB_VERB "%4.0" "" COMPU_TAB_REF Conv.cAdaPulzs._.zustand_S6_S3 /end COMPU_METHOD
/begin COMPU_METHOD Conv.cAdaPulzs._.prueftyp_S6_S3 "Umrechnung fuer Messgroesse cAdaPulzs::prueftyp" TAB_VERB "%4.0" "" COMPU_TAB_REF Conv.cAdaPulzs._.prueftyp_S6_S3 /end COMPU_METHOD
/begin COMPU_METHOD Conv.cAdaPulzs._.prueftyp_alt_S6_S3 "Umrechnung fuer Messgroesse cAdaPulzs::prueftyp_alt" TAB_VERB "%4.0" "" COMPU_TAB_REF Conv.cAdaPulzs._.prueftyp_alt_S6_S3 /end COMPU_METHOD
/begin COMPU_METHOD Conv.cAdaPulzs._.pulsid_S6_S3 "Umrechnung fuer Messgroesse cAdaPulzs::pulsid" TAB_VERB "%4.0" "" COMPU_TAB_REF Conv.cAdaPulzs._.pulsid_S6_S3 /end COMPU_METHOD
/begin COMPU_METHOD Conv.cAdaPulzs._.kup_puls_S6_S3 "Umrechnung fuer Messgroesse cAdaPulzs::kup_puls" TAB_VERB "%4.0" "" COMPU_TAB_REF Conv.cAdaPulzs._.kup_puls_S6_S3 /end COMPU_METHOD
/begin COMPU_METHOD Conv.cAdaPulzs._.z_pfad_cgt_adkl_kup_puls_S6_S3 "Umrechnung fuer Messgroesse cAdaPulzs::z_pfad_cgt_adkl_kup_puls" TAB_VERB "%4.0" "" COMPU_TAB_REF Conv.cAdaPulzs._.z_pfad_cgt_adkl_kup_puls_S6_S3 /end COMPU_METHOD
/begin COMPU_METHOD Conv.cAdaPulzs._.f_in_gang_fertig_S6_S3 "Umrechnung fuer Messgroesse cAdaPulzs::f_in_gang_fertig" TAB_VERB "%4.0" "" COMPU_TAB_REF Conv.cAdaPulzs._.f_in_gang_fertig_S6_S3 /end COMPU_METHOD
/begin COMPU_METHOD Conv.cAdaPulzs._.f_startpuls_nguete_S6_S3 "Umrechnung fuer Messgroesse cAdaPulzs::f_startpuls_nguete" TAB_VERB "%4.0" "" COMPU_TAB_REF Conv.cAdaPulzs._.f_startpuls_nguete_S6_S3 /end COMPU_METHOD
/begin COMPU_METHOD Conv.cAdaPulzs._.f_ndabbr_verletzt_S6_S3 "Umrechnung fuer Messgroesse cAdaPulzs::f_ndabbr_verletzt" TAB_VERB "%4.0" "" COMPU_TAB_REF Conv.cAdaPulzs._.f_ndabbr_verletzt_S6_S3 /end COMPU_METHOD
/begin COMPU_METHOD Conv.cAdaPulzs._.f_startpruefung_aktiv_S6_S3 "Umrechnung fuer Messgroesse cAdaPulzs::f_startpruefung_aktiv" TAB_VERB "%4.0" "" COMPU_TAB_REF Conv.cAdaPulzs._.f_startpruefung_aktiv_S6_S3 /end COMPU_METHOD
/begin COMPU_METHOD Conv.cAdaPulzs._.f_schubabschaltung_aktiv_start_S6_S3 "Umrechnung fuer Messgroesse cAdaPulzs::f_schubabschaltung_aktiv_start" TAB_VERB "%4.0" "" COMPU_TAB_REF Conv.cAdaPulzs._.f_schubabschaltung_aktiv_start_S6_S3 /end COMPU_METHOD
/begin COMPU_METHOD Conv.cAdaPulzs._.f_deak_daempfer_S6_S3 "Umrechnung fuer Messgroesse cAdaPulzs::f_deak_daempfer" TAB_VERB "%4.0" "" COMPU_TAB_REF Conv.cAdaPulzs._.f_deak_daempfer_S6_S3 /end COMPU_METHOD
/begin COMPU_METHOD Conv.cAdaPulzs._.f_deak_daempfer_alt_S6_S3 "Umrechnung fuer Messgroesse cAdaPulzs::f_deak_daempfer_alt" TAB_VERB "%4.0" "" COMPU_TAB_REF Conv.cAdaPulzs._.f_deak_daempfer_alt_S6_S3 /end COMPU_METHOD
/begin COMPU_METHOD Conv.cAdaPulzs._.f_red_bef_kup_S6_S3 "Umrechnung fuer Messgroesse cAdaPulzs::f_red_bef_kup" TAB_VERB "%4.0" "" COMPU_TAB_REF Conv.cAdaPulzs._.f_red_bef_kup_S6_S3 /end COMPU_METHOD
/begin COMPU_METHOD Conv.cAdaPulzs._.pruefung_kup_fertig_S6_S3 "Umrechnung fuer Messgroesse cAdaPulzs::pruefung_kup_fertig" TAB_VERB "%4.0" "" COMPU_TAB_REF Conv.cAdaPulzs._.pruefung_kup_fertig_S6_S3 /end COMPU_METHOD
/begin COMPU_METHOD Conv.cAdaPulzs._.schnellfuellung_aktiv_S6_S3 "Umrechnung fuer Messgroesse cAdaPulzs::schnellfuellung_aktiv" TAB_VERB "%4.0" "" COMPU_TAB_REF Conv.cAdaPulzs._.schnellfuellung_aktiv_S6_S3 /end COMPU_METHOD
/begin COMPU_METHOD Conv.cAdaPulzs._.druck_statisch_S6_S3 "Umrechnung fuer Messgroesse cAdaPulzs::druck_statisch" TAB_VERB "%4.0" "" COMPU_TAB_REF Conv.cAdaPulzs._.druck_statisch_S6_S3 /end COMPU_METHOD
/begin COMPU_METHOD Conv.cAdaPulzs._.pulszyklus_beenden_S6_S3 "Umrechnung fuer Messgroesse cAdaPulzs::pulszyklus_beenden" TAB_VERB "%4.0" "" COMPU_TAB_REF Conv.cAdaPulzs._.pulszyklus_beenden_S6_S3 /end COMPU_METHOD
/begin COMPU_METHOD Conv.cAdaPulzs._.f_nmotsoll_em_S6_S3 "Umrechnung fuer Messgroesse cAdaPulzs::f_nmotsoll_em" TAB_VERB "%4.0" "" COMPU_TAB_REF Conv.cAdaPulzs._.f_nmotsoll_em_S6_S3 /end COMPU_METHOD
/begin COMPU_METHOD Conv.cAdaPulzs._.kup_puls_alt_S6_S3 "Umrechnung fuer Messgroesse cAdaPulzs::kup_puls_alt" TAB_VERB "%4.0" "" COMPU_TAB_REF Conv.cAdaPulzs._.kup_puls_alt_S6_S3 /end COMPU_METHOD
/begin COMPU_METHOD Conv.cAdaPulzs._.kup_puls_neu_S6_S3 "Umrechnung fuer Messgroesse cAdaPulzs::kup_puls_neu" TAB_VERB "%4.0" "" COMPU_TAB_REF Conv.cAdaPulzs._.kup_puls_neu_S6_S3 /end COMPU_METHOD
/begin COMPU_METHOD Conv.cAdaPulzs._.startinfo_index_S6_S3 "Umrechnung fuer Messgroesse cAdaPulzs::startinfo_index" TAB_VERB "%4.0" "" COMPU_TAB_REF Conv.cAdaPulzs._.startinfo_index_S6_S3 /end COMPU_METHOD
/begin COMPU_METHOD Conv.cAdaPulzs._.anz_kup_puls_S6_S3 "Umrechnung fuer Messgroesse cAdaPulzs::anz_kup_puls" TAB_VERB "%4.0" "" COMPU_TAB_REF Conv.cAdaPulzs._.anz_kup_puls_S6_S3 /end COMPU_METHOD
/begin COMPU_METHOD Conv.cAdaPulzs._.anz_kup_kalt_S6_S3 "Umrechnung fuer Messgroesse cAdaPulzs::anz_kup_kalt" TAB_VERB "%4.0" "" COMPU_TAB_REF Conv.cAdaPulzs._.anz_kup_kalt_S6_S3 /end COMPU_METHOD
/begin COMPU_METHOD Conv.cAdaPulzs._.anz_prueftyp_S6_S3 "Umrechnung fuer Messgroesse cAdaPulzs::anz_prueftyp" TAB_VERB "%4.0" "" COMPU_TAB_REF Conv.cAdaPulzs._.anz_prueftyp_S6_S3 /end COMPU_METHOD
/begin COMPU_METHOD Conv.cAdaPulzs._.anz_pulsid_S6_S3 "Umrechnung fuer Messgroesse cAdaPulzs::anz_pulsid" TAB_VERB "%4.0" "" COMPU_TAB_REF Conv.cAdaPulzs._.anz_pulsid_S6_S3 /end COMPU_METHOD
/begin COMPU_METHOD Conv.cAdaPulzs._.ada_starttyp_pf_S6_S3 "Umrechnung fuer Messgroesse cAdaPulzs::ada_starttyp_pf" TAB_VERB "%4.0" "" COMPU_TAB_REF Conv.cAdaPulzs._.ada_starttyp_pf_S6_S3 /end COMPU_METHOD
/begin COMPU_METHOD Conv.cAdaPulKr._.i_pulse_stop_req_S6_S3 "Umrechnung fuer Messgroesse cAdaPulKr::i_pulse_stop_req" TAB_VERB "%4.0" "" COMPU_TAB_REF Conv.cAdaPulKr._.i_pulse_stop_req_S6_S3 /end COMPU_METHOD
/begin COMPU_VTAB Conv.cModHysKo._.f_pg_abssoll_S6_S3 "Umrechnung fuer Messgroesse cModHysKo::f_pg_abssoll" TAB_VERB 2 0 "Steigender Gradient Solldruck" 1 "Fallender Gradient Solldruck" /end COMPU_VTAB
/begin COMPU_VTAB Conv.cModHysKo._.pg_wechsel_erkannt_S6_S3 "Umrechnung fuer Messgroesse cModHysKo::pg_wechsel_erkannt" TAB_VERB 2 0 "Kein Richtungswechsel Gradient" 1 "Richtungswechsel Gradient erkannt" /end COMPU_VTAB
/begin COMPU_VTAB Conv.cModHysKo._.f_ig_eds_S6_S3 "Umrechnung fuer Messgroesse cModHysKo::f_ig_eds" TAB_VERB 2 0 "Steigender Gradient Sollstrom" 1 "Fallender Gradient Sollstrom" /end COMPU_VTAB
/begin COMPU_VTAB Conv.cModHysKo._.ig_wechsel_erkannt_S6_S3 "Umrechnung fuer Messgroesse cModHysKo::ig_wechsel_erkannt" TAB_VERB 2 0 "Kein Richtungswechsel Gradient" 1 "Richtungswechsel Gradient erkannt" /end COMPU_VTAB
/begin COMPU_VTAB Conv.cModHysKo._.z_rampe_S6_S3 "Umrechnung fuer Messgroesse cModHysKo::z_rampe" TAB_VERB 4 0 "Z_DRUCK_MIN" 1 "Z_NACH_SF" 2 "Z_DRUCK_HOCH" 3 "Z_DRUCK_REGEL" /end COMPU_VTAB
/begin COMPU_VTAB Conv.cModPVorg._.f_druck_vorgegeben_S6_S3 "Umrechnung fuer Messgroesse cModPVorg::f_druck_vorgegeben" TAB_VERB 2 0 "FALSE" 1 "TRUE" /end COMPU_VTAB
/begin COMPU_VTAB Conv.cModPVorg._.f_anst_statisch_S6_S3 "Umrechnung fuer Messgroesse cModPVorg::f_anst_statisch" TAB_VERB 2 0 "FALSE" 1 "TRUE" /end COMPU_VTAB
/begin COMPU_VTAB Conv.cModPVorg._.fktn_druckvorgabe_S6_S3 "Umrechnung fuer Messgroesse cModPVorg::fktn_druckvorgabe" TAB_VERB 41 0 "DRUCKVORGABE_STATISCH" 1 "DRUCKVORGABE_KZU" 2 "DRUCKVORGABE_KAB" 3 "DRUCKVORGABE_VKZU" 4 "DRUCKVORGABE_VKAB" 5 "DRUCKVORGABE_GE1GA" 6 "DRUCKVORGABE_GE1GE" 7 "DRUCKVORGABE_GE2GA" 8 "DRUCKVORGABE_GE2GE" 9 "DRUCKVORGABE_GE3GA" 10 "DRUCKVORGABE_GE3GE" 11 "DRUCKVORGABE_KUPZU_IN_N" 12 "DRUCKVORGABE_KUP_PF_IN_N" 13 "DRUCKVORGABE_GSK" 15 "DRUCKVORGABE_PRUEFPULS" 16 "DRUCKVORGABE_KAB_KFL_WECHSEL_KUP1" 17 "DRUCKVORGABE_KAB_KFL_WECHSEL_KUP2" 18 "DRUCKVORGABE_ABSENK_AUSERHALB_SAS" 19 "DRUCKVORGABE_K0S" 20 "DRUCKVORGABE_EL_VORBEF" 21 "DRUCKVORGABE_SYSTEM" 22 "DRUCKVORGABE_WK" 23 "DRUCKVORGABE_GESYNC1GA" 24 "DRUCKVORGABE_GESYNC1GE" 25 "DRUCKVORGABE_GESYNC2GA" 26 "DRUCKVORGABE_GESYNC2GE" 27 "DRUCKVORGABE_TSTEDS" 28 "DRUCKVORGABE_PULS_LEER" 29 "DRUCKVORGABE_KUP_SEGELN" 30 "DRUCKVORGABE_KUP_PARKSPERRE" 31 "DRUCKVORGABE_GESYNC3GA" 32 "DRUCKVORGABE_GESYNC3GE" 33 "DRUCKVORGABE_KLAUE_F_PLAUSI" 34 "DRUCKVORGABE_RKUP_ANST" 35 "DRUCKVORGABE_KAB_ANST_ESPFKT" 36 "DRUCKVORGABE_ASPFKT_HS" 37 "DRUCKVORGABE_ESPFKT_RS" 38 "DRUCKVORGABE_KUPZU_GNF_ZE" 39 "DRUCKVORGABE_KUPAB_GNF_ZE" 40 "DRUCKVORGABE_KUP_PF_SEGELN" 41 "DRUCKVORGABE_KUP_2_PF_IN_N" /end COMPU_VTAB
/begin COMPU_VTAB Conv.cModPVorg._.typ_druckvorgabe_S6_S3 "Umrechnung fuer Messgroesse cModPVorg::typ_druckvorgabe" TAB_VERB 5 0 "STD_KUP_WIRKDRUCK_MIT_HYS" 1 "STD_KUP_WIRKDRUCK_OHNE_HYS" 2 "MANUELL_SF" 3 "MANUELL_ABSOLUTDRUCKVORGABE_MIT_HYS" 4 "ABSOLUTDRUCKVORGABE" /end COMPU_VTAB
/begin COMPU_VTAB Conv.cPAnzeige._.befuellung_schaltelement_aktiv_S6_S3 "Umrechnung fuer Messgroesse cPAnzeige::befuellung_schaltelement_aktiv" TAB_VERB 2 0 "FALSE" 1 "TRUE" /end COMPU_VTAB
/begin COMPU_VTAB Conv.cPAnzeige._.kzu_beob_kup_ada_S6_S3 "Umrechnung fuer Messgroesse cPAnzeige::kzu_beob_kup_ada" TAB_VERB 7 0 "KEINE_KUPPLUNG" 1 "K_A" 2 "K_B" 3 "K_C" 4 "K_D" 5 "K_E" 6 "K_K0" /end COMPU_VTAB
/begin COMPU_VTAB Conv.cModKuppl._.zustand_S6_S3 "Umrechnung fuer Messgroesse cModKuppl::zustand" TAB_VERB 6 0 "K_LEER_STEHT" 1 "K_FUELLT_STEHT" 2 "K_FUELLT_LAEUFT" 3 "K_VOLL_STEHT" 4 "K_ENTLEERT_STEHT" 5 "K_ENTLEERT_LAEUFT" /end COMPU_VTAB
/begin COMPU_VTAB Conv.cModKuppl._.kup_schaltart_sas_S6_S3 "Umrechnung fuer Messgroesse cModKuppl::kup_schaltart_sas" TAB_VERB 6 0 "KEINE_SCHALTUNG" 1 "HS" 2 "RS" 3 "SCHALTART_GE" 4 "SCHALTART_GA" 5 "nicht verwendet" /end COMPU_VTAB
/begin COMPU_VTAB Conv.cModKuppl._.kup_index_spsas_S6_S3 "Umrechnung fuer Messgroesse cModKuppl::kup_index_spsas" TAB_VERB 3 0 "Normal" 1 "Spontan" 2 "Sport/AMax" /end COMPU_VTAB
/begin COMPU_VTAB Conv.cModKuppl._.f_sf_ausgabe_aktiv_S6_S3 "Umrechnung fuer Messgroesse cModKuppl::f_sf_ausgabe_aktiv" TAB_VERB 2 0 "FALSE" 1 "TRUE" /end COMPU_VTAB
/begin COMPU_VTAB Conv.cModKuppl._.f_deakt_dither_sf_S6_S3 "Umrechnung fuer Messgroesse cModKuppl::f_deakt_dither_sf" TAB_VERB 2 0 "FALSE" 1 "TRUE" /end COMPU_VTAB
/begin COMPU_VTAB Conv.cModKuppl._.f_sf_vorhanden_S6_S3 "Umrechnung fuer Messgroesse cModKuppl::f_sf_vorhanden" TAB_VERB 2 0 "FALSE" 1 "TRUE" /end COMPU_VTAB
/begin COMPU_VTAB Conv.cModKuppl._.kpl_inaktiv_S6_S3 "Umrechnung fuer Messgroesse cModKuppl::kpl_inaktiv" TAB_VERB 2 0 "FALSE" 1 "TRUE" /end COMPU_VTAB
/begin COMPU_VTAB Conv.cModKuppl._.f_fuellred_S6_S3 "Umrechnung fuer Messgroesse cModKuppl::f_fuellred" TAB_VERB 2 0 "FALSE" 1 "TRUE" /end COMPU_VTAB
/begin COMPU_VTAB Conv.cModKuppl._.f_fuellopt_S6_S3 "Umrechnung fuer Messgroesse cModKuppl::f_fuellopt" TAB_VERB 2 0 "FALSE" 1 "TRUE" /end COMPU_VTAB
/begin COMPU_VTAB Conv.cModKuppl._.f_kolben_anlegen_S6_S3 "Umrechnung fuer Messgroesse cModKuppl::f_kolben_anlegen" TAB_VERB 2 0 "FALSE" 1 "TRUE" /end COMPU_VTAB
/begin COMPU_VTAB Conv.cModKuppl._.f_geschlossen_S6_S3 "Umrechnung fuer Messgroesse cModKuppl::f_geschlossen" TAB_VERB 2 0 "FALSE" 1 "TRUE" /end COMPU_VTAB
/begin COMPU_VTAB Conv.cModKuppl._.f_erste_bef_S6_S3 "Umrechnung fuer Messgroesse cModKuppl::f_erste_bef" TAB_VERB 2 0 "FALSE" 1 "TRUE" /end COMPU_VTAB
/begin COMPU_VTAB Conv.cModKuppl._.f_erste_bef_aus_sb_S6_S3 "Umrechnung fuer Messgroesse cModKuppl::f_erste_bef_aus_sb" TAB_VERB 2 0 "FALSE" 1 "TRUE" /end COMPU_VTAB
/begin COMPU_VTAB Conv.cModKuppl._.f_strom_pre_puls_erf_S6_S3 "Umrechnung fuer Messgroesse cModKuppl::f_strom_pre_puls_erf" TAB_VERB 2 0 "FALSE" 1 "TRUE" /end COMPU_VTAB
/begin COMPU_VTAB Conv.cModKuppl._.f_stromschl_angefordert_S6_S3 "Umrechnung fuer Messgroesse cModKuppl::f_stromschl_angefordert" TAB_VERB 2 0 "FALSE" 1 "TRUE" /end COMPU_VTAB
/begin COMPU_VTAB Conv.cModKuppl._.f_stromrampe_kab_S6_S3 "Umrechnung fuer Messgroesse cModKuppl::f_stromrampe_kab" TAB_VERB 2 0 "FALSE" 1 "TRUE" /end COMPU_VTAB
/begin COMPU_VTAB Conv.cModKuppl._.f_pfmin_ga_aktiv_S6_S3 "Umrechnung fuer Messgroesse cModKuppl::f_pfmin_ga_aktiv" TAB_VERB 2 0 "FALSE" 1 "TRUE" /end COMPU_VTAB
/begin COMPU_VTAB Conv.cModKuppl._.z_pfad_cgt_adaklasse_S6_S3 "Umrechnung fuer Messgroesse cModKuppl::z_pfad_cgt_adaklasse" TAB_VERB 7 0 "Z_PFAD_CGT_ADKL_INAKTIV" 1 "Z_PFAD_CGT_ADKL_UNTER_KALT" 2 "Z_PFAD_CGT_ADKL_IN_KALT" 3 "Z_PFAD_CGT_ADKL_ZWISCHEN" 4 "Z_PFAD_CGT_ADKL_IN_WARM" 5 "Z_PFAD_CGT_ADKL_UEBER_WARM" 6 "Z_PFAD_CGT_ADKL_SCHLECHTWEGE" /end COMPU_VTAB
/begin COMPU_VTAB Conv.cModHydlg._.status_pruef_abgldat_S6_S3 "Umrechnung fuer Messgroesse cModHydlg::status_pruef_abgldat" TAB_VERB 2 0 "Abgleichdaten Boot n.i.O." 1 "Abgleichdaten Boot i.O." /end COMPU_VTAB
/begin COMPU_VTAB Conv.cModHydlg._.zugriff_abgleichdaten_S6_S3 "Umrechnung fuer Messgroesse cModHydlg::zugriff_abgleichdaten" TAB_VERB 5 0 "Abgleichdaten aus Boot" 1 "Abgleichdaten aus Appl. ROM wegen SWI_ABGLDAT" 2 "Abgleichdaten aus Appl. ROM wegen n. i.O. Pruefung" 3 "Abgleichdaten aus Appl. ROM wegen SWI und n.i.O. Pruefung" 4 "Abgleichdaten aus Appl. wegen Teachin" /end COMPU_VTAB
/begin COMPU_VTAB Conv.cModHydlg._.err_v_nr_abgldat_S6_S3 "Umrechnung fuer Messgroesse cModHydlg::err_v_nr_abgldat" TAB_VERB 2 0 "Versionsnr. Abgleichdaten Boot i.O." 1 "Versionsnr. Abgleichdaten Boot n.i.O." /end COMPU_VTAB
/begin COMPU_VTAB Conv.cModHydlg._.version_abgleichdaten_S6_S3 "Umrechnung fuer Messgroesse cModHydlg::version_abgleichdaten" TAB_VERB 26 0 "unbelegt" 4 "Hydraulik E26/1 oder E26/2" 5 "Hydraulik E26/5 (Hybrid)" 6 "Hydraulik E26/6 (E-Schaltung mit WFS)" 7 "Hydraulik E26/4 (M-Schaltung mit WFS)" 8 "Hydraulik E26/9 (Hybrid mit WFS)" 9 "Hydraulik E28/1 (FQ12)" 10 "Hydraulik E28/2 E28/3 E28/4 (9HP EP2)" 11 "Hydraulik E26/11 (Hybrid E-Schaltung mit WFS)" 13 "Hydraulik E26/14 (8HPTU E-Schaltung)" 14 "Hydraulik E26/16 (8HPTU E-Schaltung mit WFS)" 15 "Hydraulik E26/13 (Hybrid Gen3 E-Schaltung)" 16 "Hydraulik E26/18 (Hybrid Gen3 K11 E-Schaltung)" 17 "Hydraulik E26/23 (Hybrid Gen3 K11 E-Schaltung mit WFS)" 19 "Hydraulik E28/5 9HPxx E-Schaltung" 22 "Hydraulik E26/28 8HPTU E-Schaltung" 23 "Hydraulik E26/29 8HPTU E-Schaltung mit WFS" 25 "Hydraulik E28/6 9HPxx M-Schaltung" 27 "Hydraulik E26/90 8HPTU E-Schaltung Proto" 29 "Hydraulik E26/32 8PxxH E/M-Schaltung WFS Gen3" 30 "Hydraulik E26/33 8PxxH E-Schaltung WFS Gen3" 31 "Hydraulik E26/35 8HPTU E-Schaltung WFS Remote" 32 "Hydraulik E26/30 8HPTU E-Schaltung Remote" 33 "Hydraulik E26/39 8HPTU E-Schaltung mit WFS" 34 "Hydraulik E26/36 8HP3GEN E-Schaltung" 36 "Hydraulik E26/24 8HPxy M-Schaltung" /end COMPU_VTAB
/begin COMPU_VTAB Conv.cModHydlg._.vnr_abgldat_im_boot_S6_S3 "Umrechnung fuer Messgroesse cModHydlg::vnr_abgldat_im_boot" TAB_VERB 26 0 "unbelegt" 4 "Hydraulik E26/1 oder E26/2" 5 "Hydraulik E26/5 (Hybrid)" 6 "Hydraulik E26/6 (E-Schaltung mit WFS)" 7 "Hydraulik E26/4 (M-Schaltung mit WFS)" 8 "Hydraulik E26/9 (Hybrid mit WFS)" 9 "Hydraulik E28/1 (FQ12)" 10 "Hydraulik E28/2 E28/3 E28/4 (9HP EP2)" 11 "Hydraulik E26/11 (Hybrid E-Schaltung mit WFS)" 13 "Hydraulik E26/14 (8HPTU E-Schaltung)" 14 "Hydraulik E26/16 (8HPTU E-Schaltung mit WFS)" 15 "Hydraulik E26/13 (Hybrid Gen3 E-Schaltung)" 16 "Hydraulik E26/18 (Hybrid Gen3 K11 E-Schaltung)" 17 "Hydraulik E26/23 (Hybrid Gen3 K11 E-Schaltung mit WFS)" 19 "Hydraulik E28/5 9HPxx E-Schaltung" 22 "Hydraulik E26/28 8HPTU E-Schaltung" 23 "Hydraulik E26/29 8HPTU E-Schaltung mit WFS" 25 "Hydraulik E28/6 9HPxx M-Schaltung" 27 "Hydraulik E26/90 8HPTU E-Schaltung Proto" 29 "Hydraulik E26/32 8PxxH E/M-Schaltung WFS Gen3" 30 "Hydraulik E26/33 8PxxH E-Schaltung WFS Gen3" 31 "Hydraulik E26/35 8HPTU E-Schaltung WFS Remote" 32 "Hydraulik E26/30 8HPTU E-Schaltung Remote" 33 "Hydraulik E26/39 8HPTU E-Schaltung mit WFS" 34 "Hydraulik E26/36 8HP3GEN E-Schaltung" 36 "Hydraulik E26/24 8HPxy M-Schaltung" /end COMPU_VTAB
/begin COMPU_VTAB Conv.cHydEdsKombi._.typ_ansteuerung_S6_S3 "Umrechnung fuer Messgroesse cHydEdsKombi::typ_ansteuerung" TAB_VERB 3 0 "Keine Ansteuerung" 1 "Ansteuerung I1" 2 "Ansteuerung I2" /end COMPU_VTAB
/begin COMPU_VTAB Conv.cHydEdsBfm._.z_rampe_kab_S6_S3 "Umrechnung fuer Messgroesse cHydEdsBfm::z_rampe_kab" TAB_VERB 3 0 "Z_RAMPE_INAKTIV" 1 "Z_RAMPE_LAEUFT" 2 "Z_RAMPE_BEENDET" /end COMPU_VTAB
/begin COMPU_VTAB Conv.cAdaGloku._.puls_lock_S6_S3 "Umrechnung fuer Messgroesse cAdaGloku::puls_lock" TAB_VERB 2 0 "kein Abbruch" 1 "Abbruch" /end COMPU_VTAB
/begin COMPU_VTAB Conv.cAdaGloku._.index_startada_pf_S6_S3 "Umrechnung fuer Messgroesse cAdaGloku::index_startada_pf" TAB_VERB 6 1 "Hochschaltadaption" 2 "nicht belegt" 3 "IAE-Adaption (nur bei IAE-Varianten)" 4 "Gangeinlegeadaption (nur bei Var. mit GE-Ada)" 5 "Gangauslegeadaption (nur bei Var. mit GA-Ada)" 6 "Rueckschaltadaption" /end COMPU_VTAB
/begin COMPU_VTAB Conv.cAdaPulbwFenster._.f_aktiv_S6_S3 "Umrechnung fuer Messgroesse cAdaPulbwFenster::f_aktiv" TAB_VERB 2 0 "FALSE" 1 "TRUE" /end COMPU_VTAB
/begin COMPU_VTAB Conv.cAdaPulbwFenster._.f_starten_S6_S3 "Umrechnung fuer Messgroesse cAdaPulbwFenster::f_starten" TAB_VERB 2 0 "FALSE" 1 "TRUE" /end COMPU_VTAB
/begin COMPU_VTAB Conv.cAdaPulbwFenster._.f_beenden_S6_S3 "Umrechnung fuer Messgroesse cAdaPulbwFenster::f_beenden" TAB_VERB 2 0 "FALSE" 1 "TRUE" /end COMPU_VTAB
/begin COMPU_VTAB Conv.cAdaPulbw._.zustand_S6_S3 "Umrechnung fuer Messgroesse cAdaPulbw::zustand" TAB_VERB 7 0 "Kein Beobachtungsablauf aktiv" 1 "Es wird die Reaktion bestimmt" 2 "Es wird bewertet" 3 "Die Bewertung ist abgeschlossen" 4 "Das Kriterium ND_ABBR ist nicht erfuellt" 5 "Es hat waehrend dem Puls eine Schaltung stattgefunden" 6 "Es ist ein Fehler aufgetreten" /end COMPU_VTAB
/begin COMPU_VTAB Conv.cAdaPulbw._.testresultat_S6_S3 "Umrechnung fuer Messgroesse cAdaPulbw::testresultat" TAB_VERB 5 0 "Keine Reaktion" 1 "Reaktion zu klein" 2 "Reaktion erwartet" 3 "Reaktion zu gross" 4 "Reaktion viel zu gross" /end COMPU_VTAB
/begin COMPU_VTAB Conv.cAdaPulbw._.neg_rea_S6_S3 "Umrechnung fuer Messgroesse cAdaPulbw::neg_rea" TAB_VERB 3 0 "Keine Reaktion erkannt" 1 "ND_TSF/PFPULSNEG erkannt" 2 "ND_TSF/PFPULSZWNEG erkannt" /end COMPU_VTAB
/begin COMPU_VTAB Conv.cAdaPulbw._.pos_rea_S6_S3 "Umrechnung fuer Messgroesse cAdaPulbw::pos_rea" TAB_VERB 3 0 "Keine Reaktion erkannt" 1 "ND_TSF/PFPULSPOS erkannt" 2 "ND_TSF/PFPULSZWPOS erkannt" /end COMPU_VTAB
/begin COMPU_VTAB Conv.cAdaPulbw._.rea_amplitude_S6_S3 "Umrechnung fuer Messgroesse cAdaPulbw::rea_amplitude" TAB_VERB 2 0 "Keine Reaktion erkannt" 1 "ND_TSF/PFPULSAMP erkannt" /end COMPU_VTAB
/begin COMPU_VTAB Conv.cAdaPulbw._.f_start_t_sperrt_nach_reak_S6_S3 "Umrechnung fuer Messgroesse cAdaPulbw::f_start_t_sperrt_nach_reak" TAB_VERB 2 0 "Reaktion erkannt" 1 "Keine Reaktion erkannt" /end COMPU_VTAB
/begin COMPU_VTAB Conv.cAdaPulpf._.zustand_S6_S3 "Umrechnung fuer Messgroesse cAdaPulpf::zustand" TAB_VERB 10 0 "KPAD_PF_KEINE_PRUEFUNG" 1 "KPAD_PF_WARTEN_AUF_SF" 2 "KPAD_PF_SF_AKTIV" 3 "KPAD_PF_FD_AKTIV" 4 "KPAD_PF_FD_PULS_AKTIV" 5 "KPAD_PF_UEBERWACHUNG_AKTIV" 6 "KPAD_PF_ENDE" 7 "KPAD_PF_ND_ABBR_NICHT_ERFUELLT" 8 "KPAD_PF_ABBRUCH_WG_SCHALTUNG" 9 "KPAD_PF_FEHLER_BEI_PRUEFUNG" /end COMPU_VTAB
/begin COMPU_VTAB Conv.cAdaPulpf._.fenster_nach_sf_S6_S3 "Umrechnung fuer Messgroesse cAdaPulpf::fenster_nach_sf" TAB_VERB 2 0 "Abfrage auf ND_ADABBR erlaubt" 1 "Abfrage auf ND_ADABBR ist verboten" /end COMPU_VTAB
/begin COMPU_VTAB Conv.cAdaPulsf._.zustand_S6_S3 "Umrechnung fuer Messgroesse cAdaPulsf::zustand" TAB_VERB 9 0 "KPAD_TSF_KEINE_PRUEFUNG" 1 "KPAD_TSF_WARTEN_AUF_SF" 2 "KPAD_TSF_SF_AKTIV" 3 "KPAD_TSF_FD_AKTIV" 4 "KPAD_TSF_UEBERWACHUNG_AKTIV" 5 "KPAD_TSF_ENDE" 6 "KPAD_TSF_ND_ABBR_NICHT_ERFUELLT" 7 "KPAD_TSF_ABBRUCH_WG_SCHALTUNG" 8 "KPAD_TSF_FEHLER_BEI_PRUEFUNG" /end COMPU_VTAB
/begin COMPU_VTAB Conv.cAdaPulhv._.zustand_S6_S3 "Umrechnung fuer Messgroesse cAdaPulhv::zustand" TAB_VERB 3 0 "KPAD_HSV_PASSIV" 1 "KPAD_HSV_NICHT_AKTIV" 2 "KPAD_HSV_TIMER_AKTIV" /end COMPU_VTAB
/begin COMPU_VTAB Conv.cAdaPulhv._.hs_verzoegerung_S6_S3 "Umrechnung fuer Messgroesse cAdaPulhv::hs_verzoegerung" TAB_VERB 3 0 "HS_VERZOEGERUNG_NICHT_GEFORDERT" 1 "HS_VERZOEGERUNG_MEDIUM_PRIO" 2 "HS_VERZOEGERUNG_HIGH_PRIO" /end COMPU_VTAB
/begin COMPU_VTAB Conv.cAdaPulzs._.zustand_S6_S3 "Umrechnung fuer Messgroesse cAdaPulzs::zustand" TAB_VERB 12 0 "KPAD_KEINE_AGL_BERECHNUNG" 1 "KPAD_WARTEN_AGL_GUELTIG" 2 "KPAD_SPERRZEITEN_AKTIV" 3 "KPAD_PASSIV" 4 "KPAD_START" 5 "KPAD_WARTEN" 6 "KPAD_SCHNELLFUELLUNG" 7 "KPAD_FUELLDRUCK" 8 "KPAD_PULSENDE_BEWERTUNG_AKTIV" 9 "KPAD_ND_ABBR_NICHT_ERFUELLT" 10 "KPAD_ABBRUCH_WG_SCHALTUNG" 11 "KPAD_FEHLER_BEI_PRUEFUNG" /end COMPU_VTAB
/begin COMPU_VTAB Conv.cAdaPulzs._.prueftyp_S6_S3 "Umrechnung fuer Messgroesse cAdaPulzs::prueftyp" TAB_VERB 3 0 "KPAD_KEINE_PRUEFUNG_AKTIV" 1 "KPAD_SF_PRUEFUNG_AKTIV" 2 "KPAD_PF_PRUEFUNG_AKTIV" /end COMPU_VTAB
/begin COMPU_VTAB Conv.cAdaPulzs._.prueftyp_alt_S6_S3 "Umrechnung fuer Messgroesse cAdaPulzs::prueftyp_alt" TAB_VERB 3 0 "KPAD_KEINE_PRUEFUNG_AKTIV" 1 "KPAD_SF_PRUEFUNG_AKTIV" 2 "KPAD_PF_PRUEFUNG_AKTIV" /end COMPU_VTAB
/begin COMPU_VTAB Conv.cAdaPulzs._.pulsid_S6_S3 "Umrechnung fuer Messgroesse cAdaPulzs::pulsid" TAB_VERB 5 0 "KPAD_KEIN_PULS" 1 "KPAD_PULSID_1" 2 "KPAD_PULSID_2" 3 "KPAD_PULSID_3" 4 "KPAD_PULSID_4" /end COMPU_VTAB
/begin COMPU_VTAB Conv.cAdaPulzs._.kup_puls_S6_S3 "Umrechnung fuer Messgroesse cAdaPulzs::kup_puls" TAB_VERB 7 0 "KEINE_KUPPLUNG" 1 "K_A" 2 "K_B" 3 "K_C" 4 "K_D" 5 "K_E" 6 "K_K0" /end COMPU_VTAB
/begin COMPU_VTAB Conv.cAdaPulzs._.z_pfad_cgt_adkl_kup_puls_S6_S3 "Umrechnung fuer Messgroesse cAdaPulzs::z_pfad_cgt_adkl_kup_puls" TAB_VERB 7 0 "Z_PFAD_CGT_ADKL_INAKTIV" 1 "Z_PFAD_CGT_ADKL_UNTER_KALT" 2 "Z_PFAD_CGT_ADKL_IN_KALT" 3 "Z_PFAD_CGT_ADKL_ZWISCHEN" 4 "Z_PFAD_CGT_ADKL_IN_WARM" 5 "Z_PFAD_CGT_ADKL_UEBER_WARM" 6 "Z_PFAD_CGT_ADKL_SCHLECHTWEGE" /end COMPU_VTAB
/begin COMPU_VTAB Conv.cAdaPulzs._.f_in_gang_fertig_S6_S3 "Umrechnung fuer Messgroesse cAdaPulzs::f_in_gang_fertig" TAB_VERB 2 0 "FALSE" 1 "TRUE" /end COMPU_VTAB
/begin COMPU_VTAB Conv.cAdaPulzs._.f_startpuls_nguete_S6_S3 "Umrechnung fuer Messgroesse cAdaPulzs::f_startpuls_nguete" TAB_VERB 2 0 "FALSE" 1 "TRUE" /end COMPU_VTAB
/begin COMPU_VTAB Conv.cAdaPulzs._.f_ndabbr_verletzt_S6_S3 "Umrechnung fuer Messgroesse cAdaPulzs::f_ndabbr_verletzt" TAB_VERB 2 0 "FALSE" 1 "TRUE" /end COMPU_VTAB
/begin COMPU_VTAB Conv.cAdaPulzs._.f_startpruefung_aktiv_S6_S3 "Umrechnung fuer Messgroesse cAdaPulzs::f_startpruefung_aktiv" TAB_VERB 2 0 "FALSE" 1 "TRUE" /end COMPU_VTAB
/begin COMPU_VTAB Conv.cAdaPulzs._.f_schubabschaltung_aktiv_start_S6_S3 "Umrechnung fuer Messgroesse cAdaPulzs::f_schubabschaltung_aktiv_start" TAB_VERB 2 0 "FALSE" 1 "TRUE" /end COMPU_VTAB
/begin COMPU_VTAB Conv.cAdaPulzs._.f_deak_daempfer_S6_S3 "Umrechnung fuer Messgroesse cAdaPulzs::f_deak_daempfer" TAB_VERB 2 0 "FALSE" 1 "TRUE" /end COMPU_VTAB
/begin COMPU_VTAB Conv.cAdaPulzs._.f_deak_daempfer_alt_S6_S3 "Umrechnung fuer Messgroesse cAdaPulzs::f_deak_daempfer_alt" TAB_VERB 2 0 "FALSE" 1 "TRUE" /end COMPU_VTAB
/begin COMPU_VTAB Conv.cAdaPulzs._.f_red_bef_kup_S6_S3 "Umrechnung fuer Messgroesse cAdaPulzs::f_red_bef_kup" TAB_VERB 2 0 "FALSE" 1 "TRUE" /end COMPU_VTAB
/begin COMPU_VTAB Conv.cAdaPulzs._.pruefung_kup_fertig_S6_S3 "Umrechnung fuer Messgroesse cAdaPulzs::pruefung_kup_fertig" TAB_VERB 2 0 "FALSE" 1 "TRUE" /end COMPU_VTAB
/begin COMPU_VTAB Conv.cAdaPulzs._.schnellfuellung_aktiv_S6_S3 "Umrechnung fuer Messgroesse cAdaPulzs::schnellfuellung_aktiv" TAB_VERB 2 0 "FALSE" 1 "TRUE" /end COMPU_VTAB
/begin COMPU_VTAB Conv.cAdaPulzs._.druck_statisch_S6_S3 "Umrechnung fuer Messgroesse cAdaPulzs::druck_statisch" TAB_VERB 2 0 "FALSE" 1 "TRUE" /end COMPU_VTAB
/begin COMPU_VTAB Conv.cAdaPulzs._.pulszyklus_beenden_S6_S3 "Umrechnung fuer Messgroesse cAdaPulzs::pulszyklus_beenden" TAB_VERB 4 0 "KPAD_ZYKLUS_NICHT_BEENDEN" 1 "KPAD_ZYKL_BEENDEN_WG_PULS_4" 2 "KPAD_ZYKL_BEENDEN_WG_PULSGRENZ" 3 "KPAD_ZYKL_BEENDEN_WG_ZWSP" /end COMPU_VTAB
/begin COMPU_VTAB Conv.cAdaPulzs._.f_nmotsoll_em_S6_S3 "Umrechnung fuer Messgroesse cAdaPulzs::f_nmotsoll_em" TAB_VERB 2 0 "FALSE" 1 "TRUE" /end COMPU_VTAB
/begin COMPU_VTAB Conv.cAdaPulzs._.kup_puls_alt_S6_S3 "Umrechnung fuer Messgroesse cAdaPulzs::kup_puls_alt" TAB_VERB 7 0 "KEINE_KUPPLUNG" 1 "K_A" 2 "K_B" 3 "K_C" 4 "K_D" 5 "K_E" 6 "K_K0" /end COMPU_VTAB
/begin COMPU_VTAB Conv.cAdaPulzs._.kup_puls_neu_S6_S3 "Umrechnung fuer Messgroesse cAdaPulzs::kup_puls_neu" TAB_VERB 7 0 "KEINE_KUPPLUNG" 1 "K_A" 2 "K_B" 3 "K_C" 4 "K_D" 5 "K_E" 6 "K_K0" /end COMPU_VTAB
/begin COMPU_VTAB Conv.cAdaPulzs._.startinfo_index_S6_S3 "Umrechnung fuer Messgroesse cAdaPulzs::startinfo_index" TAB_VERB 7 0 "KPAD_PRIO_INDEX_KEINE" 1 "KPAD_SEK_TSF" 2 "KPAD_SEK_PF" 3 "KPAD_PRIO_INDEX_1_TSF" 4 "KPAD_PRIO_INDEX_1_PF" 5 "KPAD_PRIO_INDEX_2_TSF" 6 "KPAD_PRIO_INDEX_2_PF" /end COMPU_VTAB
/begin COMPU_VTAB Conv.cAdaPulzs._.anz_kup_puls_S6_S3 "Umrechnung fuer Messgroesse cAdaPulzs::anz_kup_puls" TAB_VERB 7 0 "KEINE_KUPPLUNG" 1 "K_A" 2 "K_B" 3 "K_C" 4 "K_D" 5 "K_E" 6 "K_K0" /end COMPU_VTAB
/begin COMPU_VTAB Conv.cAdaPulzs._.anz_kup_kalt_S6_S3 "Umrechnung fuer Messgroesse cAdaPulzs::anz_kup_kalt" TAB_VERB 2 0 "FALSE" 1 "TRUE" /end COMPU_VTAB
/begin COMPU_VTAB Conv.cAdaPulzs._.anz_prueftyp_S6_S3 "Umrechnung fuer Messgroesse cAdaPulzs::anz_prueftyp" TAB_VERB 3 0 "KPAD_KEINE_PRUEFUNG_AKTIV" 1 "KPAD_SF_PRUEFUNG_AKTIV" 2 "KPAD_PF_PRUEFUNG_AKTIV" /end COMPU_VTAB
/begin COMPU_VTAB Conv.cAdaPulzs._.anz_pulsid_S6_S3 "Umrechnung fuer Messgroesse cAdaPulzs::anz_pulsid" TAB_VERB 5 0 "KPAD_KEIN_PULS" 1 "KPAD_PULSID_1" 2 "KPAD_PULSID_2" 3 "KPAD_PULSID_3" 4 "KPAD_PULSID_4" /end COMPU_VTAB
/begin COMPU_VTAB Conv.cAdaPulzs._.ada_starttyp_pf_S6_S3 "Umrechnung fuer Messgroesse cAdaPulzs::ada_starttyp_pf" TAB_VERB 5 0 "KBPTYP_KEINE" 1 "KBPTYP_START" 2 "KBPTYP_HAUPT" 3 "KBPTYP_SCHLECHTWEGE" 4 "KBPTYP_INAKTIV" /end COMPU_VTAB
/begin COMPU_VTAB Conv.cAdaPulKr._.i_pulse_stop_req_S6_S3 "Umrechnung fuer Messgroesse cAdaPulKr::i_pulse_stop_req" TAB_VERB 4 0 "kein Abbruch der Pulses" 1 "Stillstandsadaption" 2 "Pulsadaption" 3 "Kupplungsbefuellung" /end COMPU_VTAB
/begin FUNCTION HYD_DRUCKVORGABE "Druckvorgaben"
 /begin LOC_MEASUREMENT iKupA.cModPVorg._.f_anst_statisch iKupA.cModPVorg._.f_druck_vorgegeben iKupA.cModPVorg._.fktn_druckvorgabe iKupA.cModPVorg._.p_abssoll iKupA.cModPVorg._.p_abssoll_sys iKupA.cModPVorg._.p_vorgabe iKupA.cModPVorg._.typ_druckvorgabe iKupA.drehzahl iKupA.f_deakt_dither_sf iKupA.f_erste_bef iKupA.f_erste_bef_aus_sb iKupA.f_fuellopt iKupA.f_fuellred iKupA.f_geschlossen iKupA.f_kolben_anlegen iKupA.f_pfmin_ga_aktiv iKupA.f_sf_ausgabe_aktiv iKupA.f_sf_vorhanden iKupA.f_strom_pre_puls_erf iKupA.f_stromrampe_kab iKupA.f_stromschl_angefordert iKupA.kolben_pos iKupA.kolben_posbas iKupA.kpl_inaktiv iKupA.kup_index_spsas iKupA.kup_schaltart_sas iKupA.kv_nummer iKupA.n_kup_zbeg iKupA.p_absist iKupA.p_bedarf iKupA.p_filter.fl_filter.x iKupA.p_filter.letzter_ms_timer iKupA.p_fmin iKupA.t0_sf iKupA.t_kpl_aktiv.timer iKupA.t_kpl_inaktiv.timer iKupA.t_lauf_entleer iKupA.t_lauf_fuell iKupA.timer_kolbenpos_kor iKupA.timer_sas_ende_mit_pmax.timer iKupA.to_sf_ada iKupA.totzeit iKupA.totzeit_abgelaufen.timer iKupA.z_pfad_cgt_adaklasse iKupA.zustand iKupA.zustandstimer.timer iKupB.cModPVorg._.f_anst_statisch iKupB.cModPVorg._.f_druck_vorgegeben iKupB.cModPVorg._.fktn_druckvorgabe iKupB.cModPVorg._.p_abssoll iKupB.cModPVorg._.p_abssoll_sys iKupB.cModPVorg._.p_vorgabe iKupB.cModPVorg._.typ_druckvorgabe iKupB.drehzahl iKupB.f_deakt_dither_sf iKupB.f_erste_bef iKupB.f_erste_bef_aus_sb iKupB.f_fuellopt iKupB.f_fuellred iKupB.f_geschlossen iKupB.f_kolben_anlegen iKupB.f_pfmin_ga_aktiv iKupB.f_sf_ausgabe_aktiv iKupB.f_sf_vorhanden iKupB.f_strom_pre_puls_erf iKupB.f_stromrampe_kab iKupB.f_stromschl_angefordert iKupB.kolben_pos iKupB.kolben_posbas iKupB.kpl_inaktiv iKupB.kup_index_spsas iKupB.kup_schaltart_sas iKupB.kv_nummer iKupB.n_kup_zbeg iKupB.p_absist iKupB.p_bedarf iKupB.p_filter.fl_filter.x iKupB.p_filter.letzter_ms_timer iKupB.p_fmin iKupB.t0_sf iKupB.t_kpl_aktiv.timer iKupB.t_kpl_inaktiv.timer iKupB.t_lauf_entleer iKupB.t_lauf_fuell iKupB.timer_kolbenpos_kor iKupB.timer_sas_ende_mit_pmax.timer iKupB.to_sf_ada iKupB.totzeit iKupB.totzeit_abgelaufen.timer iKupB.z_pfad_cgt_adaklasse iKupB.zustand iKupB.zustandstimer.timer iKupC.cModPVorg._.f_anst_statisch iKupC.cModPVorg._.f_druck_vorgegeben iKupC.cModPVorg._.fktn_druckvorgabe iKupC.cModPVorg._.p_abssoll iKupC.cModPVorg._.p_abssoll_sys iKupC.cModPVorg._.p_vorgabe iKupC.cModPVorg._.typ_druckvorgabe iKupC.drehzahl iKupC.f_deakt_dither_sf iKupC.f_erste_bef iKupC.f_erste_bef_aus_sb iKupC.f_fuellopt iKupC.f_fuellred iKupC.f_geschlossen iKupC.f_kolben_anlegen iKupC.f_pfmin_ga_aktiv iKupC.f_sf_ausgabe_aktiv iKupC.f_sf_vorhanden iKupC.f_strom_pre_puls_erf iKupC.f_stromrampe_kab iKupC.f_stromschl_angefordert iKupC.kolben_pos iKupC.kolben_posbas iKupC.kpl_inaktiv iKupC.kup_index_spsas iKupC.kup_schaltart_sas iKupC.kv_nummer iKupC.n_kup_zbeg iKupC.p_absist iKupC.p_bedarf iKupC.p_filter.fl_filter.x iKupC.p_filter.letzter_ms_timer iKupC.p_fmin iKupC.t0_sf iKupC.t_kpl_aktiv.timer iKupC.t_kpl_inaktiv.timer iKupC.t_lauf_entleer iKupC.t_lauf_fuell iKupC.timer_kolbenpos_kor iKupC.timer_sas_ende_mit_pmax.timer iKupC.to_sf_ada iKupC.totzeit iKupC.totzeit_abgelaufen.timer iKupC.z_pfad_cgt_adaklasse iKupC.zustand iKupC.zustandstimer.timer iKupD.cModPVorg._.f_anst_statisch iKupD.cModPVorg._.f_druck_vorgegeben iKupD.cModPVorg._.fktn_druckvorgabe iKupD.cModPVorg._.p_abssoll iKupD.cModPVorg._.p_abssoll_sys iKupD.cModPVorg._.p_vorgabe iKupD.cModPVorg._.typ_druckvorgabe iKupD.drehzahl iKupD.f_deakt_dither_sf iKupD.f_erste_bef iKupD.f_erste_bef_aus_sb iKupD.f_fuellopt iKupD.f_fuellred iKupD.f_geschlossen iKupD.f_kolben_anlegen iKupD.f_pfmin_ga_aktiv iKupD.f_sf_ausgabe_aktiv iKupD.f_sf_vorhanden iKupD.f_strom_pre_puls_erf iKupD.f_stromrampe_kab iKupD.f_stromschl_angefordert iKupD.kolben_pos iKupD.kolben_posbas iKupD.kpl_inaktiv iKupD.kup_index_spsas iKupD.kup_schaltart_sas iKupD.kv_nummer iKupD.n_kup_zbeg iKupD.p_absist iKupD.p_bedarf iKupD.p_filter.fl_filter.x iKupD.p_filter.letzter_ms_timer iKupD.p_fmin iKupD.t0_sf iKupD.t_kpl_aktiv.timer iKupD.t_kpl_inaktiv.timer iKupD.t_lauf_entleer iKupD.t_lauf_fuell iKupD.timer_kolbenpos_kor iKupD.timer_sas_ende_mit_pmax.timer iKupD.to_sf_ada iKupD.totzeit iKupD.totzeit_abgelaufen.timer iKupD.z_pfad_cgt_adaklasse iKupD.zustand iKupD.zustandstimer.timer iKupE.cModPVorg._.f_anst_statisch iKupE.cModPVorg._.f_druck_vorgegeben iKupE.cModPVorg._.fktn_druckvorgabe iKupE.cModPVorg._.p_abssoll iKupE.cModPVorg._.p_abssoll_sys iKupE.cModPVorg._.p_vorgabe iKupE.cModPVorg._.typ_druckvorgabe iKupE.drehzahl iKupE.f_deakt_dither_sf iKupE.f_erste_bef iKupE.f_erste_bef_aus_sb iKupE.f_fuellopt iKupE.f_fuellred iKupE.f_geschlossen iKupE.f_kolben_anlegen iKupE.f_pfmin_ga_aktiv iKupE.f_sf_ausgabe_aktiv iKupE.f_sf_vorhanden iKupE.f_strom_pre_puls_erf iKupE.f_stromrampe_kab iKupE.f_stromschl_angefordert iKupE.kolben_pos iKupE.kolben_posbas iKupE.kpl_inaktiv iKupE.kup_index_spsas iKupE.kup_schaltart_sas iKupE.kv_nummer iKupE.n_kup_zbeg iKupE.p_absist iKupE.p_bedarf iKupE.p_filter.fl_filter.x iKupE.p_filter.letzter_ms_timer iKupE.p_fmin iKupE.t0_sf iKupE.t_kpl_aktiv.timer iKupE.t_kpl_inaktiv.timer iKupE.t_lauf_entleer iKupE.t_lauf_fuell iKupE.timer_kolbenpos_kor iKupE.timer_sas_ende_mit_pmax.timer iKupE.to_sf_ada iKupE.totzeit iKupE.totzeit_abgelaufen.timer iKupE.z_pfad_cgt_adaklasse iKupE.zustand iKupE.zustandstimer.timer iKupHysA.f_ig_eds iKupHysA.f_pg_abssoll iKupHysA.iDt1IEds.Pt1Si16.x iKupHysA.iDt1IEds.xp iKupHysA.iDt1PAbssoll.Pt1Fl32.x iKupHysA.iDt1PAbssoll.xp iKupHysA.iDt1Verz.Pt1Fl32.x iKupHysA.iDt1Verz.xp iKupHysA.iPt2IoKomp.x iKupHysA.iPt2IoKomp.xp iKupHysA.iPt2MoKomp.x iKupHysA.iPt2MoKomp.xp iKupHysA.i_eds iKupHysA.i_umkehr iKupHysA.i_umkehr_alt iKupHysA.ig_eds iKupHysA.ig_wechsel_erkannt iKupHysA.io_stg iKupHysA.k_kf_out iKupHysA.k_rampe_out iKupHysA.mo_kpl iKupHysA.p_abssoll iKupHysA.p_umkehr iKupHysA.p_umkehr_alt iKupHysA.pg_abssoll iKupHysA.pg_wechsel_erkannt iKupHysA.pg_wirk iKupHysA.po_kpl iKupHysA.po_vhyskomp iKupHysA.po_wirk iKupHysA.trajekfort_kpl iKupHysA.trajekfort_stg iKupHysA.z_rampe iKupHysB.f_ig_eds iKupHysB.f_pg_abssoll iKupHysB.iDt1IEds.Pt1Si16.x iKupHysB.iDt1IEds.xp iKupHysB.iDt1PAbssoll.Pt1Fl32.x iKupHysB.iDt1PAbssoll.xp iKupHysB.iDt1Verz.Pt1Fl32.x iKupHysB.iDt1Verz.xp iKupHysB.iPt2IoKomp.x iKupHysB.iPt2IoKomp.xp iKupHysB.iPt2MoKomp.x iKupHysB.iPt2MoKomp.xp iKupHysB.i_eds iKupHysB.i_umkehr iKupHysB.i_umkehr_alt iKupHysB.ig_eds iKupHysB.ig_wechsel_erkannt iKupHysB.io_stg iKupHysB.k_kf_out iKupHysB.k_rampe_out iKupHysB.mo_kpl iKupHysB.p_abssoll iKupHysB.p_umkehr iKupHysB.p_umkehr_alt iKupHysB.pg_abssoll iKupHysB.pg_wechsel_erkannt iKupHysB.pg_wirk iKupHysB.po_kpl iKupHysB.po_vhyskomp iKupHysB.po_wirk iKupHysB.trajekfort_kpl iKupHysB.trajekfort_stg iKupHysB.z_rampe iKupHysC.f_ig_eds iKupHysC.f_pg_abssoll iKupHysC.iDt1IEds.Pt1Si16.x iKupHysC.iDt1IEds.xp iKupHysC.iDt1PAbssoll.Pt1Fl32.x iKupHysC.iDt1PAbssoll.xp iKupHysC.iDt1Verz.Pt1Fl32.x iKupHysC.iDt1Verz.xp iKupHysC.iPt2IoKomp.x iKupHysC.iPt2IoKomp.xp iKupHysC.iPt2MoKomp.x iKupHysC.iPt2MoKomp.xp iKupHysC.i_eds iKupHysC.i_umkehr iKupHysC.i_umkehr_alt iKupHysC.ig_eds iKupHysC.ig_wechsel_erkannt iKupHysC.io_stg iKupHysC.k_kf_out iKupHysC.k_rampe_out iKupHysC.mo_kpl iKupHysC.p_abssoll iKupHysC.p_umkehr iKupHysC.p_umkehr_alt iKupHysC.pg_abssoll iKupHysC.pg_wechsel_erkannt iKupHysC.pg_wirk iKupHysC.po_kpl iKupHysC.po_vhyskomp iKupHysC.po_wirk iKupHysC.trajekfort_kpl iKupHysC.trajekfort_stg iKupHysC.z_rampe iKupHysD.f_ig_eds iKupHysD.f_pg_abssoll iKupHysD.iDt1IEds.Pt1Si16.x iKupHysD.iDt1IEds.xp iKupHysD.iDt1PAbssoll.Pt1Fl32.x iKupHysD.iDt1PAbssoll.xp iKupHysD.iDt1Verz.Pt1Fl32.x iKupHysD.iDt1Verz.xp iKupHysD.iPt2IoKomp.x iKupHysD.iPt2IoKomp.xp iKupHysD.iPt2MoKomp.x iKupHysD.iPt2MoKomp.xp iKupHysD.i_eds iKupHysD.i_umkehr iKupHysD.i_umkehr_alt iKupHysD.ig_eds iKupHysD.ig_wechsel_erkannt iKupHysD.io_stg iKupHysD.k_kf_out iKupHysD.k_rampe_out iKupHysD.mo_kpl iKupHysD.p_abssoll iKupHysD.p_umkehr iKupHysD.p_umkehr_alt iKupHysD.pg_abssoll iKupHysD.pg_wechsel_erkannt iKupHysD.pg_wirk iKupHysD.po_kpl iKupHysD.po_vhyskomp iKupHysD.po_wirk iKupHysD.trajekfort_kpl iKupHysD.trajekfort_stg iKupHysD.z_rampe iKupHysE.f_ig_eds iKupHysE.f_pg_abssoll iKupHysE.iDt1IEds.Pt1Si16.x iKupHysE.iDt1IEds.xp iKupHysE.iDt1PAbssoll.Pt1Fl32.x iKupHysE.iDt1PAbssoll.xp iKupHysE.iDt1Verz.Pt1Fl32.x iKupHysE.iDt1Verz.xp iKupHysE.iPt2IoKomp.x iKupHysE.iPt2IoKomp.xp iKupHysE.iPt2MoKomp.x iKupHysE.iPt2MoKomp.xp iKupHysE.i_eds iKupHysE.i_umkehr iKupHysE.i_umkehr_alt iKupHysE.ig_eds iKupHysE.ig_wechsel_erkannt iKupHysE.io_stg iKupHysE.k_kf_out iKupHysE.k_rampe_out iKupHysE.mo_kpl iKupHysE.p_abssoll iKupHysE.p_umkehr iKupHysE.p_umkehr_alt iKupHysE.pg_abssoll iKupHysE.pg_wechsel_erkannt iKupHysE.pg_wirk iKupHysE.po_kpl iKupHysE.po_vhyskomp iKupHysE.po_wirk iKupHysE.trajekfort_kpl iKupHysE.trajekfort_stg iKupHysE.z_rampe iKupHysK0.f_ig_eds iKupHysK0.f_pg_abssoll iKupHysK0.iDt1IEds.Pt1Si16.x iKupHysK0.iDt1IEds.xp iKupHysK0.iDt1PAbssoll.Pt1Fl32.x iKupHysK0.iDt1PAbssoll.xp iKupHysK0.iDt1Verz.Pt1Fl32.x iKupHysK0.iDt1Verz.xp iKupHysK0.iPt2IoKomp.x iKupHysK0.iPt2IoKomp.xp iKupHysK0.iPt2MoKomp.x iKupHysK0.iPt2MoKomp.xp iKupHysK0.i_eds iKupHysK0.i_umkehr iKupHysK0.i_umkehr_alt iKupHysK0.ig_eds iKupHysK0.ig_wechsel_erkannt iKupHysK0.io_stg iKupHysK0.k_kf_out iKupHysK0.k_rampe_out iKupHysK0.mo_kpl iKupHysK0.p_abssoll iKupHysK0.p_umkehr iKupHysK0.p_umkehr_alt iKupHysK0.pg_abssoll iKupHysK0.pg_wechsel_erkannt iKupHysK0.pg_wirk iKupHysK0.po_kpl iKupHysK0.po_vhyskomp iKupHysK0.po_wirk iKupHysK0.trajekfort_kpl iKupHysK0.trajekfort_stg iKupHysK0.z_rampe iKupK0.cModPVorg._.f_anst_statisch iKupK0.cModPVorg._.f_druck_vorgegeben iKupK0.cModPVorg._.fktn_druckvorgabe iKupK0.cModPVorg._.p_abssoll iKupK0.cModPVorg._.p_abssoll_sys iKupK0.cModPVorg._.p_vorgabe iKupK0.cModPVorg._.typ_druckvorgabe iKupK0.drehzahl iKupK0.f_deakt_dither_sf iKupK0.f_erste_bef iKupK0.f_erste_bef_aus_sb iKupK0.f_fuellopt iKupK0.f_fuellred iKupK0.f_geschlossen iKupK0.f_kolben_anlegen iKupK0.f_pfmin_ga_aktiv iKupK0.f_sf_ausgabe_aktiv iKupK0.f_sf_vorhanden iKupK0.f_strom_pre_puls_erf iKupK0.f_stromrampe_kab iKupK0.f_stromschl_angefordert iKupK0.kolben_pos iKupK0.kolben_posbas iKupK0.kpl_inaktiv iKupK0.kup_index_spsas iKupK0.kup_schaltart_sas iKupK0.kv_nummer iKupK0.n_kup_zbeg iKupK0.p_absist iKupK0.p_bedarf iKupK0.p_filter.fl_filter.x iKupK0.p_filter.letzter_ms_timer iKupK0.p_fmin iKupK0.t0_sf iKupK0.t_kpl_aktiv.timer iKupK0.t_kpl_inaktiv.timer iKupK0.t_lauf_entleer iKupK0.t_lauf_fuell iKupK0.timer_kolbenpos_kor iKupK0.timer_sas_ende_mit_pmax.timer iKupK0.to_sf_ada iKupK0.totzeit iKupK0.totzeit_abgelaufen.timer iKupK0.z_pfad_cgt_adaklasse iKupK0.zustand iKupK0.zustandstimer.timer iModKupSfktK0.befuellgrad_k0 iModKupSfktK0.pgo_sf_rampe.cBibRampeGradSi16._.letzter_ms_timer iModKupSfktK0.pgo_sf_rampe.cBibRampeGradSi16._.letzter_wert iModKupSfktK0.pgo_sf_rampe.cBibRampeGradSi16._.maximum iModKupSfktK0.pgo_sf_rampe.cBibRampeGradSi16._.minimum iPAnzeige.befuellung_schaltelement_aktiv iPAnzeige.kzu_beob_kup_ada iPAnzeige.p_abs_gsk iPAnzeige.p_abs_kab iPAnzeige.p_abs_kzu_puls iPAnzeige.p_abs_v2kab iPAnzeige.p_abs_v2kzu iPAnzeige.p_abs_vkab iPAnzeige.p_abs_vkzu iPAnzeige.po_fkup_ada iPAnzeige.to_sfkup_ada iPSystem.f_anst_statisch iPSystem.f_druck_vorgegeben iPSystem.fktn_druckvorgabe iPSystem.p_abssoll iPSystem.p_abssoll_sys iPSystem.p_vorgabe iPSystem.typ_druckvorgabe iPWk.f_anst_statisch iPWk.f_druck_vorgegeben iPWk.fktn_druckvorgabe iPWk.p_abssoll iPWk.p_abssoll_sys iPWk.p_vorgabe iPWk.typ_druckvorgabe /end LOC_MEASUREMENT
/end FUNCTION
/begin FUNCTION HYD_NACHBILDUNG "Hydrauliknachbildung"
 /begin LOC_MEASUREMENT iModHydlg.err_v_nr_abgldat iModHydlg.status_pruef_abgldat iModHydlg.version_abgleichdaten iModHydlg.vnr_abgldat_im_boot iModHydlg.zugriff_abgleichdaten /end LOC_MEASUREMENT
/end FUNCTION
/begin FUNCTION HYD_EDS_NACHBILDUNG "Dieses Paket beinhaltet die Stromberechnungen für die Ausgaenge"
 /begin LOC_MEASUREMENT iEdsK0.cHydEdsBase._.i_eds iEdsK0.cHydEdsBase._.i_eds_komp iEdsK0.iTimerZRampe.timer iEdsK0.z_rampe_kab iEdsKupA.cHydEdsBase._.i_eds iEdsKupA.cHydEdsBase._.i_eds_komp iEdsKupA.iTimerZRampe.timer iEdsKupA.z_rampe_kab iEdsKupB.cHydEdsBase._.i_eds iEdsKupB.cHydEdsBase._.i_eds_komp iEdsKupB.iTimerZRampe.timer iEdsKupB.z_rampe_kab iEdsKupC.cHydEdsBase._.i_eds iEdsKupC.cHydEdsBase._.i_eds_komp iEdsKupC.iTimerZRampe.timer iEdsKupC.z_rampe_kab iEdsKupD.cHydEdsBase._.i_eds iEdsKupD.cHydEdsBase._.i_eds_komp iEdsKupD.iTimerZRampe.timer iEdsKupD.z_rampe_kab iEdsKupE.cHydEdsBase._.i_eds iEdsKupE.cHydEdsBase._.i_eds_komp iEdsKupE.iTimerZRampe.timer iEdsKupE.z_rampe_kab iEdsMvPZyl.cHydEdsBase._.i_eds iEdsMvPZyl.cHydEdsBase._.i_eds_komp iEdsPSys.cHydEdsBase._.i_eds iEdsPSys.cHydEdsBase._.i_eds_komp iEdsPos.cHydEdsBase._.i_eds iEdsPos.cHydEdsBase._.i_eds_komp iEdsPos.timer_iedsofpsv.timer iEdsPos.typ_ansteuerung /end LOC_MEASUREMENT
/end FUNCTION
/begin FUNCTION ADA "Das Paket ADA enthält alle Klassen und Funktionalitäten, welche für die Adaption von Getriebedaten notwendig sind." /begin SUB_FUNCTION ADA_KUP ADA_SAS ADA_GLOBAL ADA_IAE /end SUB_FUNCTION /end FUNCTION
/begin FUNCTION ADA_KUP "In ADA_KUP sind kupplungsbezogene Adaptionsfunktionen enthalten" /begin SUB_FUNCTION ADA_GLOKU ADA_PULS ADA_PFUSF ADA_STADA ADA_URLUFT /end SUB_FUNCTION /end FUNCTION
/begin FUNCTION ADA_GLOKU "In ADA_GLOKU sind globale Kupplungsfunktionen zur Adaption enthalten"
 /begin LOC_MEASUREMENT iAdaGloku.index_startada_pf iAdaGloku.kup_beeinfluss_ada_delta_wert iAdaGloku.kup_beeinfluss_ada_typ iAdaGloku.kup_beeinfluss_d_ada_wert iAdaGloku.pre_timer_lock iAdaGloku.pre_timer_max_lock iAdaGloku.puls_lock iAdaPstzs.iVerbotRedBef_stada.puls_verb_redbef iAdaPulzs.iVerbotRedBef_pfa.puls_verb_redbef iAdaPulzs.iVerbotRedBef_tsfa.puls_verb_redbef /end LOC_MEASUREMENT
/end FUNCTION
/begin FUNCTION ADA_PULS "In ADA_PULS sind alle Funktionen zur Pulsadaptionen enthalten"
 /begin LOC_MEASUREMENT iAdaPulKr.i_pulse_stop_req iAdaPulzs.ada_starttyp_pf iAdaPulzs.anz_kup_kalt iAdaPulzs.anz_kup_puls iAdaPulzs.anz_n_pruefschleife iAdaPulzs.anz_n_pruefzyklen iAdaPulzs.anz_n_pulsgrenz iAdaPulzs.anz_pf_adawert iAdaPulzs.anz_prueftyp iAdaPulzs.anz_pulsid iAdaPulzs.anz_tsf_adawert iAdaPulzs.anz_zwsp_pf iAdaPulzs.anz_zwsp_tsf iAdaPulzs.dki_start iAdaPulzs.druck_statisch iAdaPulzs.f_deak_daempfer iAdaPulzs.f_deak_daempfer_alt iAdaPulzs.f_in_gang_fertig iAdaPulzs.f_ndabbr_verletzt iAdaPulzs.f_nmotsoll_em iAdaPulzs.f_red_bef_kup iAdaPulzs.f_schubabschaltung_aktiv_start iAdaPulzs.f_startpruefung_aktiv iAdaPulzs.f_startpuls_nguete iAdaPulzs.iBew.amplitude_ss iAdaPulzs.iBew.f_start_t_sperrt_nach_reak iAdaPulzs.iBew.iFensterNeg.f_aktiv iAdaPulzs.iBew.iFensterNeg.f_beenden iAdaPulzs.iBew.iFensterNeg.f_starten iAdaPulzs.iBew.iFensterNeg.iTimerBeenden.timer iAdaPulzs.iBew.iFensterNeg.iTimerStarten.timer iAdaPulzs.iBew.iFensterPos.f_aktiv iAdaPulzs.iBew.iFensterPos.f_beenden iAdaPulzs.iBew.iFensterPos.f_starten iAdaPulzs.iBew.iFensterPos.iTimerBeenden.timer iAdaPulzs.iBew.iFensterPos.iTimerStarten.timer iAdaPulzs.iBew.iTimerAmp.timer iAdaPulzs.iBew.max_adawert iAdaPulzs.iBew.n_guete_min iAdaPulzs.iBew.nd_pulsamp iAdaPulzs.iBew.nd_pulsneg iAdaPulzs.iBew.nd_pulspos iAdaPulzs.iBew.nd_pulszwneg iAdaPulzs.iBew.nd_pulszwpos iAdaPulzs.iBew.neg_rea iAdaPulzs.iBew.pos_rea iAdaPulzs.iBew.rea_amplitude iAdaPulzs.iBew.testresultat iAdaPulzs.iBew.zeit_erk_amp iAdaPulzs.iBew.zustand iAdaPulzs.iHsv.hs_verzoegerung iAdaPulzs.iHsv.iAbbruch.timer iAdaPulzs.iHsv.t_bis_puls iAdaPulzs.iHsv.zustand iAdaPulzs.iPf.f_deakt_dither_ada iAdaPulzs.iPf.fenster_nach_sf iAdaPulzs.iPf.iZustandstimer.timer iAdaPulzs.iPf.t_fenster_nach_sf iAdaPulzs.iPf.zustand iAdaPulzs.iTSf.zustand iAdaPulzs.iTimerDeakDaempfer.timer iAdaPulzs.iTimerSpzNRea.timer iAdaPulzs.iVerbotRedBef_pfa.puls_verb_redbef iAdaPulzs.iVerbotRedBef_tsfa.puls_verb_redbef iAdaPulzs.iZustandstimer.timer iAdaPulzs.kup_puls iAdaPulzs.kup_puls_alt iAdaPulzs.kup_puls_neu iAdaPulzs.m_t_start iAdaPulzs.n_pruefschleife iAdaPulzs.n_pruefzyklen iAdaPulzs.n_pulsgrenz iAdaPulzs.p_pulsausgabe iAdaPulzs.prueftyp iAdaPulzs.prueftyp_alt iAdaPulzs.pruefung_kup_fertig iAdaPulzs.pulsid iAdaPulzs.pulszyklus_beenden iAdaPulzs.schnellfuellung_aktiv iAdaPulzs.startinfo_index iAdaPulzs.timer_fenster iAdaPulzs.z_pfad_cgt_adkl_kup_puls iAdaPulzs.zeit_sf_1ms iAdaPulzs.zustand iAdaPulzs.zwsp_pf iAdaPulzs.zwsp_tsf /end LOC_MEASUREMENT
/end FUNCTION
/end MODULE
/end PROJECT
