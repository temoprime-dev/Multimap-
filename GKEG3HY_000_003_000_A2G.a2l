ASAP2_VERSION 1 51
/begin PROJECT _929_929 "Gen2_BMW_System_Supplier_Lib"
/begin HEADER "" VERSION "C_03_03" PROJECT_NO _929_929 /end HEADER
/begin MODULE DIM ""
/begin MOD_COMMON "" BYTE_ORDER MSB_FIRST ALIGNMENT_BYTE 1 ALIGNMENT_WORD 2 ALIGNMENT_LONG 4 ALIGNMENT_FLOAT32_IEEE 4 /end MOD_COMMON
/begin CHARACTERISTIC sK0SollPrio.CS_MINREG_K0 "Untere Temperaturschwelle zum Regelnverbot bei Kaelte K0" VALUE 0x21808C Parameter.ui8_S6_S3 255 UMRM_GRADC__1_1_M40_S6_S3 -40 215 /end CHARACTERISTIC
/begin CHARACTERISTIC sK0SollPrio.CO_MINREG_K0 "Temperaturoffset zum Aufheben Regelnverbot bei Kaelte K0" VALUE 0x21808A Parameter.ui8_S6_S3 214 UMRM_GRADC__1_1_0_S6_S3 1 215 /end CHARACTERISTIC
/begin CHARACTERISTIC sK0SollPrio.CS_MAXREG_K0 "Obere Temperaturschwelle zum Regelnverbot bei zu hoher Getriebesumpftemperatur" VALUE 0x21808B Parameter.ui8_S6_S3 255 UMRM_GRADC__1_1_M40_S6_S3 -40 215 /end CHARACTERISTIC
/begin CHARACTERISTIC sK0SollPrio.CO_MAXREG_K0 "Temperaturoffset zum Aufheben Regelnverbot bei zu hoher Getriebesumpftemperatur" VALUE 0x218089 Parameter.ui8_S6_S3 214 UMRM_GRADC__1_1_0_S6_S3 1 215 /end CHARACTERISTIC
/begin CHARACTERISTIC sK0SollPrio.TAB_SOLLGEPR_K0 "Tabelle zur Anpassung des K0 Sollzustands vor Priorisierung" CURVE 0x218096 Table.ui8_S6_S3 5 eK0Soll_S6_S3 0 5
 /begin AXIS_DESCR FIX_AXIS NO_INPUT_QUANTITY eK0Soll_S6_S3 6 0 5 FIX_AXIS_PAR_DIST 0 1 6 /end AXIS_DESCR
/end CHARACTERISTIC
/begin CHARACTERISTIC sK0SollPrio.TAB_REGKUPSTATUSIAE_K0 "Tabelle zum Schliessen der K0 in Abhaengigkeit vom IAE Status" CURVE 0x21808D Table.ui8_S6_S3 1 eBool_true_false_S6_S3 0 1
 /begin AXIS_DESCR FIX_AXIS NO_INPUT_QUANTITY eKupStatusIae_S6_S3 9 0 8 FIX_AXIS_PAR_DIST 0 1 9 /end AXIS_DESCR
/end CHARACTERISTIC
/begin CHARACTERISTIC sK0SollPrio.TAB_SWIGESTGES_K0_SP "Label fuer Spontanitaetsindex zur Vermeidung geregeltes Schliessen" CURVE 0x21809C Table.ui8_S6_S3 1 eBool_on_off_S6_S3 0 1
 /begin AXIS_DESCR FIX_AXIS NO_INPUT_QUANTITY eIndexSpSps_S6_S3 100 0 99 FIX_AXIS_PAR_DIST 0 1 100 /end AXIS_DESCR
/end CHARACTERISTIC
/begin CHARACTERISTIC sK0SollPrio.TAB_SWISCHALTUNGDIREKT_K0 "Schalter fuer Schaltungen ohne Schlupf (nur in GESCHLOSSEN moeglich)" MAP 0x218100 Matrix.ui8_S6_S3 1 eBool_true_false_S6_S3 0 1
 /begin AXIS_DESCR FIX_AXIS NO_INPUT_QUANTITY eSchaltungsIdx_S6_S3 5 0 4 FIX_AXIS_PAR_DIST 0 1 5 /end AXIS_DESCR
 /begin AXIS_DESCR FIX_AXIS NO_INPUT_QUANTITY eBool_zug_schub_S6_S3 2 0 1 FIX_AXIS_PAR_DIST 0 1 2 /end AXIS_DESCR
/end CHARACTERISTIC
/begin CHARACTERISTIC sK0Stat.NDS_K0ZU_PLAUSI "Differenzdrehzahlschwelle fuer anzeige ko_ist geschlossen" VALUE 0x216361 Parameter.ui8_S6_S3 255 UMRM_U_MIN_1_1_0_S6_S3 0 255 /end CHARACTERISTIC
/begin CHARACTERISTIC sK0Stat.MS_OFFEN_K0 "Momentenschwelle fuer Offen Anzeige" VALUE 0x216360 Parameter.ui8_S6_S3 255 UMRM_NM__1_1_0_S6_S3 0 255 /end CHARACTERISTIC
/begin CHARACTERISTIC sK0Stat.TAB_STATUS_K0 "Tabelle zur Bestimmung von k0_ist aus z_k0" CURVE 0x216362 Table.ui8_S6_S3 5 eK0Ist_S6_S3 0 5
 /begin AXIS_DESCR FIX_AXIS sK0Zust.z_k0 eK0Zust_S6_S3 13 0 12 FIX_AXIS_PAR_DIST 0 1 13 /end AXIS_DESCR
/end CHARACTERISTIC
/begin CHARACTERISTIC sK0Stat.TAB_ZK0_ZUL_APERK "Waehrend der IaeAP-Ada zulaessige K0 Zustaende" CURVE 0x21636F Table.ui8_S6_S3 1 eBool_true_false_S6_S3 0 1
 /begin AXIS_DESCR FIX_AXIS sK0Stat.k0_ist eK0Ist_S6_S3 6 0 5 FIX_AXIS_PAR_DIST 0 1 6 /end AXIS_DESCR
/end CHARACTERISTIC
/begin CHARACTERISTIC sK0Stat.TAB_MVG_KLASSE_K0 "TAB8x8 f(TAB_MVG_NDK0, TAB_MVG_MISTK0): K0 Belastungsklassen" MAP 0x216375 Matrix.ui8_S6_S3 255 UMRM___1_1_0_S6_S3 0 255 READ_ONLY
 /begin AXIS_DESCR FIX_AXIS NO_INPUT_QUANTITY eMVG_S6_S3 8 0 7 FIX_AXIS_PAR_DIST 0 1 8 /end AXIS_DESCR
 /begin AXIS_DESCR FIX_AXIS NO_INPUT_QUANTITY eMVG_S6_S3 8 0 7 FIX_AXIS_PAR_DIST 0 1 8 /end AXIS_DESCR
/end CHARACTERISTIC
/begin CHARACTERISTIC sK0Stat.KL_MIST_SCHLEPP_K0 "Kennlinie zum Vertrimmen des K0-Schleppmoments" CURVE 0x216350 Curve.ui16.ui16_S6_S3 1 UMRM___1_100_0_S6_S3 0 1
 /begin AXIS_DESCR STD_AXIS sK0Signa.nd_k0_abs UMRM_U_MIN_1_1_0_S6_S3 4 0 3000 DEPOSIT ABSOLUTE MONOTONY STRICT_INCREASE /end AXIS_DESCR
/end CHARACTERISTIC
/begin CHARACTERISTIC sK0Stat.KF_T_POIST_K0 "" MAP 0x216274 Map.fl32.fl32.fl32_S6_S3 2E+037 UMRM___1_1_0_S6_S3 -1E+037 1E+037 FORMAT "%5.3"
 /begin AXIS_DESCR STD_AXIS sK0Stat.po_ist_k0 UMRM_BAR__1_1_0_S6_S3 6 0 12 DEPOSIT ABSOLUTE MONOTONY STRICT_INCREASE FORMAT "%5.3" /end AXIS_DESCR
 /begin AXIS_DESCR STD_AXIS NO_INPUT_QUANTITY UMRM_GRADC__1_1_0_S6_S3 6 -270 5000 DEPOSIT ABSOLUTE MONOTONY STRICT_INCREASE FORMAT "%5.3" /end AXIS_DESCR
/end CHARACTERISTIC
/begin CHARACTERISTIC sK0Stat.KF_D_POIST_K0 "" MAP 0x2161B4 Map.fl32.fl32.fl32_S6_S3 2E+037 UMRM___1_1_0_S6_S3 -1E+037 1E+037 FORMAT "%5.3"
 /begin AXIS_DESCR STD_AXIS sK0Stat.po_ist_k0 UMRM_BAR__1_1_0_S6_S3 6 0 12 DEPOSIT ABSOLUTE MONOTONY STRICT_INCREASE FORMAT "%5.3" /end AXIS_DESCR
 /begin AXIS_DESCR STD_AXIS NO_INPUT_QUANTITY UMRM_GRADC__1_1_0_S6_S3 6 -270 5000 DEPOSIT ABSOLUTE MONOTONY STRICT_INCREASE FORMAT "%5.3" /end AXIS_DESCR
/end CHARACTERISTIC
/begin CHARACTERISTIC sK0Stat.TAB_MVG_NDK0 "KLAS7 f(nd_k0_abs): Klassifizierung MVG Belastung nd_k0_abs" CURVE 0x216342 Classification.ui16_S6_S3 65535 UMRM_U_MIN_1_1_0_S6_S3 0 65535
 /begin AXIS_DESCR FIX_AXIS NO_INPUT_QUANTITY __DATAFIELD_NO_FORMULA___S6_S3 7 0 6 FIX_AXIS_PAR_DIST 0 1 7 /end AXIS_DESCR
/end CHARACTERISTIC
/begin CHARACTERISTIC sK0Stat.TAB_MVG_MISTK0 "KLAS7 f(m_ist_k0): Klassifizierung MVG Belastung m_ist_k0" CURVE 0x216334 Classification.si16_S6_S3 65535 UMRM_NM__1_1_0_S6_S3 -32768 32767
 /begin AXIS_DESCR FIX_AXIS NO_INPUT_QUANTITY __DATAFIELD_NO_FORMULA___S6_S3 7 0 6 FIX_AXIS_PAR_DIST 0 1 7 /end AXIS_DESCR
/end CHARACTERISTIC
/begin CHARACTERISTIC sK0TempM.CO_CGETRTEMPMOD_K0 "Korrekturoffset fuer Getriebesumpftemperatur c_getriebe im K0 Temperaturmodell" VALUE 0x2163B8 Parameter.fl32_S6_S3 100 UMRM_GRADC__1_1_0_S6_S3 -50 50 FORMAT "%5.3" /end CHARACTERISTIC
/begin CHARACTERISTIC sK0TempM.F_K0_VERLUST "Faktor zur Gewichtung der Reibleistung, um diese auf die Lamelle zu beziehen" VALUE 0x2163BC Parameter.fl32_S6_S3 1 UMRM___1_1_0_S6_S3 0 1 FORMAT "%5.3" /end CHARACTERISTIC
/begin CHARACTERISTIC sK0TempM.F_RHO_CP_OEL "Produkt der spezifischen Waermekapazitaet und der Getriebeoeldichte in J/l*K" VALUE 0x2163C0 Parameter.fl32_S6_S3 3900 UMRM___1_1_0_S6_S3 100 4000 FORMAT "%5.3" /end CHARACTERISTIC
/begin CHARACTERISTIC sK0TempM.F_WAERMEKAP_BELAG_K0 "Waermekapazitaet des K0-Reibbelags" VALUE 0x2163C4 Parameter.fl32_S6_S3 99.9 UMRM___1_1_0_S6_S3 0.1 100 FORMAT "%5.3" /end CHARACTERISTIC
/begin CHARACTERISTIC sK0TempM.F_WAERMEKAP_OEALAUS_K0 "Ersatzwaermekapazitaet des K0 Kuehloels zur Abbildung Zeitverhalten" VALUE 0x2163C8 Parameter.fl32_S6_S3 100000 UMRM___1_1_0_S6_S3 0.01 100000 FORMAT "%5.3" /end CHARACTERISTIC
/begin CHARACTERISTIC sK0TempM.MPT_VPOEL_K0 "Filterzeitkonstante des PT1-Filters zur Berechnung das Kuehloelvolumenstroms K0" VALUE 0x2167A2 Parameter.ui8_S6_S3 0.99 UMRM___1_100_0_S6_S3 0.01 1 /end CHARACTERISTIC
/begin CHARACTERISTIC sK0TempM.PS_KUEHLUNGAKTIV_K0 "Einschaltschwelle der aktiven Kuehlung fuer die K0" VALUE 0x2167A0 Parameter.ui16_S6_S3 5 UMRM_BAR__1_1000_0_S6_S3 0 5 /end CHARACTERISTIC
/begin CHARACTERISTIC sK0TempM.K_FVPOELVERTKUEAUS_K0 "Verteilungsfaktor von Oelmenge Hybridantrieb zu Gesamtschmieroelmenge (ueber Schmierventil) bei ausgeschalteter Kuehlung der K0" VALUE 0x2163D0 Parameter.fl32_S6_S3 1 UMRM___1_1_0_S6_S3 0 1 FORMAT "%5.3" /end CHARACTERISTIC
/begin CHARACTERISTIC sK0TempM.K_FVPOELVERTKUEAN_K0 "Verteilungsfaktor von Oelmenge Hybridantrieb inkl. Kuehloelmenge K0 zu Gesamtschmieroelmenge (ueber Schmierventil) bei eingeschalteter Kuehlung der K0" VALUE 0x2163CC Parameter.fl32_S6_S3 1 UMRM___1_1_0_S6_S3 0 1 FORMAT "%5.3" /end CHARACTERISTIC
/begin CHARACTERISTIC sK0TempM.TAB_MVG_CBELK0 "TAB7 Klassengrenzen fuer K0 Belag-Temperatur MvG" CURVE 0x2163D4 Table.fl32_S6_S3 540 UMRM_GRADC__1_1_0_S6_S3 -40 500 FORMAT "%5.3"
 /begin AXIS_DESCR FIX_AXIS NO_INPUT_QUANTITY UMRM___1_1_0_S6_S3 7 0 6 FIX_AXIS_PAR_DIST 0 1 7 FORMAT "%5.3" /end AXIS_DESCR
/end CHARACTERISTIC
/begin CHARACTERISTIC sK0TempM.KL_VPSEKK0IAEMAX_K0 "Maxwert Gesamtschmieroelmenge(ueber Schmierventil) in Abhaengigkeit von p_sys. Damit wird die Druckbegrenzung des Schmierventils beruecksichtigt" CURVE 0x216450 Curve.fl32.fl32_S6_S3 30 UMRM_LITER_MIN_1_1_0_S6_S3 0 30 FORMAT "%5.3"
 /begin AXIS_DESCR STD_AXIS NO_INPUT_QUANTITY UMRM_BAR__1_1_0_S6_S3 3 0 30 DEPOSIT ABSOLUTE MONOTONY STRICT_INCREASE FORMAT "%5.3" /end AXIS_DESCR
/end CHARACTERISTIC
/begin CHARACTERISTIC sK0TempM.KL_FQBELAGKORRK0OFFEN_K0 "Korrekturfaktor auf q_belag_ab_k0 bei offener K0 zur Beruecksichtigung der unterschiedlichen Lamellentemperaturen sowie der abgegebenen Waermestroeme von den Lamellen an umliegende Bauteile (nicht ans Oel)" CURVE 0x216420 Curve.fl32.fl32_S6_S3 4 UMRM___1_1_0_S6_S3 0 4 FORMAT "%5.3"
 /begin AXIS_DESCR STD_AXIS sK0TempM.vp_oelgesamt_k0 UMRM_LITER_MIN_1_1_0_S6_S3 6 0 15 DEPOSIT ABSOLUTE MONOTONY STRICT_INCREASE FORMAT "%5.3" /end AXIS_DESCR
/end CHARACTERISTIC
/begin CHARACTERISTIC sK0TempM.KL_FQBELAGKORRK0GESCHL_K0 "Korrekturfaktor auf q_belag_ab_k0 bei angesteuerter K0 zur Beruecksichtigung der unterschiedlichen Lamellentemperaturen sowie der abgegebenen Waermestroeme von den Lamellen an umliegende Bauteile (nicht ans Oel)" CURVE 0x2163F0 Curve.fl32.fl32_S6_S3 4 UMRM___1_1_0_S6_S3 0 4 FORMAT "%5.3"
 /begin AXIS_DESCR STD_AXIS sK0TempM.vp_oelgesamt_k0 UMRM_LITER_MIN_1_1_0_S6_S3 6 0 15 DEPOSIT ABSOLUTE MONOTONY STRICT_INCREASE FORMAT "%5.3" /end AXIS_DESCR
/end CHARACTERISTIC
/begin CHARACTERISTIC sK0TempM.KF_MIST_SCHLEPP_K0 "" MAP 0x21672C Map.fl32.fl32.fl32_S6_S3 100 UMRM_U_MIN_1_1_0_S6_S3 0 100 FORMAT "%5.3"
 /begin AXIS_DESCR STD_AXIS NO_INPUT_QUANTITY UMRM_U_MIN_1_1_0_S6_S3 4 0 3000 DEPOSIT ABSOLUTE MONOTONY STRICT_INCREASE FORMAT "%5.3" /end AXIS_DESCR
 /begin AXIS_DESCR STD_AXIS sK0TempM.c_getr_korr_k0 UMRM_GRADC__1_1_0_S6_S3 5 -270 5000 DEPOSIT ABSOLUTE MONOTONY STRICT_INCREASE FORMAT "%5.3" /end AXIS_DESCR
/end CHARACTERISTIC
/begin CHARACTERISTIC sK0TempM.KF_ALPHA_BELAG_OFFEN_K0 "" MAP 0x216468 Map.fl32.fl32.fl32_S6_S3 100 UMRM_W_K_1_1_0_S6_S3 0 100 FORMAT "%5.3"
 /begin AXIS_DESCR STD_AXIS NO_INPUT_QUANTITY UMRM_U_MIN_1_1_0_S6_S3 9 -8128 8128 DEPOSIT ABSOLUTE MONOTONY STRICT_INCREASE FORMAT "%5.3" /end AXIS_DESCR
 /begin AXIS_DESCR STD_AXIS sK0TempM.vp_oelgesamt_k0 UMRM_LITER_MIN_1_1_0_S6_S3 7 -1500 1500 DEPOSIT ABSOLUTE MONOTONY STRICT_INCREASE FORMAT "%5.3" /end AXIS_DESCR
/end CHARACTERISTIC
/begin CHARACTERISTIC sK0TempM.KF_ALPHA_BELAG_REGELN_K0 "" MAP 0x2165A4 Map.fl32.fl32.fl32_S6_S3 100 UMRM_W_K_1_1_0_S6_S3 0 100 FORMAT "%5.3"
 /begin AXIS_DESCR STD_AXIS NO_INPUT_QUANTITY UMRM_U_MIN_1_1_0_S6_S3 10 -8128 8128 DEPOSIT ABSOLUTE MONOTONY STRICT_INCREASE FORMAT "%5.3" /end AXIS_DESCR
 /begin AXIS_DESCR STD_AXIS sK0TempM.vp_oelgesamt_k0 UMRM_LITER_MIN_1_1_0_S6_S3 8 -1500 1500 DEPOSIT ABSOLUTE MONOTONY STRICT_INCREASE FORMAT "%5.3" /end AXIS_DESCR
/end CHARACTERISTIC
/begin CHARACTERISTIC sK0Diag.SWI_DIAGTEMPERLAUBT_K0 "Diagnose KFC_C0HOT aktiv : SWI = 1: ja, SWI = 0: nein" VALUE 0x2167F8 Parameter.ui8_S6_S3 1 eBool_on_off_S6_S3 0 1 /end CHARACTERISTIC
/begin CHARACTERISTIC sK0Diag.SWI_DIAGAKTIV_K0 "Diagnose KFC_C0DEFEKT und KFC_C0DEFEKTHOT aktiv : SWI = 1: ja, SWI = 0: nein" VALUE 0x2167F7 Parameter.ui8_S6_S3 1 eBool_on_off_S6_S3 0 1 /end CHARACTERISTIC
/begin CHARACTERISTIC sK0Diag.SWI_SCHUTZ_K0 "K0-Schutzfunktion bei erreichter Stellgrenze aktiv : SWI = 1: ja, SWI = 0: nein" VALUE 0x2167F9 Parameter.ui8_S6_S3 1 eBool_on_off_S6_S3 0 1 /end CHARACTERISTIC
/begin CHARACTERISTIC sK0Diag.CS_BELAGDIAG_K0 "Temperaturschwelle Fehlerbedingung KFC_CODEFEKTHOT" VALUE 0x2167A4 Parameter.fl32_S6_S3 5270 UMRM_GRADC__1_1_0_S6_S3 -270 5000 FORMAT "%5.3" /end CHARACTERISTIC
/begin CHARACTERISTIC sK0Diag.CS_BELAGOG_K0 "Temperaturschwelle Fehlerbedingung KFC_COHOT und KFC_C0SYNCHOT" VALUE 0x2167A8 Parameter.fl32_S6_S3 5270 UMRM_GRADC__1_1_0_S6_S3 -270 5000 FORMAT "%5.3" /end CHARACTERISTIC
/begin CHARACTERISTIC sK0Diag.CS_BELAGHYS_K0 "Hysterese Temperaturschwelle Rueckfilterung KFC_COHOT und KFC_C0SYNCHOT" VALUE 0x2167F6 Parameter.ui8_S6_S3 255 UMRM_GRADC__1_1_0_S6_S3 0 255 /end CHARACTERISTIC
/begin CHARACTERISTIC sK0Diag.PS_PSOLLDIAG_K0 "Mindestsolldruckschwelle p_k0_soll zur Aktivierung der Diagnosefunktion K0 zur Ueberpruefung eines mechanischen Defekts" VALUE 0x2167E4 Parameter.ui16_S6_S3 65.535 UMRM_BAR__1_1000_0_S6_S3 0 65.535 /end CHARACTERISTIC
/begin CHARACTERISTIC sK0Diag.MS_MVMISTDIAG_K0 "Schwelle Verbrennungsmotoristmoment m_vmist_sync_k0 zur Aktivierung der Diagnosefunktion K0 zur ueberpruefung eines mechanischen Defekts" VALUE 0x2167DE Parameter.ui16_S6_S3 1000 UMRM_NM__1_1_0_S6_S3 0 1000 /end CHARACTERISTIC
/begin CHARACTERISTIC sK0Diag.NDS_SCHUTZEINSTIEG_K0 "Spezifikation folgt" VALUE 0x2167E2 Parameter.ui16_S6_S3 3000 UMRM_U_MIN_1_1_0_S6_S3 0 3000 /end CHARACTERISTIC
/begin CHARACTERISTIC sK0Diag.WND_SCHUTZ_K0 "Schlupfabweichungsoffset" VALUE 0x2167FA Parameter.ui8_S6_S3 255 UMRM_U_MIN_1_1_0_S6_S3 0 255 /end CHARACTERISTIC
/begin CHARACTERISTIC sK0Diag.MS_ME_MAXSCHUTZ_K0 "Maximales Moment waehrend aktiver Schutzfunktion" VALUE 0x2167DC Parameter.ui16_S6_S3 500 UMRM_NM__1_1_0_S6_S3 0 500 /end CHARACTERISTIC
/begin CHARACTERISTIC sK0Diag.MS_SCHUTZENDE_K0 "Momentenschwelle zum Austieg aus der Schutzfunktion" VALUE 0x2167E0 Parameter.ui16_S6_S3 500 UMRM_NM__1_1_0_S6_S3 0 500 /end CHARACTERISTIC
/begin CHARACTERISTIC sK0Diag.TAB_KI_SCHUTZ_K0 "Dynamik des I-Reglers bei aktiver K0-Schutzfunktion/Schlupfnachfuehrung" CURVE 0x2167AC Table.fl32_S6_S3 2E+037 UMRM___1_1_0_S6_S3 -1E+037 1E+037 FORMAT "%5.3"
 /begin AXIS_DESCR FIX_AXIS NO_INPUT_QUANTITY eBool_true_false_S6_S3 2 0 1 FIX_AXIS_PAR_DIST 0 1 2 /end AXIS_DESCR
/end CHARACTERISTIC
/begin CHARACTERISTIC sK0Diag.KL_CSBELAGSYNC_K0 "Belagtemperaturschwelle fuer Setzen/Ruecksetzen GET_ST_C0_ENERGY_BAL Bit1." CURVE 0x2167B4 Curve.fl32.fl32_S6_S3 500 UMRM_GRADC__1_1_0_S6_S3 0 500 FORMAT "%5.3"
 /begin AXIS_DESCR STD_AXIS sK0TempM.grad_c_belag_k0 UMRM_GRADC_SEC_1_1_0_S6_S3 5 -1E+037 1E+037 DEPOSIT ABSOLUTE MONOTONY STRICT_INCREASE FORMAT "%5.3" /end AXIS_DESCR
/end CHARACTERISTIC
/begin CHARACTERISTIC sK0Diag.KL_NDSK0DEFEKTREG1_K0 "Schwelle fuer max. zulaessige Regelabweichung xd" CURVE 0x2167E6 Curve.si16.si16_S6_S3 2000 UMRM_NM__1_1_0_S6_S3 -1000 1000
 /begin AXIS_DESCR STD_AXIS sK0Signa.m_vmist_sync_k0 UMRM_NM__1_1_0_S6_S3 2 -1500 1500 DEPOSIT ABSOLUTE MONOTONY STRICT_INCREASE /end AXIS_DESCR
/end CHARACTERISTIC
/begin CHARACTERISTIC sK0Diag.KL_NDSK0DEFEKTREG2_K0 "Differenzdrehzahlschwelle 2 zur Ueberpruefung eines mechanischen Defekts der K0 im Regelbetrieb" CURVE 0x2167EE Curve.si16.si16_S6_S3 2000 UMRM_NM__1_1_0_S6_S3 -1000 1000
 /begin AXIS_DESCR STD_AXIS sK0Signa.m_vmist_sync_k0 UMRM_NM__1_1_0_S6_S3 2 -1500 1500 DEPOSIT ABSOLUTE MONOTONY STRICT_INCREASE /end AXIS_DESCR
/end CHARACTERISTIC
/begin CHARACTERISTIC sK0Zust.SWI_MANUELL_K0 "Erster Schalter von zwei um die manuelle Druckvorgabe zu aktivieren" VALUE 0x218552 Parameter.ui8_S6_S3 1 eBool_on_off_S6_S3 0 1 /end CHARACTERISTIC
/begin CHARACTERISTIC sK0Zust.SWI_MANUELL_SEK_K0 "Zweiter Schalter von zwei um die manuelle Druckvorgabe zu aktivieren" VALUE 0x218553 Parameter.ui8_S6_S3 1 eBool_on_off_S6_S3 0 1 /end CHARACTERISTIC
/begin CHARACTERISTIC sK0Zust.SWI_SGSCHLIESSGEST_K0 "Aktivierung Ausstieg aus Schlupfregelung ueber Momentenrampen, sonst Schliessen ueber Regler" VALUE 0x218554 Parameter.ui8_S6_S3 1 eBool_on_off_S6_S3 0 1 /end CHARACTERISTIC
/begin CHARACTERISTIC sK0Zust.NDS_K0ZU "Differenzdrehzahlschwelle zum Erkennen Synchron" VALUE 0x218551 Parameter.ui8_S6_S3 255 UMRM_U_MIN_1_1_0_S6_S3 0 255 /end CHARACTERISTIC
/begin CHARACTERISTIC sK0Zust.NDS_GERGESZU_K0 "Differenzdrehzahlschwelle Uebergang GergeltGeschlossen nach Schliessen" VALUE 0x21854F Parameter.ui8_S6_S3 255 UMRM_U_MIN_1_1_0_S6_S3 0 255 /end CHARACTERISTIC
/begin CHARACTERISTIC sK0Zust.NDS_K0VMSTART "Differenzdrehzahlschwelle zum Erkennen Synchron bei Zustart bzw. Schleppstart" VALUE 0x218550 Parameter.ui8_S6_S3 255 UMRM_U_MIN_1_1_0_S6_S3 0 255 /end CHARACTERISTIC
/begin CHARACTERISTIC sK0Zust.MS_ANGELEGT_K0 "Momentenschwelle unter der die K0 als angelegt gilt" VALUE 0x21854E Parameter.ui8_S6_S3 255 UMRM_NM__1_1_0_S6_S3 0 255 /end CHARACTERISTIC
/begin CHARACTERISTIC sK0Zust.TAB_ANFORDERUNG_P_SYS_K0 "TAB13 f(sK0Zust.z_k0): Tabelle zur Zustandsabhaengigen K0-Anforderung zur Systemdruckanhebung" CURVE 0x218555 Table.ui8_S6_S3 1 eBool_true_false_S6_S3 0 1
 /begin AXIS_DESCR FIX_AXIS sK0Zust.z_k0 eK0Zust_S6_S3 13 0 12 FIX_AXIS_PAR_DIST 0 1 13 /end AXIS_DESCR
/end CHARACTERISTIC
/begin CHARACTERISTIC sK0Zust.TAB_T_ZUNACHREGELNMAX_K0 "TAB5x2 f(schaltung_anfahren_idx, sK0Signa.zs_zug_k0): Maxtimer fuer den Zustand ZUNACHREGELN" MAP 0x218522 Matrix.ui16_S6_S3 20000 UMRM_MSEC__10_1_0_S6_S3 0 20000
 /begin AXIS_DESCR FIX_AXIS NO_INPUT_QUANTITY eSchaltungsIdx_S6_S3 5 0 4 FIX_AXIS_PAR_DIST 0 1 5 /end AXIS_DESCR
 /begin AXIS_DESCR FIX_AXIS NO_INPUT_QUANTITY eBool_zug_schub_S6_S3 2 0 1 FIX_AXIS_PAR_DIST 0 1 2 /end AXIS_DESCR
/end CHARACTERISTIC
/begin CHARACTERISTIC sK0Zust.KL_MSZUREGSG_K0 "KL6 f(sK0Signa.m_vmist_sync_k0): Umschalten Zuregeln nach Schlupfgeregelt wenn mo_k0zu unterhalb der Schwelle" CURVE 0x218536 Curve.si16.ui16_S6_S3 1300 UMRM_NM__1_1_0_S6_S3 0 1300
 /begin AXIS_DESCR STD_AXIS sK0Signa.m_vmist_sync_k0 UMRM_NM__1_1_0_S6_S3 6 -200 1300 DEPOSIT ABSOLUTE MONOTONY STRICT_INCREASE /end AXIS_DESCR
/end CHARACTERISTIC
/begin CHARACTERISTIC sK0Zust.KL_TFC_K0 "KL9 f(c_getr): Fuellausgleichszeit" CURVE 0x218562 Curve.ui8.ui8_S6_S3 2550 UMRM_MSEC__10_1_0_S6_S3 0 2550
 /begin AXIS_DESCR STD_AXIS NO_INPUT_QUANTITY UMRM_GRADC__1_1_M40_S6_S3 9 -40 215 DEPOSIT ABSOLUTE MONOTONY STRICT_INCREASE /end AXIS_DESCR
/end CHARACTERISTIC
/begin CHARACTERISTIC sK0Zust.KL_TFC_K0_OPT "KL9 f(c_getr): optimierte Fuellausgleichszeit" CURVE 0x218574 Curve.ui8.ui8_S6_S3 2550 UMRM_MSEC__10_1_0_S6_S3 0 2550
 /begin AXIS_DESCR STD_AXIS NO_INPUT_QUANTITY UMRM_GRADC__1_1_M40_S6_S3 9 -40 215 DEPOSIT ABSOLUTE MONOTONY STRICT_INCREASE /end AXIS_DESCR
/end CHARACTERISTIC
/begin CHARACTERISTIC sK0Zust.KL_TFC_K0_RED "KL9 f(c_getr): reduzierte Fuellausgleichszeit" CURVE 0x218586 Curve.ui8.ui8_S6_S3 2550 UMRM_MSEC__10_1_0_S6_S3 0 2550
 /begin AXIS_DESCR STD_AXIS NO_INPUT_QUANTITY UMRM_GRADC__1_1_M40_S6_S3 9 -40 215 DEPOSIT ABSOLUTE MONOTONY STRICT_INCREASE /end AXIS_DESCR
/end CHARACTERISTIC
/begin CHARACTERISTIC TAB_SWI_NAGL "Switch f.Auswahl Eing.groesse Ausgleichsgerade 5=n_vm, 4=n_6, 3=n_mot, 2=Mittelwert, 1=n_t, 0=n_ab" CURVE 0x21E730 tab_ui8_S6_S3 5 UMR___1_1_0_S6_S3 0 5
 /begin AXIS_DESCR FIX_AXIS zff_atsys._.iSignale._.obj.sig_istgang UMR___1_1_0_S6_S3 10 -1 8 FIX_AXIS_PAR_DIST -1 1 10 /end AXIS_DESCR
/end CHARACTERISTIC
/begin CHARACTERISTIC SWI_STAGL_KUP "Switch f.Auswahl Eing.groesse Ausgleichsgerade 5=n_vm, 4=n_6, 3=n_mot, 2=Mittelwert, 1=n_t, 0=n_ab" VALUE 0x26E4BF kw_ui8_S6_S3 5 UMR___1_1_0_S6_S3 0 5 /end CHARACTERISTIC
/begin CHARACTERISTIC I_AGLAENGE "Laenge der Ausgleichsgeraden" VALUE 0x26E4C0 kw_ui8_S6_S3 68 UMR___1_1_0_S6_S3 3 71 /end CHARACTERISTIC
/begin CHARACTERISTIC I_AGEX "Extrapolierschritte in die Zukunft" VALUE 0x26E4C1 kw_ui8_S6_S3 16 UMR___1_1_0_S6_S3 0 16 /end CHARACTERISTIC
/begin CHARACTERISTIC FI_NADANEU "Filteranzahl n_ab & n_t neuer Wert" VALUE 0x26E4C2 kw_ui8_S6_S3 9 UMR___1_1_0_S6_S3 1 10 /end CHARACTERISTIC
/begin CHARACTERISTIC FI_NADAALT "Filteranzahl n_ab & n_t alter Wert" VALUE 0x26E4C3 kw_ui8_S6_S3 10 UMR___1_1_0_S6_S3 0 10 /end CHARACTERISTIC
/begin CHARACTERISTIC SWI_CK_SPSAS "Aktiviert die Erhöhung des Spontanitätsindex." VALUE 0x26E4B7 kw_ui8_S6_S3 3 UMR___1_1_0_S6_S3 0 3 /end CHARACTERISTIC
/begin CHARACTERISTIC SWI_CK_MMOTMAX "Aktiviert die Reduzierung des max. Motormoments." VALUE 0x26E4B8 kw_ui8_S6_S3 3 UMR___1_1_0_S6_S3 0 3 /end CHARACTERISTIC
/begin CHARACTERISTIC SWI_CK_KEINTIPP "Aktiviert das Verbieten von manuellen Schaltungen." VALUE 0x26E4B9 kw_ui8_S6_S3 3 UMR___1_1_0_S6_S3 0 3 /end CHARACTERISTIC
/begin CHARACTERISTIC SWI_CK_SCHALTVERH "Aktiviert das Verhindern von Schaltungen." VALUE 0x26E4BA kw_ui8_S6_S3 3 UMR___1_1_0_S6_S3 0 3 /end CHARACTERISTIC
/begin CHARACTERISTIC SWI_CK_SCHALTBEEIN "Aktiviert die Schaltungbeeinflussung." VALUE 0x26E4BB kw_ui8_S6_S3 3 UMR___1_1_0_S6_S3 0 3 /end CHARACTERISTIC
/begin CHARACTERISTIC SWI_MASS_CKMAX "Schalter zur auswahl ob Massnahme für die aktive Schaltung oder abhängig von Maxauswahl der Kupplungstemperaturausgeführt wird." VALUE 0x26E4BC kw_bool8_S6_S3 1 UMR___1_1_0_S6_S3 0 1 /end CHARACTERISTIC
/begin CHARACTERISTIC TAB_CS_KUPPL_1 "Temperaturschwelle 1 zur Aktivierung der zugeordneten Schutzmaßnahmen" CURVE 0x21E698 tab_si16_S6_S3 550 UMR_GRADC__1_1_0_S6_S3 0 550
 /begin AXIS_DESCR FIX_AXIS iTciCompu.k_zu UMR___1_1_0_S6_S3 5 1 5 FIX_AXIS_PAR_DIST 1 1 5 /end AXIS_DESCR
/end CHARACTERISTIC
/begin CHARACTERISTIC TAB_CS_KUPPL_2 "Temperaturschwelle 2 zur Aktivierung der zugeordneten Schutzmaßnahmen" CURVE 0x21E6A8 tab_si16_S6_S3 550 UMR_GRADC__1_1_0_S6_S3 0 550
 /begin AXIS_DESCR FIX_AXIS iTciCompu.k_zu UMR___1_1_0_S6_S3 5 1 5 FIX_AXIS_PAR_DIST 1 1 5 /end AXIS_DESCR
/end CHARACTERISTIC
/begin CHARACTERISTIC TAB_CS_KUPPL_3 "Temperaturschwelle 3 zur Aktivierung der zugeordneten Schutzmaßnahmen" CURVE 0x21E6B8 tab_si16_S6_S3 550 UMR_GRADC__1_1_0_S6_S3 0 550
 /begin AXIS_DESCR FIX_AXIS iTciCompu.k_zu UMR___1_1_0_S6_S3 5 1 5 FIX_AXIS_PAR_DIST 1 1 5 /end AXIS_DESCR
/end CHARACTERISTIC
/begin CHARACTERISTIC CS_KUPPLMAXSPSAS "Temperaturschwelle zur Aktivierung der Beeinflussung der Spontanitätsstufe über Maxauswahl der Kupplungstemperatur" VALUE 0x26D48E kw_si16_S6_S3 500 UMR_GRADC__1_1_0_S6_S3 0 500 /end CHARACTERISTIC
/begin CHARACTERISTIC HYS_CKUPPLMASS "Hysterese auf Temperaturschwellen für Schutzmaßnahmen bei der der Fehlereintrag wiede zurück genommen wird" VALUE 0x26E4BD kw_ui8_S6_S3 100 UMR_GRADC__1_1_0_S6_S3 0 100 /end CHARACTERISTIC
/begin CHARACTERISTIC HYS_CKUPPLMAXSPSAS "Hysterese auf Temperaturschwellen zur Aktivierung der Beeinflussung der Spontanitätsstufe über Maxauswahl der Kupplungstemperatur" VALUE 0x26E4BE kw_ui8_S6_S3 100 UMR_GRADC__1_1_0_S6_S3 0 100 /end CHARACTERISTIC
/begin CHARACTERISTIC T_VCKSCHALTVERH "Verzögerungszeit für Schaltungen für Kupplungschutz." VALUE 0x26D490 kw_ui16_S6_S3 50000 UMR_MSEC__10_1_0_S6_S3 0 50000 /end CHARACTERISTIC
/begin CHARACTERISTIC T_VCKKEINTIPP "Verzögerungszeit für manuelle Schaltung für Kupplungschutz." VALUE 0x26D492 kw_ui16_S6_S3 50000 UMR_MSEC__10_1_0_S6_S3 0 50000 /end CHARACTERISTIC
/begin CHARACTERISTIC TAB_SPSAS_DEF "Spontanitätsindex der bei der Massnahme Beeinflussung Spontanitätsindex gesetzt wird." CURVE 0x21E6C8 tab_ui8_S6_S3 2 UMR___1_1_0_S6_S3 0 2
 /begin AXIS_DESCR FIX_AXIS zff_atsys._.iSignale._.obj.sig_index_sp_sps UMR___1_1_0_S6_S3 100 0 99 FIX_AXIS_PAR_DIST 0 1 100 /end AXIS_DESCR
/end CHARACTERISTIC
/begin CHARACTERISTIC TAB_NSABVB "Tabelle n_ab-Schwelle fuer Momentenschutz Schaltverbot" MAP 0x21E0DC tab2d_ui16_S6_S3 8160 UMR_U_MIN_1_1_0_S6_S3 0 8160
 /begin AXIS_DESCR FIX_AXIS zff_atsys._.iSignale._.obj.sig_istgang UMR___1_1_0_S6_S3 10 -1 8 FIX_AXIS_PAR_DIST -1 1 10 /end AXIS_DESCR
 /begin AXIS_DESCR FIX_AXIS zff_atsys._.iSignale._.obj.sig_zielgang_sas UMR___1_1_0_S6_S3 10 -1 8 FIX_AXIS_PAR_DIST -1 1 10 /end AXIS_DESCR
/end CHARACTERISTIC
/begin CHARACTERISTIC TAB_MSTVB "Tabelle m_t-Schwelle fuer Momentenschutz Schaltverbot" MAP 0x21E1AC tab2d_si16_S6_S3 2040 UMR_NM__1_1_0_S6_S3 -400 1640
 /begin AXIS_DESCR FIX_AXIS zff_atsys._.iSignale._.obj.sig_istgang UMR___1_1_0_S6_S3 10 -1 8 FIX_AXIS_PAR_DIST -1 1 10 /end AXIS_DESCR
 /begin AXIS_DESCR FIX_AXIS zff_atsys._.iSignale._.obj.sig_zielgang_sas UMR___1_1_0_S6_S3 10 -1 8 FIX_AXIS_PAR_DIST -1 1 10 /end AXIS_DESCR
/end CHARACTERISTIC
/begin CHARACTERISTIC TAB_MSTVB_REKU "Tabelle untere m_t-Schwelle fuer Momentenschutz Schaltverbot" MAP 0x21E27C tab2d_si16_S6_S3 800 UMR_NM__1_1_0_S6_S3 -800 0
 /begin AXIS_DESCR FIX_AXIS zff_atsys._.iSignale._.obj.sig_istgang UMR___1_1_0_S6_S3 10 -1 8 FIX_AXIS_PAR_DIST -1 1 10 /end AXIS_DESCR
 /begin AXIS_DESCR FIX_AXIS zff_atsys._.iSignale._.obj.sig_zielgang_sas UMR___1_1_0_S6_S3 10 -1 8 FIX_AXIS_PAR_DIST -1 1 10 /end AXIS_DESCR
/end CHARACTERISTIC
/begin CHARACTERISTIC TAB_NSTRSV "Tabelle Rueckschaltverhinderung, Turbinendrehzahlschwelle fuer Rueckschaltungen" MAP 0x21E34C tab2d_ui16_S6_S3 8160 UMR_U_MIN_1_1_0_S6_S3 0 8160
 /begin AXIS_DESCR FIX_AXIS zff_atsys._.iSignale._.obj.sig_istgang UMR___1_1_0_S6_S3 10 -1 8 FIX_AXIS_PAR_DIST -1 1 10 /end AXIS_DESCR
 /begin AXIS_DESCR FIX_AXIS zff_atsys._.iSignale._.obj.sig_zielgang_sas UMR___1_1_0_S6_S3 10 -1 8 FIX_AXIS_PAR_DIST -1 1 10 /end AXIS_DESCR
/end CHARACTERISTIC
/begin CHARACTERISTIC TAB_NSMOTRSV "Tabelle Rueckschaltverhinderung, Motordrehzahlschwelle fuer Rueckschaltungen" MAP 0x21E41C tab2d_ui16_S6_S3 8160 UMR_U_MIN_1_1_0_S6_S3 0 8160
 /begin AXIS_DESCR FIX_AXIS zff_atsys._.iSignale._.obj.sig_istgang UMR___1_1_0_S6_S3 10 -1 8 FIX_AXIS_PAR_DIST -1 1 10 /end AXIS_DESCR
 /begin AXIS_DESCR FIX_AXIS zff_atsys._.iSignale._.obj.sig_zielgang_sas UMR___1_1_0_S6_S3 10 -1 8 FIX_AXIS_PAR_DIST -1 1 10 /end AXIS_DESCR
/end CHARACTERISTIC
/begin CHARACTERISTIC TAB_NSABRSV "Tabelle Rueckschaltverhinderung, Abtriebsdrehzahlschwelle fuer Rueckschaltungen" MAP 0x21E4EC tab2d_ui16_S6_S3 8160 UMR_U_MIN_1_1_0_S6_S3 0 8160
 /begin AXIS_DESCR FIX_AXIS zff_atsys._.iSignale._.obj.sig_istgang UMR___1_1_0_S6_S3 10 -1 8 FIX_AXIS_PAR_DIST -1 1 10 /end AXIS_DESCR
 /begin AXIS_DESCR FIX_AXIS zff_atsys._.iSignale._.obj.sig_zielgang_sas UMR___1_1_0_S6_S3 10 -1 8 FIX_AXIS_PAR_DIST -1 1 10 /end AXIS_DESCR
/end CHARACTERISTIC
/begin CHARACTERISTIC TAB_CSGVBMRS "Tabelle Getriebetemperaturschwelle Verbot MRS" MAP 0x21E5BC tab2d_ui8_S6_S3 255 UMR_GRADC__1_1_M40_S6_S3 -40 215
 /begin AXIS_DESCR FIX_AXIS zff_atsys._.iSignale._.obj.sig_istgang UMR___1_1_0_S6_S3 10 -1 8 FIX_AXIS_PAR_DIST -1 1 10 /end AXIS_DESCR
 /begin AXIS_DESCR FIX_AXIS zff_atsys._.iSignale._.obj.sig_zielgang_sas UMR___1_1_0_S6_S3 10 -1 8 FIX_AXIS_PAR_DIST -1 1 10 /end AXIS_DESCR
/end CHARACTERISTIC
/begin CHARACTERISTIC KL_TVCG_GE_STADA "Wartezeit Stillstands-Ada nach GE" CURVE 0x21E628 kl_ui8_S6_S3 2550 UMR_MSEC__10_1_0_S6_S3 0 2550
 /begin AXIS_DESCR STD_AXIS iItfInput.c_getr UMR_GRADC__1_1_M40_S6_S3 4 -40 215 DEPOSIT ABSOLUTE MONOTONY MON_INCREASE /end AXIS_DESCR
/end CHARACTERISTIC
/begin CHARACTERISTIC SWI_MRS_MRS_ERLAUBT "Schalter um verschachtelte Folge MRS zu erlauben" VALUE 0x26E4B6 kw_bool8_S6_S3 1 UMR___1_1_0_S6_S3 0 1 /end CHARACTERISTIC
/begin CHARACTERISTIC TAB_VERBOT_VERSCHACHTELTER_MRS "10 Schalterzeilen um Folge-Schaltungen abhaengig von istgang, zielgang, zielgang_soll und m_t zu verbieten" MAP 0x21E634 tab2d_si16_S6_S3 2040 UMR___1_1_0_S6_S3 -400 1640
 /begin AXIS_DESCR FIX_AXIS NO_INPUT_QUANTITY UMR___1_1_0_S6_S3 4 0 3 FIX_AXIS_PAR_DIST 0 1 4 /end AXIS_DESCR
 /begin AXIS_DESCR FIX_AXIS NO_INPUT_QUANTITY UMR___1_1_0_S6_S3 10 0 9 FIX_AXIS_PAR_DIST 0 1 10 /end AXIS_DESCR
/end CHARACTERISTIC
/begin CHARACTERISTIC KL_TVCGKFLSOLL "Wartezeit Ausstieg bei Stromlos" CURVE 0x21E68C kl_ui8_S6_S3 100 UMR_MSEC__10_1_0_S6_S3 0 100
 /begin AXIS_DESCR STD_AXIS iItfInput.c_getr UMR_GRADC__1_1_M40_S6_S3 3 -40 215 DEPOSIT ABSOLUTE MONOTONY MON_INCREASE /end AXIS_DESCR
/end CHARACTERISTIC
/begin CHARACTERISTIC KL_MGMOTMAXAUF1HSS12 "Momentengradient Phase 1 bei HSS" CURVE 0x21F18C kl_ui16_S6_S3 25500 UMR_NM_SEC_10_1_0_S6_S3 0 25500
 /begin AXIS_DESCR STD_AXIS NO_INPUT_QUANTITY UMR_NM_SEC_10_1_0_S6_S3 6 0 2550 DEPOSIT ABSOLUTE MONOTONY MON_INCREASE /end AXIS_DESCR
/end CHARACTERISTIC
/begin CHARACTERISTIC KL_MGMOTMAXAUF2HSS12 "Momentengradient Phase 2 bei HSS" CURVE 0x21F1A8 kl_ui16_S6_S3 25500 UMR_NM_SEC_10_1_0_S6_S3 0 25500
 /begin AXIS_DESCR STD_AXIS NO_INPUT_QUANTITY UMR_NM_SEC_10_1_0_S6_S3 6 0 2550 DEPOSIT ABSOLUTE MONOTONY MON_INCREASE /end AXIS_DESCR
/end CHARACTERISTIC
/begin CHARACTERISTIC MS_MOTISTHSS12 "Momentenschwelle zum Start der Funktion" VALUE 0x26D4CA kw_si16_S6_S3 1600 UMR_NM__1_1_0_S6_S3 -200 1400 /end CHARACTERISTIC
/begin CHARACTERISTIC MO_MOTMAXHSS12 "Sicherheitsmomentenoffset bei Rücknahme Sonderfunktion, HSS" VALUE 0x26D4CC kw_ui16_S6_S3 1000 UMR_NM__1_1_0_S6_S3 0 1000 /end CHARACTERISTIC
/begin CHARACTERISTIC KL_TVSYNCGHSS12 "Start der Sonderfunktion mit Zeit vor/ nach Synchron" CURVE 0x21F1C4 kl_ui16_S6_S3 1000 UMR_MSEC__10_1_0_S6_S3 0 1000
 /begin AXIS_DESCR STD_AXIS zff_atsys._.iSignale._.obj.sig_c_getr UMR_GRADC__1_1_M40_S6_S3 4 -40 150 DEPOSIT ABSOLUTE MONOTONY MON_INCREASE /end AXIS_DESCR
/end CHARACTERISTIC
/begin CHARACTERISTIC M_MOTMAXHSS_HYS12 "Motmax Hysterese" VALUE 0x26D4CE kw_ui16_S6_S3 1200 UMR_NM__1_1_0_S6_S3 0 1200 /end CHARACTERISTIC
/begin CHARACTERISTIC KL_MGMOTMAXAUF1HSS23 "Momentengradient Phase 1 bei HSS" CURVE 0x21F1D8 kl_ui16_S6_S3 25500 UMR_NM_SEC_10_1_0_S6_S3 0 25500
 /begin AXIS_DESCR STD_AXIS NO_INPUT_QUANTITY UMR_NM_SEC_10_1_0_S6_S3 6 0 2550 DEPOSIT ABSOLUTE MONOTONY MON_INCREASE /end AXIS_DESCR
/end CHARACTERISTIC
/begin CHARACTERISTIC KL_MGMOTMAXAUF2HSS23 "Momentengradient Phase 2 bei HSS" CURVE 0x21F1F4 kl_ui16_S6_S3 25500 UMR_NM_SEC_10_1_0_S6_S3 0 25500
 /begin AXIS_DESCR STD_AXIS NO_INPUT_QUANTITY UMR_NM_SEC_10_1_0_S6_S3 6 0 2550 DEPOSIT ABSOLUTE MONOTONY MON_INCREASE /end AXIS_DESCR
/end CHARACTERISTIC
/begin CHARACTERISTIC MS_MOTISTHSS23 "Momentenschwelle zum Start der Funktion" VALUE 0x26D4D0 kw_si16_S6_S3 1600 UMR_NM__1_1_0_S6_S3 -200 1400 /end CHARACTERISTIC
/begin CHARACTERISTIC MO_MOTMAXHSS23 "Sicherheitsmomentenoffset bei Rücknahme Sonderfunktion, HSS" VALUE 0x26D4D2 kw_ui16_S6_S3 1000 UMR_NM__1_1_0_S6_S3 0 1000 /end CHARACTERISTIC
/begin CHARACTERISTIC KL_TVSYNCGHSS23 "Start der Sonderfunktion mit Zeit vor/ nach Synchron" CURVE 0x21F210 kl_ui16_S6_S3 1000 UMR_MSEC__10_1_0_S6_S3 0 1000
 /begin AXIS_DESCR STD_AXIS zff_atsys._.iSignale._.obj.sig_c_getr UMR_GRADC__1_1_M40_S6_S3 4 -40 150 DEPOSIT ABSOLUTE MONOTONY MON_INCREASE /end AXIS_DESCR
/end CHARACTERISTIC
/begin CHARACTERISTIC M_MOTMAXHSS_HYS23 "Motmax Hysterese" VALUE 0x26D4D4 kw_ui16_S6_S3 1200 UMR_NM__1_1_0_S6_S3 0 1200 /end CHARACTERISTIC
/begin CHARACTERISTIC KL_MGMOTMAXAUF1HSS34 "Momentengradient Phase 1 bei HSS" CURVE 0x21F224 kl_ui16_S6_S3 25500 UMR_NM_SEC_10_1_0_S6_S3 0 25500
 /begin AXIS_DESCR STD_AXIS NO_INPUT_QUANTITY UMR_NM_SEC_10_1_0_S6_S3 6 0 2550 DEPOSIT ABSOLUTE MONOTONY MON_INCREASE /end AXIS_DESCR
/end CHARACTERISTIC
/begin CHARACTERISTIC KL_MGMOTMAXAUF2HSS34 "Momentengradient Phase 2 bei HSS" CURVE 0x21F240 kl_ui16_S6_S3 25500 UMR_NM_SEC_10_1_0_S6_S3 0 25500
 /begin AXIS_DESCR STD_AXIS NO_INPUT_QUANTITY UMR_NM_SEC_10_1_0_S6_S3 6 0 2550 DEPOSIT ABSOLUTE MONOTONY MON_INCREASE /end AXIS_DESCR
/end CHARACTERISTIC
/begin CHARACTERISTIC MS_MOTISTHSS34 "Momentenschwelle zum Start der Funktion" VALUE 0x26D4D6 kw_si16_S6_S3 1600 UMR_NM__1_1_0_S6_S3 -200 1400 /end CHARACTERISTIC
/begin CHARACTERISTIC MO_MOTMAXHSS34 "Sicherheitsmomentenoffset bei Rücknahme Sonderfunktion, HSS" VALUE 0x26D4D8 kw_ui16_S6_S3 1000 UMR_NM__1_1_0_S6_S3 0 1000 /end CHARACTERISTIC
/begin CHARACTERISTIC KL_TVSYNCGHSS34 "Start der Sonderfunktion mit Zeit vor/ nach Synchron" CURVE 0x21F25C kl_ui16_S6_S3 1000 UMR_MSEC__10_1_0_S6_S3 0 1000
 /begin AXIS_DESCR STD_AXIS zff_atsys._.iSignale._.obj.sig_c_getr UMR_GRADC__1_1_M40_S6_S3 4 -40 150 DEPOSIT ABSOLUTE MONOTONY MON_INCREASE /end AXIS_DESCR
/end CHARACTERISTIC
/begin CHARACTERISTIC M_MOTMAXHSS_HYS34 "Motmax Hysterese" VALUE 0x26D4DA kw_ui16_S6_S3 1200 UMR_NM__1_1_0_S6_S3 0 1200 /end CHARACTERISTIC
/begin CHARACTERISTIC KL_MGMOTMAXAUF1HSS45 "Momentengradient Phase 1 bei HSS" CURVE 0x21F270 kl_ui16_S6_S3 25500 UMR_NM_SEC_10_1_0_S6_S3 0 25500
 /begin AXIS_DESCR STD_AXIS NO_INPUT_QUANTITY UMR_NM_SEC_10_1_0_S6_S3 6 0 2550 DEPOSIT ABSOLUTE MONOTONY MON_INCREASE /end AXIS_DESCR
/end CHARACTERISTIC
/begin CHARACTERISTIC KL_MGMOTMAXAUF2HSS45 "Momentengradient Phase 2 bei HSS" CURVE 0x21F28C kl_ui16_S6_S3 25500 UMR_NM_SEC_10_1_0_S6_S3 0 25500
 /begin AXIS_DESCR STD_AXIS NO_INPUT_QUANTITY UMR_NM_SEC_10_1_0_S6_S3 6 0 2550 DEPOSIT ABSOLUTE MONOTONY MON_INCREASE /end AXIS_DESCR
/end CHARACTERISTIC
/begin CHARACTERISTIC MS_MOTISTHSS45 "Momentenschwelle zum Start der Funktion" VALUE 0x26D4DC kw_si16_S6_S3 1600 UMR_NM__1_1_0_S6_S3 -200 1400 /end CHARACTERISTIC
/begin CHARACTERISTIC MO_MOTMAXHSS45 "Sicherheitsmomentenoffset bei Rücknahme Sonderfunktion, HSS" VALUE 0x26D4DE kw_ui16_S6_S3 1000 UMR_NM__1_1_0_S6_S3 0 1000 /end CHARACTERISTIC
/begin CHARACTERISTIC KL_TVSYNCGHSS45 "Start der Sonderfunktion mit Zeit vor/ nach Synchron" CURVE 0x21F2A8 kl_ui16_S6_S3 1000 UMR_MSEC__10_1_0_S6_S3 0 1000
 /begin AXIS_DESCR STD_AXIS zff_atsys._.iSignale._.obj.sig_c_getr UMR_GRADC__1_1_M40_S6_S3 4 -40 150 DEPOSIT ABSOLUTE MONOTONY MON_INCREASE /end AXIS_DESCR
/end CHARACTERISTIC
/begin CHARACTERISTIC M_MOTMAXHSS_HYS45 "Motmax Hysterese" VALUE 0x26D4E0 kw_ui16_S6_S3 1200 UMR_NM__1_1_0_S6_S3 0 1200 /end CHARACTERISTIC
/begin CHARACTERISTIC KL_MGMOTMAXAUF1HSS56 "Momentengradient Phase 1 bei HSS" CURVE 0x21F2BC kl_ui16_S6_S3 25500 UMR_NM_SEC_10_1_0_S6_S3 0 25500
 /begin AXIS_DESCR STD_AXIS NO_INPUT_QUANTITY UMR_NM_SEC_10_1_0_S6_S3 6 0 2550 DEPOSIT ABSOLUTE MONOTONY MON_INCREASE /end AXIS_DESCR
/end CHARACTERISTIC
/begin CHARACTERISTIC KL_MGMOTMAXAUF2HSS56 "Momentengradient Phase 2 bei HSS" CURVE 0x21F2D8 kl_ui16_S6_S3 25500 UMR_NM_SEC_10_1_0_S6_S3 0 25500
 /begin AXIS_DESCR STD_AXIS NO_INPUT_QUANTITY UMR_NM_SEC_10_1_0_S6_S3 6 0 2550 DEPOSIT ABSOLUTE MONOTONY MON_INCREASE /end AXIS_DESCR
/end CHARACTERISTIC
/begin CHARACTERISTIC MS_MOTISTHSS56 "Momentenschwelle zum Start der Funktion" VALUE 0x26D4E2 kw_si16_S6_S3 1600 UMR_NM__1_1_0_S6_S3 -200 1400 /end CHARACTERISTIC
/begin CHARACTERISTIC MO_MOTMAXHSS56 "Sicherheitsmomentenoffset bei Rücknahme Sonderfunktion, HSS" VALUE 0x26D4E4 kw_ui16_S6_S3 1000 UMR_NM__1_1_0_S6_S3 0 1000 /end CHARACTERISTIC
/begin CHARACTERISTIC KL_TVSYNCGHSS56 "Start der Sonderfunktion mit Zeit vor/ nach Synchron" CURVE 0x21F2F4 kl_ui16_S6_S3 1000 UMR_MSEC__10_1_0_S6_S3 0 1000
 /begin AXIS_DESCR STD_AXIS zff_atsys._.iSignale._.obj.sig_c_getr UMR_GRADC__1_1_M40_S6_S3 4 -40 150 DEPOSIT ABSOLUTE MONOTONY MON_INCREASE /end AXIS_DESCR
/end CHARACTERISTIC
/begin CHARACTERISTIC M_MOTMAXHSS_HYS56 "Motmax Hysterese" VALUE 0x26D4E6 kw_ui16_S6_S3 1200 UMR_NM__1_1_0_S6_S3 0 1200 /end CHARACTERISTIC
/begin CHARACTERISTIC KL_MGMOTMAXAUF1HSS67 "Momentengradient Phase 1 bei HSS" CURVE 0x21F308 kl_ui16_S6_S3 25500 UMR_NM_SEC_10_1_0_S6_S3 0 25500
 /begin AXIS_DESCR STD_AXIS NO_INPUT_QUANTITY UMR_NM_SEC_10_1_0_S6_S3 6 0 2550 DEPOSIT ABSOLUTE MONOTONY MON_INCREASE /end AXIS_DESCR
/end CHARACTERISTIC
/begin CHARACTERISTIC KL_MGMOTMAXAUF2HSS67 "Momentengradient Phase 2 bei HSS" CURVE 0x21F324 kl_ui16_S6_S3 25500 UMR_NM_SEC_10_1_0_S6_S3 0 25500
 /begin AXIS_DESCR STD_AXIS NO_INPUT_QUANTITY UMR_NM_SEC_10_1_0_S6_S3 6 0 2550 DEPOSIT ABSOLUTE MONOTONY MON_INCREASE /end AXIS_DESCR
/end CHARACTERISTIC
/begin CHARACTERISTIC MS_MOTISTHSS67 "Momentenschwelle zum Start der Funktion" VALUE 0x26D4E8 kw_si16_S6_S3 1600 UMR_NM__1_1_0_S6_S3 -200 1400 /end CHARACTERISTIC
/begin CHARACTERISTIC MO_MOTMAXHSS67 "Sicherheitsmomentenoffset bei Rücknahme Sonderfunktion, HSS" VALUE 0x26D4EA kw_ui16_S6_S3 1000 UMR_NM__1_1_0_S6_S3 0 1000 /end CHARACTERISTIC
/begin CHARACTERISTIC KL_TVSYNCGHSS67 "Start der Sonderfunktion mit Zeit vor/ nach Synchron" CURVE 0x21F340 kl_ui16_S6_S3 1000 UMR_MSEC__10_1_0_S6_S3 0 1000
 /begin AXIS_DESCR STD_AXIS zff_atsys._.iSignale._.obj.sig_c_getr UMR_GRADC__1_1_M40_S6_S3 4 -40 150 DEPOSIT ABSOLUTE MONOTONY MON_INCREASE /end AXIS_DESCR
/end CHARACTERISTIC
/begin CHARACTERISTIC M_MOTMAXHSS_HYS67 "Motmax Hysterese" VALUE 0x26D4EC kw_ui16_S6_S3 1200 UMR_NM__1_1_0_S6_S3 0 1200 /end CHARACTERISTIC
/begin CHARACTERISTIC KL_MGMOTMAXAUF1HSS78 "Momentengradient Phase 1 bei HSS" CURVE 0x21F354 kl_ui16_S6_S3 25500 UMR_NM_SEC_10_1_0_S6_S3 0 25500
 /begin AXIS_DESCR STD_AXIS NO_INPUT_QUANTITY UMR_NM_SEC_10_1_0_S6_S3 6 0 2550 DEPOSIT ABSOLUTE MONOTONY MON_INCREASE /end AXIS_DESCR
/end CHARACTERISTIC
/begin CHARACTERISTIC KL_MGMOTMAXAUF2HSS78 "Momentengradient Phase 2 bei HSS" CURVE 0x21F370 kl_ui16_S6_S3 25500 UMR_NM_SEC_10_1_0_S6_S3 0 25500
 /begin AXIS_DESCR STD_AXIS NO_INPUT_QUANTITY UMR_NM_SEC_10_1_0_S6_S3 6 0 2550 DEPOSIT ABSOLUTE MONOTONY MON_INCREASE /end AXIS_DESCR
/end CHARACTERISTIC
/begin CHARACTERISTIC MS_MOTISTHSS78 "Momentenschwelle zum Start der Funktion" VALUE 0x26D4EE kw_si16_S6_S3 1600 UMR_NM__1_1_0_S6_S3 -200 1400 /end CHARACTERISTIC
/begin CHARACTERISTIC MO_MOTMAXHSS78 "Sicherheitsmomentenoffset bei Rücknahme Sonderfunktion, HSS" VALUE 0x26D4F0 kw_ui16_S6_S3 1000 UMR_NM__1_1_0_S6_S3 0 1000 /end CHARACTERISTIC
/begin CHARACTERISTIC KL_TVSYNCGHSS78 "Start der Sonderfunktion mit Zeit vor/ nach Synchron" CURVE 0x21F38C kl_ui16_S6_S3 1000 UMR_MSEC__10_1_0_S6_S3 0 1000
 /begin AXIS_DESCR STD_AXIS zff_atsys._.iSignale._.obj.sig_c_getr UMR_GRADC__1_1_M40_S6_S3 4 -40 150 DEPOSIT ABSOLUTE MONOTONY MON_INCREASE /end AXIS_DESCR
/end CHARACTERISTIC
/begin CHARACTERISTIC M_MOTMAXHSS_HYS78 "Motmax Hysterese" VALUE 0x26D4F2 kw_ui16_S6_S3 1200 UMR_NM__1_1_0_S6_S3 0 1200 /end CHARACTERISTIC
/begin CHARACTERISTIC KL_MGMOTMAXAUF1HSS13 "Momentengradient Phase 1 bei HSS" CURVE 0x21F3A0 kl_ui16_S6_S3 25500 UMR_NM_SEC_10_1_0_S6_S3 0 25500
 /begin AXIS_DESCR STD_AXIS NO_INPUT_QUANTITY UMR_NM_SEC_10_1_0_S6_S3 6 0 2550 DEPOSIT ABSOLUTE MONOTONY MON_INCREASE /end AXIS_DESCR
/end CHARACTERISTIC
/begin CHARACTERISTIC KL_MGMOTMAXAUF2HSS13 "Momentengradient Phase 2 bei HSS" CURVE 0x21F3BC kl_ui16_S6_S3 25500 UMR_NM_SEC_10_1_0_S6_S3 0 25500
 /begin AXIS_DESCR STD_AXIS NO_INPUT_QUANTITY UMR_NM_SEC_10_1_0_S6_S3 6 0 2550 DEPOSIT ABSOLUTE MONOTONY MON_INCREASE /end AXIS_DESCR
/end CHARACTERISTIC
/begin CHARACTERISTIC MS_MOTISTHSS13 "Momentenschwelle zum Start der Funktion" VALUE 0x26D4F4 kw_si16_S6_S3 1600 UMR_NM__1_1_0_S6_S3 -200 1400 /end CHARACTERISTIC
/begin CHARACTERISTIC MO_MOTMAXHSS13 "Sicherheitsmomentenoffset bei Rücknahme Sonderfunktion, HSS" VALUE 0x26D4F6 kw_ui16_S6_S3 1000 UMR_NM__1_1_0_S6_S3 0 1000 /end CHARACTERISTIC
/begin CHARACTERISTIC KL_TVSYNCGHSS13 "Start der Sonderfunktion mit Zeit vor/ nach Synchron" CURVE 0x21F3D8 kl_ui16_S6_S3 1000 UMR_MSEC__10_1_0_S6_S3 0 1000
 /begin AXIS_DESCR STD_AXIS zff_atsys._.iSignale._.obj.sig_c_getr UMR_GRADC__1_1_M40_S6_S3 4 -40 150 DEPOSIT ABSOLUTE MONOTONY MON_INCREASE /end AXIS_DESCR
/end CHARACTERISTIC
/begin CHARACTERISTIC M_MOTMAXHSS_HYS13 "Motmax Hysterese" VALUE 0x26D4F8 kw_ui16_S6_S3 1200 UMR_NM__1_1_0_S6_S3 0 1200 /end CHARACTERISTIC
/begin CHARACTERISTIC KL_MGMOTMAXAUF1HSS24 "Momentengradient Phase 1 bei HSS" CURVE 0x21F3EC kl_ui16_S6_S3 25500 UMR_NM_SEC_10_1_0_S6_S3 0 25500
 /begin AXIS_DESCR STD_AXIS NO_INPUT_QUANTITY UMR_NM_SEC_10_1_0_S6_S3 6 0 2550 DEPOSIT ABSOLUTE MONOTONY MON_INCREASE /end AXIS_DESCR
/end CHARACTERISTIC
/begin CHARACTERISTIC KL_MGMOTMAXAUF2HSS24 "Momentengradient Phase 2 bei HSS" CURVE 0x21F408 kl_ui16_S6_S3 25500 UMR_NM_SEC_10_1_0_S6_S3 0 25500
 /begin AXIS_DESCR STD_AXIS NO_INPUT_QUANTITY UMR_NM_SEC_10_1_0_S6_S3 6 0 2550 DEPOSIT ABSOLUTE MONOTONY MON_INCREASE /end AXIS_DESCR
/end CHARACTERISTIC
/begin CHARACTERISTIC MS_MOTISTHSS24 "Momentenschwelle zum Start der Funktion" VALUE 0x26D4FA kw_si16_S6_S3 1600 UMR_NM__1_1_0_S6_S3 -200 1400 /end CHARACTERISTIC
/begin CHARACTERISTIC MO_MOTMAXHSS24 "Sicherheitsmomentenoffset bei Rücknahme Sonderfunktion, HSS" VALUE 0x26D4FC kw_ui16_S6_S3 1000 UMR_NM__1_1_0_S6_S3 0 1000 /end CHARACTERISTIC
/begin CHARACTERISTIC KL_TVSYNCGHSS24 "Start der Sonderfunktion mit Zeit vor/ nach Synchron" CURVE 0x21F424 kl_ui16_S6_S3 1000 UMR_MSEC__10_1_0_S6_S3 0 1000
 /begin AXIS_DESCR STD_AXIS zff_atsys._.iSignale._.obj.sig_c_getr UMR_GRADC__1_1_M40_S6_S3 4 -40 150 DEPOSIT ABSOLUTE MONOTONY MON_INCREASE /end AXIS_DESCR
/end CHARACTERISTIC
/begin CHARACTERISTIC M_MOTMAXHSS_HYS24 "Motmax Hysterese" VALUE 0x26D4FE kw_ui16_S6_S3 1200 UMR_NM__1_1_0_S6_S3 0 1200 /end CHARACTERISTIC
/begin CHARACTERISTIC KL_MGMOTMAXAUF1HSS35 "Momentengradient Phase 1 bei HSS" CURVE 0x21F438 kl_ui16_S6_S3 25500 UMR_NM_SEC_10_1_0_S6_S3 0 25500
 /begin AXIS_DESCR STD_AXIS NO_INPUT_QUANTITY UMR_NM_SEC_10_1_0_S6_S3 6 0 2550 DEPOSIT ABSOLUTE MONOTONY MON_INCREASE /end AXIS_DESCR
/end CHARACTERISTIC
/begin CHARACTERISTIC KL_MGMOTMAXAUF2HSS35 "Momentengradient Phase 2 bei HSS" CURVE 0x21F454 kl_ui16_S6_S3 25500 UMR_NM_SEC_10_1_0_S6_S3 0 25500
 /begin AXIS_DESCR STD_AXIS NO_INPUT_QUANTITY UMR_NM_SEC_10_1_0_S6_S3 6 0 2550 DEPOSIT ABSOLUTE MONOTONY MON_INCREASE /end AXIS_DESCR
/end CHARACTERISTIC
/begin CHARACTERISTIC MS_MOTISTHSS35 "Momentenschwelle zum Start der Funktion" VALUE 0x26D500 kw_si16_S6_S3 1600 UMR_NM__1_1_0_S6_S3 -200 1400 /end CHARACTERISTIC
/begin CHARACTERISTIC MO_MOTMAXHSS35 "Sicherheitsmomentenoffset bei Rücknahme Sonderfunktion, HSS" VALUE 0x26D502 kw_ui16_S6_S3 1000 UMR_NM__1_1_0_S6_S3 0 1000 /end CHARACTERISTIC
/begin CHARACTERISTIC KL_TVSYNCGHSS35 "Start der Sonderfunktion mit Zeit vor/ nach Synchron" CURVE 0x21F470 kl_ui16_S6_S3 1000 UMR_MSEC__10_1_0_S6_S3 0 1000
 /begin AXIS_DESCR STD_AXIS zff_atsys._.iSignale._.obj.sig_c_getr UMR_GRADC__1_1_M40_S6_S3 4 -40 150 DEPOSIT ABSOLUTE MONOTONY MON_INCREASE /end AXIS_DESCR
/end CHARACTERISTIC
/begin CHARACTERISTIC M_MOTMAXHSS_HYS35 "Motmax Hysterese" VALUE 0x26D504 kw_ui16_S6_S3 1200 UMR_NM__1_1_0_S6_S3 0 1200 /end CHARACTERISTIC
/begin CHARACTERISTIC KL_MGMOTMAXAUF1HSS46 "Momentengradient Phase 1 bei HSS" CURVE 0x21F484 kl_ui16_S6_S3 25500 UMR_NM_SEC_10_1_0_S6_S3 0 25500
 /begin AXIS_DESCR STD_AXIS NO_INPUT_QUANTITY UMR_NM_SEC_10_1_0_S6_S3 6 0 2550 DEPOSIT ABSOLUTE MONOTONY MON_INCREASE /end AXIS_DESCR
/end CHARACTERISTIC
/begin CHARACTERISTIC KL_MGMOTMAXAUF2HSS46 "Momentengradient Phase 2 bei HSS" CURVE 0x21F4A0 kl_ui16_S6_S3 25500 UMR_NM_SEC_10_1_0_S6_S3 0 25500
 /begin AXIS_DESCR STD_AXIS NO_INPUT_QUANTITY UMR_NM_SEC_10_1_0_S6_S3 6 0 2550 DEPOSIT ABSOLUTE MONOTONY MON_INCREASE /end AXIS_DESCR
/end CHARACTERISTIC
/begin CHARACTERISTIC MS_MOTISTHSS46 "Momentenschwelle zum Start der Funktion" VALUE 0x26D506 kw_si16_S6_S3 1600 UMR_NM__1_1_0_S6_S3 -200 1400 /end CHARACTERISTIC
/begin CHARACTERISTIC MO_MOTMAXHSS46 "Sicherheitsmomentenoffset bei Rücknahme Sonderfunktion, HSS" VALUE 0x26D508 kw_ui16_S6_S3 1000 UMR_NM__1_1_0_S6_S3 0 1000 /end CHARACTERISTIC
/begin CHARACTERISTIC KL_TVSYNCGHSS46 "Start der Sonderfunktion mit Zeit vor/ nach Synchron" CURVE 0x21F4BC kl_ui16_S6_S3 1000 UMR_MSEC__10_1_0_S6_S3 0 1000
 /begin AXIS_DESCR STD_AXIS zff_atsys._.iSignale._.obj.sig_c_getr UMR_GRADC__1_1_M40_S6_S3 4 -40 150 DEPOSIT ABSOLUTE MONOTONY MON_INCREASE /end AXIS_DESCR
/end CHARACTERISTIC
/begin CHARACTERISTIC M_MOTMAXHSS_HYS46 "Motmax Hysterese" VALUE 0x26D50A kw_ui16_S6_S3 1200 UMR_NM__1_1_0_S6_S3 0 1200 /end CHARACTERISTIC
/begin CHARACTERISTIC KL_MGMOTMAXAUF1HSS57 "Momentengradient Phase 1 bei HSS" CURVE 0x21F4D0 kl_ui16_S6_S3 25500 UMR_NM_SEC_10_1_0_S6_S3 0 25500
 /begin AXIS_DESCR STD_AXIS NO_INPUT_QUANTITY UMR_NM_SEC_10_1_0_S6_S3 6 0 2550 DEPOSIT ABSOLUTE MONOTONY MON_INCREASE /end AXIS_DESCR
/end CHARACTERISTIC
/begin CHARACTERISTIC KL_MGMOTMAXAUF2HSS57 "Momentengradient Phase 2 bei HSS" CURVE 0x21F4EC kl_ui16_S6_S3 25500 UMR_NM_SEC_10_1_0_S6_S3 0 25500
 /begin AXIS_DESCR STD_AXIS NO_INPUT_QUANTITY UMR_NM_SEC_10_1_0_S6_S3 6 0 2550 DEPOSIT ABSOLUTE MONOTONY MON_INCREASE /end AXIS_DESCR
/end CHARACTERISTIC
/begin CHARACTERISTIC MS_MOTISTHSS57 "Momentenschwelle zum Start der Funktion" VALUE 0x26D50C kw_si16_S6_S3 1600 UMR_NM__1_1_0_S6_S3 -200 1400 /end CHARACTERISTIC
/begin CHARACTERISTIC MO_MOTMAXHSS57 "Sicherheitsmomentenoffset bei Rücknahme Sonderfunktion, HSS" VALUE 0x26D50E kw_ui16_S6_S3 1000 UMR_NM__1_1_0_S6_S3 0 1000 /end CHARACTERISTIC
/begin CHARACTERISTIC KL_TVSYNCGHSS57 "Start der Sonderfunktion mit Zeit vor/ nach Synchron" CURVE 0x21F508 kl_ui16_S6_S3 1000 UMR_MSEC__10_1_0_S6_S3 0 1000
 /begin AXIS_DESCR STD_AXIS zff_atsys._.iSignale._.obj.sig_c_getr UMR_GRADC__1_1_M40_S6_S3 4 -40 150 DEPOSIT ABSOLUTE MONOTONY MON_INCREASE /end AXIS_DESCR
/end CHARACTERISTIC
/begin CHARACTERISTIC M_MOTMAXHSS_HYS57 "Motmax Hysterese" VALUE 0x26D510 kw_ui16_S6_S3 1200 UMR_NM__1_1_0_S6_S3 0 1200 /end CHARACTERISTIC
/begin CHARACTERISTIC KL_MGMOTMAXAUF1HSS68 "Momentengradient Phase 1 bei HSS" CURVE 0x21F51C kl_ui16_S6_S3 25500 UMR_NM_SEC_10_1_0_S6_S3 0 25500
 /begin AXIS_DESCR STD_AXIS NO_INPUT_QUANTITY UMR_NM_SEC_10_1_0_S6_S3 6 0 2550 DEPOSIT ABSOLUTE MONOTONY MON_INCREASE /end AXIS_DESCR
/end CHARACTERISTIC
/begin CHARACTERISTIC KL_MGMOTMAXAUF2HSS68 "Momentengradient Phase 2 bei HSS" CURVE 0x21F538 kl_ui16_S6_S3 25500 UMR_NM_SEC_10_1_0_S6_S3 0 25500
 /begin AXIS_DESCR STD_AXIS NO_INPUT_QUANTITY UMR_NM_SEC_10_1_0_S6_S3 6 0 2550 DEPOSIT ABSOLUTE MONOTONY MON_INCREASE /end AXIS_DESCR
/end CHARACTERISTIC
/begin CHARACTERISTIC MS_MOTISTHSS68 "Momentenschwelle zum Start der Funktion" VALUE 0x26D512 kw_si16_S6_S3 1600 UMR_NM__1_1_0_S6_S3 -200 1400 /end CHARACTERISTIC
/begin CHARACTERISTIC MO_MOTMAXHSS68 "Sicherheitsmomentenoffset bei Rücknahme Sonderfunktion, HSS" VALUE 0x26D514 kw_ui16_S6_S3 1000 UMR_NM__1_1_0_S6_S3 0 1000 /end CHARACTERISTIC
/begin CHARACTERISTIC KL_TVSYNCGHSS68 "Start der Sonderfunktion mit Zeit vor/ nach Synchron" CURVE 0x21F554 kl_ui16_S6_S3 1000 UMR_MSEC__10_1_0_S6_S3 0 1000
 /begin AXIS_DESCR STD_AXIS zff_atsys._.iSignale._.obj.sig_c_getr UMR_GRADC__1_1_M40_S6_S3 4 -40 150 DEPOSIT ABSOLUTE MONOTONY MON_INCREASE /end AXIS_DESCR
/end CHARACTERISTIC
/begin CHARACTERISTIC M_MOTMAXHSS_HYS68 "Motmax Hysterese" VALUE 0x26D516 kw_ui16_S6_S3 1200 UMR_NM__1_1_0_S6_S3 0 1200 /end CHARACTERISTIC
/begin CHARACTERISTIC KL_KCGMPUAUF "Kennlinie Korrektur Pumpenaufnahmemoment" CURVE 0x21E840 kl_si16_S6_S3 20 UMR___1_100_0_S6_S3 0 20
 /begin AXIS_DESCR STD_AXIS zff_atsys._.iSignale._.obj.sig_c_getr UMR_GRADC__1_1_M40_S6_S3 4 -40 150 DEPOSIT ABSOLUTE MONOTONY MON_INCREASE /end AXIS_DESCR
/end CHARACTERISTIC
/begin CHARACTERISTIC SWI_NMOTMPUAUF "Schalter für die Umschaltung der Eingangsgröße für die Pumpenaufnahmeberechnung 0: n_mot_pu 1: n_mot" VALUE 0x26E4D7 kw_bool8_S6_S3 1 UMR___1_1_0_S6_S3 0 1 /end CHARACTERISTIC
/begin CHARACTERISTIC MPT_MPUAUF "PT1- Filterzeitkonstante für m_puauf" VALUE 0x26E4D8 kw_ui8_S6_S3 0.99 UMR___1_100_0_S6_S3 0.01 1 /end CHARACTERISTIC
/begin CHARACTERISTIC KF_MPUAUF "Pumpenaufnahmemoment" MAP 0x21E854 kf_ui16_S6_S3 1000 UMR_NM__1_10_0_S6_S3 0 1000
 /begin AXIS_DESCR STD_AXIS iBihMPuauf.n_mot_pu UMR_U_MIN_1_1_0_S6_S3 3 0 8160 DEPOSIT ABSOLUTE MONOTONY MON_INCREASE /end AXIS_DESCR
 /begin AXIS_DESCR STD_AXIS iSasPsyst.p_mod UMR_BAR__1_1000_0_S6_S3 2 0 20 DEPOSIT ABSOLUTE MONOTONY MON_INCREASE /end AXIS_DESCR
/end CHARACTERISTIC
/begin CHARACTERISTIC NS_NEIGFILTER1 "Abtriebsdrehzahlschwellwert fuer Filtereinstieg" VALUE 0x26D518 kw_ui16_S6_S3 2500 UMR_U_MIN_1_1_0_S6_S3 0 2500 /end CHARACTERISTIC
/begin CHARACTERISTIC NS_NEIGFILTER2 "Abtriebsdrehzahlschwellwert fuer Filtereinstieg" VALUE 0x26D51A kw_ui16_S6_S3 2500 UMR_U_MIN_1_1_0_S6_S3 0 2500 /end CHARACTERISTIC
/begin CHARACTERISTIC T_NEIG1 "Neigungssignal Zeitschwelle Uebergang Phase 1->2" VALUE 0x26E4E5 kw_ui8_S6_S3 2500 UMR_MSEC__10_1_0_S6_S3 0 2500 /end CHARACTERISTIC
/begin CHARACTERISTIC T_NEIG2 "Neigungssignal Zeitschwelle Uebergang Phase 2->3" VALUE 0x26E4E6 kw_ui8_S6_S3 2500 UMR_MSEC__10_1_0_S6_S3 0 2500 /end CHARACTERISTIC
/begin CHARACTERISTIC T_FILTERNEIG1 "Filterzeit Phase 1" VALUE 0x26D51C kw_ui16_S6_S3 999 UMR_MSEC__1_1_0_S6_S3 1 1000 /end CHARACTERISTIC
/begin CHARACTERISTIC T_FILTERNEIG2 "Filterzeit Phase 2 und 3" VALUE 0x26D51E kw_ui16_S6_S3 999 UMR_MSEC__1_1_0_S6_S3 1 1000 /end CHARACTERISTIC
/begin CHARACTERISTIC NEIG_MIN "Minimale Hangneigung Begrenzung" VALUE 0x26E4E7 kw_ui8_S6_S3 84.6667 UMR_GRAD__1_3_M128_S6_S3 -42.6666666667 42 /end CHARACTERISTIC
/begin CHARACTERISTIC NEIG_MAX "Maximale Hangneigung Begrenzung" VALUE 0x26E4E8 kw_ui8_S6_S3 84.6667 UMR_GRAD__1_3_M128_S6_S3 -42.6666666667 42 /end CHARACTERISTIC
/begin CHARACTERISTIC NEIG_ERSATZ "Ersatzwert fuer Neigungssignal" VALUE 0x26E4E9 kw_ui8_S6_S3 84.6667 UMR_GRAD__1_3_M128_S6_S3 -42.6666666667 42 /end CHARACTERISTIC
/begin CHARACTERISTIC NEIG_INI "Initialisierung des Filters Neigungssignal" VALUE 0x26E4EA kw_ui8_S6_S3 84.6667 UMR_GRAD__1_3_M128_S6_S3 -42.6666666667 42 /end CHARACTERISTIC
/begin CHARACTERISTIC KL_TOHOTMODEVFZG "Fahrzeuggeschwindigkeitsabhängiger Temperaturoffset auf Hotmodeschwellen" CURVE 0x21E740 kl_si16_S6_S3 100 UMR_NM__1_1_0_S6_S3 0 100
 /begin AXIS_DESCR STD_AXIS iItfInput.fzg_geschwindigkeit UMR_KM_H_1_1_0_S6_S3 4 0 400 DEPOSIT ABSOLUTE MONOTONY MON_INCREASE /end AXIS_DESCR
/end CHARACTERISTIC
/begin CHARACTERISTIC M_HOTMODEMAXINC "Motormomentenerhoehung pro Task fuer Hot-Mode-Funktion" VALUE 0x26D49C kw_si16_S6_S3 1640 UMR_NM__1_1_0_S6_S3 0 1640 /end CHARACTERISTIC
/begin CHARACTERISTIC M_HOTMODEMAXDEC "Motormomentenreduzierung pro Task fuer Hot-Mode-Funktion" VALUE 0x26D49E kw_si16_S6_S3 1640 UMR_NM__1_1_0_S6_S3 0 1640 /end CHARACTERISTIC
/begin CHARACTERISTIC CGT_KUEHL1MAX "Getriebtemperaturschwelle fuer Anforderung max. Kuehlleistung" VALUE 0x26E4C8 kw_ui8_S6_S3 240 UMR_GRADC__1_1_M40_S6_S3 -40 200 /end CHARACTERISTIC
/begin CHARACTERISTIC CCH_KUEHL1MAX "Chiptemperaturschwelle fuer Anforderung max. Kuehlleistung" VALUE 0x26E4C9 kw_ui8_S6_S3 240 UMR_GRADC__1_1_M40_S6_S3 -40 200 /end CHARACTERISTIC
/begin CHARACTERISTIC CIAE_KUEHL1MAX "IAE-Temperaturschwelle für Anforderung max.Kühlerstufe" VALUE 0x26D4A0 kw_si16_S6_S3 340 UMR_GRADC__1_1_M40_S6_S3 -40 300 /end CHARACTERISTIC
/begin CHARACTERISTIC CIAE_KUEHL2MAX "IAE-Temperaturschwelle für Anforderung max.Kühlerstufe" VALUE 0x26D4A2 kw_si16_S6_S3 340 UMR_GRADC__1_1_M40_S6_S3 -40 300 /end CHARACTERISTIC
/begin CHARACTERISTIC CIAE_HMHYS "Hysterese fuer IAE-Temperatur" VALUE 0x26E4CA kw_ui8_S6_S3 100 UMR_GRADC__1_1_0_S6_S3 0 100 /end CHARACTERISTIC
/begin CHARACTERISTIC CGT_KUEHL2MAX "Getriebtemperaturschwelle fuer Anforderung max. Kuehlleistung" VALUE 0x26E4CB kw_ui8_S6_S3 240 UMR_GRADC__1_1_M40_S6_S3 -40 200 /end CHARACTERISTIC
/begin CHARACTERISTIC CCH_KUEHL2MAX "Chiptemperaturschwelle fuer Anforderung max. Kuehlleistung" VALUE 0x26E4CC kw_ui8_S6_S3 240 UMR_GRADC__1_1_M40_S6_S3 -40 200 /end CHARACTERISTIC
/begin CHARACTERISTIC CGT_HOTMODE "Getriebtemperaturschwelle fuer Anforderung Hot-Mode" VALUE 0x26E4CD kw_ui8_S6_S3 240 UMR_GRADC__1_1_M40_S6_S3 -40 200 /end CHARACTERISTIC
/begin CHARACTERISTIC CCH_HOTMODE "Chiptemperaturschwelle fuer Anforderung Hot-Mode" VALUE 0x26E4CE kw_ui8_S6_S3 240 UMR_GRADC__1_1_M40_S6_S3 -40 200 /end CHARACTERISTIC
/begin CHARACTERISTIC CGT_HMME "Getriebtemperaturschwelle fuer Anforderung Momentenreduzierung" VALUE 0x26E4CF kw_ui8_S6_S3 240 UMR_GRADC__1_1_M40_S6_S3 -40 200 /end CHARACTERISTIC
/begin CHARACTERISTIC CCH_HMME "Chiptemperaturschwelle fuer Anforderung Momentenreduzierung" VALUE 0x26E4D0 kw_ui8_S6_S3 240 UMR_GRADC__1_1_M40_S6_S3 -40 200 /end CHARACTERISTIC
/begin CHARACTERISTIC CGT_HMHYS "Hysterese fuer Getriebtemperatur" VALUE 0x26E4D1 kw_ui8_S6_S3 100 UMR_GRADC__1_1_0_S6_S3 0 100 /end CHARACTERISTIC
/begin CHARACTERISTIC CCH_HMHYS "Hysterese fuer Chiptemperatur" VALUE 0x26E4D2 kw_ui8_S6_S3 100 UMR_GRADC__1_1_0_S6_S3 0 100 /end CHARACTERISTIC
/begin CHARACTERISTIC KL_MHOTMODEMAX_R "Kennlinie Momentenbegrenzung aus der Hot-Mode-Funktion f(c_chip , c_getr)" CURVE 0x21E754 kl_si16_S6_S3 2040 UMR_NM__1_1_0_S6_S3 -400 1640
 /begin AXIS_DESCR STD_AXIS iBihHotmode.c_maxhotmode UMR_GRADC__1_1_M40_S6_S3 4 -40 150 DEPOSIT ABSOLUTE MONOTONY MON_INCREASE /end AXIS_DESCR
/end CHARACTERISTIC
/begin CHARACTERISTIC KL_MHOTMODEMAX_1 "Kennlinie Momentenbegrenzung aus der Hot-Mode-Funktion f(c_chip , c_getr)" CURVE 0x21E768 kl_si16_S6_S3 2040 UMR_NM__1_1_0_S6_S3 -400 1640
 /begin AXIS_DESCR STD_AXIS iBihHotmode.c_maxhotmode UMR_GRADC__1_1_M40_S6_S3 4 -40 150 DEPOSIT ABSOLUTE MONOTONY MON_INCREASE /end AXIS_DESCR
/end CHARACTERISTIC
/begin CHARACTERISTIC KL_MHOTMODEMAX_2 "Kennlinie Momentenbegrenzung aus der Hot-Mode-Funktion f(c_chip , c_getr)" CURVE 0x21E77C kl_si16_S6_S3 2040 UMR_NM__1_1_0_S6_S3 -400 1640
 /begin AXIS_DESCR STD_AXIS iBihHotmode.c_maxhotmode UMR_GRADC__1_1_M40_S6_S3 4 -40 150 DEPOSIT ABSOLUTE MONOTONY MON_INCREASE /end AXIS_DESCR
/end CHARACTERISTIC
/begin CHARACTERISTIC KL_MHOTMODEMAX_3 "Kennlinie Momentenbegrenzung aus der Hot-Mode-Funktion f(c_chip , c_getr)" CURVE 0x21E790 kl_si16_S6_S3 2040 UMR_NM__1_1_0_S6_S3 -400 1640
 /begin AXIS_DESCR STD_AXIS iBihHotmode.c_maxhotmode UMR_GRADC__1_1_M40_S6_S3 4 -40 150 DEPOSIT ABSOLUTE MONOTONY MON_INCREASE /end AXIS_DESCR
/end CHARACTERISTIC
/begin CHARACTERISTIC KL_MHOTMODEMAX_4 "Kennlinie Momentenbegrenzung aus der Hot-Mode-Funktion f(c_chip , c_getr)" CURVE 0x21E7A4 kl_si16_S6_S3 2040 UMR_NM__1_1_0_S6_S3 -400 1640
 /begin AXIS_DESCR STD_AXIS iBihHotmode.c_maxhotmode UMR_GRADC__1_1_M40_S6_S3 4 -40 150 DEPOSIT ABSOLUTE MONOTONY MON_INCREASE /end AXIS_DESCR
/end CHARACTERISTIC
/begin CHARACTERISTIC KL_MHOTMODEMAX_5 "Kennlinie Momentenbegrenzung aus der Hot-Mode-Funktion f(c_chip , c_getr)" CURVE 0x21E7B8 kl_si16_S6_S3 2040 UMR_NM__1_1_0_S6_S3 -400 1640
 /begin AXIS_DESCR STD_AXIS iBihHotmode.c_maxhotmode UMR_GRADC__1_1_M40_S6_S3 4 -40 150 DEPOSIT ABSOLUTE MONOTONY MON_INCREASE /end AXIS_DESCR
/end CHARACTERISTIC
/begin CHARACTERISTIC KL_MHOTMODEMAX_6 "Kennlinie Momentenbegrenzung aus der Hot-Mode-Funktion f(c_chip , c_getr)" CURVE 0x21E7CC kl_si16_S6_S3 2040 UMR_NM__1_1_0_S6_S3 -400 1640
 /begin AXIS_DESCR STD_AXIS iBihHotmode.c_maxhotmode UMR_GRADC__1_1_M40_S6_S3 4 -40 150 DEPOSIT ABSOLUTE MONOTONY MON_INCREASE /end AXIS_DESCR
/end CHARACTERISTIC
/begin CHARACTERISTIC KL_MHOTMODEMAX_7 "Kennlinie Momentenbegrenzung aus der Hot-Mode-Funktion f(c_chip , c_getr)" CURVE 0x21E7E0 kl_si16_S6_S3 2040 UMR_NM__1_1_0_S6_S3 -400 1640
 /begin AXIS_DESCR STD_AXIS iBihHotmode.c_maxhotmode UMR_GRADC__1_1_M40_S6_S3 4 -40 150 DEPOSIT ABSOLUTE MONOTONY MON_INCREASE /end AXIS_DESCR
/end CHARACTERISTIC
/begin CHARACTERISTIC KL_MHOTMODEMAX_8 "Kennlinie Momentenbegrenzung aus der Hot-Mode-Funktion f(c_chip , c_getr)" CURVE 0x21E7F4 kl_si16_S6_S3 2040 UMR_NM__1_1_0_S6_S3 -400 1640
 /begin AXIS_DESCR STD_AXIS iBihHotmode.c_maxhotmode UMR_GRADC__1_1_M40_S6_S3 4 -40 150 DEPOSIT ABSOLUTE MONOTONY MON_INCREASE /end AXIS_DESCR
/end CHARACTERISTIC
/begin CHARACTERISTIC FI_NABNEU "Filteranzahl n_ab neuer Wert" VALUE 0x26E4C4 kw_ui8_S6_S3 9 UMR___1_1_0_S6_S3 1 10 /end CHARACTERISTIC
/begin CHARACTERISTIC FI_NABALT "Filteranzahl n_ab alter Wert" VALUE 0x26E4C5 kw_ui8_S6_S3 10 UMR___1_1_0_S6_S3 0 10 /end CHARACTERISTIC
/begin CHARACTERISTIC FI_NTNEU "Filteranzahl n_t neuer Wert" VALUE 0x26E4C6 kw_ui8_S6_S3 9 UMR___1_1_0_S6_S3 1 10 /end CHARACTERISTIC
/begin CHARACTERISTIC FI_NTALT "Filteranzahl n_t alter Wert" VALUE 0x26E4C7 kw_ui8_S6_S3 10 UMR___1_1_0_S6_S3 0 10 /end CHARACTERISTIC
/begin CHARACTERISTIC T_FNUEG "Filterzeit fuer Gradientenberechnung nue" VALUE 0x26D494 kw_ui16_S6_S3 999 UMR_MSEC__1_1_0_S6_S3 1 1000 /end CHARACTERISTIC
/begin CHARACTERISTIC T_FNGT "Filterzeit fuer Gradientenfilter n_t" VALUE 0x26D496 kw_ui16_S6_S3 999 UMR_MSEC__1_1_0_S6_S3 1 1000 /end CHARACTERISTIC
/begin CHARACTERISTIC T_FNGMOT "Filterzeit fuer Gradientenfilter n_mot" VALUE 0x26D498 kw_ui16_S6_S3 999 UMR_MSEC__1_1_0_S6_S3 1 1000 /end CHARACTERISTIC
/begin CHARACTERISTIC T_FNGAB "Filterzeit fuer Abtriebsdrehzahlgradient" VALUE 0x26D49A kw_ui16_S6_S3 999 UMR_MSEC__1_1_0_S6_S3 1 1000 /end CHARACTERISTIC
/begin CHARACTERISTIC SWI_MEUW "Switch Motoreingriffsueberwachung" VALUE 0x26E4D9 kw_bool8_S6_S3 1 UMR___1_1_0_S6_S3 0 1 /end CHARACTERISTIC
/begin CHARACTERISTIC T_MEMAXGL "maximale Motoreingriffszeit" VALUE 0x26D4AA kw_ui16_S6_S3 60000 UMR_MSEC__10_1_0_S6_S3 0 60000 /end CHARACTERISTIC
/begin CHARACTERISTIC T_METOT "Motoreingriffsunterbrechungszeit" VALUE 0x26E4DA kw_ui8_S6_S3 2000 UMR_MSEC__10_1_0_S6_S3 0 2000 /end CHARACTERISTIC
/begin CHARACTERISTIC NS_ABMEDA "Abtriebsdrehzahlschwelle Dauermotoreingriff" VALUE 0x26D4AC kw_ui16_S6_S3 8200 UMR_U_MIN_1_1_0_S6_S3 0 8200 /end CHARACTERISTIC
/begin CHARACTERISTIC KL_KMMOTMAXCM "Korrekturwert Max. Motormoment fuer gefuehrter Getriebeschutz" CURVE 0x21E874 kl_ui16_S6_S3 10 UMR___1_100_0_S6_S3 0 10
 /begin AXIS_DESCR STD_AXIS zff_atsys._.iSignale._.obj.sig_c_mot UMR_GRADC__1_1_M48_S6_S3 7 -48 152 DEPOSIT ABSOLUTE MONOTONY MON_INCREASE /end AXIS_DESCR
/end CHARACTERISTIC
/begin CHARACTERISTIC M_ERSMOTMAXGE "Ersatzwert Max. Motormoment bei GE fuer gef. Getriebeschutz" VALUE 0x26D4AE kw_si16_S6_S3 1640 UMR_NM__1_1_0_S6_S3 0 1640 /end CHARACTERISTIC
/begin CHARACTERISTIC SICH_MMOTMAX "Sicherheitsfaktor Berechnung max. zul. Motormoment" VALUE 0x26E4DB kw_ui8_S6_S3 100 UMR_PROZENT__20_51_0_S6_S3 0 100 /end CHARACTERISTIC
/begin CHARACTERISTIC T_MMOTMAXAUF "Rampenzeit fuer die Erhoehung des max. zulaessigen Motormoments" VALUE 0x26E4DC kw_ui8_S6_S3 2540 UMR_MSEC__10_1_0_S6_S3 0 2540 /end CHARACTERISTIC
/begin CHARACTERISTIC M_MOTORMAX "Maximal zulässiges Motormoment fuer gef. Getriebeschutz" VALUE 0x26D4B0 kw_si16_S6_S3 1640 UMR_NM__1_1_0_S6_S3 0 1640 /end CHARACTERISTIC
/begin CHARACTERISTIC SWI_CONSIDER_EPB "Schalter zur Aktivierung der Bed. mit Feststellbremse" VALUE 0x26E4DD kw_bool8_S6_S3 1 UMR___1_1_0_S6_S3 0 1 /end CHARACTERISTIC
/begin CHARACTERISTIC TAB_MGETRMAX "Tabelle fuer zul. Getriebeeingangsmoment" CURVE 0x21E894 tab_si16_S6_S3 1640 UMR_NM__1_1_0_S6_S3 0 1640
 /begin AXIS_DESCR FIX_AXIS zff_atsys._.iSignale._.obj.sig_zielgang UMR___1_1_0_S6_S3 10 -1 8 FIX_AXIS_PAR_DIST -1 1 10 /end AXIS_DESCR
/end CHARACTERISTIC
/begin CHARACTERISTIC TAB_TRANSPORTMGETRMAX "Momentenbegrenzung während Transportmode" CURVE 0x21E8AC tab_si16_S6_S3 1640 UMR_NM__1_1_0_S6_S3 0 1640
 /begin AXIS_DESCR FIX_AXIS zff_atsys._.iSignale._.obj.sig_zielgang UMR___1_1_0_S6_S3 10 -1 8 FIX_AXIS_PAR_DIST -1 1 10 /end AXIS_DESCR
/end CHARACTERISTIC
/begin CHARACTERISTIC KF_MGETRMAXCK "Kennfeld für zul. Getriebeeingangsmomente von c_kupplung" MAP 0x21E8C4 kf_si16_S6_S3 1640 UMR_NM__1_1_0_S6_S3 0 1640
 /begin AXIS_DESCR STD_AXIS zff_atsys._.iSignale._.obj.sig_istgang UMR___1_1_0_S6_S3 8 -1 8 DEPOSIT ABSOLUTE MONOTONY MON_INCREASE /end AXIS_DESCR
 /begin AXIS_DESCR STD_AXIS NO_INPUT_QUANTITY UMR_GRADC__1_1_0_S6_S3 3 -40 500 DEPOSIT ABSOLUTE MONOTONY MON_INCREASE /end AXIS_DESCR
/end CHARACTERISTIC
/begin CHARACTERISTIC TAB_MGETRMAXSHIFT "Tabelle fuer zul. Getriebeeingangsmoment in Hochschaltung" MAP 0x21E914 tab2d_si16_S6_S3 1640 UMR_NM__1_1_0_S6_S3 0 1640
 /begin AXIS_DESCR FIX_AXIS zff_atsys._.iSignale._.obj.sig_istgang UMR___1_1_0_S6_S3 10 -1 8 FIX_AXIS_PAR_DIST -1 1 10 /end AXIS_DESCR
 /begin AXIS_DESCR FIX_AXIS zff_atsys._.iSignale._.obj.sig_zielgang UMR___1_1_0_S6_S3 10 -1 8 FIX_AXIS_PAR_DIST -1 1 10 /end AXIS_DESCR
/end CHARACTERISTIC
/begin CHARACTERISTIC KF_MESCHLUPFAS "Kennfeld zur Momentenreduzierung in Abhängigkeit von Schlupf und Motormoment" MAP 0x21E9E4 kf_si16_S6_S3 1640 UMR_NM__1_1_0_S6_S3 0 1640
 /begin AXIS_DESCR STD_AXIS iBihMobef.nd_synschutz UMR_U_MIN_1_1_0_S6_S3 4 0 8160 DEPOSIT ABSOLUTE MONOTONY MON_INCREASE /end AXIS_DESCR
 /begin AXIS_DESCR STD_AXIS iItfInput.m_t UMR_NM__1_1_0_S6_S3 4 -400 1640 DEPOSIT ABSOLUTE MONOTONY MON_INCREASE /end AXIS_DESCR
/end CHARACTERISTIC
/begin CHARACTERISTIC KL_NDSYNMESCHLUPF "Schlupfschwelle zum Einstieg in die Funktion" CURVE 0x21EA1C kl_ui16_S6_S3 8000 UMR_U_MIN_1_1_0_S6_S3 0 8000
 /begin AXIS_DESCR STD_AXIS iItfInput.n_ab UMR_U_MIN_1_1_0_S6_S3 3 0 8160 DEPOSIT ABSOLUTE MONOTONY MON_INCREASE /end AXIS_DESCR
/end CHARACTERISTIC
/begin CHARACTERISTIC M_MOTSCHLUPF "Motormomentengrenze zum Einstieg in die Funktion gef. Getreiebschutz bei Schlupf" VALUE 0x26D4B2 kw_si16_S6_S3 1640 UMR_NM__1_1_0_S6_S3 0 1640 /end CHARACTERISTIC
/begin CHARACTERISTIC T_MESCHLUPFASMRED "Zeit während der die Momentenreduzierung bei Schupf aktiv bleibt" VALUE 0x26D4B4 kw_ui16_S6_S3 650000 UMR_MSEC__10_1_0_S6_S3 0 650000 /end CHARACTERISTIC
/begin CHARACTERISTIC T_MESCHLUPFASMMOT "Rampenzeit in der die Momentenbegrenzung wegen Schlupf aufgehoben wird" VALUE 0x26E4DE kw_ui8_S6_S3 2550 UMR_MSEC__10_1_0_S6_S3 0 2550 /end CHARACTERISTIC
/begin CHARACTERISTIC NS_ABSCHLUPF "Abtriebsdrehzahl Schwelle fuer Schlupferkennung" VALUE 0x26D4B6 kw_ui16_S6_S3 8000 UMR_U_MIN_1_1_0_S6_S3 0 8000 /end CHARACTERISTIC
/begin CHARACTERISTIC TS_SYNMESCHLUPF "Zeitschwelle für Geführten Getriebeschutz bei Schlupferkennung" VALUE 0x26E4DF kw_ui8_S6_S3 500 UMR_MSEC__10_1_0_S6_S3 0 500 /end CHARACTERISTIC
/begin CHARACTERISTIC DKIS_STALL "DKI-Schwelle fuer gefuehrte Getriebeschutz im Stallspeed" VALUE 0x26E4E0 kw_ui8_S6_S3 100 UMR_PROZENT__20_51_0_S6_S3 0 100 /end CHARACTERISTIC
/begin CHARACTERISTIC M_MOTMAXINC "Incrementwert Motoraufregelrampe gef. Getriebeschutz im Stallspeed" VALUE 0x26D4B8 kw_si16_S6_S3 1640 UMR_NM__1_1_0_S6_S3 0 1640 /end CHARACTERISTIC
/begin CHARACTERISTIC NS_MOTSTALL "Motordrehzahlschwelle fuer gefuehrter Getriebeschutz im Stallspeed" VALUE 0x26D4BA kw_ui16_S6_S3 8000 UMR_U_MIN_1_1_0_S6_S3 0 8000 /end CHARACTERISTIC
/begin CHARACTERISTIC NS_TSTALL "Turbinendrehzahlschwelle fuer gefuehrter Getriebeschutz im Stallspeed" VALUE 0x26D4BC kw_ui16_S6_S3 8000 UMR_U_MIN_1_1_0_S6_S3 0 8000 /end CHARACTERISTIC
/begin CHARACTERISTIC T_MMOTMAXAB "Rampenzeit fuer die Erniedrigung des max. zulaessigen Motormoments" VALUE 0x26E4E1 kw_ui8_S6_S3 2540 UMR_MSEC__10_1_0_S6_S3 0 2540 /end CHARACTERISTIC
/begin CHARACTERISTIC KL_RGANGLIMIT "Kennlinie zur Momentenreduzierung in Abhängigkeit von der Turbinendrehzahl" CURVE 0x21EA2C kl_si16_S6_S3 1640 UMR_NM__1_1_0_S6_S3 0 1640
 /begin AXIS_DESCR STD_AXIS iItfInput.n_t UMR_U_MIN_1_1_0_S6_S3 4 0 8160 DEPOSIT ABSOLUTE MONOTONY MON_INCREASE /end AXIS_DESCR
/end CHARACTERISTIC
/begin CHARACTERISTIC M_MOTMAXOFFSETOB "Obergrenze für Motorträgheit für Beeinflussung Geführten Getriebeschutz" VALUE 0x26E4E2 kw_ui8_S6_S3 250 UMR_NM__1_1_0_S6_S3 0 250 /end CHARACTERISTIC
/begin CHARACTERISTIC J_MOT_GETRMAX "Motorträgheit für Beeinflussung Geführten Getriebeschutz" VALUE 0x26D4BE kw_ui16_S6_S3 1.275 UMR_KGM2__1_1000_0_S6_S3 0 1.275 /end CHARACTERISTIC
/begin CHARACTERISTIC T_VSTALL "Verzögerungszeit für den Einstieg in die Fkt. zur Vermeidung von Bauteilschäden im Antriebsstrang" VALUE 0x26E4E3 kw_ui8_S6_S3 2540 UMR_MSEC__10_1_0_S6_S3 0 2540 /end CHARACTERISTIC
/begin CHARACTERISTIC TAB_MGETRMAXSTALL "Gangabhängiges Motormaximalmoment für Stallspeedfunktion" CURVE 0x21EA40 tab_si16_S6_S3 1640 UMR_NM__1_1_0_S6_S3 0 1640
 /begin AXIS_DESCR FIX_AXIS zff_atsys._.iSignale._.obj.sig_istgang UMR___1_1_0_S6_S3 10 -1 8 FIX_AXIS_PAR_DIST -1 1 10 /end AXIS_DESCR
/end CHARACTERISTIC
/begin CHARACTERISTIC KF_MMOTMAXGE_R "Max. Motormoment GE fuer gefuehrter Getriebeschutz" MAP 0x21EA58 kf_si16_S6_S3 2040 UMR_NM__1_1_0_S6_S3 -400 1640
 /begin AXIS_DESCR STD_AXIS zff_atsys._.iSignale._.obj.sig_n_mot UMR_U_MIN_1_1_0_S6_S3 4 0 8160 DEPOSIT ABSOLUTE MONOTONY MON_INCREASE /end AXIS_DESCR
 /begin AXIS_DESCR STD_AXIS iBihMobef.nd_synmmotmax UMR_U_MIN_1_1_0_S6_S3 4 -7000 7000 DEPOSIT ABSOLUTE MONOTONY MON_INCREASE /end AXIS_DESCR
/end CHARACTERISTIC
/begin CHARACTERISTIC KF_MMOTMAXGE_R_EL "Max. Motormoment GE fuer gefuehrter Getriebeschutz" MAP 0x21EA90 kf_si16_S6_S3 2040 UMR_NM__1_1_0_S6_S3 -400 1640
 /begin AXIS_DESCR STD_AXIS zff_atsys._.iSignale._.obj.sig_n_mot UMR_U_MIN_1_1_0_S6_S3 4 0 8160 DEPOSIT ABSOLUTE MONOTONY MON_INCREASE /end AXIS_DESCR
 /begin AXIS_DESCR STD_AXIS iBihMobef.nd_synmmotmax UMR_U_MIN_1_1_0_S6_S3 4 -7000 7000 DEPOSIT ABSOLUTE MONOTONY MON_INCREASE /end AXIS_DESCR
/end CHARACTERISTIC
/begin CHARACTERISTIC KF_MMOTMAXGE_1 "Max. Motormoment GE fuer gefuehrter Getriebeschutz" MAP 0x21EAC8 kf_si16_S6_S3 2040 UMR_NM__1_1_0_S6_S3 -400 1640
 /begin AXIS_DESCR STD_AXIS zff_atsys._.iSignale._.obj.sig_n_mot UMR_U_MIN_1_1_0_S6_S3 4 0 8160 DEPOSIT ABSOLUTE MONOTONY MON_INCREASE /end AXIS_DESCR
 /begin AXIS_DESCR STD_AXIS iBihMobef.nd_synmmotmax UMR_U_MIN_1_1_0_S6_S3 4 -7000 7000 DEPOSIT ABSOLUTE MONOTONY MON_INCREASE /end AXIS_DESCR
/end CHARACTERISTIC
/begin CHARACTERISTIC KF_MMOTMAXGE_1_EL "Max. Motormoment GE fuer gefuehrter Getriebeschutz" MAP 0x21EB00 kf_si16_S6_S3 2040 UMR_NM__1_1_0_S6_S3 -400 1640
 /begin AXIS_DESCR STD_AXIS zff_atsys._.iSignale._.obj.sig_n_mot UMR_U_MIN_1_1_0_S6_S3 4 0 8160 DEPOSIT ABSOLUTE MONOTONY MON_INCREASE /end AXIS_DESCR
 /begin AXIS_DESCR STD_AXIS iBihMobef.nd_synmmotmax UMR_U_MIN_1_1_0_S6_S3 4 -7000 7000 DEPOSIT ABSOLUTE MONOTONY MON_INCREASE /end AXIS_DESCR
/end CHARACTERISTIC
/begin CHARACTERISTIC KF_MMOTMAXGE_2 "Max. Motormoment GE fuer gefuehrter Getriebeschutz" MAP 0x21EB38 kf_si16_S6_S3 2040 UMR_NM__1_1_0_S6_S3 -400 1640
 /begin AXIS_DESCR STD_AXIS zff_atsys._.iSignale._.obj.sig_n_mot UMR_U_MIN_1_1_0_S6_S3 4 0 8160 DEPOSIT ABSOLUTE MONOTONY MON_INCREASE /end AXIS_DESCR
 /begin AXIS_DESCR STD_AXIS iBihMobef.nd_synmmotmax UMR_U_MIN_1_1_0_S6_S3 4 -7000 7000 DEPOSIT ABSOLUTE MONOTONY MON_INCREASE /end AXIS_DESCR
/end CHARACTERISTIC
/begin CHARACTERISTIC KF_MMOTMAXGE_2_EL "Max. Motormoment GE fuer gefuehrter Getriebeschutz" MAP 0x21EB70 kf_si16_S6_S3 2040 UMR_NM__1_1_0_S6_S3 -400 1640
 /begin AXIS_DESCR STD_AXIS zff_atsys._.iSignale._.obj.sig_n_mot UMR_U_MIN_1_1_0_S6_S3 4 0 8160 DEPOSIT ABSOLUTE MONOTONY MON_INCREASE /end AXIS_DESCR
 /begin AXIS_DESCR STD_AXIS iBihMobef.nd_synmmotmax UMR_U_MIN_1_1_0_S6_S3 4 -7000 7000 DEPOSIT ABSOLUTE MONOTONY MON_INCREASE /end AXIS_DESCR
/end CHARACTERISTIC
/begin CHARACTERISTIC KF_MMOTMAXGE_3 "Max. Motormoment GE fuer gefuehrter Getriebeschutz" MAP 0x21EBA8 kf_si16_S6_S3 2040 UMR_NM__1_1_0_S6_S3 -400 1640
 /begin AXIS_DESCR STD_AXIS zff_atsys._.iSignale._.obj.sig_n_mot UMR_U_MIN_1_1_0_S6_S3 4 0 8160 DEPOSIT ABSOLUTE MONOTONY MON_INCREASE /end AXIS_DESCR
 /begin AXIS_DESCR STD_AXIS iBihMobef.nd_synmmotmax UMR_U_MIN_1_1_0_S6_S3 4 -7000 7000 DEPOSIT ABSOLUTE MONOTONY MON_INCREASE /end AXIS_DESCR
/end CHARACTERISTIC
/begin CHARACTERISTIC KF_MMOTMAXGE_3_EL "Max. Motormoment GE fuer gefuehrter Getriebeschutz" MAP 0x21EBE0 kf_si16_S6_S3 2040 UMR_NM__1_1_0_S6_S3 -400 1640
 /begin AXIS_DESCR STD_AXIS zff_atsys._.iSignale._.obj.sig_n_mot UMR_U_MIN_1_1_0_S6_S3 4 0 8160 DEPOSIT ABSOLUTE MONOTONY MON_INCREASE /end AXIS_DESCR
 /begin AXIS_DESCR STD_AXIS iBihMobef.nd_synmmotmax UMR_U_MIN_1_1_0_S6_S3 4 -7000 7000 DEPOSIT ABSOLUTE MONOTONY MON_INCREASE /end AXIS_DESCR
/end CHARACTERISTIC
/begin CHARACTERISTIC KF_MMOTMAXGE_4 "Max. Motormoment GE fuer gefuehrter Getriebeschutz" MAP 0x21EC18 kf_si16_S6_S3 2040 UMR_NM__1_1_0_S6_S3 -400 1640
 /begin AXIS_DESCR STD_AXIS zff_atsys._.iSignale._.obj.sig_n_mot UMR_U_MIN_1_1_0_S6_S3 4 0 8160 DEPOSIT ABSOLUTE MONOTONY MON_INCREASE /end AXIS_DESCR
 /begin AXIS_DESCR STD_AXIS iBihMobef.nd_synmmotmax UMR_U_MIN_1_1_0_S6_S3 4 -7000 7000 DEPOSIT ABSOLUTE MONOTONY MON_INCREASE /end AXIS_DESCR
/end CHARACTERISTIC
/begin CHARACTERISTIC KF_MMOTMAXGE_4_EL "Max. Motormoment GE fuer gefuehrter Getriebeschutz" MAP 0x21EC50 kf_si16_S6_S3 2040 UMR_NM__1_1_0_S6_S3 -400 1640
 /begin AXIS_DESCR STD_AXIS zff_atsys._.iSignale._.obj.sig_n_mot UMR_U_MIN_1_1_0_S6_S3 4 0 8160 DEPOSIT ABSOLUTE MONOTONY MON_INCREASE /end AXIS_DESCR
 /begin AXIS_DESCR STD_AXIS iBihMobef.nd_synmmotmax UMR_U_MIN_1_1_0_S6_S3 4 -7000 7000 DEPOSIT ABSOLUTE MONOTONY MON_INCREASE /end AXIS_DESCR
/end CHARACTERISTIC
/begin CHARACTERISTIC KF_MMOTMAXGE_5 "Max. Motormoment GE fuer gefuehrter Getriebeschutz" MAP 0x21EC88 kf_si16_S6_S3 2040 UMR_NM__1_1_0_S6_S3 -400 1640
 /begin AXIS_DESCR STD_AXIS zff_atsys._.iSignale._.obj.sig_n_mot UMR_U_MIN_1_1_0_S6_S3 4 0 8160 DEPOSIT ABSOLUTE MONOTONY MON_INCREASE /end AXIS_DESCR
 /begin AXIS_DESCR STD_AXIS iBihMobef.nd_synmmotmax UMR_U_MIN_1_1_0_S6_S3 4 -7000 7000 DEPOSIT ABSOLUTE MONOTONY MON_INCREASE /end AXIS_DESCR
/end CHARACTERISTIC
/begin CHARACTERISTIC KF_MMOTMAXGE_5_EL "Max. Motormoment GE fuer gefuehrter Getriebeschutz" MAP 0x21ECC0 kf_si16_S6_S3 2040 UMR_NM__1_1_0_S6_S3 -400 1640
 /begin AXIS_DESCR STD_AXIS zff_atsys._.iSignale._.obj.sig_n_mot UMR_U_MIN_1_1_0_S6_S3 4 0 8160 DEPOSIT ABSOLUTE MONOTONY MON_INCREASE /end AXIS_DESCR
 /begin AXIS_DESCR STD_AXIS iBihMobef.nd_synmmotmax UMR_U_MIN_1_1_0_S6_S3 4 -7000 7000 DEPOSIT ABSOLUTE MONOTONY MON_INCREASE /end AXIS_DESCR
/end CHARACTERISTIC
/begin CHARACTERISTIC KF_MMOTMAXGE_6 "Max. Motormoment GE fuer gefuehrter Getriebeschutz" MAP 0x21ECF8 kf_si16_S6_S3 2040 UMR_NM__1_1_0_S6_S3 -400 1640
 /begin AXIS_DESCR STD_AXIS zff_atsys._.iSignale._.obj.sig_n_mot UMR_U_MIN_1_1_0_S6_S3 4 0 8160 DEPOSIT ABSOLUTE MONOTONY MON_INCREASE /end AXIS_DESCR
 /begin AXIS_DESCR STD_AXIS iBihMobef.nd_synmmotmax UMR_U_MIN_1_1_0_S6_S3 4 -7000 7000 DEPOSIT ABSOLUTE MONOTONY MON_INCREASE /end AXIS_DESCR
/end CHARACTERISTIC
/begin CHARACTERISTIC KF_MMOTMAXGE_6_EL "Max. Motormoment GE fuer gefuehrter Getriebeschutz" MAP 0x21ED30 kf_si16_S6_S3 2040 UMR_NM__1_1_0_S6_S3 -400 1640
 /begin AXIS_DESCR STD_AXIS zff_atsys._.iSignale._.obj.sig_n_mot UMR_U_MIN_1_1_0_S6_S3 4 0 8160 DEPOSIT ABSOLUTE MONOTONY MON_INCREASE /end AXIS_DESCR
 /begin AXIS_DESCR STD_AXIS iBihMobef.nd_synmmotmax UMR_U_MIN_1_1_0_S6_S3 4 -7000 7000 DEPOSIT ABSOLUTE MONOTONY MON_INCREASE /end AXIS_DESCR
/end CHARACTERISTIC
/begin CHARACTERISTIC KF_MMOTMAXGE_7 "Max. Motormoment GE fuer gefuehrter Getriebeschutz" MAP 0x21ED68 kf_si16_S6_S3 2040 UMR_NM__1_1_0_S6_S3 -400 1640
 /begin AXIS_DESCR STD_AXIS zff_atsys._.iSignale._.obj.sig_n_mot UMR_U_MIN_1_1_0_S6_S3 4 0 8160 DEPOSIT ABSOLUTE MONOTONY MON_INCREASE /end AXIS_DESCR
 /begin AXIS_DESCR STD_AXIS iBihMobef.nd_synmmotmax UMR_U_MIN_1_1_0_S6_S3 4 -7000 7000 DEPOSIT ABSOLUTE MONOTONY MON_INCREASE /end AXIS_DESCR
/end CHARACTERISTIC
/begin CHARACTERISTIC KF_MMOTMAXGE_7_EL "Max. Motormoment GE fuer gefuehrter Getriebeschutz" MAP 0x21EDA0 kf_si16_S6_S3 2040 UMR_NM__1_1_0_S6_S3 -400 1640
 /begin AXIS_DESCR STD_AXIS zff_atsys._.iSignale._.obj.sig_n_mot UMR_U_MIN_1_1_0_S6_S3 4 0 8160 DEPOSIT ABSOLUTE MONOTONY MON_INCREASE /end AXIS_DESCR
 /begin AXIS_DESCR STD_AXIS iBihMobef.nd_synmmotmax UMR_U_MIN_1_1_0_S6_S3 4 -7000 7000 DEPOSIT ABSOLUTE MONOTONY MON_INCREASE /end AXIS_DESCR
/end CHARACTERISTIC
/begin CHARACTERISTIC KF_MMOTMAXGE_8 "Max. Motormoment GE fuer gefuehrter Getriebeschutz" MAP 0x21EDD8 kf_si16_S6_S3 2040 UMR_NM__1_1_0_S6_S3 -400 1640
 /begin AXIS_DESCR STD_AXIS zff_atsys._.iSignale._.obj.sig_n_mot UMR_U_MIN_1_1_0_S6_S3 4 0 8160 DEPOSIT ABSOLUTE MONOTONY MON_INCREASE /end AXIS_DESCR
 /begin AXIS_DESCR STD_AXIS iBihMobef.nd_synmmotmax UMR_U_MIN_1_1_0_S6_S3 4 -7000 7000 DEPOSIT ABSOLUTE MONOTONY MON_INCREASE /end AXIS_DESCR
/end CHARACTERISTIC
/begin CHARACTERISTIC KF_MMOTMAXGE_8_EL "Max. Motormoment GE fuer gefuehrter Getriebeschutz" MAP 0x21EE10 kf_si16_S6_S3 2040 UMR_NM__1_1_0_S6_S3 -400 1640
 /begin AXIS_DESCR STD_AXIS zff_atsys._.iSignale._.obj.sig_n_mot UMR_U_MIN_1_1_0_S6_S3 4 0 8160 DEPOSIT ABSOLUTE MONOTONY MON_INCREASE /end AXIS_DESCR
 /begin AXIS_DESCR STD_AXIS iBihMobef.nd_synmmotmax UMR_U_MIN_1_1_0_S6_S3 4 -7000 7000 DEPOSIT ABSOLUTE MONOTONY MON_INCREASE /end AXIS_DESCR
/end CHARACTERISTIC
/begin CHARACTERISTIC KL_FMMOTCM "Kennlinie Korrektur Motormotormoment" CURVE 0x21EE48 kl_ui8_S6_S3 2.55 UMR___1_100_0_S6_S3 0 2.55
 /begin AXIS_DESCR STD_AXIS zff_atsys._.iSignale._.obj.sig_c_mot UMR_GRADC__1_1_M48_S6_S3 6 -48 144 DEPOSIT ABSOLUTE MONOTONY MON_INCREASE /end AXIS_DESCR
/end CHARACTERISTIC
/begin CHARACTERISTIC KL_FGMMOTMDMOTPSYS "Gewichtungsfaktor f.Momentenberechng m_motkor_psys" CURVE 0x21EE58 kl_si16_S6_S3 100 UMR_PROZENT__20_51_0_S6_S3 0 100
 /begin AXIS_DESCR STD_AXIS iBihMomen.md_motsollist UMR_NM__1_1_0_S6_S3 4 -2000 2000 DEPOSIT ABSOLUTE MONOTONY MON_INCREASE /end AXIS_DESCR
/end CHARACTERISTIC
/begin CHARACTERISTIC J_MOT "Traegheitsmoment Motor" VALUE 0x26D4C0 kw_ui16_S6_S3 10 UMR_KGM2__1_1000_0_S6_S3 0 10 /end CHARACTERISTIC
/begin CHARACTERISTIC J_MOT_EL "Traegheitsmoment Motor" VALUE 0x26D4C2 kw_ui16_S6_S3 10 UMR_KGM2__1_1000_0_S6_S3 0 10 /end CHARACTERISTIC
/begin CHARACTERISTIC M_ABDYNERR "Ersatzwert fuer dynamisches Abtriebsmoment" VALUE 0x26D4C4 kw_si16_S6_S3 65535 UMR_NM__1_1_0_S6_S3 -32768 32767 /end CHARACTERISTIC
/begin CHARACTERISTIC TAB_JGETR "Traegheitsmoment Getriebe" CURVE 0x21EE6C tab_ui16_S6_S3 10 UMR_KGM2__1_1000_0_S6_S3 0 10
 /begin AXIS_DESCR FIX_AXIS zff_atsys._.iSignale._.obj.sig_zielgang UMR___1_1_0_S6_S3 10 -1 8 FIX_AXIS_PAR_DIST -1 1 10 /end AXIS_DESCR
/end CHARACTERISTIC
/begin CHARACTERISTIC T_FDKIG "Filterzeit fuer Drosselklappengradient" VALUE 0x26D4C6 kw_ui16_S6_S3 999 UMR_MSEC__1_1_0_S6_S3 1 1000 /end CHARACTERISTIC
/begin CHARACTERISTIC MS_GETRVERL "Momentenschwelle zur Begrenzung des Getriebeverlustmomentes nach oben" VALUE 0x26E4E4 kw_ui8_S6_S3 200 UMR_NM__1_1_0_S6_S3 0 200 /end CHARACTERISTIC
/begin CHARACTERISTIC T_MVERL_K0 "Zeit zur Auf-/Abschaltung von Momentverlusen von K0" VALUE 0x26D4C8 kw_ui16_S6_S3 2520 UMR_MSEC__30_1_0_S6_S3 0 2520 /end CHARACTERISTIC
/begin CHARACTERISTIC KF_MVERLMTNT_K0 "Getriebeverlustmoment durch Oelpumpe fuer Gang K0" MAP 0x21EE84 kf_ui8_S6_S3 150 UMR_NM__1_1_0_S6_S3 0 150
 /begin AXIS_DESCR STD_AXIS zff_atsys._.iSignale._.obj.sig_m_t8 UMR_NM__8_1_M50_S6_S3 6 -400 1640 DEPOSIT ABSOLUTE MONOTONY MON_INCREASE /end AXIS_DESCR
 /begin AXIS_DESCR STD_AXIS zff_atsys._.iSignale._.obj.sig_n_t8 UMR_U_MIN_32_1_0_S6_S3 6 0 8160 DEPOSIT ABSOLUTE MONOTONY MON_INCREASE /end AXIS_DESCR
/end CHARACTERISTIC
/begin CHARACTERISTIC KL_F_MVERLCG "Faktor für Getriebeverlustmoment über Temperatur" CURVE 0x21EEBC kl_si16_S6_S3 10 UMR___1_100_0_S6_S3 -5 5
 /begin AXIS_DESCR STD_AXIS zff_atsys._.iSignale._.obj.sig_c_getr UMR_GRADC__1_1_M40_S6_S3 8 -40 150 DEPOSIT ABSOLUTE MONOTONY MON_INCREASE /end AXIS_DESCR
/end CHARACTERISTIC
/begin CHARACTERISTIC KF_MVERLMTNT_R "Getriebeverlustmoment inkl. Oelpumpe fuer Gang" MAP 0x21EEE0 kf_ui8_S6_S3 150 UMR_NM__1_1_0_S6_S3 0 150
 /begin AXIS_DESCR STD_AXIS zff_atsys._.iSignale._.obj.sig_m_t8 UMR_NM__8_1_M50_S6_S3 6 -400 1640 DEPOSIT ABSOLUTE MONOTONY MON_INCREASE /end AXIS_DESCR
 /begin AXIS_DESCR STD_AXIS zff_atsys._.iSignale._.obj.sig_n_t8 UMR_U_MIN_32_1_0_S6_S3 6 0 8160 DEPOSIT ABSOLUTE MONOTONY MON_INCREASE /end AXIS_DESCR
/end CHARACTERISTIC
/begin CHARACTERISTIC KL_FGMMOTMDMOT_R "Gewichtungsfaktor f.Momentenberechng m_motkor" CURVE 0x21EF18 kl_si16_S6_S3 100 UMR_PROZENT__20_51_0_S6_S3 0 100
 /begin AXIS_DESCR STD_AXIS iBihMomen.md_motsollist UMR_NM__1_1_0_S6_S3 4 -2000 2000 DEPOSIT ABSOLUTE MONOTONY MON_INCREASE /end AXIS_DESCR
/end CHARACTERISTIC
/begin CHARACTERISTIC KF_MVERLMTNT_1 "Getriebeverlustmoment inkl. Oelpumpe fuer Gang" MAP 0x21EF2C kf_ui8_S6_S3 150 UMR_NM__1_1_0_S6_S3 0 150
 /begin AXIS_DESCR STD_AXIS zff_atsys._.iSignale._.obj.sig_m_t8 UMR_NM__8_1_M50_S6_S3 6 -400 1640 DEPOSIT ABSOLUTE MONOTONY MON_INCREASE /end AXIS_DESCR
 /begin AXIS_DESCR STD_AXIS zff_atsys._.iSignale._.obj.sig_n_t8 UMR_U_MIN_32_1_0_S6_S3 6 0 8160 DEPOSIT ABSOLUTE MONOTONY MON_INCREASE /end AXIS_DESCR
/end CHARACTERISTIC
/begin CHARACTERISTIC KL_FGMMOTMDMOT_1 "Gewichtungsfaktor f.Momentenberechng m_motkor" CURVE 0x21EF64 kl_si16_S6_S3 100 UMR_PROZENT__20_51_0_S6_S3 0 100
 /begin AXIS_DESCR STD_AXIS iBihMomen.md_motsollist UMR_NM__1_1_0_S6_S3 4 -2000 2000 DEPOSIT ABSOLUTE MONOTONY MON_INCREASE /end AXIS_DESCR
/end CHARACTERISTIC
/begin CHARACTERISTIC KF_MVERLMTNT_2 "Getriebeverlustmoment inkl. Oelpumpe fuer Gang" MAP 0x21EF78 kf_ui8_S6_S3 150 UMR_NM__1_1_0_S6_S3 0 150
 /begin AXIS_DESCR STD_AXIS zff_atsys._.iSignale._.obj.sig_m_t8 UMR_NM__8_1_M50_S6_S3 6 -400 1640 DEPOSIT ABSOLUTE MONOTONY MON_INCREASE /end AXIS_DESCR
 /begin AXIS_DESCR STD_AXIS zff_atsys._.iSignale._.obj.sig_n_t8 UMR_U_MIN_32_1_0_S6_S3 6 0 8160 DEPOSIT ABSOLUTE MONOTONY MON_INCREASE /end AXIS_DESCR
/end CHARACTERISTIC
/begin CHARACTERISTIC KL_FGMMOTMDMOT_2 "Gewichtungsfaktor f.Momentenberechng m_motkor" CURVE 0x21EFB0 kl_si16_S6_S3 100 UMR_PROZENT__20_51_0_S6_S3 0 100
 /begin AXIS_DESCR STD_AXIS iBihMomen.md_motsollist UMR_NM__1_1_0_S6_S3 4 -2000 2000 DEPOSIT ABSOLUTE MONOTONY MON_INCREASE /end AXIS_DESCR
/end CHARACTERISTIC
/begin CHARACTERISTIC KF_MVERLMTNT_3 "Getriebeverlustmoment inkl. Oelpumpe fuer Gang" MAP 0x21EFC4 kf_ui8_S6_S3 150 UMR_NM__1_1_0_S6_S3 0 150
 /begin AXIS_DESCR STD_AXIS zff_atsys._.iSignale._.obj.sig_m_t8 UMR_NM__8_1_M50_S6_S3 6 -400 1640 DEPOSIT ABSOLUTE MONOTONY MON_INCREASE /end AXIS_DESCR
 /begin AXIS_DESCR STD_AXIS zff_atsys._.iSignale._.obj.sig_n_t8 UMR_U_MIN_32_1_0_S6_S3 6 0 8160 DEPOSIT ABSOLUTE MONOTONY MON_INCREASE /end AXIS_DESCR
/end CHARACTERISTIC
/begin CHARACTERISTIC KL_FGMMOTMDMOT_3 "Gewichtungsfaktor f.Momentenberechng m_motkor" CURVE 0x21EFFC kl_si16_S6_S3 100 UMR_PROZENT__20_51_0_S6_S3 0 100
 /begin AXIS_DESCR STD_AXIS iBihMomen.md_motsollist UMR_NM__1_1_0_S6_S3 4 -2000 2000 DEPOSIT ABSOLUTE MONOTONY MON_INCREASE /end AXIS_DESCR
/end CHARACTERISTIC
/begin CHARACTERISTIC KF_MVERLMTNT_4 "Getriebeverlustmoment inkl. Oelpumpe fuer Gang" MAP 0x21F010 kf_ui8_S6_S3 150 UMR_NM__1_1_0_S6_S3 0 150
 /begin AXIS_DESCR STD_AXIS zff_atsys._.iSignale._.obj.sig_m_t8 UMR_NM__8_1_M50_S6_S3 6 -400 1640 DEPOSIT ABSOLUTE MONOTONY MON_INCREASE /end AXIS_DESCR
 /begin AXIS_DESCR STD_AXIS zff_atsys._.iSignale._.obj.sig_n_t8 UMR_U_MIN_32_1_0_S6_S3 6 0 8160 DEPOSIT ABSOLUTE MONOTONY MON_INCREASE /end AXIS_DESCR
/end CHARACTERISTIC
/begin CHARACTERISTIC KL_FGMMOTMDMOT_4 "Gewichtungsfaktor f.Momentenberechng m_motkor" CURVE 0x21F048 kl_si16_S6_S3 100 UMR_PROZENT__20_51_0_S6_S3 0 100
 /begin AXIS_DESCR STD_AXIS iBihMomen.md_motsollist UMR_NM__1_1_0_S6_S3 4 -2000 2000 DEPOSIT ABSOLUTE MONOTONY MON_INCREASE /end AXIS_DESCR
/end CHARACTERISTIC
/begin CHARACTERISTIC KF_MVERLMTNT_5 "Getriebeverlustmoment inkl. Oelpumpe fuer Gang" MAP 0x21F05C kf_ui8_S6_S3 150 UMR_NM__1_1_0_S6_S3 0 150
 /begin AXIS_DESCR STD_AXIS zff_atsys._.iSignale._.obj.sig_m_t8 UMR_NM__8_1_M50_S6_S3 6 -400 1640 DEPOSIT ABSOLUTE MONOTONY MON_INCREASE /end AXIS_DESCR
 /begin AXIS_DESCR STD_AXIS zff_atsys._.iSignale._.obj.sig_n_t8 UMR_U_MIN_32_1_0_S6_S3 6 0 8160 DEPOSIT ABSOLUTE MONOTONY MON_INCREASE /end AXIS_DESCR
/end CHARACTERISTIC
/begin CHARACTERISTIC KL_FGMMOTMDMOT_5 "Gewichtungsfaktor f.Momentenberechng m_motkor" CURVE 0x21F094 kl_si16_S6_S3 100 UMR_PROZENT__20_51_0_S6_S3 0 100
 /begin AXIS_DESCR STD_AXIS iBihMomen.md_motsollist UMR_NM__1_1_0_S6_S3 4 -2000 2000 DEPOSIT ABSOLUTE MONOTONY MON_INCREASE /end AXIS_DESCR
/end CHARACTERISTIC
/begin CHARACTERISTIC KF_MVERLMTNT_6 "Getriebeverlustmoment inkl. Oelpumpe fuer Gang" MAP 0x21F0A8 kf_ui8_S6_S3 150 UMR_NM__1_1_0_S6_S3 0 150
 /begin AXIS_DESCR STD_AXIS zff_atsys._.iSignale._.obj.sig_m_t8 UMR_NM__8_1_M50_S6_S3 6 -400 1640 DEPOSIT ABSOLUTE MONOTONY MON_INCREASE /end AXIS_DESCR
 /begin AXIS_DESCR STD_AXIS zff_atsys._.iSignale._.obj.sig_n_t8 UMR_U_MIN_32_1_0_S6_S3 6 0 8160 DEPOSIT ABSOLUTE MONOTONY MON_INCREASE /end AXIS_DESCR
/end CHARACTERISTIC
/begin CHARACTERISTIC KL_FGMMOTMDMOT_6 "Gewichtungsfaktor f.Momentenberechng m_motkor" CURVE 0x21F0E0 kl_si16_S6_S3 100 UMR_PROZENT__20_51_0_S6_S3 0 100
 /begin AXIS_DESCR STD_AXIS iBihMomen.md_motsollist UMR_NM__1_1_0_S6_S3 4 -2000 2000 DEPOSIT ABSOLUTE MONOTONY MON_INCREASE /end AXIS_DESCR
/end CHARACTERISTIC
/begin CHARACTERISTIC KF_MVERLMTNT_7 "Getriebeverlustmoment inkl. Oelpumpe fuer Gang" MAP 0x21F0F4 kf_ui8_S6_S3 150 UMR_NM__1_1_0_S6_S3 0 150
 /begin AXIS_DESCR STD_AXIS zff_atsys._.iSignale._.obj.sig_m_t8 UMR_NM__8_1_M50_S6_S3 6 -400 1640 DEPOSIT ABSOLUTE MONOTONY MON_INCREASE /end AXIS_DESCR
 /begin AXIS_DESCR STD_AXIS zff_atsys._.iSignale._.obj.sig_n_t8 UMR_U_MIN_32_1_0_S6_S3 6 0 8160 DEPOSIT ABSOLUTE MONOTONY MON_INCREASE /end AXIS_DESCR
/end CHARACTERISTIC
/begin CHARACTERISTIC KL_FGMMOTMDMOT_7 "Gewichtungsfaktor f.Momentenberechng m_motkor" CURVE 0x21F12C kl_si16_S6_S3 100 UMR_PROZENT__20_51_0_S6_S3 0 100
 /begin AXIS_DESCR STD_AXIS iBihMomen.md_motsollist UMR_NM__1_1_0_S6_S3 4 -2000 2000 DEPOSIT ABSOLUTE MONOTONY MON_INCREASE /end AXIS_DESCR
/end CHARACTERISTIC
/begin CHARACTERISTIC KF_MVERLMTNT_8 "Getriebeverlustmoment inkl. Oelpumpe fuer Gang" MAP 0x21F140 kf_ui8_S6_S3 150 UMR_NM__1_1_0_S6_S3 0 150
 /begin AXIS_DESCR STD_AXIS zff_atsys._.iSignale._.obj.sig_m_t8 UMR_NM__8_1_M50_S6_S3 6 -400 1640 DEPOSIT ABSOLUTE MONOTONY MON_INCREASE /end AXIS_DESCR
 /begin AXIS_DESCR STD_AXIS zff_atsys._.iSignale._.obj.sig_n_t8 UMR_U_MIN_32_1_0_S6_S3 6 0 8160 DEPOSIT ABSOLUTE MONOTONY MON_INCREASE /end AXIS_DESCR
/end CHARACTERISTIC
/begin CHARACTERISTIC KL_FGMMOTMDMOT_8 "Gewichtungsfaktor f.Momentenberechng m_motkor" CURVE 0x21F178 kl_si16_S6_S3 100 UMR_PROZENT__20_51_0_S6_S3 0 100
 /begin AXIS_DESCR STD_AXIS iBihMomen.md_motsollist UMR_NM__1_1_0_S6_S3 4 -2000 2000 DEPOSIT ABSOLUTE MONOTONY MON_INCREASE /end AXIS_DESCR
/end CHARACTERISTIC
/begin CHARACTERISTIC NS_MOTIMIN "Drehzahlschwelle für Ansteuerung Minimalbestromung" VALUE 0x26D2E2 kw_ui16_S6_S3 8000 UMR_U_MIN_1_1_0_S6_S3 0 8000 /end CHARACTERISTIC
/begin CHARACTERISTIC NS_MOTPUMPE "Motordrehzahlschwelle fuer Pumpendruck" VALUE 0x26D2E4 kw_ui16_S6_S3 8000 UMR_U_MIN_1_1_0_S6_S3 0 8000 /end CHARACTERISTIC
/begin CHARACTERISTIC HYS_NSMOTPUMPE "Hysterese der Motordrehzahl fuer Pumpendruck" VALUE 0x26D2E6 kw_si16_S6_S3 1000 UMR_U_MIN_1_1_0_S6_S3 0 1000 /end CHARACTERISTIC
/begin CHARACTERISTIC NS_TPUMPE "Turbinendrehzahlschwelle fuer Pumpendruck" VALUE 0x26D2E8 kw_ui16_S6_S3 8000 UMR_U_MIN_1_1_0_S6_S3 0 8000 /end CHARACTERISTIC
/begin CHARACTERISTIC KL_ZSOCMOTMRS "Korr.off. Z/S Abhaeng.C_MOT MRS" CURVE 0x2187EC kl_si16_S6_S3 2040 UMR_NM__1_1_0_S6_S3 -400 1640
 /begin AXIS_DESCR STD_AXIS zff_atsys._.iSignale._.obj.sig_c_mot UMR_GRADC__1_1_M48_S6_S3 6 -48 144 DEPOSIT ABSOLUTE MONOTONY MON_INCREASE /end AXIS_DESCR
/end CHARACTERISTIC
/begin CHARACTERISTIC KL_ZSHS "Z/S Kl. fuer Hochschaltungen" CURVE 0x218808 kl_si16_S6_S3 2040 UMR_NM__1_1_0_S6_S3 -400 1640
 /begin AXIS_DESCR STD_AXIS zff_atsys._.iSignale._.obj.sig_n_mot UMR_U_MIN_1_1_0_S6_S3 6 0 8165 DEPOSIT ABSOLUTE MONOTONY MON_INCREASE /end AXIS_DESCR
/end CHARACTERISTIC
/begin CHARACTERISTIC ZS_HYS "Hysterese Zug/Schub fuer alle Z/S Kennlinien gueltig" VALUE 0x26D2EA kw_si16_S6_S3 2040 UMR_NM__1_1_0_S6_S3 -400 1640 /end CHARACTERISTIC
/begin CHARACTERISTIC KL_ZSOCMOT "Korr.off. Z/S Abhaeng.C_MOT" CURVE 0x218824 kl_si16_S6_S3 2040 UMR_NM__1_1_0_S6_S3 -400 1640
 /begin AXIS_DESCR STD_AXIS zff_atsys._.iSignale._.obj.sig_c_mot UMR_GRADC__1_1_M48_S6_S3 6 -48 144 DEPOSIT ABSOLUTE MONOTONY MON_INCREASE /end AXIS_DESCR
/end CHARACTERISTIC
/begin CHARACTERISTIC KL_ZS "Z/S Kl. ausserhalb von Schalt." CURVE 0x218840 kl_si16_S6_S3 2040 UMR_NM__1_1_0_S6_S3 -400 1640
 /begin AXIS_DESCR STD_AXIS zff_atsys._.iSignale._.obj.sig_n_mot UMR_U_MIN_1_1_0_S6_S3 6 0 8165 DEPOSIT ABSOLUTE MONOTONY MON_INCREASE /end AXIS_DESCR
/end CHARACTERISTIC
/begin CHARACTERISTIC NEIGUNG_PAUS "Neigungsschwelle zur Anforderung Drehzahlerhöhung bei Auslegen P" VALUE 0x26E3BC kw_ui8_S6_S3 42 UMR_GRAD__1_3_M128_S6_S3 0 42 /end CHARACTERISTIC
/begin CHARACTERISTIC NEIGUNG_HYS_PAUS "Neigungshysterese zur Rücksetzung der Anforderung Drehzahlerhöhung bei Auslegen P" VALUE 0x26D2EC kw_si16_S6_S3 42 UMR_GRAD__1_3_M128_S6_S3 -42 0 /end CHARACTERISTIC
/begin CHARACTERISTIC PS_BREMS "Bremsdruckschwelle für Bremsbedingung" VALUE 0x26D2EE kw_ui16_S6_S3 99 UMR_BAR__1_1_0_S6_S3 1 100 /end CHARACTERISTIC
/begin CHARACTERISTIC PS_BREMSHYS "Hysterese auf Bremsdruckschwelle für Bremsbedingung" VALUE 0x26D2F0 kw_ui16_S6_S3 19 UMR_BAR__1_1_0_S6_S3 1 20 /end CHARACTERISTIC
/begin CHARACTERISTIC SWI_FSTBREMSE "Schalter, ob Feststellbremse fuer Bremsbedingung ausgewertet werden soll (true, dann erfolgt Auswertung)" VALUE 0x26E3BD kw_bool8_S6_S3 1 UMR___1_1_0_S6_S3 0 1 /end CHARACTERISTIC
/begin CHARACTERISTIC SWI_PBR "Schalter, ob Bremsdruckschwelle fuer Bremsbedingung ausgewertet werden soll (true, dann erfolgt Auswertung)" VALUE 0x26E3BE kw_bool8_S6_S3 1 UMR___1_1_0_S6_S3 0 1 /end CHARACTERISTIC
/begin CHARACTERISTIC SWI_PREADAPTION_START_STADA "Manipulation der Schnittstelle GET_PREADAPTION_START zu Testzwecken" VALUE 0x26E3BF kw_ui8_S6_S3 2 UMR___1_1_0_S6_S3 0 2 /end CHARACTERISTIC
/begin CHARACTERISTIC SWI_UMSCHALTDKI "Über den Schalter SWI_UMSCHALTDKI wird die Eingangsgröße für verschiedene Label ausgewählt. Es kann zwischen dki (0) und m_motsoll_mod (1) gewählt werden" VALUE 0x26E3C0 kw_bool8_S6_S3 1 UMR___1_1_0_S6_S3 0 1 /end CHARACTERISTIC
/begin CHARACTERISTIC TAB_DEACT_IAE_DAMPG "Deaktivierung Aktive Schwingungsdaempfung von IAE" CURVE 0x21885C tab_bool8_S6_S3 1 UMR___1_1_0_S6_S3 0 1
 /begin AXIS_DESCR FIX_AXIS iIaeKordi.kup_status_iae UMR___1_1_0_S6_S3 9 0 8 FIX_AXIS_PAR_DIST 0 1 9 /end AXIS_DESCR
/end CHARACTERISTIC
/begin CHARACTERISTIC T_DEACTVT_ACTV_DAMPG "Zeit seit Zielgangaenderung fuer Deaktivierung Daempfung" VALUE 0x26E3C1 kw_ui8_S6_S3 2540 UMR_MSEC__10_1_0_S6_S3 0 2540 /end CHARACTERISTIC
/begin CHARACTERISTIC TAB_SBC_AKTIV_IAE "Tabelle fuer die Berechnung von GET_SBC_AKTIV in Abhaengigkeit des IAE-Zustands" MAP 0x21886C tab2d_ui8_S6_S3 10 UMR___1_1_0_S6_S3 0 10
 /begin AXIS_DESCR FIX_AXIS iIaeKordi.z_iae UMR___1_1_0_S6_S3 10 0 9 FIX_AXIS_PAR_DIST 0 1 10 /end AXIS_DESCR
 /begin AXIS_DESCR FIX_AXIS iAdaGlosc.ada_iae_info UMR___1_1_0_S6_S3 3 0 2 FIX_AXIS_PAR_DIST 0 1 3 /end AXIS_DESCR
/end CHARACTERISTIC
/begin CHARACTERISTIC T_SBC_AKTIV "Zeit fuer die der Wert 3 bei der Berechnung von GET_SBC_AKTIV gehalten wird" VALUE 0x26D2F2 kw_ui16_S6_S3 10000 UMR_MSEC__10_1_0_S6_S3 0 10000 /end CHARACTERISTIC
/begin CHARACTERISTIC NS_AB_SBC_AKTIV "Abtriebsdrehzahlschwelle zur Berechnung von GET_SBC_AKTIV" VALUE 0x26D2F4 kw_ui16_S6_S3 1000 UMR_U_MIN_1_1_0_S6_S3 0 1000 /end CHARACTERISTIC
/begin CHARACTERISTIC KL_ZSRS21 "Z/S Kl. fuer Rueckschaltungen" CURVE 0x21F568 kl_si16_S6_S3 2040 UMR_NM__1_1_0_S6_S3 -400 1640
 /begin AXIS_DESCR STD_AXIS zff_atsys._.iSignale._.obj.sig_n_mot UMR_U_MIN_1_1_0_S6_S3 6 0 8165 DEPOSIT ABSOLUTE MONOTONY MON_INCREASE /end AXIS_DESCR
/end CHARACTERISTIC
/begin CHARACTERISTIC KL_ZSRS32 "Z/S Kl. fuer Rueckschaltungen" CURVE 0x21F584 kl_si16_S6_S3 2040 UMR_NM__1_1_0_S6_S3 -400 1640
 /begin AXIS_DESCR STD_AXIS zff_atsys._.iSignale._.obj.sig_n_mot UMR_U_MIN_1_1_0_S6_S3 6 0 8165 DEPOSIT ABSOLUTE MONOTONY MON_INCREASE /end AXIS_DESCR
/end CHARACTERISTIC
/begin CHARACTERISTIC KL_ZSRS43 "Z/S Kl. fuer Rueckschaltungen" CURVE 0x21F5A0 kl_si16_S6_S3 2040 UMR_NM__1_1_0_S6_S3 -400 1640
 /begin AXIS_DESCR STD_AXIS zff_atsys._.iSignale._.obj.sig_n_mot UMR_U_MIN_1_1_0_S6_S3 6 0 8165 DEPOSIT ABSOLUTE MONOTONY MON_INCREASE /end AXIS_DESCR
/end CHARACTERISTIC
/begin CHARACTERISTIC KL_ZSRS54 "Z/S Kl. fuer Rueckschaltungen" CURVE 0x21F5BC kl_si16_S6_S3 2040 UMR_NM__1_1_0_S6_S3 -400 1640
 /begin AXIS_DESCR STD_AXIS zff_atsys._.iSignale._.obj.sig_n_mot UMR_U_MIN_1_1_0_S6_S3 6 0 8165 DEPOSIT ABSOLUTE MONOTONY MON_INCREASE /end AXIS_DESCR
/end CHARACTERISTIC
/begin CHARACTERISTIC KL_ZSRS65 "Z/S Kl. fuer Rueckschaltungen" CURVE 0x21F5D8 kl_si16_S6_S3 2040 UMR_NM__1_1_0_S6_S3 -400 1640
 /begin AXIS_DESCR STD_AXIS zff_atsys._.iSignale._.obj.sig_n_mot UMR_U_MIN_1_1_0_S6_S3 6 0 8165 DEPOSIT ABSOLUTE MONOTONY MON_INCREASE /end AXIS_DESCR
/end CHARACTERISTIC
/begin CHARACTERISTIC KL_ZSRS76 "Z/S Kl. fuer Rueckschaltungen" CURVE 0x21F5F4 kl_si16_S6_S3 2040 UMR_NM__1_1_0_S6_S3 -400 1640
 /begin AXIS_DESCR STD_AXIS zff_atsys._.iSignale._.obj.sig_n_mot UMR_U_MIN_1_1_0_S6_S3 6 0 8165 DEPOSIT ABSOLUTE MONOTONY MON_INCREASE /end AXIS_DESCR
/end CHARACTERISTIC
/begin CHARACTERISTIC KL_ZSRS87 "Z/S Kl. fuer Rueckschaltungen" CURVE 0x21F610 kl_si16_S6_S3 2040 UMR_NM__1_1_0_S6_S3 -400 1640
 /begin AXIS_DESCR STD_AXIS zff_atsys._.iSignale._.obj.sig_n_mot UMR_U_MIN_1_1_0_S6_S3 6 0 8165 DEPOSIT ABSOLUTE MONOTONY MON_INCREASE /end AXIS_DESCR
/end CHARACTERISTIC
/begin CHARACTERISTIC KL_ZSRSSP31 "Z/S Kl. fuer Rueckschaltungen" CURVE 0x21F62C kl_si16_S6_S3 2040 UMR_NM__1_1_0_S6_S3 -400 1640
 /begin AXIS_DESCR STD_AXIS zff_atsys._.iSignale._.obj.sig_n_mot UMR_U_MIN_1_1_0_S6_S3 6 0 8165 DEPOSIT ABSOLUTE MONOTONY MON_INCREASE /end AXIS_DESCR
/end CHARACTERISTIC
/begin CHARACTERISTIC KL_ZSRSSP42 "Z/S Kl. fuer Rueckschaltungen" CURVE 0x21F648 kl_si16_S6_S3 2040 UMR_NM__1_1_0_S6_S3 -400 1640
 /begin AXIS_DESCR STD_AXIS zff_atsys._.iSignale._.obj.sig_n_mot UMR_U_MIN_1_1_0_S6_S3 6 0 8165 DEPOSIT ABSOLUTE MONOTONY MON_INCREASE /end AXIS_DESCR
/end CHARACTERISTIC
/begin CHARACTERISTIC KL_ZSRSSP51 "Z/S Kl. fuer Rueckschaltungen" CURVE 0x21F664 kl_si16_S6_S3 2040 UMR_NM__1_1_0_S6_S3 -400 1640
 /begin AXIS_DESCR STD_AXIS zff_atsys._.iSignale._.obj.sig_n_mot UMR_U_MIN_1_1_0_S6_S3 6 0 8165 DEPOSIT ABSOLUTE MONOTONY MON_INCREASE /end AXIS_DESCR
/end CHARACTERISTIC
/begin CHARACTERISTIC KL_ZSRSSP53 "Z/S Kl. fuer Rueckschaltungen" CURVE 0x21F680 kl_si16_S6_S3 2040 UMR_NM__1_1_0_S6_S3 -400 1640
 /begin AXIS_DESCR STD_AXIS zff_atsys._.iSignale._.obj.sig_n_mot UMR_U_MIN_1_1_0_S6_S3 6 0 8165 DEPOSIT ABSOLUTE MONOTONY MON_INCREASE /end AXIS_DESCR
/end CHARACTERISTIC
/begin CHARACTERISTIC KL_ZSRSSP63 "Z/S Kl. fuer Rueckschaltungen" CURVE 0x21F69C kl_si16_S6_S3 2040 UMR_NM__1_1_0_S6_S3 -400 1640
 /begin AXIS_DESCR STD_AXIS zff_atsys._.iSignale._.obj.sig_n_mot UMR_U_MIN_1_1_0_S6_S3 6 0 8165 DEPOSIT ABSOLUTE MONOTONY MON_INCREASE /end AXIS_DESCR
/end CHARACTERISTIC
/begin CHARACTERISTIC KL_ZSRSSP64 "Z/S Kl. fuer Rueckschaltungen" CURVE 0x21F6B8 kl_si16_S6_S3 2040 UMR_NM__1_1_0_S6_S3 -400 1640
 /begin AXIS_DESCR STD_AXIS zff_atsys._.iSignale._.obj.sig_n_mot UMR_U_MIN_1_1_0_S6_S3 6 0 8165 DEPOSIT ABSOLUTE MONOTONY MON_INCREASE /end AXIS_DESCR
/end CHARACTERISTIC
/begin CHARACTERISTIC KL_ZSRSSP71 "Z/S Kl. fuer Rueckschaltungen" CURVE 0x21F6D4 kl_si16_S6_S3 2040 UMR_NM__1_1_0_S6_S3 -400 1640
 /begin AXIS_DESCR STD_AXIS zff_atsys._.iSignale._.obj.sig_n_mot UMR_U_MIN_1_1_0_S6_S3 6 0 8165 DEPOSIT ABSOLUTE MONOTONY MON_INCREASE /end AXIS_DESCR
/end CHARACTERISTIC
/begin CHARACTERISTIC KL_ZSRSSP75 "Z/S Kl. fuer Rueckschaltungen" CURVE 0x21F6F0 kl_si16_S6_S3 2040 UMR_NM__1_1_0_S6_S3 -400 1640
 /begin AXIS_DESCR STD_AXIS zff_atsys._.iSignale._.obj.sig_n_mot UMR_U_MIN_1_1_0_S6_S3 6 0 8165 DEPOSIT ABSOLUTE MONOTONY MON_INCREASE /end AXIS_DESCR
/end CHARACTERISTIC
/begin CHARACTERISTIC KL_ZSRSSP82 "Z/S Kl. fuer Rueckschaltungen" CURVE 0x21F70C kl_si16_S6_S3 2040 UMR_NM__1_1_0_S6_S3 -400 1640
 /begin AXIS_DESCR STD_AXIS zff_atsys._.iSignale._.obj.sig_n_mot UMR_U_MIN_1_1_0_S6_S3 6 0 8165 DEPOSIT ABSOLUTE MONOTONY MON_INCREASE /end AXIS_DESCR
/end CHARACTERISTIC
/begin CHARACTERISTIC KL_ZSRSSP84 "Z/S Kl. fuer Rueckschaltungen" CURVE 0x21F728 kl_si16_S6_S3 2040 UMR_NM__1_1_0_S6_S3 -400 1640
 /begin AXIS_DESCR STD_AXIS zff_atsys._.iSignale._.obj.sig_n_mot UMR_U_MIN_1_1_0_S6_S3 6 0 8165 DEPOSIT ABSOLUTE MONOTONY MON_INCREASE /end AXIS_DESCR
/end CHARACTERISTIC
/begin CHARACTERISTIC KL_ZSRSSP86 "Z/S Kl. fuer Rueckschaltungen" CURVE 0x21F744 kl_si16_S6_S3 2040 UMR_NM__1_1_0_S6_S3 -400 1640
 /begin AXIS_DESCR STD_AXIS zff_atsys._.iSignale._.obj.sig_n_mot UMR_U_MIN_1_1_0_S6_S3 6 0 8165 DEPOSIT ABSOLUTE MONOTONY MON_INCREASE /end AXIS_DESCR
/end CHARACTERISTIC
/begin CHARACTERISTIC I_MIN "Minimalstrom" VALUE 0x26D4A4 kw_ui16_S6_S3 200 UMR_MA__1_10_0_S6_S3 0 200 READ_ONLY /end CHARACTERISTIC
/begin CHARACTERISTIC I_MAX "Maximalstrom" VALUE 0x26D4A6 kw_ui16_S6_S3 200 UMR_MA__1_10_0_S6_S3 700 900 READ_ONLY /end CHARACTERISTIC
/begin CHARACTERISTIC KF_POFNABCGKPLBINN "Kennfeld fuer Druckoffset fuer Kupplung B in Neutral (N1) (gilt auch in P)" MAP 0x21E808 kf_ui16_S6_S3 1 UMR_BAR__1_1000_0_S6_S3 0 1
 /begin AXIS_DESCR STD_AXIS zff_atsys._.iSignale._.obj.sig_n_ab UMR_U_MIN_1_1_0_S6_S3 2 0 8200 DEPOSIT ABSOLUTE MONOTONY MON_INCREASE /end AXIS_DESCR
 /begin AXIS_DESCR STD_AXIS zff_atsys._.iSignale._.obj.sig_c_getr UMR_GRADC__1_1_M40_S6_S3 4 -40 150 DEPOSIT ABSOLUTE MONOTONY MON_INCREASE /end AXIS_DESCR
/end CHARACTERISTIC
/begin CHARACTERISTIC P_OF1KPLBINN "Druckoffset für Kupplung B in Neutral nach Neustart" VALUE 0x26D4A8 kw_si16_S6_S3 1 UMR_BAR__1_1000_0_S6_S3 0 1 /end CHARACTERISTIC
/begin CHARACTERISTIC T_POF1KPLBINN "Zeitdauer für Druckoffset für Kupplung B in Neutral nach Neustart" VALUE 0x26E4D3 kw_ui8_S6_S3 2550 UMR_MSEC__10_1_0_S6_S3 0 2550 /end CHARACTERISTIC
/begin CHARACTERISTIC T_VGEINIT "Verzoegerung Gangeinlegen nach Initialisierung(Motorstart)" VALUE 0x26E4D4 kw_ui8_S6_S3 2360 UMR_MSEC__10_1_0_S6_S3 180 2540 /end CHARACTERISTIC
/begin CHARACTERISTIC KL_IEDSOFPSV "Stromoffset für Umschaltpunkt Parksperrenventil" CURVE 0x21E82C kl_ui16_S6_S3 250 UMR_MA__1_10_0_S6_S3 0 250
 /begin AXIS_DESCR STD_AXIS zff_atsys._.iSignale._.obj.sig_c_getr UMR_GRADC__1_1_M40_S6_S3 4 -40 215 DEPOSIT ABSOLUTE MONOTONY MON_INCREASE /end AXIS_DESCR
/end CHARACTERISTIC
/begin CHARACTERISTIC T_IEDSOFPSV "Zeit fuer Stromoffset auf Umschaltpunkt Parksperrenventil" VALUE 0x26E4D5 kw_ui8_S6_S3 2540 UMR_MSEC__10_1_0_S6_S3 0 2540 /end CHARACTERISTIC
/begin CHARACTERISTIC T_IKABENTLEER "Maximale Zeitdauer Stromrampe KAB" VALUE 0x26E4D6 kw_ui8_S6_S3 120 UMR_MSEC__10_1_0_S6_S3 0 120 /end CHARACTERISTIC
/begin CHARACTERISTIC KF_KIEDSCGFAACE "Korrekurkennfeld fallender ACE Druckregler" MAP 0x223360 kf_si16_S6_S3 400 UMR_MA__1_10_0_S6_S3 -200 200
 /begin AXIS_DESCR STD_AXIS i_eds1 UMR_MA__1_10_0_S6_S3 12 0 1275 DEPOSIT ABSOLUTE MONOTONY MON_INCREASE /end AXIS_DESCR
 /begin AXIS_DESCR STD_AXIS zff_atsys._.iSignale._.obj.sig_c_getr UMR_GRADC__1_1_M40_S6_S3 5 -40 215 DEPOSIT ABSOLUTE MONOTONY MON_INCREASE /end AXIS_DESCR
/end CHARACTERISTIC
/begin CHARACTERISTIC KF_KIEDSCGSTACE "Korrekurkennfeld steigender ACE Druckregler" MAP 0x223404 kf_si16_S6_S3 400 UMR_MA__1_10_0_S6_S3 -200 200
 /begin AXIS_DESCR STD_AXIS i_eds1 UMR_MA__1_10_0_S6_S3 12 0 1275 DEPOSIT ABSOLUTE MONOTONY MON_INCREASE /end AXIS_DESCR
 /begin AXIS_DESCR STD_AXIS zff_atsys._.iSignale._.obj.sig_c_getr UMR_GRADC__1_1_M40_S6_S3 5 -40 215 DEPOSIT ABSOLUTE MONOTONY MON_INCREASE /end AXIS_DESCR
/end CHARACTERISTIC
/begin CHARACTERISTIC SWI_ABGLDAT "Schalter Verwendung appl. Daten (Mittelkl.) der EDSKV-KL" VALUE 0x26E553 kw_ui8_S6_S3 2 UMR___1_1_0_S6_S3 0 2 /end CHARACTERISTIC
/begin CHARACTERISTIC KF_KIEDSCGKOR "Korrekturkennfeld auf druckreglertypabhängige Temperaturkorrektur" MAP 0x2234A8 kf_si16_S6_S3 400 UMR_MA__1_10_0_S6_S3 -200 200
 /begin AXIS_DESCR STD_AXIS i_eds_kupb UMR_MA__1_10_0_S6_S3 12 0 1275 DEPOSIT ABSOLUTE MONOTONY MON_INCREASE /end AXIS_DESCR
 /begin AXIS_DESCR STD_AXIS zff_atsys._.iSignale._.obj.sig_c_getr UMR_GRADC__1_1_M40_S6_S3 5 -40 215 DEPOSIT ABSOLUTE MONOTONY MON_INCREASE /end AXIS_DESCR
/end CHARACTERISTIC
/begin CHARACTERISTIC KL_EDSKVA "EDS Kupplungsventil A" CURVE 0x22354C kl_ui16_S6_S3 1000 UMR_MA__1_10_0_S6_S3 0 1000
 /begin AXIS_DESCR STD_AXIS NO_INPUT_QUANTITY UMR_MBAR__1_1_0_S6_S3 12 0 65535 DEPOSIT ABSOLUTE MONOTONY MON_INCREASE /end AXIS_DESCR
/end CHARACTERISTIC
/begin CHARACTERISTIC KL_EDSKVB "EDS Kupplungsventil B" CURVE 0x223580 kl_ui16_S6_S3 1000 UMR_MA__1_10_0_S6_S3 0 1000
 /begin AXIS_DESCR STD_AXIS NO_INPUT_QUANTITY UMR_MBAR__1_1_0_S6_S3 12 0 65535 DEPOSIT ABSOLUTE MONOTONY MON_INCREASE /end AXIS_DESCR
/end CHARACTERISTIC
/begin CHARACTERISTIC KL_EDSKVC "EDS Kupplungsventil C" CURVE 0x2235B4 kl_ui16_S6_S3 1000 UMR_MA__1_10_0_S6_S3 0 1000
 /begin AXIS_DESCR STD_AXIS NO_INPUT_QUANTITY UMR_MBAR__1_1_0_S6_S3 12 0 65535 DEPOSIT ABSOLUTE MONOTONY MON_INCREASE /end AXIS_DESCR
/end CHARACTERISTIC
/begin CHARACTERISTIC KL_EDSKVD "EDS Kupplungsventil D" CURVE 0x2235E8 kl_ui16_S6_S3 1000 UMR_MA__1_10_0_S6_S3 0 1000
 /begin AXIS_DESCR STD_AXIS NO_INPUT_QUANTITY UMR_MBAR__1_1_0_S6_S3 12 0 65535 DEPOSIT ABSOLUTE MONOTONY MON_INCREASE /end AXIS_DESCR
/end CHARACTERISTIC
/begin CHARACTERISTIC KL_EDSKVE "EDS Kupplungsventil E" CURVE 0x22361C kl_ui16_S6_S3 1000 UMR_MA__1_10_0_S6_S3 0 1000
 /begin AXIS_DESCR STD_AXIS NO_INPUT_QUANTITY UMR_MBAR__1_1_0_S6_S3 12 0 65535 DEPOSIT ABSOLUTE MONOTONY MON_INCREASE /end AXIS_DESCR
/end CHARACTERISTIC
/begin CHARACTERISTIC KL_EDSKVSYS "EDS Kupplungsventil SYS" CURVE 0x223650 kl_ui16_S6_S3 1000 UMR_MA__1_10_0_S6_S3 0 1000
 /begin AXIS_DESCR STD_AXIS NO_INPUT_QUANTITY UMR_MBAR__1_1_0_S6_S3 12 0 65535 DEPOSIT ABSOLUTE MONOTONY MON_INCREASE /end AXIS_DESCR
/end CHARACTERISTIC
/begin CHARACTERISTIC KL_EDSKVK0 "EDS Kupplungsventil K0" CURVE 0x223684 kl_ui16_S6_S3 1000 UMR_MA__1_10_0_S6_S3 0 1000
 /begin AXIS_DESCR STD_AXIS NO_INPUT_QUANTITY UMR_MBAR__1_1_0_S6_S3 12 0 65535 DEPOSIT ABSOLUTE MONOTONY MON_INCREASE /end AXIS_DESCR
/end CHARACTERISTIC
/begin CHARACTERISTIC KL_EDSKVPOS "EDS Positionsventil / Kuehloelvolumenstrom" CURVE 0x2236B8 kl_ui16_S6_S3 1000 UMR_MA__1_10_0_S6_S3 0 1000
 /begin AXIS_DESCR STD_AXIS NO_INPUT_QUANTITY UMR_MBAR__1_1_0_S6_S3 12 0 65535 DEPOSIT ABSOLUTE MONOTONY MON_INCREASE /end AXIS_DESCR
/end CHARACTERISTIC
/begin CHARACTERISTIC I_EDSPOSV "Stromwert für Umschaltpunkt Positonsventil" VALUE 0x2236EC kw_ui32_S6_S3 1000 UMR_MA__1_10_0_S6_S3 0 1000 /end CHARACTERISTIC
/begin CHARACTERISTIC I_EDSPSV "Stromwert für Umschaltpunkt Parksperrenventil" VALUE 0x2236F0 kw_ui32_S6_S3 1000 UMR_MA__1_10_0_S6_S3 0 1000 /end CHARACTERISTIC
/begin CHARACTERISTIC KF_KIEDSPSYSKORSTACE "Systemdruckabhaengiges Korrekturkennfeld" MAP 0x2236F4 kf_fl32_S6_S3 400 UMR_MA__1_10_0_S6_S3 -200 200
 /begin AXIS_DESCR STD_AXIS NO_INPUT_QUANTITY UMR_MA__1_10_0_S6_S3 4 0 1275 DEPOSIT ABSOLUTE MONOTONY MON_INCREASE /end AXIS_DESCR
 /begin AXIS_DESCR STD_AXIS iSasPsyst.p_sysist UMR_BAR__1_1000_0_S6_S3 2 0 23.5 DEPOSIT ABSOLUTE MONOTONY MON_INCREASE /end AXIS_DESCR
/end CHARACTERISTIC
/begin CHARACTERISTIC KF_KIEDSPSYSKORFAACE "Systemdruckabhaengiges Korrekturkennfeld" MAP 0x223734 kf_fl32_S6_S3 400 UMR_MA__1_10_0_S6_S3 -200 200
 /begin AXIS_DESCR STD_AXIS NO_INPUT_QUANTITY UMR_MA__1_10_0_S6_S3 4 0 1275 DEPOSIT ABSOLUTE MONOTONY MON_INCREASE /end AXIS_DESCR
 /begin AXIS_DESCR STD_AXIS iSasPsyst.p_sysist UMR_BAR__1_1000_0_S6_S3 2 0 23.5 DEPOSIT ABSOLUTE MONOTONY MON_INCREASE /end AXIS_DESCR
/end CHARACTERISTIC
/begin CHARACTERISTIC MDT_PGABSSOLL_HYSKOMP "Filterzeit Solldruckgradient" VALUE 0x26E554 kw_ui8_S6_S3 0.99 UMR___1_100_0_S6_S3 0.01 1 /end CHARACTERISTIC
/begin CHARACTERISTIC KF_MUEKPL_IAE_HYSKOMP "Übertragungswert der Kupplung" MAP 0x223774 kf_fl32_S6_S3 1000 UMR_NM_BAR_1_1_0_S6_S3 0 1000 FORMAT "%5.3"
 /begin AXIS_DESCR STD_AXIS NO_INPUT_QUANTITY UMR_BAR__1_1000_0_S6_S3 6 0 65.535 DEPOSIT ABSOLUTE MONOTONY MON_INCREASE /end AXIS_DESCR
 /begin AXIS_DESCR STD_AXIS NO_INPUT_QUANTITY UMR_U_MIN_1_1_0_S6_S3 6 -32768 32767 DEPOSIT ABSOLUTE MONOTONY MON_INCREASE /end AXIS_DESCR
/end CHARACTERISTIC
/begin CHARACTERISTIC KF_MUEKPL_K0_HYSKOMP "Übertragungswert der Kupplung" MAP 0x22383C kf_fl32_S6_S3 1000 UMR_NM_BAR_1_1_0_S6_S3 0 1000 FORMAT "%5.3"
 /begin AXIS_DESCR STD_AXIS NO_INPUT_QUANTITY UMR_BAR__1_1000_0_S6_S3 6 0 65.535 DEPOSIT ABSOLUTE MONOTONY MON_INCREASE /end AXIS_DESCR
 /begin AXIS_DESCR STD_AXIS NO_INPUT_QUANTITY UMR_U_MIN_1_1_0_S6_S3 6 -8000 8000 DEPOSIT ABSOLUTE MONOTONY MON_INCREASE /end AXIS_DESCR
/end CHARACTERISTIC
/begin CHARACTERISTIC PS_MAX_K0_HYSKOMP "Maximaldruck K0 fuer Kompensation" VALUE 0x26D60E kw_ui16_S6_S3 20 UMR_BAR__1_1000_0_S6_S3 0 20 /end CHARACTERISTIC
/begin CHARACTERISTIC MDT_IGEDS_HYSKOMP "Filterzeit Sollstromgradient" VALUE 0x26E555 kw_ui8_S6_S3 0.99 UMR___1_100_0_S6_S3 0.01 1 /end CHARACTERISTIC
/begin CHARACTERISTIC MDT_V_HYSKOMP "DT1-Filterkonstante zur Gradientenberechnung des po_wirk" VALUE 0x26E556 kw_ui8_S6_S3 0.99 UMR___1_100_0_S6_S3 0.01 1 /end CHARACTERISTIC
/begin CHARACTERISTIC TAB_SWI_AKTIV_A_HYSKOMP "Kompensation Kupplung, Index 0=Kein GSK 1=GSK, Werte: 0=aus, 1=KUP aktiv, 2=STG aktiv, 3=Beide aktiv" CURVE 0x223904 tab_ui8_S6_S3 3 UMR___1_1_0_S6_S3 0 3
 /begin AXIS_DESCR FIX_AXIS NO_INPUT_QUANTITY UMR___1_1_0_S6_S3 2 0 1 FIX_AXIS_PAR_DIST 0 1 2 /end AXIS_DESCR
/end CHARACTERISTIC
/begin CHARACTERISTIC PGS_A_HYSKOMP "Gradientenschwelle für Richtungsumschaltung" VALUE 0x26D610 kw_ui16_S6_S3 0.999 UMR_BAR_SEC_1_1000_0_S6_S3 0.001 1 /end CHARACTERISTIC
/begin CHARACTERISTIC KL_F_TRAJEK_KPL_A_HYSKOMP "Trajekorienform der Kupplungshysteresekompensationsfkt" CURVE 0x22390C kl_ui8_S6_S3 1 UMR___1_100_0_S6_S3 0 1
 /begin AXIS_DESCR STD_AXIS NO_INPUT_QUANTITY UMR___1_100_0_S6_S3 12 0 1 DEPOSIT ABSOLUTE MONOTONY MON_INCREASE /end AXIS_DESCR
/end CHARACTERISTIC
/begin CHARACTERISTIC KL_HYSB_KPL_A_HYSKOMP "Hysteresebreite Kupplung" CURVE 0x223928 kl_ui16_S6_S3 150 UMR_NM__1_1_0_S6_S3 0 150
 /begin AXIS_DESCR STD_AXIS NO_INPUT_QUANTITY UMR_BAR__1_1000_0_S6_S3 8 0 65.535 DEPOSIT ABSOLUTE MONOTONY MON_INCREASE /end AXIS_DESCR
/end CHARACTERISTIC
/begin CHARACTERISTIC KL_F_GRAD_KPL_A_HYSKOMP "Faktor Hysteresebreite" CURVE 0x22394C kl_si16_S6_S3 3 UMR___1_100_0_S6_S3 0 3
 /begin AXIS_DESCR STD_AXIS NO_INPUT_QUANTITY UMR_BAR_SEC_1_1000_0_S6_S3 6 -32.768 32.767 DEPOSIT ABSOLUTE MONOTONY MON_INCREASE /end AXIS_DESCR
/end CHARACTERISTIC
/begin CHARACTERISTIC KL_T_KPL_A_HYSKOMP "Filterzeitkonstante zum Abfiltern des Momentenoffsets" CURVE 0x223968 kl_si16_S6_S3 0.99 UMR___1_100_0_S6_S3 0.01 1
 /begin AXIS_DESCR STD_AXIS NO_INPUT_QUANTITY UMR_BAR_SEC_1_1_0_S6_S3 6 -32768 32767 DEPOSIT ABSOLUTE MONOTONY MON_INCREASE /end AXIS_DESCR
/end CHARACTERISTIC
/begin CHARACTERISTIC KL_MUEKPL_A_HYSKOMP "Übertragungswert der Kupplung" CURVE 0x223984 kl_ui16_S6_S3 1000 UMR_BAR_NM_1_1_0_S6_S3 0 1000
 /begin AXIS_DESCR STD_AXIS NO_INPUT_QUANTITY UMR_BAR__1_1000_0_S6_S3 6 0 20 DEPOSIT ABSOLUTE MONOTONY MON_INCREASE /end AXIS_DESCR
/end CHARACTERISTIC
/begin CHARACTERISTIC IGS_A_HYSKOMP "Gradientenschwelle für Richtungsumschaltung" VALUE 0x26D612 kw_si16_S6_S3 999 UMR_MA_SEC_1_1_0_S6_S3 1 1000 /end CHARACTERISTIC
/begin CHARACTERISTIC KL_F_TRAJEK_STG_A_HYSKOMP "Trajekorienform der Steuerungshysteresekompensationsfkt" CURVE 0x2239A0 kl_ui8_S6_S3 1 UMR___1_100_0_S6_S3 0 1
 /begin AXIS_DESCR STD_AXIS NO_INPUT_QUANTITY UMR___1_100_0_S6_S3 12 0 1 DEPOSIT ABSOLUTE MONOTONY MON_INCREASE /end AXIS_DESCR
/end CHARACTERISTIC
/begin CHARACTERISTIC KF_F_GRAD_STG_A_HYSKOMP "Faktor Hysteresebreite" MAP 0x2239BC kf_si16_S6_S3 3 UMR___1_100_0_S6_S3 0 3
 /begin AXIS_DESCR STD_AXIS NO_INPUT_QUANTITY UMR_MA_SEC_1_1_0_S6_S3 6 -32768 32767 DEPOSIT ABSOLUTE MONOTONY MON_INCREASE /end AXIS_DESCR
 /begin AXIS_DESCR STD_AXIS zff_atsys._.iSignale._.obj.sig_c_getr UMR_GRADC__1_1_M40_S6_S3 4 -40 150 DEPOSIT ABSOLUTE MONOTONY MON_INCREASE /end AXIS_DESCR
/end CHARACTERISTIC
/begin CHARACTERISTIC KL_T_STG_A_HYSKOMP "Filterzeitkonstante zum Abfiltern des Stromoffsets" CURVE 0x223A08 kl_si16_S6_S3 0.99 UMR___1_100_0_S6_S3 0.01 1
 /begin AXIS_DESCR STD_AXIS NO_INPUT_QUANTITY UMR_MA_SEC_1_1_0_S6_S3 6 -32768 32767 DEPOSIT ABSOLUTE MONOTONY MON_INCREASE /end AXIS_DESCR
/end CHARACTERISTIC
/begin CHARACTERISTIC IS_IMIN_A_HYSKOMP "Stromschwelle(min) für Berechnung des Trajektorienfortschritts" VALUE 0x26D614 kw_si16_S6_S3 850 UMR_MA__1_10_0_S6_S3 0 850 /end CHARACTERISTIC
/begin CHARACTERISTIC IS_IMAX_A_HYSKOMP "Stromschwelle(max) für Berechnung des Trajektorienfortschritts" VALUE 0x26D616 kw_si16_S6_S3 850 UMR_MA__1_10_0_S6_S3 0 850 /end CHARACTERISTIC
/begin CHARACTERISTIC KF_F_V_A_HYSKOMP "Faktorisierung des DT1-Filterausgangs Verzugskompensation" MAP 0x223A24 kf_si16_S6_S3 2 UMR___1_1000_0_S6_S3 0 2
 /begin AXIS_DESCR STD_AXIS NO_INPUT_QUANTITY UMR_BAR__1_1000_0_S6_S3 8 0 32.767 DEPOSIT ABSOLUTE MONOTONY MON_INCREASE /end AXIS_DESCR
 /begin AXIS_DESCR STD_AXIS zff_atsys._.iSignale._.obj.sig_c_getr UMR_GRADC__1_1_M40_S6_S3 5 -40 150 DEPOSIT ABSOLUTE MONOTONY MON_INCREASE /end AXIS_DESCR
/end CHARACTERISTIC
/begin CHARACTERISTIC PO_MAX_V_A_HYSKOMP "Obere Verzugskompensationsbreitenbegrenzung" VALUE 0x26D618 kw_si16_S6_S3 1 UMR_BAR__1_1000_0_S6_S3 0 1 /end CHARACTERISTIC
/begin CHARACTERISTIC PO_MIN_V_A_HYSKOMP "Untere Verzugskompensationsbreitenbegrenzung" VALUE 0x26D61A kw_si16_S6_S3 1 UMR_BAR__1_1000_0_S6_S3 -1 0 /end CHARACTERISTIC
/begin CHARACTERISTIC PS_INIT_V_A_HYSKOMP "Initialisierungsdruckschwelle fuer den Funktionseinstieg" VALUE 0x26D61C kw_si16_S6_S3 4 UMR_BAR__1_1000_0_S6_S3 -2 2 /end CHARACTERISTIC
/begin CHARACTERISTIC PS_INIT_HYS_V_A_HYSKOMP "Initialisierungsschwelle Hysterese fuer den Funktionsausstieg" VALUE 0x26D61E kw_si16_S6_S3 2 UMR_BAR__1_1000_0_S6_S3 0 2 /end CHARACTERISTIC
/begin CHARACTERISTIC KF_T_RAMPE_V_A_HYSKOMP "Anstiegszeit der Rampe" MAP 0x223A98 kf_ui16_S6_S3 100 UMR_SEC__1_100_0_S6_S3 0 100
 /begin AXIS_DESCR STD_AXIS NO_INPUT_QUANTITY UMR_BAR__1_1000_0_S6_S3 6 0 20 DEPOSIT ABSOLUTE MONOTONY MON_INCREASE /end AXIS_DESCR
 /begin AXIS_DESCR STD_AXIS zff_atsys._.iSignale._.obj.sig_c_getr UMR_GRADC__1_1_M40_S6_S3 5 -40 150 DEPOSIT ABSOLUTE MONOTONY MON_INCREASE /end AXIS_DESCR
/end CHARACTERISTIC
/begin CHARACTERISTIC KL_INIT_V_A_HYSKOMP "Initialisierungswert fuer Rampe" CURVE 0x223AF4 kl_ui16_S6_S3 1 UMR_BAR__1_1000_0_S6_S3 0 1
 /begin AXIS_DESCR STD_AXIS NO_INPUT_QUANTITY UMR_BAR__1_1000_0_S6_S3 6 0 20 DEPOSIT ABSOLUTE MONOTONY MON_INCREASE /end AXIS_DESCR
/end CHARACTERISTIC
/begin CHARACTERISTIC SWI_AKTIV_V_A_HYSKOMP "Kupplungsverzugskompensation 0=aus, 1=KUP aktiv" VALUE 0x26E557 kw_ui8_S6_S3 1 UMR___1_1_0_S6_S3 0 1 /end CHARACTERISTIC
/begin CHARACTERISTIC TAB_SWI_AKTIV_B_HYSKOMP "Kompensation Kupplung, Index 0=Kein GSK 1=GSK, Werte: 0=aus, 1=KUP aktiv, 2=STG aktiv, 3=Beide aktiv" CURVE 0x223B10 tab_ui8_S6_S3 3 UMR___1_1_0_S6_S3 0 3
 /begin AXIS_DESCR FIX_AXIS NO_INPUT_QUANTITY UMR___1_1_0_S6_S3 2 0 1 FIX_AXIS_PAR_DIST 0 1 2 /end AXIS_DESCR
/end CHARACTERISTIC
/begin CHARACTERISTIC PGS_B_HYSKOMP "Gradientenschwelle für Richtungsumschaltung" VALUE 0x26D620 kw_ui16_S6_S3 0.999 UMR_BAR_SEC_1_1000_0_S6_S3 0.001 1 /end CHARACTERISTIC
/begin CHARACTERISTIC KL_F_TRAJEK_KPL_B_HYSKOMP "Trajekorienform der Kupplungshysteresekompensationsfkt" CURVE 0x223B18 kl_ui8_S6_S3 1 UMR___1_100_0_S6_S3 0 1
 /begin AXIS_DESCR STD_AXIS NO_INPUT_QUANTITY UMR___1_100_0_S6_S3 12 0 1 DEPOSIT ABSOLUTE MONOTONY MON_INCREASE /end AXIS_DESCR
/end CHARACTERISTIC
/begin CHARACTERISTIC KL_HYSB_KPL_B_HYSKOMP "Hysteresebreite Kupplung" CURVE 0x223B34 kl_ui16_S6_S3 150 UMR_NM__1_1_0_S6_S3 0 150
 /begin AXIS_DESCR STD_AXIS NO_INPUT_QUANTITY UMR_BAR__1_1000_0_S6_S3 8 0 65.535 DEPOSIT ABSOLUTE MONOTONY MON_INCREASE /end AXIS_DESCR
/end CHARACTERISTIC
/begin CHARACTERISTIC KL_F_GRAD_KPL_B_HYSKOMP "Faktor Hysteresebreite" CURVE 0x223B58 kl_si16_S6_S3 3 UMR___1_100_0_S6_S3 0 3
 /begin AXIS_DESCR STD_AXIS NO_INPUT_QUANTITY UMR_BAR_SEC_1_1000_0_S6_S3 6 -32.768 32.767 DEPOSIT ABSOLUTE MONOTONY MON_INCREASE /end AXIS_DESCR
/end CHARACTERISTIC
/begin CHARACTERISTIC KL_T_KPL_B_HYSKOMP "Filterzeitkonstante zum Abfiltern des Momentenoffsets" CURVE 0x223B74 kl_si16_S6_S3 0.99 UMR___1_100_0_S6_S3 0.01 1
 /begin AXIS_DESCR STD_AXIS NO_INPUT_QUANTITY UMR_BAR_SEC_1_1_0_S6_S3 6 -32768 32767 DEPOSIT ABSOLUTE MONOTONY MON_INCREASE /end AXIS_DESCR
/end CHARACTERISTIC
/begin CHARACTERISTIC KL_MUEKPL_B_HYSKOMP "Übertragungswert der Kupplung" CURVE 0x223B90 kl_ui16_S6_S3 1000 UMR_BAR_NM_1_1_0_S6_S3 0 1000
 /begin AXIS_DESCR STD_AXIS NO_INPUT_QUANTITY UMR_BAR__1_1000_0_S6_S3 6 0 20 DEPOSIT ABSOLUTE MONOTONY MON_INCREASE /end AXIS_DESCR
/end CHARACTERISTIC
/begin CHARACTERISTIC IGS_B_HYSKOMP "Gradientenschwelle für Richtungsumschaltung" VALUE 0x26D622 kw_si16_S6_S3 999 UMR_MA_SEC_1_1_0_S6_S3 1 1000 /end CHARACTERISTIC
/begin CHARACTERISTIC KL_F_TRAJEK_STG_B_HYSKOMP "Trajekorienform der Steuerungshysteresekompensationsfkt" CURVE 0x223BAC kl_ui8_S6_S3 1 UMR___1_100_0_S6_S3 0 1
 /begin AXIS_DESCR STD_AXIS NO_INPUT_QUANTITY UMR___1_100_0_S6_S3 12 0 1 DEPOSIT ABSOLUTE MONOTONY MON_INCREASE /end AXIS_DESCR
/end CHARACTERISTIC
/begin CHARACTERISTIC KF_F_GRAD_STG_B_HYSKOMP "Faktor Hysteresebreite" MAP 0x223BC8 kf_si16_S6_S3 3 UMR___1_100_0_S6_S3 0 3
 /begin AXIS_DESCR STD_AXIS NO_INPUT_QUANTITY UMR_MA_SEC_1_1_0_S6_S3 6 -32768 32767 DEPOSIT ABSOLUTE MONOTONY MON_INCREASE /end AXIS_DESCR
 /begin AXIS_DESCR STD_AXIS zff_atsys._.iSignale._.obj.sig_c_getr UMR_GRADC__1_1_M40_S6_S3 4 -40 150 DEPOSIT ABSOLUTE MONOTONY MON_INCREASE /end AXIS_DESCR
/end CHARACTERISTIC
/begin CHARACTERISTIC KL_T_STG_B_HYSKOMP "Filterzeitkonstante zum Abfiltern des Stromoffsets" CURVE 0x223C14 kl_si16_S6_S3 0.99 UMR___1_100_0_S6_S3 0.01 1
 /begin AXIS_DESCR STD_AXIS NO_INPUT_QUANTITY UMR_MA_SEC_1_1_0_S6_S3 6 -32768 32767 DEPOSIT ABSOLUTE MONOTONY MON_INCREASE /end AXIS_DESCR
/end CHARACTERISTIC
/begin CHARACTERISTIC IS_IMIN_B_HYSKOMP "Stromschwelle(min) für Berechnung des Trajektorienfortschritts" VALUE 0x26D624 kw_si16_S6_S3 850 UMR_MA__1_10_0_S6_S3 0 850 /end CHARACTERISTIC
/begin CHARACTERISTIC IS_IMAX_B_HYSKOMP "Stromschwelle(max) für Berechnung des Trajektorienfortschritts" VALUE 0x26D626 kw_si16_S6_S3 850 UMR_MA__1_10_0_S6_S3 0 850 /end CHARACTERISTIC
/begin CHARACTERISTIC KF_F_V_B_HYSKOMP "Faktorisierung des DT1-Filterausgangs Verzugskompensation" MAP 0x223C30 kf_si16_S6_S3 2 UMR___1_1000_0_S6_S3 0 2
 /begin AXIS_DESCR STD_AXIS NO_INPUT_QUANTITY UMR_BAR__1_1000_0_S6_S3 8 0 32.767 DEPOSIT ABSOLUTE MONOTONY MON_INCREASE /end AXIS_DESCR
 /begin AXIS_DESCR STD_AXIS zff_atsys._.iSignale._.obj.sig_c_getr UMR_GRADC__1_1_M40_S6_S3 5 -40 150 DEPOSIT ABSOLUTE MONOTONY MON_INCREASE /end AXIS_DESCR
/end CHARACTERISTIC
/begin CHARACTERISTIC PO_MAX_V_B_HYSKOMP "Obere Verzugskompensationsbreitenbegrenzung" VALUE 0x26D628 kw_si16_S6_S3 1 UMR_BAR__1_1000_0_S6_S3 0 1 /end CHARACTERISTIC
/begin CHARACTERISTIC PO_MIN_V_B_HYSKOMP "Untere Verzugskompensationsbreitenbegrenzung" VALUE 0x26D62A kw_si16_S6_S3 1 UMR_BAR__1_1000_0_S6_S3 -1 0 /end CHARACTERISTIC
/begin CHARACTERISTIC PS_INIT_V_B_HYSKOMP "Initialisierungsdruckschwelle fuer den Funktionseinstieg" VALUE 0x26D62C kw_si16_S6_S3 4 UMR_BAR__1_1000_0_S6_S3 -2 2 /end CHARACTERISTIC
/begin CHARACTERISTIC PS_INIT_HYS_V_B_HYSKOMP "Initialisierungsschwelle Hysterese fuer den Funktionsausstieg" VALUE 0x26D62E kw_si16_S6_S3 2 UMR_BAR__1_1000_0_S6_S3 0 2 /end CHARACTERISTIC
/begin CHARACTERISTIC KF_T_RAMPE_V_B_HYSKOMP "Anstiegszeit der Rampe" MAP 0x223CA4 kf_ui16_S6_S3 100 UMR_SEC__1_100_0_S6_S3 0 100
 /begin AXIS_DESCR STD_AXIS NO_INPUT_QUANTITY UMR_BAR__1_1000_0_S6_S3 6 0 20 DEPOSIT ABSOLUTE MONOTONY MON_INCREASE /end AXIS_DESCR
 /begin AXIS_DESCR STD_AXIS zff_atsys._.iSignale._.obj.sig_c_getr UMR_GRADC__1_1_M40_S6_S3 5 -40 150 DEPOSIT ABSOLUTE MONOTONY MON_INCREASE /end AXIS_DESCR
/end CHARACTERISTIC
/begin CHARACTERISTIC KL_INIT_V_B_HYSKOMP "Initialisierungswert fuer Rampe" CURVE 0x223D00 kl_ui16_S6_S3 1 UMR_BAR__1_1000_0_S6_S3 0 1
 /begin AXIS_DESCR STD_AXIS NO_INPUT_QUANTITY UMR_BAR__1_1000_0_S6_S3 6 0 20 DEPOSIT ABSOLUTE MONOTONY MON_INCREASE /end AXIS_DESCR
/end CHARACTERISTIC
/begin CHARACTERISTIC SWI_AKTIV_V_B_HYSKOMP "Kupplungsverzugskompensation 0=aus, 1=KUP aktiv" VALUE 0x26E558 kw_ui8_S6_S3 1 UMR___1_1_0_S6_S3 0 1 /end CHARACTERISTIC
/begin CHARACTERISTIC TAB_SWI_AKTIV_C_HYSKOMP "Kompensation Kupplung, Index 0=Kein GSK 1=GSK, Werte: 0=aus, 1=KUP aktiv, 2=STG aktiv, 3=Beide aktiv" CURVE 0x223D1C tab_ui8_S6_S3 3 UMR___1_1_0_S6_S3 0 3
 /begin AXIS_DESCR FIX_AXIS NO_INPUT_QUANTITY UMR___1_1_0_S6_S3 2 0 1 FIX_AXIS_PAR_DIST 0 1 2 /end AXIS_DESCR
/end CHARACTERISTIC
/begin CHARACTERISTIC PGS_C_HYSKOMP "Gradientenschwelle für Richtungsumschaltung" VALUE 0x26D630 kw_ui16_S6_S3 0.999 UMR_BAR_SEC_1_1000_0_S6_S3 0.001 1 /end CHARACTERISTIC
/begin CHARACTERISTIC KL_F_TRAJEK_KPL_C_HYSKOMP "Trajekorienform der Kupplungshysteresekompensationsfkt" CURVE 0x223D24 kl_ui8_S6_S3 1 UMR___1_100_0_S6_S3 0 1
 /begin AXIS_DESCR STD_AXIS NO_INPUT_QUANTITY UMR___1_100_0_S6_S3 12 0 1 DEPOSIT ABSOLUTE MONOTONY MON_INCREASE /end AXIS_DESCR
/end CHARACTERISTIC
/begin CHARACTERISTIC KL_HYSB_KPL_C_HYSKOMP "Hysteresebreite Kupplung" CURVE 0x223D40 kl_ui16_S6_S3 150 UMR_NM__1_1_0_S6_S3 0 150
 /begin AXIS_DESCR STD_AXIS NO_INPUT_QUANTITY UMR_BAR__1_1000_0_S6_S3 8 0 65.535 DEPOSIT ABSOLUTE MONOTONY MON_INCREASE /end AXIS_DESCR
/end CHARACTERISTIC
/begin CHARACTERISTIC KL_F_GRAD_KPL_C_HYSKOMP "Faktor Hysteresebreite" CURVE 0x223D64 kl_si16_S6_S3 3 UMR___1_100_0_S6_S3 0 3
 /begin AXIS_DESCR STD_AXIS NO_INPUT_QUANTITY UMR_BAR_SEC_1_1000_0_S6_S3 6 -32.768 32.767 DEPOSIT ABSOLUTE MONOTONY MON_INCREASE /end AXIS_DESCR
/end CHARACTERISTIC
/begin CHARACTERISTIC KL_T_KPL_C_HYSKOMP "Filterzeitkonstante zum Abfiltern des Momentenoffsets" CURVE 0x223D80 kl_si16_S6_S3 0.99 UMR___1_100_0_S6_S3 0.01 1
 /begin AXIS_DESCR STD_AXIS NO_INPUT_QUANTITY UMR_BAR_SEC_1_1_0_S6_S3 6 -32768 32767 DEPOSIT ABSOLUTE MONOTONY MON_INCREASE /end AXIS_DESCR
/end CHARACTERISTIC
/begin CHARACTERISTIC KL_MUEKPL_C_HYSKOMP "Übertragungswert der Kupplung" CURVE 0x223D9C kl_ui16_S6_S3 1000 UMR_BAR_NM_1_1_0_S6_S3 0 1000
 /begin AXIS_DESCR STD_AXIS NO_INPUT_QUANTITY UMR_BAR__1_1000_0_S6_S3 6 0 20 DEPOSIT ABSOLUTE MONOTONY MON_INCREASE /end AXIS_DESCR
/end CHARACTERISTIC
/begin CHARACTERISTIC IGS_C_HYSKOMP "Gradientenschwelle für Richtungsumschaltung" VALUE 0x26D632 kw_si16_S6_S3 999 UMR_MA_SEC_1_1_0_S6_S3 1 1000 /end CHARACTERISTIC
/begin CHARACTERISTIC KL_F_TRAJEK_STG_C_HYSKOMP "Trajekorienform der Steuerungshysteresekompensationsfkt" CURVE 0x223DB8 kl_ui8_S6_S3 1 UMR___1_100_0_S6_S3 0 1
 /begin AXIS_DESCR STD_AXIS NO_INPUT_QUANTITY UMR___1_100_0_S6_S3 12 0 1 DEPOSIT ABSOLUTE MONOTONY MON_INCREASE /end AXIS_DESCR
/end CHARACTERISTIC
/begin CHARACTERISTIC KF_F_GRAD_STG_C_HYSKOMP "Faktor Hysteresebreite" MAP 0x223DD4 kf_si16_S6_S3 3 UMR___1_100_0_S6_S3 0 3
 /begin AXIS_DESCR STD_AXIS NO_INPUT_QUANTITY UMR_MA_SEC_1_1_0_S6_S3 6 -32768 32767 DEPOSIT ABSOLUTE MONOTONY MON_INCREASE /end AXIS_DESCR
 /begin AXIS_DESCR STD_AXIS zff_atsys._.iSignale._.obj.sig_c_getr UMR_GRADC__1_1_M40_S6_S3 4 -40 150 DEPOSIT ABSOLUTE MONOTONY MON_INCREASE /end AXIS_DESCR
/end CHARACTERISTIC
/begin CHARACTERISTIC KL_T_STG_C_HYSKOMP "Filterzeitkonstante zum Abfiltern des Stromoffsets" CURVE 0x223E20 kl_si16_S6_S3 0.99 UMR___1_100_0_S6_S3 0.01 1
 /begin AXIS_DESCR STD_AXIS NO_INPUT_QUANTITY UMR_MA_SEC_1_1_0_S6_S3 6 -32768 32767 DEPOSIT ABSOLUTE MONOTONY MON_INCREASE /end AXIS_DESCR
/end CHARACTERISTIC
/begin CHARACTERISTIC IS_IMIN_C_HYSKOMP "Stromschwelle(min) für Berechnung des Trajektorienfortschritts" VALUE 0x26D634 kw_si16_S6_S3 850 UMR_MA__1_10_0_S6_S3 0 850 /end CHARACTERISTIC
/begin CHARACTERISTIC IS_IMAX_C_HYSKOMP "Stromschwelle(max) für Berechnung des Trajektorienfortschritts" VALUE 0x26D636 kw_si16_S6_S3 850 UMR_MA__1_10_0_S6_S3 0 850 /end CHARACTERISTIC
/begin CHARACTERISTIC KF_F_V_C_HYSKOMP "Faktorisierung des DT1-Filterausgangs Verzugskompensation" MAP 0x223E3C kf_si16_S6_S3 2 UMR___1_1000_0_S6_S3 0 2
 /begin AXIS_DESCR STD_AXIS NO_INPUT_QUANTITY UMR_BAR__1_1000_0_S6_S3 8 0 32.767 DEPOSIT ABSOLUTE MONOTONY MON_INCREASE /end AXIS_DESCR
 /begin AXIS_DESCR STD_AXIS zff_atsys._.iSignale._.obj.sig_c_getr UMR_GRADC__1_1_M40_S6_S3 5 -40 150 DEPOSIT ABSOLUTE MONOTONY MON_INCREASE /end AXIS_DESCR
/end CHARACTERISTIC
/begin CHARACTERISTIC PO_MAX_V_C_HYSKOMP "Obere Verzugskompensationsbreitenbegrenzung" VALUE 0x26D638 kw_si16_S6_S3 1 UMR_BAR__1_1000_0_S6_S3 0 1 /end CHARACTERISTIC
/begin CHARACTERISTIC PO_MIN_V_C_HYSKOMP "Untere Verzugskompensationsbreitenbegrenzung" VALUE 0x26D63A kw_si16_S6_S3 1 UMR_BAR__1_1000_0_S6_S3 -1 0 /end CHARACTERISTIC
/begin CHARACTERISTIC PS_INIT_V_C_HYSKOMP "Initialisierungsdruckschwelle fuer den Funktionseinstieg" VALUE 0x26D63C kw_si16_S6_S3 4 UMR_BAR__1_1000_0_S6_S3 -2 2 /end CHARACTERISTIC
/begin CHARACTERISTIC PS_INIT_HYS_V_C_HYSKOMP "Initialisierungsschwelle Hysterese fuer den Funktionsausstieg" VALUE 0x26D63E kw_si16_S6_S3 2 UMR_BAR__1_1000_0_S6_S3 0 2 /end CHARACTERISTIC
/begin CHARACTERISTIC KF_T_RAMPE_V_C_HYSKOMP "Anstiegszeit der Rampe" MAP 0x223EB0 kf_ui16_S6_S3 100 UMR_SEC__1_100_0_S6_S3 0 100
 /begin AXIS_DESCR STD_AXIS NO_INPUT_QUANTITY UMR_BAR__1_1000_0_S6_S3 6 0 20 DEPOSIT ABSOLUTE MONOTONY MON_INCREASE /end AXIS_DESCR
 /begin AXIS_DESCR STD_AXIS zff_atsys._.iSignale._.obj.sig_c_getr UMR_GRADC__1_1_M40_S6_S3 5 -40 150 DEPOSIT ABSOLUTE MONOTONY MON_INCREASE /end AXIS_DESCR
/end CHARACTERISTIC
/begin CHARACTERISTIC KL_INIT_V_C_HYSKOMP "Initialisierungswert fuer Rampe" CURVE 0x223F0C kl_ui16_S6_S3 1 UMR_BAR__1_1000_0_S6_S3 0 1
 /begin AXIS_DESCR STD_AXIS NO_INPUT_QUANTITY UMR_BAR__1_1000_0_S6_S3 6 0 20 DEPOSIT ABSOLUTE MONOTONY MON_INCREASE /end AXIS_DESCR
/end CHARACTERISTIC
/begin CHARACTERISTIC SWI_AKTIV_V_C_HYSKOMP "Kupplungsverzugskompensation 0=aus, 1=KUP aktiv" VALUE 0x26E559 kw_ui8_S6_S3 1 UMR___1_1_0_S6_S3 0 1 /end CHARACTERISTIC
/begin CHARACTERISTIC TAB_SWI_AKTIV_D_HYSKOMP "Kompensation Kupplung, Index 0=Kein GSK 1=GSK, Werte: 0=aus, 1=KUP aktiv, 2=STG aktiv, 3=Beide aktiv" CURVE 0x223F28 tab_ui8_S6_S3 3 UMR___1_1_0_S6_S3 0 3
 /begin AXIS_DESCR FIX_AXIS NO_INPUT_QUANTITY UMR___1_1_0_S6_S3 2 0 1 FIX_AXIS_PAR_DIST 0 1 2 /end AXIS_DESCR
/end CHARACTERISTIC
/begin CHARACTERISTIC PGS_D_HYSKOMP "Gradientenschwelle für Richtungsumschaltung" VALUE 0x26D640 kw_ui16_S6_S3 0.999 UMR_BAR_SEC_1_1000_0_S6_S3 0.001 1 /end CHARACTERISTIC
/begin CHARACTERISTIC KL_F_TRAJEK_KPL_D_HYSKOMP "Trajekorienform der Kupplungshysteresekompensationsfkt" CURVE 0x223F30 kl_ui8_S6_S3 1 UMR___1_100_0_S6_S3 0 1
 /begin AXIS_DESCR STD_AXIS NO_INPUT_QUANTITY UMR___1_100_0_S6_S3 12 0 1 DEPOSIT ABSOLUTE MONOTONY MON_INCREASE /end AXIS_DESCR
/end CHARACTERISTIC
/begin CHARACTERISTIC KL_HYSB_KPL_D_HYSKOMP "Hysteresebreite Kupplung" CURVE 0x223F4C kl_ui16_S6_S3 150 UMR_NM__1_1_0_S6_S3 0 150
 /begin AXIS_DESCR STD_AXIS NO_INPUT_QUANTITY UMR_BAR__1_1000_0_S6_S3 8 0 65.535 DEPOSIT ABSOLUTE MONOTONY MON_INCREASE /end AXIS_DESCR
/end CHARACTERISTIC
/begin CHARACTERISTIC KL_F_GRAD_KPL_D_HYSKOMP "Faktor Hysteresebreite" CURVE 0x223F70 kl_si16_S6_S3 3 UMR___1_100_0_S6_S3 0 3
 /begin AXIS_DESCR STD_AXIS NO_INPUT_QUANTITY UMR_BAR_SEC_1_1000_0_S6_S3 6 -32.768 32.767 DEPOSIT ABSOLUTE MONOTONY MON_INCREASE /end AXIS_DESCR
/end CHARACTERISTIC
/begin CHARACTERISTIC KL_T_KPL_D_HYSKOMP "Filterzeitkonstante zum Abfiltern des Momentenoffsets" CURVE 0x223F8C kl_si16_S6_S3 0.99 UMR___1_100_0_S6_S3 0.01 1
 /begin AXIS_DESCR STD_AXIS NO_INPUT_QUANTITY UMR_BAR_SEC_1_1_0_S6_S3 6 -32768 32767 DEPOSIT ABSOLUTE MONOTONY MON_INCREASE /end AXIS_DESCR
/end CHARACTERISTIC
/begin CHARACTERISTIC KL_MUEKPL_D_HYSKOMP "Übertragungswert der Kupplung" CURVE 0x223FA8 kl_ui16_S6_S3 1000 UMR_BAR_NM_1_1_0_S6_S3 0 1000
 /begin AXIS_DESCR STD_AXIS NO_INPUT_QUANTITY UMR_BAR__1_1000_0_S6_S3 6 0 20 DEPOSIT ABSOLUTE MONOTONY MON_INCREASE /end AXIS_DESCR
/end CHARACTERISTIC
/begin CHARACTERISTIC IGS_D_HYSKOMP "Gradientenschwelle für Richtungsumschaltung" VALUE 0x26D642 kw_si16_S6_S3 999 UMR_MA_SEC_1_1_0_S6_S3 1 1000 /end CHARACTERISTIC
/begin CHARACTERISTIC KL_F_TRAJEK_STG_D_HYSKOMP "Trajekorienform der Steuerungshysteresekompensationsfkt" CURVE 0x223FC4 kl_ui8_S6_S3 1 UMR___1_100_0_S6_S3 0 1
 /begin AXIS_DESCR STD_AXIS NO_INPUT_QUANTITY UMR___1_100_0_S6_S3 12 0 1 DEPOSIT ABSOLUTE MONOTONY MON_INCREASE /end AXIS_DESCR
/end CHARACTERISTIC
/begin CHARACTERISTIC KF_F_GRAD_STG_D_HYSKOMP "Faktor Hysteresebreite" MAP 0x223FE0 kf_si16_S6_S3 3 UMR___1_100_0_S6_S3 0 3
 /begin AXIS_DESCR STD_AXIS NO_INPUT_QUANTITY UMR_MA_SEC_1_1_0_S6_S3 6 -32768 32767 DEPOSIT ABSOLUTE MONOTONY MON_INCREASE /end AXIS_DESCR
 /begin AXIS_DESCR STD_AXIS zff_atsys._.iSignale._.obj.sig_c_getr UMR_GRADC__1_1_M40_S6_S3 4 -40 150 DEPOSIT ABSOLUTE MONOTONY MON_INCREASE /end AXIS_DESCR
/end CHARACTERISTIC
/begin CHARACTERISTIC KL_T_STG_D_HYSKOMP "Filterzeitkonstante zum Abfiltern des Stromoffsets" CURVE 0x22402C kl_si16_S6_S3 0.99 UMR___1_100_0_S6_S3 0.01 1
 /begin AXIS_DESCR STD_AXIS NO_INPUT_QUANTITY UMR_MA_SEC_1_1_0_S6_S3 6 -32768 32767 DEPOSIT ABSOLUTE MONOTONY MON_INCREASE /end AXIS_DESCR
/end CHARACTERISTIC
/begin CHARACTERISTIC IS_IMIN_D_HYSKOMP "Stromschwelle(min) für Berechnung des Trajektorienfortschritts" VALUE 0x26D644 kw_si16_S6_S3 850 UMR_MA__1_10_0_S6_S3 0 850 /end CHARACTERISTIC
/begin CHARACTERISTIC IS_IMAX_D_HYSKOMP "Stromschwelle(max) für Berechnung des Trajektorienfortschritts" VALUE 0x26D646 kw_si16_S6_S3 850 UMR_MA__1_10_0_S6_S3 0 850 /end CHARACTERISTIC
/begin CHARACTERISTIC KF_F_V_D_HYSKOMP "Faktorisierung des DT1-Filterausgangs Verzugskompensation" MAP 0x224048 kf_si16_S6_S3 2 UMR___1_1000_0_S6_S3 0 2
 /begin AXIS_DESCR STD_AXIS NO_INPUT_QUANTITY UMR_BAR__1_1000_0_S6_S3 8 0 32.767 DEPOSIT ABSOLUTE MONOTONY MON_INCREASE /end AXIS_DESCR
 /begin AXIS_DESCR STD_AXIS zff_atsys._.iSignale._.obj.sig_c_getr UMR_GRADC__1_1_M40_S6_S3 5 -40 150 DEPOSIT ABSOLUTE MONOTONY MON_INCREASE /end AXIS_DESCR
/end CHARACTERISTIC
/begin CHARACTERISTIC PO_MAX_V_D_HYSKOMP "Obere Verzugskompensationsbreitenbegrenzung" VALUE 0x26D648 kw_si16_S6_S3 1 UMR_BAR__1_1000_0_S6_S3 0 1 /end CHARACTERISTIC
/begin CHARACTERISTIC PO_MIN_V_D_HYSKOMP "Untere Verzugskompensationsbreitenbegrenzung" VALUE 0x26D64A kw_si16_S6_S3 1 UMR_BAR__1_1000_0_S6_S3 -1 0 /end CHARACTERISTIC
/begin CHARACTERISTIC PS_INIT_V_D_HYSKOMP "Initialisierungsdruckschwelle fuer den Funktionseinstieg" VALUE 0x26D64C kw_si16_S6_S3 4 UMR_BAR__1_1000_0_S6_S3 -2 2 /end CHARACTERISTIC
/begin CHARACTERISTIC PS_INIT_HYS_V_D_HYSKOMP "Initialisierungsschwelle Hysterese fuer den Funktionsausstieg" VALUE 0x26D64E kw_si16_S6_S3 2 UMR_BAR__1_1000_0_S6_S3 0 2 /end CHARACTERISTIC
/begin CHARACTERISTIC KF_T_RAMPE_V_D_HYSKOMP "Anstiegszeit der Rampe" MAP 0x2240BC kf_ui16_S6_S3 100 UMR_SEC__1_100_0_S6_S3 0 100
 /begin AXIS_DESCR STD_AXIS NO_INPUT_QUANTITY UMR_BAR__1_1000_0_S6_S3 6 0 20 DEPOSIT ABSOLUTE MONOTONY MON_INCREASE /end AXIS_DESCR
 /begin AXIS_DESCR STD_AXIS zff_atsys._.iSignale._.obj.sig_c_getr UMR_GRADC__1_1_M40_S6_S3 5 -40 150 DEPOSIT ABSOLUTE MONOTONY MON_INCREASE /end AXIS_DESCR
/end CHARACTERISTIC
/begin CHARACTERISTIC KL_INIT_V_D_HYSKOMP "Initialisierungswert fuer Rampe" CURVE 0x224118 kl_ui16_S6_S3 1 UMR_BAR__1_1000_0_S6_S3 0 1
 /begin AXIS_DESCR STD_AXIS NO_INPUT_QUANTITY UMR_BAR__1_1000_0_S6_S3 6 0 20 DEPOSIT ABSOLUTE MONOTONY MON_INCREASE /end AXIS_DESCR
/end CHARACTERISTIC
/begin CHARACTERISTIC SWI_AKTIV_V_D_HYSKOMP "Kupplungsverzugskompensation 0=aus, 1=KUP aktiv" VALUE 0x26E55A kw_ui8_S6_S3 1 UMR___1_1_0_S6_S3 0 1 /end CHARACTERISTIC
/begin CHARACTERISTIC TAB_SWI_AKTIV_E_HYSKOMP "Kompensation Kupplung, Index 0=Kein GSK 1=GSK, Werte: 0=aus, 1=KUP aktiv, 2=STG aktiv, 3=Beide aktiv" CURVE 0x224134 tab_ui8_S6_S3 3 UMR___1_1_0_S6_S3 0 3
 /begin AXIS_DESCR FIX_AXIS NO_INPUT_QUANTITY UMR___1_1_0_S6_S3 2 0 1 FIX_AXIS_PAR_DIST 0 1 2 /end AXIS_DESCR
/end CHARACTERISTIC
/begin CHARACTERISTIC PGS_E_HYSKOMP "Gradientenschwelle für Richtungsumschaltung" VALUE 0x26D650 kw_ui16_S6_S3 0.999 UMR_BAR_SEC_1_1000_0_S6_S3 0.001 1 /end CHARACTERISTIC
/begin CHARACTERISTIC KL_F_TRAJEK_KPL_E_HYSKOMP "Trajekorienform der Kupplungshysteresekompensationsfkt" CURVE 0x22413C kl_ui8_S6_S3 1 UMR___1_100_0_S6_S3 0 1
 /begin AXIS_DESCR STD_AXIS NO_INPUT_QUANTITY UMR___1_100_0_S6_S3 12 0 1 DEPOSIT ABSOLUTE MONOTONY MON_INCREASE /end AXIS_DESCR
/end CHARACTERISTIC
/begin CHARACTERISTIC KL_HYSB_KPL_E_HYSKOMP "Hysteresebreite Kupplung" CURVE 0x224158 kl_ui16_S6_S3 150 UMR_NM__1_1_0_S6_S3 0 150
 /begin AXIS_DESCR STD_AXIS NO_INPUT_QUANTITY UMR_BAR__1_1000_0_S6_S3 8 0 65.535 DEPOSIT ABSOLUTE MONOTONY MON_INCREASE /end AXIS_DESCR
/end CHARACTERISTIC
/begin CHARACTERISTIC KL_F_GRAD_KPL_E_HYSKOMP "Faktor Hysteresebreite" CURVE 0x22417C kl_si16_S6_S3 3 UMR___1_100_0_S6_S3 0 3
 /begin AXIS_DESCR STD_AXIS NO_INPUT_QUANTITY UMR_BAR_SEC_1_1000_0_S6_S3 6 -32.768 32.767 DEPOSIT ABSOLUTE MONOTONY MON_INCREASE /end AXIS_DESCR
/end CHARACTERISTIC
/begin CHARACTERISTIC KL_T_KPL_E_HYSKOMP "Filterzeitkonstante zum Abfiltern des Momentenoffsets" CURVE 0x224198 kl_si16_S6_S3 0.99 UMR___1_100_0_S6_S3 0.01 1
 /begin AXIS_DESCR STD_AXIS NO_INPUT_QUANTITY UMR_BAR_SEC_1_1_0_S6_S3 6 -32768 32767 DEPOSIT ABSOLUTE MONOTONY MON_INCREASE /end AXIS_DESCR
/end CHARACTERISTIC
/begin CHARACTERISTIC KL_MUEKPL_E_HYSKOMP "Übertragungswert der Kupplung" CURVE 0x2241B4 kl_ui16_S6_S3 1000 UMR_BAR_NM_1_1_0_S6_S3 0 1000
 /begin AXIS_DESCR STD_AXIS NO_INPUT_QUANTITY UMR_BAR__1_1000_0_S6_S3 6 0 20 DEPOSIT ABSOLUTE MONOTONY MON_INCREASE /end AXIS_DESCR
/end CHARACTERISTIC
/begin CHARACTERISTIC IGS_E_HYSKOMP "Gradientenschwelle für Richtungsumschaltung" VALUE 0x26D652 kw_si16_S6_S3 999 UMR_MA_SEC_1_1_0_S6_S3 1 1000 /end CHARACTERISTIC
/begin CHARACTERISTIC KL_F_TRAJEK_STG_E_HYSKOMP "Trajekorienform der Steuerungshysteresekompensationsfkt" CURVE 0x2241D0 kl_ui8_S6_S3 1 UMR___1_100_0_S6_S3 0 1
 /begin AXIS_DESCR STD_AXIS NO_INPUT_QUANTITY UMR___1_100_0_S6_S3 12 0 1 DEPOSIT ABSOLUTE MONOTONY MON_INCREASE /end AXIS_DESCR
/end CHARACTERISTIC
/begin CHARACTERISTIC KF_F_GRAD_STG_E_HYSKOMP "Faktor Hysteresebreite" MAP 0x2241EC kf_si16_S6_S3 3 UMR___1_100_0_S6_S3 0 3
 /begin AXIS_DESCR STD_AXIS NO_INPUT_QUANTITY UMR_MA_SEC_1_1_0_S6_S3 6 -32768 32767 DEPOSIT ABSOLUTE MONOTONY MON_INCREASE /end AXIS_DESCR
 /begin AXIS_DESCR STD_AXIS zff_atsys._.iSignale._.obj.sig_c_getr UMR_GRADC__1_1_M40_S6_S3 4 -40 150 DEPOSIT ABSOLUTE MONOTONY MON_INCREASE /end AXIS_DESCR
/end CHARACTERISTIC
/begin CHARACTERISTIC KL_T_STG_E_HYSKOMP "Filterzeitkonstante zum Abfiltern des Stromoffsets" CURVE 0x224238 kl_si16_S6_S3 0.99 UMR___1_100_0_S6_S3 0.01 1
 /begin AXIS_DESCR STD_AXIS NO_INPUT_QUANTITY UMR_MA_SEC_1_1_0_S6_S3 6 -32768 32767 DEPOSIT ABSOLUTE MONOTONY MON_INCREASE /end AXIS_DESCR
/end CHARACTERISTIC
/begin CHARACTERISTIC IS_IMIN_E_HYSKOMP "Stromschwelle(min) für Berechnung des Trajektorienfortschritts" VALUE 0x26D654 kw_si16_S6_S3 850 UMR_MA__1_10_0_S6_S3 0 850 /end CHARACTERISTIC
/begin CHARACTERISTIC IS_IMAX_E_HYSKOMP "Stromschwelle(max) für Berechnung des Trajektorienfortschritts" VALUE 0x26D656 kw_si16_S6_S3 850 UMR_MA__1_10_0_S6_S3 0 850 /end CHARACTERISTIC
/begin CHARACTERISTIC KF_F_V_E_HYSKOMP "Faktorisierung des DT1-Filterausgangs Verzugskompensation" MAP 0x224254 kf_si16_S6_S3 2 UMR___1_1000_0_S6_S3 0 2
 /begin AXIS_DESCR STD_AXIS NO_INPUT_QUANTITY UMR_BAR__1_1000_0_S6_S3 8 0 32.767 DEPOSIT ABSOLUTE MONOTONY MON_INCREASE /end AXIS_DESCR
 /begin AXIS_DESCR STD_AXIS zff_atsys._.iSignale._.obj.sig_c_getr UMR_GRADC__1_1_M40_S6_S3 5 -40 150 DEPOSIT ABSOLUTE MONOTONY MON_INCREASE /end AXIS_DESCR
/end CHARACTERISTIC
/begin CHARACTERISTIC PO_MAX_V_E_HYSKOMP "Obere Verzugskompensationsbreitenbegrenzung" VALUE 0x26D658 kw_si16_S6_S3 1 UMR_BAR__1_1000_0_S6_S3 0 1 /end CHARACTERISTIC
/begin CHARACTERISTIC PO_MIN_V_E_HYSKOMP "Untere Verzugskompensationsbreitenbegrenzung" VALUE 0x26D65A kw_si16_S6_S3 1 UMR_BAR__1_1000_0_S6_S3 -1 0 /end CHARACTERISTIC
/begin CHARACTERISTIC PS_INIT_V_E_HYSKOMP "Initialisierungsdruckschwelle fuer den Funktionseinstieg" VALUE 0x26D65C kw_si16_S6_S3 4 UMR_BAR__1_1000_0_S6_S3 -2 2 /end CHARACTERISTIC
/begin CHARACTERISTIC PS_INIT_HYS_V_E_HYSKOMP "Initialisierungsschwelle Hysterese fuer den Funktionsausstieg" VALUE 0x26D65E kw_si16_S6_S3 2 UMR_BAR__1_1000_0_S6_S3 0 2 /end CHARACTERISTIC
/begin CHARACTERISTIC KF_T_RAMPE_V_E_HYSKOMP "Anstiegszeit der Rampe" MAP 0x2242C8 kf_ui16_S6_S3 100 UMR_SEC__1_100_0_S6_S3 0 100
 /begin AXIS_DESCR STD_AXIS NO_INPUT_QUANTITY UMR_BAR__1_1000_0_S6_S3 6 0 20 DEPOSIT ABSOLUTE MONOTONY MON_INCREASE /end AXIS_DESCR
 /begin AXIS_DESCR STD_AXIS zff_atsys._.iSignale._.obj.sig_c_getr UMR_GRADC__1_1_M40_S6_S3 5 -40 150 DEPOSIT ABSOLUTE MONOTONY MON_INCREASE /end AXIS_DESCR
/end CHARACTERISTIC
/begin CHARACTERISTIC KL_INIT_V_E_HYSKOMP "Initialisierungswert fuer Rampe" CURVE 0x224324 kl_ui16_S6_S3 1 UMR_BAR__1_1000_0_S6_S3 0 1
 /begin AXIS_DESCR STD_AXIS NO_INPUT_QUANTITY UMR_BAR__1_1000_0_S6_S3 6 0 20 DEPOSIT ABSOLUTE MONOTONY MON_INCREASE /end AXIS_DESCR
/end CHARACTERISTIC
/begin CHARACTERISTIC SWI_AKTIV_V_E_HYSKOMP "Kupplungsverzugskompensation 0=aus, 1=KUP aktiv" VALUE 0x26E55B kw_ui8_S6_S3 1 UMR___1_1_0_S6_S3 0 1 /end CHARACTERISTIC
/begin CHARACTERISTIC TAB_SWI_AKTIV_K0_HYSKOMP "Kompensation Kupplung, Index 0=Kein GSK 1=GSK, Werte: 0=aus, 1=KUP aktiv, 2=STG aktiv, 3=Beide aktiv" CURVE 0x224340 tab_ui8_S6_S3 3 UMR___1_1_0_S6_S3 0 3
 /begin AXIS_DESCR FIX_AXIS NO_INPUT_QUANTITY UMR___1_1_0_S6_S3 2 0 1 FIX_AXIS_PAR_DIST 0 1 2 /end AXIS_DESCR
/end CHARACTERISTIC
/begin CHARACTERISTIC PGS_K0_HYSKOMP "Gradientenschwelle für Richtungsumschaltung" VALUE 0x26D660 kw_ui16_S6_S3 0.999 UMR_BAR_SEC_1_1000_0_S6_S3 0.001 1 /end CHARACTERISTIC
/begin CHARACTERISTIC KL_F_TRAJEK_KPL_K0_HYSKOMP "Trajekorienform der Kupplungshysteresekompensationsfkt" CURVE 0x224348 kl_ui8_S6_S3 1 UMR___1_100_0_S6_S3 0 1
 /begin AXIS_DESCR STD_AXIS NO_INPUT_QUANTITY UMR___1_100_0_S6_S3 12 0 1 DEPOSIT ABSOLUTE MONOTONY MON_INCREASE /end AXIS_DESCR
/end CHARACTERISTIC
/begin CHARACTERISTIC KL_HYSB_KPL_K0_HYSKOMP "Hysteresebreite Kupplung" CURVE 0x224364 kl_ui16_S6_S3 150 UMR_NM__1_1_0_S6_S3 0 150
 /begin AXIS_DESCR STD_AXIS NO_INPUT_QUANTITY UMR_BAR__1_1000_0_S6_S3 8 0 65.535 DEPOSIT ABSOLUTE MONOTONY MON_INCREASE /end AXIS_DESCR
/end CHARACTERISTIC
/begin CHARACTERISTIC KL_F_GRAD_KPL_K0_HYSKOMP "Faktor Hysteresebreite" CURVE 0x224388 kl_si16_S6_S3 3 UMR___1_100_0_S6_S3 0 3
 /begin AXIS_DESCR STD_AXIS NO_INPUT_QUANTITY UMR_BAR_SEC_1_1000_0_S6_S3 6 -32.768 32.767 DEPOSIT ABSOLUTE MONOTONY MON_INCREASE /end AXIS_DESCR
/end CHARACTERISTIC
/begin CHARACTERISTIC KL_T_KPL_K0_HYSKOMP "Filterzeitkonstante zum Abfiltern des Momentenoffsets" CURVE 0x2243A4 kl_si16_S6_S3 0.99 UMR___1_100_0_S6_S3 0.01 1
 /begin AXIS_DESCR STD_AXIS NO_INPUT_QUANTITY UMR_BAR_SEC_1_1_0_S6_S3 6 -32768 32767 DEPOSIT ABSOLUTE MONOTONY MON_INCREASE /end AXIS_DESCR
/end CHARACTERISTIC
/begin CHARACTERISTIC IGS_K0_HYSKOMP "Gradientenschwelle für Richtungsumschaltung" VALUE 0x26D662 kw_si16_S6_S3 999 UMR_MA_SEC_1_1_0_S6_S3 1 1000 /end CHARACTERISTIC
/begin CHARACTERISTIC KL_F_TRAJEK_STG_K0_HYSKOMP "Trajekorienform der Steuerungshysteresekompensationsfkt" CURVE 0x2243C0 kl_ui8_S6_S3 1 UMR___1_100_0_S6_S3 0 1
 /begin AXIS_DESCR STD_AXIS NO_INPUT_QUANTITY UMR___1_100_0_S6_S3 12 0 1 DEPOSIT ABSOLUTE MONOTONY MON_INCREASE /end AXIS_DESCR
/end CHARACTERISTIC
/begin CHARACTERISTIC KF_F_GRAD_STG_K0_HYSKOMP "Faktor Hysteresebreite" MAP 0x2243DC kf_si16_S6_S3 3 UMR___1_100_0_S6_S3 0 3
 /begin AXIS_DESCR STD_AXIS NO_INPUT_QUANTITY UMR_MA_SEC_1_1_0_S6_S3 6 -32768 32767 DEPOSIT ABSOLUTE MONOTONY MON_INCREASE /end AXIS_DESCR
 /begin AXIS_DESCR STD_AXIS zff_atsys._.iSignale._.obj.sig_c_getr UMR_GRADC__1_1_M40_S6_S3 4 -40 150 DEPOSIT ABSOLUTE MONOTONY MON_INCREASE /end AXIS_DESCR
/end CHARACTERISTIC
/begin CHARACTERISTIC KL_T_STG_K0_HYSKOMP "Filterzeitkonstante zum Abfiltern des Stromoffsets" CURVE 0x224428 kl_si16_S6_S3 0.99 UMR___1_100_0_S6_S3 0.01 1
 /begin AXIS_DESCR STD_AXIS NO_INPUT_QUANTITY UMR_MA_SEC_1_1_0_S6_S3 6 -32768 32767 DEPOSIT ABSOLUTE MONOTONY MON_INCREASE /end AXIS_DESCR
/end CHARACTERISTIC
/begin CHARACTERISTIC IS_IMIN_K0_HYSKOMP "Stromschwelle(min) für Berechnung des Trajektorienfortschritts" VALUE 0x26D664 kw_si16_S6_S3 850 UMR_MA__1_10_0_S6_S3 0 850 /end CHARACTERISTIC
/begin CHARACTERISTIC IS_IMAX_K0_HYSKOMP "Stromschwelle(max) für Berechnung des Trajektorienfortschritts" VALUE 0x26D666 kw_si16_S6_S3 850 UMR_MA__1_10_0_S6_S3 0 850 /end CHARACTERISTIC
/begin CHARACTERISTIC KF_F_V_K0_HYSKOMP "Faktorisierung des DT1-Filterausgangs Verzugskompensation" MAP 0x224444 kf_si16_S6_S3 2 UMR___1_1000_0_S6_S3 0 2
 /begin AXIS_DESCR STD_AXIS NO_INPUT_QUANTITY UMR_BAR__1_1000_0_S6_S3 8 0 32.767 DEPOSIT ABSOLUTE MONOTONY MON_INCREASE /end AXIS_DESCR
 /begin AXIS_DESCR STD_AXIS zff_atsys._.iSignale._.obj.sig_c_getr UMR_GRADC__1_1_M40_S6_S3 5 -40 150 DEPOSIT ABSOLUTE MONOTONY MON_INCREASE /end AXIS_DESCR
/end CHARACTERISTIC
/begin CHARACTERISTIC PO_MAX_V_K0_HYSKOMP "Obere Verzugskompensationsbreitenbegrenzung" VALUE 0x26D668 kw_si16_S6_S3 1 UMR_BAR__1_1000_0_S6_S3 0 1 /end CHARACTERISTIC
/begin CHARACTERISTIC PO_MIN_V_K0_HYSKOMP "Untere Verzugskompensationsbreitenbegrenzung" VALUE 0x26D66A kw_si16_S6_S3 1 UMR_BAR__1_1000_0_S6_S3 -1 0 /end CHARACTERISTIC
/begin CHARACTERISTIC PS_INIT_V_K0_HYSKOMP "Initialisierungsdruckschwelle fuer den Funktionseinstieg" VALUE 0x26D66C kw_si16_S6_S3 4 UMR_BAR__1_1000_0_S6_S3 -2 2 /end CHARACTERISTIC
/begin CHARACTERISTIC PS_INIT_HYS_V_K0_HYSKOMP "Initialisierungsschwelle Hysterese fuer den Funktionsausstieg" VALUE 0x26D66E kw_si16_S6_S3 2 UMR_BAR__1_1000_0_S6_S3 0 2 /end CHARACTERISTIC
/begin CHARACTERISTIC KF_T_RAMPE_V_K0_HYSKOMP "Anstiegszeit der Rampe" MAP 0x2244B8 kf_ui16_S6_S3 100 UMR_SEC__1_100_0_S6_S3 0 100
 /begin AXIS_DESCR STD_AXIS NO_INPUT_QUANTITY UMR_BAR__1_1000_0_S6_S3 6 0 20 DEPOSIT ABSOLUTE MONOTONY MON_INCREASE /end AXIS_DESCR
 /begin AXIS_DESCR STD_AXIS zff_atsys._.iSignale._.obj.sig_c_getr UMR_GRADC__1_1_M40_S6_S3 5 -40 150 DEPOSIT ABSOLUTE MONOTONY MON_INCREASE /end AXIS_DESCR
/end CHARACTERISTIC
/begin CHARACTERISTIC KL_INIT_V_K0_HYSKOMP "Initialisierungswert fuer Rampe" CURVE 0x224514 kl_ui16_S6_S3 1 UMR_BAR__1_1000_0_S6_S3 0 1
 /begin AXIS_DESCR STD_AXIS NO_INPUT_QUANTITY UMR_BAR__1_1000_0_S6_S3 6 0 20 DEPOSIT ABSOLUTE MONOTONY MON_INCREASE /end AXIS_DESCR
/end CHARACTERISTIC
/begin CHARACTERISTIC SWI_AKTIV_V_K0_HYSKOMP "Kupplungsverzugskompensation 0=aus, 1=KUP aktiv" VALUE 0x26E55C kw_ui8_S6_S3 1 UMR___1_1_0_S6_S3 0 1 /end CHARACTERISTIC
/begin MEASUREMENT sK0SollPrio.f_verbot_regeln_k0 "Flag zum Anzeigen eines Regelverbots" UBYTE eBool_true_false_S6_S3 1 100 0 1 ECU_ADDRESS 0xFFF85436 /end MEASUREMENT
/begin MEASUREMENT sK0SollPrio.f_verbot_regeln_kalt_k0 "Flag zum Anzeigen eines Regelverbots aufgrund zu niedriger Getriebesumpftemperatur" UBYTE eBool_true_false_S6_S3 1 100 0 1 ECU_ADDRESS 0xFFF85437 /end MEASUREMENT
/begin MEASUREMENT sK0SollPrio.f_verbot_regeln_heiss_k0 "Flag zum Anzeigen eines Regelverbots aufgrund zu hoher Getriebesumpftemperatur" UBYTE eBool_true_false_S6_S3 1 100 0 1 ECU_ADDRESS 0xFFF85435 /end MEASUREMENT
/begin MEASUREMENT sK0SollPrio.f_verbot_regeln_drehzahl_k0 "Flag zum Anzeigen eines Regelverbots aufgrund ungueltigem Drehzahlsignals" UBYTE eBool_true_false_S6_S3 1 100 0 1 ECU_ADDRESS 0xFFF85434 /end MEASUREMENT
/begin MEASUREMENT sK0SollPrio.flag_verbot_regeln_k0 "Flag zum Anzeigen eines Regelverbots" UBYTE eBool_true_false_S6_S3 1 100 0 1 ECU_ADDRESS 0xFFF85438 /end MEASUREMENT
/begin MEASUREMENT sK0SollPrio.k0_soll_erw "Von der HAS angeforderter unpriorisierter Sollzustand der K0" UBYTE eK0Soll_S6_S3 1 100 0 5 ECU_ADDRESS 0xFFF85439 /end MEASUREMENT
/begin MEASUREMENT sK0SollPrio.k0_soll_gepr "Von der K0 Sollzustandspriorisierung an den Zustandsgraphen ausgegebener Sollzustand" UBYTE eK0Soll_S6_S3 1 100 0 5 ECU_ADDRESS 0xFFF8543A /end MEASUREMENT
/begin MEASUREMENT sK0SollPrio.schaltung_direkt_k0 "Schalter fuer Schaltungen ohne Schlupf (nur in GESCHLOSSEN moeglich)" UBYTE eBool_true_false_S6_S3 1 100 0 1 ECU_ADDRESS 0xFFF8543B /end MEASUREMENT
/begin MEASUREMENT sK0Stat.po_ist_k0 "Aus dem Solleffektivdruck po_soll_k0 durch PT2 Filterung berechneter Isteffektivdruck" FLOAT32_IEEE UMRM_BAR__1_1_0_S6_S3 1 100 0 40 FORMAT "%5.3" ECU_ADDRESS 0xFFF85440 /end MEASUREMENT
/begin MEASUREMENT sK0Stat.m_ist_k0 "Aus dem Isteffektivdruck berechnetes Istmoment" SWORD UMRM_NM__1_1_0_S6_S3 1 100 0 1000 ECU_ADDRESS 0xFFF85444 /end MEASUREMENT
/begin MEASUREMENT sK0Stat.k0_ist "Status der K0" UBYTE eK0Ist_S6_S3 1 100 0 5 ECU_ADDRESS 0xFFF85448 /end MEASUREMENT
/begin MEASUREMENT sK0Stat.k0_ist_komp "Komplementwert Status der K0" UBYTE UMRM___1_1_0_S6_S3 1 100 0 255 ECU_ADDRESS 0xFFF85449 /end MEASUREMENT
/begin MEASUREMENT sK0Stat.m_schlepp_k0 "K0-Schleppmoment" UBYTE UMRM_NM__1_1_0_S6_S3 1 100 0 255 ECU_ADDRESS 0xFFF8544A /end MEASUREMENT
/begin MEASUREMENT sK0Stat.qu_k0_befuellung_aktiv "Abfrage ob sich die K0 im Befuellen befindet" UBYTE UMRM___1_1_0_S6_S3 1 100 0 1 BIT_MASK 0x1 ECU_ADDRESS 0xFFF8544E /end MEASUREMENT
/begin MEASUREMENT sK0Stat.qu_k0_befuellung "Abfrage ob sich die K0 im Befuellen ueber k0_ist befindet" UBYTE UMRM___1_1_0_S6_S3 1 100 0 1 BIT_MASK 0x1 ECU_ADDRESS 0xFFF8544D /end MEASUREMENT
/begin MEASUREMENT sK0Stat.qu_iae_a_p_ada_erlaubt "Abfrage ob sich die K0 im Befuellen befindet" UBYTE UMRM___1_1_0_S6_S3 1 100 0 1 BIT_MASK 0x1 ECU_ADDRESS 0xFFF8544B /end MEASUREMENT
/begin MEASUREMENT sK0Stat.qu_k0_kraftuebertragung "Abfrage ob die K0 Moment uebertraegt" UBYTE UMRM___1_1_0_S6_S3 1 100 0 1 BIT_MASK 0x1 ECU_ADDRESS 0xFFF85450 /end MEASUREMENT
/begin MEASUREMENT sK0Stat.qu_k0_anlegen "Abfrage ob die K0 sich im Anlegen befindet" UBYTE UMRM___1_1_0_S6_S3 1 100 0 1 BIT_MASK 0x1 ECU_ADDRESS 0xFFF8544C /end MEASUREMENT
/begin MEASUREMENT sK0Stat.qu_k0_geschlossen "Abfrage ob die K0 geschlossen ist" UBYTE UMRM___1_1_0_S6_S3 1 100 0 1 BIT_MASK 0x1 ECU_ADDRESS 0xFFF8544F /end MEASUREMENT
/begin MEASUREMENT sK0TempM.vp_oelgesamt_k0 "Gefilterter Gesamtkuehloelvolumenstrom K0" FLOAT32_IEEE UMRM_LITER_MIN_1_1_0_S6_S3 1 100 -1500 1500 FORMAT "%5.3" ECU_ADDRESS 0xFFF8548C /end MEASUREMENT
/begin MEASUREMENT sK0TempM.vp_oelgesamt_k0_int "Gefilterter Gesamtkuehloelvolumenstrom K0" UBYTE UMRM___1_5_0_S6_S3 1 100 0 51 ECU_ADDRESS 0xFFF854A7 /end MEASUREMENT
/begin MEASUREMENT sK0TempM.vp_oelgesamt_k0_sts "Status des Gefilterter Gesamtkuehloelvolumenstrom K0" UBYTE UMRM___1_1_0_S6_S3 1 100 0 2 ECU_ADDRESS 0xFFF854A8 /end MEASUREMENT
/begin MEASUREMENT sK0TempM.vp_oelrohan_k0 "Ungefilterter Rohwert des Kuehloelvolumenstroms K0 im nicht gesaettigten Bereich bei aktiver K0 Kuehlung. Wird aus vp_sek_k0_iae mal K_FVPOELVERTKUEAN_K0 bestimmt" FLOAT32_IEEE UMRM_LITER_MIN_1_1_0_S6_S3 1 100 0 15 FORMAT "%5.3" ECU_ADDRESS 0xFFF8549C /end MEASUREMENT
/begin MEASUREMENT sK0TempM.vp_oelrohaus_k0 "Ungefilterter Rohwert des Kuehloelvolumenstroms K0 im nicht gesaettigten Bereich bei inaktiver K0 Kuehlung. Wird aus vp_sek_k0_iae mal K_FVPOELVERTKUEAUS_K0 bestimmt" FLOAT32_IEEE UMRM_LITER_MIN_1_1_0_S6_S3 1 100 0 15 FORMAT "%5.3" ECU_ADDRESS 0xFFF854A0 /end MEASUREMENT
/begin MEASUREMENT sK0TempM.vp_oelgesamtroh_k0 "Ungefilterter Rohwert des Gesamtkuehloelvolumenstroms K0 aus MIN(vp_oelroh_k0 und vp_oelkuehlaus/anmax_k0)" FLOAT32_IEEE UMRM_LITER_MIN_1_1_0_S6_S3 1 100 0 15 FORMAT "%5.3" ECU_ADDRESS 0xFFF85490 /end MEASUREMENT
/begin MEASUREMENT sK0TempM.vp_oelkuehlausmax_k0 "Maxwert Kuehloelvolumenstrom K0 im gesaettigten Bereich bei ausgeschalteter K0 Kuehlung. Wird aus KL_VPSEKK0IAEMAX_K0 mal K_FVPOELVERTKUEAUS_K0 bestimmt." FLOAT32_IEEE UMRM_LITER_MIN_1_1_0_S6_S3 1 100 0 15 FORMAT "%5.3" ECU_ADDRESS 0xFFF85498 /end MEASUREMENT
/begin MEASUREMENT sK0TempM.vp_oelkuehlanmax_k0 "Maxwert Kuehloelvolumenstrom K0 im gesaettigten Bereich bei eingeschalteter K0 Kuehlung. Wird aus KL_VPSEKK0IAEMAX_K0 mal K_FVPOELVERTKUEAN_K0 bestimmt." FLOAT32_IEEE UMRM_LITER_MIN_1_1_0_S6_S3 1 100 0 15 FORMAT "%5.3" ECU_ADDRESS 0xFFF85494 /end MEASUREMENT
/begin MEASUREMENT sK0TempM.alpha_belag_k0 "Waermeuebergangskoeffizient fuer den Waermeuebergang vom Reibbelag in das Kuehloel" FLOAT32_IEEE UMRM_W_K_1_1_0_S6_S3 1 100 0 250 FORMAT "%5.3" ECU_ADDRESS 0xFFF85458 /end MEASUREMENT
/begin MEASUREMENT sK0TempM.m_k0 "K0-Istmoment" FLOAT32_IEEE UMRM_NM__1_1_0_S6_S3 1 100 -2000 2000 FORMAT "%5.3" ECU_ADDRESS 0xFFF85474 /end MEASUREMENT
/begin MEASUREMENT sK0TempM.q_verlust_k0 "Waermestrom aus Verlustleistung der schlupfenden K0" FLOAT32_IEEE UMRM_W__1_1_0_S6_S3 1 100 -50000 50000 FORMAT "%5.3" ECU_ADDRESS 0xFFF85488 /end MEASUREMENT
/begin MEASUREMENT sK0TempM.q_belag_ab_k0 "Waermestrom vom Reibbelag in das Kuehloel" FLOAT32_IEEE UMRM_W__1_1_0_S6_S3 1 100 -50000 50000 FORMAT "%5.3" ECU_ADDRESS 0xFFF85480 /end MEASUREMENT
/begin MEASUREMENT sK0TempM.q_belag_ab_korr_k0 "Korrigierter Waermestrom vom Reibbelag in das Kuehloel" FLOAT32_IEEE UMRM_W__1_1_0_S6_S3 1 100 -50000 50000 FORMAT "%5.3" ECU_ADDRESS 0xFFF85484 /end MEASUREMENT
/begin MEASUREMENT sK0TempM.q_ab_k0 "Waermestrom aus K0(F_WAERMEKAP_OEALAUS_K0) in den Kuehlkreislauf" FLOAT32_IEEE UMRM_W__1_1_0_S6_S3 1 100 -50000 50000 FORMAT "%5.3" ECU_ADDRESS 0xFFF8547C /end MEASUREMENT
/begin MEASUREMENT sK0TempM.c_belag_k0 "K0-Belagstemperatur" FLOAT32_IEEE UMRM_GRADC__1_1_0_S6_S3 1 100 -40 500 FORMAT "%5.3" ECU_ADDRESS 0xFFF8545C /end MEASUREMENT
/begin MEASUREMENT sK0TempM.c_belag_k0_alt "K0-Belagstemperatur (Wert aus letztem Rechenschritt)" FLOAT32_IEEE UMRM_GRADC__1_1_0_S6_S3 1 100 -40 500 FORMAT "%5.3" ECU_ADDRESS 0xFFF85460 /end MEASUREMENT
/begin MEASUREMENT sK0TempM.grad_c_belag_k0 "K0-Belagstemperaturgradient" FLOAT32_IEEE UMRM_GRADC_SEC_1_1_0_S6_S3 1 100 -10000 10000 FORMAT "%5.3" ECU_ADDRESS 0xFFF85470 /end MEASUREMENT
/begin MEASUREMENT sK0TempM.c_getr_korr_k0 "Korrigierte Getriebsumpftemperatur fuer Berechnungen innerhalb K0 Temperaturmodell (Parameter: CO_CGETRTEMPMOD_K0)" FLOAT32_IEEE UMRM_GRADC__1_1_0_S6_S3 1 100 -40 500 FORMAT "%5.3" ECU_ADDRESS 0xFFF85464 /end MEASUREMENT
/begin MEASUREMENT sK0TempM.c_oelaus_k0 "Oelaustrittstemperatur nach Lamellenpaket" FLOAT32_IEEE UMRM_GRADC__1_1_0_S6_S3 1 100 -40 500 FORMAT "%5.3" ECU_ADDRESS 0xFFF85468 /end MEASUREMENT
/begin MEASUREMENT sK0TempM.c_oelaus_k0_int "Oelaustrittstemperatur nach Lamellenpaket" SWORD UMRM_GRADC__1_1_0_S6_S3 1 100 -40 500 ECU_ADDRESS 0xFFF854A4 /end MEASUREMENT
/begin MEASUREMENT sK0TempM.c_oelaus_k0_sts "Status Oelaustrittstemperatur nach Lamellenpaket" UBYTE UMRM___1_1_0_S6_S3 1 100 0 2 ECU_ADDRESS 0xFFF854A6 /end MEASUREMENT
/begin MEASUREMENT sK0TempM.c_oelaus_k0_alt "Oelaustrittstemperatur nach Lamellenpaket (Wert aus letztem Rechenschritt)" FLOAT32_IEEE UMRM_GRADC__1_1_0_S6_S3 1 100 -40 500 FORMAT "%5.3" ECU_ADDRESS 0xFFF8546C /end MEASUREMENT
/begin MEASUREMENT sK0TempM.m_schlepp_k0_roh "Rohwert des Schleppmoments der K0" FLOAT32_IEEE UMRM_NM__1_1_0_S6_S3 1 100 0 100 FORMAT "%5.3" ECU_ADDRESS 0xFFF85478 /end MEASUREMENT
/begin MEASUREMENT sK0Diag.z_k0_diag "Status Istzustand der K0 fuer Pruefbedingung der Diagnosen" UBYTE eBool_true_false_S6_S3 1 100 0 1 ECU_ADDRESS 0xFFF8591B /end MEASUREMENT
/begin MEASUREMENT sK0Diag.info_c0_hot "0x00 = Normalbetrieb, 0x01 = Hoher Waermeeintrag, 0x02 = Kupplung zu heiss" UBYTE UMRM___1_1_0_S6_S3 1 100 0 255 ECU_ADDRESS 0xFFF85910 /end MEASUREMENT
/begin MEASUREMENT sK0Diag.status_me_k0 "Status ob Motoreingriff erfolgen soll" UBYTE UMRM___1_1_0_S6_S3 1 100 0 255 ECU_ADDRESS 0xFFF85915 /end MEASUREMENT
/begin MEASUREMENT sK0Diag.status_me_k0_komp "Kopmlement vom Status ob Motoreingriff erfolgen soll" UBYTE UMRM___1_1_0_S6_S3 1 100 0 255 ECU_ADDRESS 0xFFF85916 /end MEASUREMENT
/begin MEASUREMENT sK0Diag.m_schutz_k0 "Absolutes Begrenzungsmoment UTF Schutzfunktion" SWORD UMRM_NM__1_1_0_S6_S3 1 100 -400 1640 ECU_ADDRESS 0xFFF8590E /end MEASUREMENT
/begin MEASUREMENT sK0Diag.pruefbedingung_c0_defect "Pruefbedingung KFC_C0DEFECT" UBYTE eBool_true_false_S6_S3 1 100 0 1 ECU_ADDRESS 0xFFF85911 /end MEASUREMENT
/begin MEASUREMENT sK0Diag.stoerungsbedingung_c0_defect "Stoerungsbedingung KFC_C0DEFECT" UBYTE eBool_true_false_S6_S3 1 100 0 1 ECU_ADDRESS 0xFFF85917 /end MEASUREMENT
/begin MEASUREMENT sK0Diag.pruefbedingung_c0_defecthot "Pruefbedingung KFC_C0DEFECTHOT" UBYTE eBool_true_false_S6_S3 1 100 0 1 ECU_ADDRESS 0xFFF85912 /end MEASUREMENT
/begin MEASUREMENT sK0Diag.stoerungsbedingung_c0_defecthot "Stoerungsbedingung KFC_C0DEFECTHOT" UBYTE eBool_true_false_S6_S3 1 100 0 1 ECU_ADDRESS 0xFFF85918 /end MEASUREMENT
/begin MEASUREMENT sK0Diag.pruefbedingung_c0_hot "Pruefbedingung KFC_C0HOT" UBYTE eBool_true_false_S6_S3 1 100 0 1 ECU_ADDRESS 0xFFF85913 /end MEASUREMENT
/begin MEASUREMENT sK0Diag.stoerungsbedingung_c0_hot "Stoerungsbedingung KFC_C0HOT" UBYTE eBool_true_false_S6_S3 1 100 0 1 ECU_ADDRESS 0xFFF85919 /end MEASUREMENT
/begin MEASUREMENT sK0Diag.pruefbedingung_c0_synchot "Pruefbedingung KFC_C0SYNCHOT" UBYTE eBool_true_false_S6_S3 1 100 0 1 ECU_ADDRESS 0xFFF85914 /end MEASUREMENT
/begin MEASUREMENT sK0Diag.stoerungsbedingung_c0_synchot "Stoerungsbedingung KFC_C0SYNCHOT" UBYTE eBool_true_false_S6_S3 1 100 0 1 ECU_ADDRESS 0xFFF8591A /end MEASUREMENT
/begin MEASUREMENT sK0Zust.z_k0 "Istzustand der K0" UBYTE eK0Zust_S6_S3 1 100 0 12 ECU_ADDRESS 0xFFF85923 /end MEASUREMENT
/begin MEASUREMENT sK0Zust.z_init_zustand_k0 "Flag fuer Zustandsinitialisierung" UBYTE eBool_true_false_S6_S3 1 100 0 1 ECU_ADDRESS 0xFFF85922 /end MEASUREMENT
/begin MEASUREMENT sK0Zust.t_fa_k0 "Fuellausgleichszeit" UBYTE UMRM_MSEC__10_1_0_S6_S3 1 100 0 2550 ECU_ADDRESS 0xFFF85920 /end MEASUREMENT
/begin MEASUREMENT sK0Zust.t_zuregmax_k0 "Maxtimer fuer den Zustand ZUNACHREGELN" UBYTE UMRM_MSEC__10_1_0_S6_S3 1 100 0 2550 ECU_ADDRESS 0xFFF85921 /end MEASUREMENT
/begin MEASUREMENT sK0Zust.z_k0_merk "gibt fuer die Dauer des aktuellen Zustand den Wert des vorherigen Zustands an" UBYTE eK0Zust_S6_S3 1 100 0 12 ECU_ADDRESS 0xFFF85924 /end MEASUREMENT
/begin MEASUREMENT sK0Zust.z_reginitmethode_k0 "sprungfreie Initialisierungsmethode des Reglers" UBYTE eBool_true_false_S6_S3 1 100 0 1 ECU_ADDRESS 0xFFF85925 /end MEASUREMENT
/begin MEASUREMENT sK0Zust.k0_bef_hysterese "Druckvorgabe mit oder ohne Hysterese" UBYTE UMRM___1_1_0_S6_S3 1 100 0 1 BIT_MASK 0x1 ECU_ADDRESS 0xFFF8591E /end MEASUREMENT
/begin MEASUREMENT sK0Zust.k0_ansteuern "Anforderung zum Ansteuern der K0" UBYTE UMRM___1_1_0_S6_S3 1 100 0 1 BIT_MASK 0x1 ECU_ADDRESS 0xFFF8591D /end MEASUREMENT
/begin MEASUREMENT sK0Zust.qu_fuellausgleich_beendet "Bedingung fuer den Uebergang von anlegen nach angelegt" UBYTE UMRM___1_1_0_S6_S3 1 100 0 1 BIT_MASK 0x1 ECU_ADDRESS 0xFFF8591F /end MEASUREMENT
/begin MEASUREMENT sK0Zust.flag_p_sys_k0 "Flag zur K0 seitigen Erhoehung des Systemdrucks" UBYTE UMRM___1_1_0_S6_S3 1 100 0 1 BIT_MASK 0x1 ECU_ADDRESS 0xFFF8591C /end MEASUREMENT
/begin COMPU_METHOD SAB_70555547324075K100000000000000_S2_S3 "int = ((phys * 1.0E14) / 7.0555547324075E13) - (0) -" RAT_FUNC "%16.14" "-" COEFFS 0 1E+014 -0 0 0 7.05555473241E+013 /end COMPU_METHOD
/begin COMPU_METHOD SAB_100000000000000K70555547324075_S2_S3 "int = ((phys * 7.0555547324075E13) / 1.0E14) - (0) -" RAT_FUNC "%16.14" "-" COEFFS 0 7.05555473241E+013 -0 0 0 1E+014 /end COMPU_METHOD
/begin COMPU_METHOD SAB_L_MM10_S2_S3 "int = ((phys * 10) / 1) - (0) mm" RAT_FUNC "%5.3" "mm" COEFFS 0 10 -0 0 0 1 /end COMPU_METHOD
/begin COMPU_METHOD SAB_L_MM100_S2_S3 "int = ((phys * 100) / 1) - (0) mm" RAT_FUNC "%5.3" "mm" COEFFS 0 100 -0 0 0 1 /end COMPU_METHOD
/begin COMPU_METHOD SAB_L_MM256_S2_S3 "int = ((phys * 256) / 1) - (0) mm" RAT_FUNC "%5.3" "mm" COEFFS 0 256 -0 0 0 1 /end COMPU_METHOD
/begin COMPU_METHOD SAB_L_M128_S2_S3 "int = ((phys * 128) / 1) - (0) m" RAT_FUNC "%5.3" "m" COEFFS 0 128 -0 0 0 1 /end COMPU_METHOD
/begin COMPU_METHOD SAB_L_MM1_M127_S2_S3 "int = ((phys * 1) / 1) - (-127) mm" RAT_FUNC "%2.0" "mm" COEFFS 0 1 127 0 0 1 /end COMPU_METHOD
/begin COMPU_METHOD SAB_L_M6554_S2_S3 "int = ((phys * 6554) / 1) - (0) m" RAT_FUNC "%8.6" "m" COEFFS 0 6554 -0 0 0 1 /end COMPU_METHOD
/begin COMPU_METHOD SAB_L_M_S2_S3 "int = ((phys * 1) / 1) - (0) m" RAT_FUNC "%2.0" "m" COEFFS 0 1 -0 0 0 1 /end COMPU_METHOD
/begin COMPU_METHOD SAB_L_M2_S2_S3 "int = ((phys * 2) / 1) - (0) m" RAT_FUNC "%5.3" "m" COEFFS 0 2 -0 0 0 1 /end COMPU_METHOD
/begin COMPU_METHOD SAB_L_2M_S2_S3 "int = ((phys * 1) / 2) - (0) m" RAT_FUNC "%5.3" "m" COEFFS 0 1 -0 0 0 2 /end COMPU_METHOD
/begin COMPU_METHOD SAB_L_10M_S2_S3 "int = ((phys * 1) / 10) - (0) m" RAT_FUNC "%5.3" "m" COEFFS 0 1 -0 0 0 10 /end COMPU_METHOD
/begin COMPU_METHOD SAB_N_RPM2_S2_S3 "int = ((phys * 2) / 1) - (0) 1/min" RAT_FUNC "%5.3" "1/min" COEFFS 0 2 -0 0 0 1 /end COMPU_METHOD
/begin COMPU_METHOD SAB_N_5RPM2_S2_S3 "int = ((phys * 2) / 5) - (0) U/min" RAT_FUNC "%5.3" "U/min" COEFFS 0 2 -0 0 0 5 /end COMPU_METHOD
/begin COMPU_METHOD UMR___1_1000_0_S6_S3 "int = ((phys * 1000) / 1) - (0) [-]" RAT_FUNC "%5.3" "[-]" COEFFS 0 1000 -0 0 0 1 /end COMPU_METHOD
/begin COMPU_METHOD UMR___1_100_0_S6_S3 "int = ((phys * 100) / 1) - (0) [-]" RAT_FUNC "%4.2" "[-]" COEFFS 0 100 -0 0 0 1 /end COMPU_METHOD
/begin COMPU_METHOD UMR___1_1_0_S6_S3 "int = ((phys * 1) / 1) - (0) [-]" RAT_FUNC "%2.0" "[-]" COEFFS 0 1 -0 0 0 1 /end COMPU_METHOD
/begin COMPU_METHOD UMR_MA__1_10_0_S6_S3 "int = ((phys * 10) / 1) - (0) [mA]" RAT_FUNC "%3.1" "[mA]" COEFFS 0 10 -0 0 0 1 /end COMPU_METHOD
/begin COMPU_METHOD UMR_MA_SEC_1_1_0_S6_S3 "int = ((phys * 1) / 1) - (0) [mA/s]" RAT_FUNC "%2.0" "[mA/s]" COEFFS 0 1 -0 0 0 1 /end COMPU_METHOD
/begin COMPU_METHOD UMR_NM__1_10_0_S6_S3 "int = ((phys * 10) / 1) - (0) [Nm]" RAT_FUNC "%3.1" "[Nm]" COEFFS 0 10 -0 0 0 1 /end COMPU_METHOD
/begin COMPU_METHOD UMR_NM__1_1_0_S6_S3 "int = ((phys * 1) / 1) - (0) [Nm]" RAT_FUNC "%2.0" "[Nm]" COEFFS 0 1 -0 0 0 1 /end COMPU_METHOD
/begin COMPU_METHOD UMR_NM__8_1_M50_S6_S3 "int = ((phys * 1) / 8) - (-50) [Nm]" RAT_FUNC "%2.0" "[Nm]" COEFFS 0 1 400 0 0 8 /end COMPU_METHOD
/begin COMPU_METHOD UMR_NM_SEC_10_1_0_S6_S3 "int = ((phys * 1) / 10) - (0) [Nm/s]" RAT_FUNC "%3.1" "[Nm/s]" COEFFS 0 1 -0 0 0 10 /end COMPU_METHOD
/begin COMPU_METHOD UMR_NM_BAR_1_1_0_S6_S3 "int = ((phys * 1) / 1) - (0) [Nm/bar]" RAT_FUNC "%2.0" "[Nm/bar]" COEFFS 0 1 -0 0 0 1 /end COMPU_METHOD
/begin COMPU_METHOD UMR_MBAR__1_1_0_S6_S3 "int = ((phys * 1) / 1) - (0) [mbar]" RAT_FUNC "%2.0" "[mbar]" COEFFS 0 1 -0 0 0 1 /end COMPU_METHOD
/begin COMPU_METHOD UMR_BAR__1_1000_0_S6_S3 "int = ((phys * 1000) / 1) - (0) [bar]" RAT_FUNC "%5.3" "[bar]" COEFFS 0 1000 -0 0 0 1 /end COMPU_METHOD
/begin COMPU_METHOD UMR_BAR__1_1_0_S6_S3 "int = ((phys * 1) / 1) - (0) [bar]" RAT_FUNC "%2.0" "[bar]" COEFFS 0 1 -0 0 0 1 /end COMPU_METHOD
/begin COMPU_METHOD UMR_BAR_SEC_1_1000_0_S6_S3 "int = ((phys * 1000) / 1) - (0) [bar/s]" RAT_FUNC "%6.4" "[bar/s]" COEFFS 0 1000 -0 0 0 1 /end COMPU_METHOD
/begin COMPU_METHOD UMR_BAR_SEC_1_1_0_S6_S3 "int = ((phys * 1) / 1) - (0) [bar/s]" RAT_FUNC "%2.0" "[bar/s]" COEFFS 0 1 -0 0 0 1 /end COMPU_METHOD
/begin COMPU_METHOD UMR_BAR_NM_1_1_0_S6_S3 "int = ((phys * 1) / 1) - (0) [bar/Nm]" RAT_FUNC "%2.0" "[bar/Nm]" COEFFS 0 1 -0 0 0 1 /end COMPU_METHOD
/begin COMPU_METHOD UMR_U_MIN_1_1_0_S6_S3 "int = ((phys * 1) / 1) - (0) [U/min]" RAT_FUNC "%2.0" "[U/min]" COEFFS 0 1 -0 0 0 1 /end COMPU_METHOD
/begin COMPU_METHOD UMR_U_MIN_32_1_0_S6_S3 "int = ((phys * 1) / 32) - (0) [U/min]" RAT_FUNC "%2.0" "[U/min]" COEFFS 0 1 -0 0 0 32 /end COMPU_METHOD
/begin COMPU_METHOD UMR_MSEC__1_1_0_S6_S3 "int = ((phys * 1) / 1) - (0) [ms]" RAT_FUNC "%2.0" "[ms]" COEFFS 0 1 -0 0 0 1 /end COMPU_METHOD
/begin COMPU_METHOD UMR_MSEC__10_1_0_S6_S3 "int = ((phys * 1) / 10) - (0) [ms]" RAT_FUNC "%2.0" "[ms]" COEFFS 0 1 -0 0 0 10 /end COMPU_METHOD
/begin COMPU_METHOD UMR_MSEC__30_1_0_S6_S3 "int = ((phys * 1) / 30) - (0) [ms]" RAT_FUNC "%2.0" "[ms]" COEFFS 0 1 -0 0 0 30 /end COMPU_METHOD
/begin COMPU_METHOD UMR_SEC__1_100_0_S6_S3 "int = ((phys * 100) / 1) - (0) [s]" RAT_FUNC "%4.2" "[s]" COEFFS 0 100 -0 0 0 1 /end COMPU_METHOD
/begin COMPU_METHOD UMR_GRADC__1_1_0_S6_S3 "int = ((phys * 1) / 1) - (0) [°C]" RAT_FUNC "%2.0" "[°C]" COEFFS 0 1 -0 0 0 1 /end COMPU_METHOD
/begin COMPU_METHOD UMR_GRADC__1_1_M40_S6_S3 "int = ((phys * 1) / 1) - (-40) [°C]" RAT_FUNC "%2.0" "[°C]" COEFFS 0 1 40 0 0 1 /end COMPU_METHOD
/begin COMPU_METHOD UMR_GRADC__1_1_M48_S6_S3 "int = ((phys * 1) / 1) - (-48) [°C]" RAT_FUNC "%2.0" "[°C]" COEFFS 0 1 48 0 0 1 /end COMPU_METHOD
/begin COMPU_METHOD UMR_PROZENT__20_51_0_S6_S3 "int = ((phys * 51) / 20) - (0) [%]" RAT_FUNC "%6.4" "[%]" COEFFS 0 51 -0 0 0 20 /end COMPU_METHOD
/begin COMPU_METHOD UMR_KGM2__1_1000_0_S6_S3 "int = ((phys * 1000) / 1) - (0) [kg*m^2]" RAT_FUNC "%5.3" "[kg*m^2]" COEFFS 0 1000 -0 0 0 1 /end COMPU_METHOD
/begin COMPU_METHOD UMR_KM_H_1_1_0_S6_S3 "int = ((phys * 1) / 1) - (0) [km/h]" RAT_FUNC "%2.0" "[km/h]" COEFFS 0 1 -0 0 0 1 /end COMPU_METHOD
/begin COMPU_METHOD UMR_GRAD__1_3_M128_S6_S3 "int = ((phys * 3) / 1) - (-128) [Grad]" RAT_FUNC "%5.3" "[Grad]" COEFFS 0 3 128 0 0 1 /end COMPU_METHOD
/begin COMPU_METHOD eK0Zust_S6_S3 "" TAB_VERB "%2.0" "" COMPU_TAB_REF eK0Zust_S6_S3 /end COMPU_METHOD
/begin COMPU_METHOD eK0Ist_S6_S3 "" TAB_VERB "%2.0" "" COMPU_TAB_REF eK0Ist_S6_S3 /end COMPU_METHOD
/begin COMPU_METHOD eK0Soll_S6_S3 "" TAB_VERB "%2.0" "" COMPU_TAB_REF eK0Soll_S6_S3 /end COMPU_METHOD
/begin COMPU_METHOD __DATAFIELD_NO_FORMULA___S6_S3 "int = ((phys * 1) / 1) - (0) -" RAT_FUNC "%2.0" "-" COEFFS 0 1 -0 0 0 1 /end COMPU_METHOD
/begin COMPU_METHOD UMRM___1_100_0_S6_S3 "Umskalierung um Faktor 100\\nint = ((phys * 100) / 1) - (0) [-]" RAT_FUNC "%5.3" "[-]" COEFFS 0 100 -0 0 0 1 /end COMPU_METHOD
/begin COMPU_METHOD UMRM___1_5_0_S6_S3 "Umskalierung um Faktor 5\\nint = ((phys * 5) / 1) - (0) [-]" RAT_FUNC "%5.3" "[-]" COEFFS 0 5 -0 0 0 1 /end COMPU_METHOD
/begin COMPU_METHOD UMRM___1_1_0_S6_S3 "Ohne Umskalierung\\nint = ((phys * 1) / 1) - (0) [-]" RAT_FUNC "%2.0" "[-]" COEFFS 0 1 -0 0 0 1 /end COMPU_METHOD
/begin COMPU_METHOD UMRM_NM__1_1_0_S6_S3 "Moment\\nint = ((phys * 1) / 1) - (0) [Nm]" RAT_FUNC "%2.0" "[Nm]" COEFFS 0 1 -0 0 0 1 /end COMPU_METHOD
/begin COMPU_METHOD UMRM_BAR__1_1000_0_S6_S3 "Umrechnung von Mbar in bar\\nint = ((phys * 1000) / 1) - (0) [Bar]" RAT_FUNC "%5.3" "[Bar]" COEFFS 0 1000 -0 0 0 1 /end COMPU_METHOD
/begin COMPU_METHOD UMRM_BAR__1_1_0_S6_S3 "Darstellung in bar\\nint = ((phys * 1) / 1) - (0) [Bar]" RAT_FUNC "%2.0" "[Bar]" COEFFS 0 1 -0 0 0 1 /end COMPU_METHOD
/begin COMPU_METHOD UMRM_U_MIN_1_1_0_S6_S3 "Darstellung in U/min\\nint = ((phys * 1) / 1) - (0) [U/min]" RAT_FUNC "%2.0" "[U/min]" COEFFS 0 1 -0 0 0 1 /end COMPU_METHOD
/begin COMPU_METHOD UMRM_MSEC__10_1_0_S6_S3 "Umrechnung von 10 msec in msec\\nint = ((phys * 1) / 10) - (0) [ms]" RAT_FUNC "%5.3" "[ms]" COEFFS 0 1 -0 0 0 10 /end COMPU_METHOD
/begin COMPU_METHOD UMRM_GRADC__1_1_M40_S6_S3 "Temperatur Skaling\\nint = ((phys * 1) / 1) - (-40) [°C]" RAT_FUNC "%2.0" "[°C]" COEFFS 0 1 40 0 0 1 /end COMPU_METHOD
/begin COMPU_METHOD UMRM_GRADC__1_1_0_S6_S3 "Temperatur\\nint = ((phys * 1) / 1) - (0) [°C]" RAT_FUNC "%2.0" "[°C]" COEFFS 0 1 -0 0 0 1 /end COMPU_METHOD
/begin COMPU_METHOD UMRM_GRADC_SEC_1_1_0_S6_S3 "Darstellung in Celsius/(sec)\\nint = ((phys * 1) / 1) - (0) [°C/s]" RAT_FUNC "%2.0" "[°C/s]" COEFFS 0 1 -0 0 0 1 /end COMPU_METHOD
/begin COMPU_METHOD UMRM_W__1_1_0_S6_S3 "Darstellung in Watt\\nint = ((phys * 1) / 1) - (0) [W]" RAT_FUNC "%2.0" "[W]" COEFFS 0 1 -0 0 0 1 /end COMPU_METHOD
/begin COMPU_METHOD UMRM_LITER_MIN_1_1_0_S6_S3 "Darstellung in Liter/min\\nint = ((phys * 1) / 1) - (0) [liter/min]" RAT_FUNC "%2.0" "[liter/min]" COEFFS 0 1 -0 0 0 1 /end COMPU_METHOD
/begin COMPU_METHOD UMRM_W_K_1_1_0_S6_S3 "Darstellung in Watt/Kelvin\\nint = ((phys * 1) / 1) - (0) [W/K]" RAT_FUNC "%2.0" "[W/K]" COEFFS 0 1 -0 0 0 1 /end COMPU_METHOD
/begin COMPU_METHOD eBool_on_off_S6_S3 "" TAB_VERB "%2.0" "" COMPU_TAB_REF eBool_on_off_S6_S3 /end COMPU_METHOD
/begin COMPU_METHOD eBool_true_false_S6_S3 "" TAB_VERB "%2.0" "" COMPU_TAB_REF eBool_true_false_S6_S3 /end COMPU_METHOD
/begin COMPU_METHOD eBool_zug_schub_S6_S3 "" TAB_VERB "%2.0" "" COMPU_TAB_REF eBool_zug_schub_S6_S3 /end COMPU_METHOD
/begin COMPU_METHOD eSchaltungsIdx_S6_S3 "" TAB_VERB "%2.0" "" COMPU_TAB_REF eSchaltungsIdx_S6_S3 /end COMPU_METHOD
/begin COMPU_METHOD eKupStatusIae_S6_S3 "" TAB_VERB "%2.0" "" COMPU_TAB_REF eKupStatusIae_S6_S3 /end COMPU_METHOD
/begin COMPU_METHOD eIndexSpSps_S6_S3 "" TAB_VERB "%2.0" "" COMPU_TAB_REF eIndexSpSps_S6_S3 /end COMPU_METHOD
/begin COMPU_METHOD eMVG_S6_S3 "" TAB_VERB "%2.0" "" COMPU_TAB_REF eMVG_S6_S3 /end COMPU_METHOD
/begin COMPU_VTAB eK0Zust_S6_S3 "" TAB_VERB 13 0 "OFFEN" 1 "SF" 2 "FA" 3 "ANGELEGT" 4 "MOMENTENSTELLUNG" 5 "SYNCRO" 6 "SCHLIESS" 7 "ZU" 8 "ZUREG" 9 "REGELN" 10 "GER_ZU" 11 "MOM_ABBAU" 12 "MANUELL" /end COMPU_VTAB
/begin COMPU_VTAB eK0Ist_S6_S3 "" TAB_VERB 6 0 "OFFEN" 1 "ANGELEGT" 2 "DRUCKST" 3 "REGELN" 4 "GER_ZU" 5 "ZU" /end COMPU_VTAB
/begin COMPU_VTAB eK0Soll_S6_S3 "" TAB_VERB 6 0 "OFFNEN" 1 "BEF_ANLEG" 2 "MOMENTENSSTELLUNG" 3 "REGELN" 4 "GER_ZU" 5 "ZU" /end COMPU_VTAB
/begin COMPU_VTAB eBool_on_off_S6_S3 "" TAB_VERB 2 0 "E_off" 1 "E_on" /end COMPU_VTAB
/begin COMPU_VTAB eBool_true_false_S6_S3 "" TAB_VERB 2 0 "FALSE" 1 "TRUE" /end COMPU_VTAB
/begin COMPU_VTAB eBool_zug_schub_S6_S3 "" TAB_VERB 2 0 "E_Schub" 1 "E_Zug" /end COMPU_VTAB
/begin COMPU_VTAB eSchaltungsIdx_S6_S3 "" TAB_VERB 5 0 "E_MehrfachrueckschaltungIdx" 1 "E_RueckschaltungIdx" 2 "E_KeineSchaltung_k0Idx" 3 "E_HochschaltungIdx" 4 "E_MehrfachochschaltungIdx" /end COMPU_VTAB
/begin COMPU_VTAB eKupStatusIae_S6_S3 "" TAB_VERB 9 0 "E_IAEINAKTIV" 1 "E_IAEANGELEGT" 2 "E_IAEKRIECHEN" 3 "E_IAEHANFAHREN" 4 "E_IAEEANFAHREN" 5 "E_IAEEANFAHRENENTKOPPELT" 6 "E_IAESYNCHRONISIEREN" 7 "E_IAEZU" 8 "E_IAEENTKOPPELT" /end COMPU_VTAB
/begin COMPU_VTAB eIndexSpSps_S6_S3 "" TAB_VERB 100 0 "E_SpIndex00" 1 "E_SpIndex01" 2 "E_SpIndex02" 3 "E_SpIndex03" 4 "E_SpIndex04" 5 "E_SpIndex05" 6 "E_SpIndex06" 7 "E_SpIndex07" 8 "E_SpIndex08" 9 "E_SpIndex09" 10 "E_SpIndex10" 11 "E_SpIndex11" 12 "E_SpIndex12" 13 "E_SpIndex13" 14 "E_SpIndex14" 15 "E_SpIndex15" 16 "E_SpIndex16" 17 "E_SpIndex17" 18 "E_SpIndex18" 19 "E_SpIndex19" 20 "E_SpIndex20" 21 "E_SpIndex21" 22 "E_SpIndex22" 23 "E_SpIndex23" 24 "E_SpIndex24" 25 "E_SpIndex25" 26 "E_SpIndex26" 27 "E_SpIndex27" 28 "E_SpIndex28" 29 "E_SpIndex29" 30 "E_SpIndex30" 31 "E_SpIndex31" 32 "E_SpIndex32" 33 "E_SpIndex33" 34 "E_SpIndex34" 35 "E_SpIndex35" 36 "E_SpIndex36" 37 "E_SpIndex37" 38 "E_SpIndex38" 39 "E_SpIndex39" 40 "E_SpIndex40" 41 "E_SpIndex41" 42 "E_SpIndex42" 43 "E_SpIndex43" 44 "E_SpIndex44" 45 "E_SpIndex45" 46 "E_SpIndex46" 47 "E_SpIndex47" 48 "E_SpIndex48" 49 "E_SpIndex49" 50 "E_SpIndex50" 51 "E_SpIndex51" 52 "E_SpIndex52" 53 "E_SpIndex53" 54 "E_SpIndex54" 55 "E_SpIndex55" 56 "E_SpIndex56" 57 "E_SpIndex57" 58 "E_SpIndex58" 59 "E_SpIndex59" 60 "E_SpIndex60" 61 "E_SpIndex61" 62 "E_SpIndex62" 63 "E_SpIndex63" 64 "E_SpIndex64" 65 "E_SpIndex65" 66 "E_SpIndex66" 67 "E_SpIndex67" 68 "E_SpIndex68" 69 "E_SpIndex69" 70 "E_SpIndex70" 71 "E_SpIndex71" 72 "E_SpIndex72" 73 "E_SpIndex73" 74 "E_SpIndex74" 75 "E_SpIndex75" 76 "E_SpIndex76" 77 "E_SpIndex77" 78 "E_SpIndex78" 79 "E_SpIndex79" 80 "E_SpIndex80" 81 "E_SpIndex81" 82 "E_SpIndex82" 83 "E_SpIndex83" 84 "E_SpIndex84" 85 "E_SpIndex85" 86 "E_SpIndex86" 87 "E_SpIndex87" 88 "E_SpIndex88" 89 "E_SpIndex89" 90 "E_SpIndex90" 91 "E_SpIndex91" 92 "E_SpIndex92" 93 "E_SpIndex93" 94 "E_SpIndex94" 95 "E_SpIndex95" 96 "E_SpIndex96" 97 "E_SpIndex97" 98 "E_SpIndex98" 99 "E_SpIndex99" /end COMPU_VTAB
/begin COMPU_VTAB eMVG_S6_S3 "" TAB_VERB 8 0 "E_SS0" 1 "E_SS1" 2 "E_SS2" 3 "E_SS3" 4 "E_SS4" 5 "E_SS5" 6 "E_SS6" 7 "E_SS7" /end COMPU_VTAB
/begin FUNCTION PAR_K0S_SOLLZPRIO ""
 /begin DEF_CHARACTERISTIC sK0SollPrio.CO_MAXREG_K0 sK0SollPrio.CO_MINREG_K0 sK0SollPrio.CS_MAXREG_K0 sK0SollPrio.CS_MINREG_K0 sK0SollPrio.TAB_REGKUPSTATUSIAE_K0 sK0SollPrio.TAB_SOLLGEPR_K0 sK0SollPrio.TAB_SWIGESTGES_K0_SP sK0SollPrio.TAB_SWISCHALTUNGDIREKT_K0 /end DEF_CHARACTERISTIC
 /begin LOC_MEASUREMENT sK0SollPrio.f_verbot_regeln_drehzahl_k0 sK0SollPrio.f_verbot_regeln_heiss_k0 sK0SollPrio.f_verbot_regeln_k0 sK0SollPrio.f_verbot_regeln_kalt_k0 sK0SollPrio.flag_verbot_regeln_k0 sK0SollPrio.k0_soll_erw sK0SollPrio.k0_soll_gepr sK0SollPrio.schaltung_direkt_k0 /end LOC_MEASUREMENT
/end FUNCTION
/begin FUNCTION PAR_K0S_STATUS ""
 /begin DEF_CHARACTERISTIC sK0Stat.KF_D_POIST_K0 sK0Stat.KF_T_POIST_K0 sK0Stat.KL_MIST_SCHLEPP_K0 sK0Stat.MS_OFFEN_K0 sK0Stat.NDS_K0ZU_PLAUSI sK0Stat.TAB_MVG_KLASSE_K0 sK0Stat.TAB_MVG_MISTK0 sK0Stat.TAB_MVG_NDK0 sK0Stat.TAB_STATUS_K0 sK0Stat.TAB_ZK0_ZUL_APERK /end DEF_CHARACTERISTIC
 /begin LOC_MEASUREMENT sK0Stat.k0_ist sK0Stat.k0_ist_komp sK0Stat.m_ist_k0 sK0Stat.m_schlepp_k0 sK0Stat.po_ist_k0 sK0Stat.qu_iae_a_p_ada_erlaubt sK0Stat.qu_k0_anlegen sK0Stat.qu_k0_befuellung sK0Stat.qu_k0_befuellung_aktiv sK0Stat.qu_k0_geschlossen sK0Stat.qu_k0_kraftuebertragung /end LOC_MEASUREMENT
/end FUNCTION
/begin FUNCTION PAR_K0S_TEMPM ""
 /begin DEF_CHARACTERISTIC sK0TempM.CO_CGETRTEMPMOD_K0 sK0TempM.F_K0_VERLUST sK0TempM.F_RHO_CP_OEL sK0TempM.F_WAERMEKAP_BELAG_K0 sK0TempM.F_WAERMEKAP_OEALAUS_K0 sK0TempM.KF_ALPHA_BELAG_OFFEN_K0 sK0TempM.KF_ALPHA_BELAG_REGELN_K0 sK0TempM.KF_MIST_SCHLEPP_K0 sK0TempM.KL_FQBELAGKORRK0GESCHL_K0 sK0TempM.KL_FQBELAGKORRK0OFFEN_K0 sK0TempM.KL_VPSEKK0IAEMAX_K0 sK0TempM.K_FVPOELVERTKUEAN_K0 sK0TempM.K_FVPOELVERTKUEAUS_K0 sK0TempM.MPT_VPOEL_K0 sK0TempM.PS_KUEHLUNGAKTIV_K0 sK0TempM.TAB_MVG_CBELK0 /end DEF_CHARACTERISTIC
 /begin LOC_MEASUREMENT sK0TempM.alpha_belag_k0 sK0TempM.c_belag_k0 sK0TempM.c_belag_k0_alt sK0TempM.c_getr_korr_k0 sK0TempM.c_oelaus_k0 sK0TempM.c_oelaus_k0_alt sK0TempM.c_oelaus_k0_int sK0TempM.c_oelaus_k0_sts sK0TempM.grad_c_belag_k0 sK0TempM.m_k0 sK0TempM.m_schlepp_k0_roh sK0TempM.q_ab_k0 sK0TempM.q_belag_ab_k0 sK0TempM.q_belag_ab_korr_k0 sK0TempM.q_verlust_k0 sK0TempM.vp_oelgesamt_k0 sK0TempM.vp_oelgesamt_k0_int sK0TempM.vp_oelgesamt_k0_sts sK0TempM.vp_oelgesamtroh_k0 sK0TempM.vp_oelkuehlanmax_k0 sK0TempM.vp_oelkuehlausmax_k0 sK0TempM.vp_oelrohan_k0 sK0TempM.vp_oelrohaus_k0 /end LOC_MEASUREMENT
/end FUNCTION
/begin FUNCTION PAR_K0S_UEW ""
 /begin DEF_CHARACTERISTIC sK0Diag.CS_BELAGDIAG_K0 sK0Diag.CS_BELAGHYS_K0 sK0Diag.CS_BELAGOG_K0 sK0Diag.KL_CSBELAGSYNC_K0 sK0Diag.KL_NDSK0DEFEKTREG1_K0 sK0Diag.KL_NDSK0DEFEKTREG2_K0 sK0Diag.MS_ME_MAXSCHUTZ_K0 sK0Diag.MS_MVMISTDIAG_K0 sK0Diag.MS_SCHUTZENDE_K0 sK0Diag.NDS_SCHUTZEINSTIEG_K0 sK0Diag.PS_PSOLLDIAG_K0 sK0Diag.SWI_DIAGAKTIV_K0 sK0Diag.SWI_DIAGTEMPERLAUBT_K0 sK0Diag.SWI_SCHUTZ_K0 sK0Diag.TAB_KI_SCHUTZ_K0 sK0Diag.WND_SCHUTZ_K0 /end DEF_CHARACTERISTIC
 /begin LOC_MEASUREMENT sK0Diag.info_c0_hot sK0Diag.m_schutz_k0 sK0Diag.pruefbedingung_c0_defect sK0Diag.pruefbedingung_c0_defecthot sK0Diag.pruefbedingung_c0_hot sK0Diag.pruefbedingung_c0_synchot sK0Diag.status_me_k0 sK0Diag.status_me_k0_komp sK0Diag.stoerungsbedingung_c0_defect sK0Diag.stoerungsbedingung_c0_defecthot sK0Diag.stoerungsbedingung_c0_hot sK0Diag.stoerungsbedingung_c0_synchot sK0Diag.z_k0_diag /end LOC_MEASUREMENT
/end FUNCTION
/begin FUNCTION PAR_K0S_ZUST ""
 /begin DEF_CHARACTERISTIC sK0Zust.KL_MSZUREGSG_K0 sK0Zust.KL_TFC_K0 sK0Zust.KL_TFC_K0_OPT sK0Zust.KL_TFC_K0_RED sK0Zust.MS_ANGELEGT_K0 sK0Zust.NDS_GERGESZU_K0 sK0Zust.NDS_K0VMSTART sK0Zust.NDS_K0ZU sK0Zust.SWI_MANUELL_K0 sK0Zust.SWI_MANUELL_SEK_K0 sK0Zust.SWI_SGSCHLIESSGEST_K0 sK0Zust.TAB_ANFORDERUNG_P_SYS_K0 sK0Zust.TAB_T_ZUNACHREGELNMAX_K0 /end DEF_CHARACTERISTIC
 /begin LOC_MEASUREMENT sK0Zust.flag_p_sys_k0 sK0Zust.k0_ansteuern sK0Zust.k0_bef_hysterese sK0Zust.qu_fuellausgleich_beendet sK0Zust.t_fa_k0 sK0Zust.t_zuregmax_k0 sK0Zust.z_init_zustand_k0 sK0Zust.z_k0 sK0Zust.z_k0_merk sK0Zust.z_reginitmethode_k0 /end LOC_MEASUREMENT
/end FUNCTION
/begin FUNCTION dBibAglex_Fktn "Applikationesgroessen der Komponente dBibAglex" /begin SUB_FUNCTION jBibAglex_Fktn /end SUB_FUNCTION /end FUNCTION
/begin FUNCTION jBibAglex_Fktn "Applikationesgroessen Instanz jBibAglex"
 /begin DEF_CHARACTERISTIC FI_NADAALT FI_NADANEU I_AGEX I_AGLAENGE SWI_STAGL_KUP TAB_SWI_NAGL /end DEF_CHARACTERISTIC
/end FUNCTION
/begin FUNCTION dAzsManko_Fktn "Applikationesgroessen der Komponente dAzsManko" /begin SUB_FUNCTION jAzsManko_Fktn /end SUB_FUNCTION /end FUNCTION
/begin FUNCTION jAzsManko_Fktn "Applikationesgroessen Instanz jAzsManko"
 /begin DEF_CHARACTERISTIC CS_KUPPLMAXSPSAS HYS_CKUPPLMASS HYS_CKUPPLMAXSPSAS SWI_CK_KEINTIPP SWI_CK_MMOTMAX SWI_CK_SCHALTBEEIN SWI_CK_SCHALTVERH SWI_CK_SPSAS SWI_MASS_CKMAX TAB_CS_KUPPL_1 TAB_CS_KUPPL_2 TAB_CS_KUPPL_3 TAB_SPSAS_DEF T_VCKKEINTIPP T_VCKSCHALTVERH /end DEF_CHARACTERISTIC
/end FUNCTION
/begin FUNCTION dAzsGangb_Fktn "Applikationesgroessen der Komponente dAzsGangb" /begin SUB_FUNCTION jAzsGangb_Fktn /end SUB_FUNCTION /end FUNCTION
/begin FUNCTION jAzsGangb_Fktn "Applikationesgroessen Instanz jAzsGangb"
 /begin DEF_CHARACTERISTIC KL_TVCGKFLSOLL KL_TVCG_GE_STADA SWI_MRS_MRS_ERLAUBT TAB_CSGVBMRS TAB_MSTVB TAB_MSTVB_REKU TAB_NSABRSV TAB_NSABVB TAB_NSMOTRSV TAB_NSTRSV TAB_VERBOT_VERSCHACHTELTER_MRS /end DEF_CHARACTERISTIC
/end FUNCTION
/begin FUNCTION dBihMomenHsHss_Fktn "Applikationesgroessen der Komponente dBihMomenHsHss"
 /begin SUB_FUNCTION jBihMomenHsHss12_Fktn jBihMomenHsHss23_Fktn jBihMomenHsHss34_Fktn jBihMomenHsHss45_Fktn jBihMomenHsHss56_Fktn jBihMomenHsHss67_Fktn jBihMomenHsHss78_Fktn jBihMomenHsHss13_Fktn jBihMomenHsHss24_Fktn jBihMomenHsHss35_Fktn jBihMomenHsHss46_Fktn jBihMomenHsHss57_Fktn jBihMomenHsHss68_Fktn /end SUB_FUNCTION
/end FUNCTION
/begin FUNCTION jBihMomenHsHss12_Fktn "Applikationesgroessen Instanz jBihMomenHsHss12"
 /begin DEF_CHARACTERISTIC KL_MGMOTMAXAUF1HSS12 KL_MGMOTMAXAUF2HSS12 KL_TVSYNCGHSS12 MO_MOTMAXHSS12 MS_MOTISTHSS12 M_MOTMAXHSS_HYS12 /end DEF_CHARACTERISTIC
/end FUNCTION
/begin FUNCTION jBihMomenHsHss23_Fktn "Applikationesgroessen Instanz jBihMomenHsHss23"
 /begin DEF_CHARACTERISTIC KL_MGMOTMAXAUF1HSS23 KL_MGMOTMAXAUF2HSS23 KL_TVSYNCGHSS23 MO_MOTMAXHSS23 MS_MOTISTHSS23 M_MOTMAXHSS_HYS23 /end DEF_CHARACTERISTIC
/end FUNCTION
/begin FUNCTION jBihMomenHsHss34_Fktn "Applikationesgroessen Instanz jBihMomenHsHss34"
 /begin DEF_CHARACTERISTIC KL_MGMOTMAXAUF1HSS34 KL_MGMOTMAXAUF2HSS34 KL_TVSYNCGHSS34 MO_MOTMAXHSS34 MS_MOTISTHSS34 M_MOTMAXHSS_HYS34 /end DEF_CHARACTERISTIC
/end FUNCTION
/begin FUNCTION jBihMomenHsHss45_Fktn "Applikationesgroessen Instanz jBihMomenHsHss45"
 /begin DEF_CHARACTERISTIC KL_MGMOTMAXAUF1HSS45 KL_MGMOTMAXAUF2HSS45 KL_TVSYNCGHSS45 MO_MOTMAXHSS45 MS_MOTISTHSS45 M_MOTMAXHSS_HYS45 /end DEF_CHARACTERISTIC
/end FUNCTION
/begin FUNCTION jBihMomenHsHss56_Fktn "Applikationesgroessen Instanz jBihMomenHsHss56"
 /begin DEF_CHARACTERISTIC KL_MGMOTMAXAUF1HSS56 KL_MGMOTMAXAUF2HSS56 KL_TVSYNCGHSS56 MO_MOTMAXHSS56 MS_MOTISTHSS56 M_MOTMAXHSS_HYS56 /end DEF_CHARACTERISTIC
/end FUNCTION
/begin FUNCTION jBihMomenHsHss67_Fktn "Applikationesgroessen Instanz jBihMomenHsHss67"
 /begin DEF_CHARACTERISTIC KL_MGMOTMAXAUF1HSS67 KL_MGMOTMAXAUF2HSS67 KL_TVSYNCGHSS67 MO_MOTMAXHSS67 MS_MOTISTHSS67 M_MOTMAXHSS_HYS67 /end DEF_CHARACTERISTIC
/end FUNCTION
/begin FUNCTION jBihMomenHsHss78_Fktn "Applikationesgroessen Instanz jBihMomenHsHss78"
 /begin DEF_CHARACTERISTIC KL_MGMOTMAXAUF1HSS78 KL_MGMOTMAXAUF2HSS78 KL_TVSYNCGHSS78 MO_MOTMAXHSS78 MS_MOTISTHSS78 M_MOTMAXHSS_HYS78 /end DEF_CHARACTERISTIC
/end FUNCTION
/begin FUNCTION jBihMomenHsHss13_Fktn "Applikationesgroessen Instanz jBihMomenHsHss13"
 /begin DEF_CHARACTERISTIC KL_MGMOTMAXAUF1HSS13 KL_MGMOTMAXAUF2HSS13 KL_TVSYNCGHSS13 MO_MOTMAXHSS13 MS_MOTISTHSS13 M_MOTMAXHSS_HYS13 /end DEF_CHARACTERISTIC
/end FUNCTION
/begin FUNCTION jBihMomenHsHss24_Fktn "Applikationesgroessen Instanz jBihMomenHsHss24"
 /begin DEF_CHARACTERISTIC KL_MGMOTMAXAUF1HSS24 KL_MGMOTMAXAUF2HSS24 KL_TVSYNCGHSS24 MO_MOTMAXHSS24 MS_MOTISTHSS24 M_MOTMAXHSS_HYS24 /end DEF_CHARACTERISTIC
/end FUNCTION
/begin FUNCTION jBihMomenHsHss35_Fktn "Applikationesgroessen Instanz jBihMomenHsHss35"
 /begin DEF_CHARACTERISTIC KL_MGMOTMAXAUF1HSS35 KL_MGMOTMAXAUF2HSS35 KL_TVSYNCGHSS35 MO_MOTMAXHSS35 MS_MOTISTHSS35 M_MOTMAXHSS_HYS35 /end DEF_CHARACTERISTIC
/end FUNCTION
/begin FUNCTION jBihMomenHsHss46_Fktn "Applikationesgroessen Instanz jBihMomenHsHss46"
 /begin DEF_CHARACTERISTIC KL_MGMOTMAXAUF1HSS46 KL_MGMOTMAXAUF2HSS46 KL_TVSYNCGHSS46 MO_MOTMAXHSS46 MS_MOTISTHSS46 M_MOTMAXHSS_HYS46 /end DEF_CHARACTERISTIC
/end FUNCTION
/begin FUNCTION jBihMomenHsHss57_Fktn "Applikationesgroessen Instanz jBihMomenHsHss57"
 /begin DEF_CHARACTERISTIC KL_MGMOTMAXAUF1HSS57 KL_MGMOTMAXAUF2HSS57 KL_TVSYNCGHSS57 MO_MOTMAXHSS57 MS_MOTISTHSS57 M_MOTMAXHSS_HYS57 /end DEF_CHARACTERISTIC
/end FUNCTION
/begin FUNCTION jBihMomenHsHss68_Fktn "Applikationesgroessen Instanz jBihMomenHsHss68"
 /begin DEF_CHARACTERISTIC KL_MGMOTMAXAUF1HSS68 KL_MGMOTMAXAUF2HSS68 KL_TVSYNCGHSS68 MO_MOTMAXHSS68 MS_MOTISTHSS68 M_MOTMAXHSS_HYS68 /end DEF_CHARACTERISTIC
/end FUNCTION
/begin FUNCTION dBihMPuauf_Fktn "Applikationesgroessen der Komponente dBihMPuauf" /begin SUB_FUNCTION jBihMPuauf_Fktn /end SUB_FUNCTION /end FUNCTION
/begin FUNCTION jBihMPuauf_Fktn "Applikationesgroessen Instanz jBihMPuauf" /begin DEF_CHARACTERISTIC KF_MPUAUF KL_KCGMPUAUF MPT_MPUAUF SWI_NMOTMPUAUF /end DEF_CHARACTERISTIC /end FUNCTION
/begin FUNCTION dBihNeigungssignal_Fktn "Applikationesgroessen der Komponente dBihNeigungssignal" /begin SUB_FUNCTION jBihNeigungssignal_Fktn /end SUB_FUNCTION /end FUNCTION
/begin FUNCTION jBihNeigungssignal_Fktn "Applikationesgroessen Instanz jBihNeigungssignal"
 /begin DEF_CHARACTERISTIC NEIG_ERSATZ NEIG_INI NEIG_MAX NEIG_MIN NS_NEIGFILTER1 NS_NEIGFILTER2 T_FILTERNEIG1 T_FILTERNEIG2 T_NEIG1 T_NEIG2 /end DEF_CHARACTERISTIC
/end FUNCTION
/begin FUNCTION dBihHotmode_Fktn "Applikationesgroessen der Komponente dBihHotmode" /begin SUB_FUNCTION jBihHotmode_Fktn /end SUB_FUNCTION /end FUNCTION
/begin FUNCTION jBihHotmode_Fktn "Applikationesgroessen Instanz jBihHotmode"
 /begin DEF_CHARACTERISTIC CCH_HMHYS CCH_HMME CCH_HOTMODE CCH_KUEHL1MAX CCH_KUEHL2MAX CGT_HMHYS CGT_HMME CGT_HOTMODE CGT_KUEHL1MAX CGT_KUEHL2MAX CIAE_HMHYS CIAE_KUEHL1MAX CIAE_KUEHL2MAX KL_TOHOTMODEVFZG M_HOTMODEMAXDEC M_HOTMODEMAXINC /end DEF_CHARACTERISTIC
/end FUNCTION
/begin FUNCTION dBihHotmodeG_Fktn "Applikationesgroessen der Komponente dBihHotmodeG"
 /begin SUB_FUNCTION jBihHotmodeGR_Fktn jBihHotmodeG1_Fktn jBihHotmodeG2_Fktn jBihHotmodeG3_Fktn jBihHotmodeG4_Fktn jBihHotmodeG5_Fktn jBihHotmodeG6_Fktn jBihHotmodeG7_Fktn jBihHotmodeG8_Fktn /end SUB_FUNCTION
/end FUNCTION
/begin FUNCTION jBihHotmodeGR_Fktn "Applikationesgroessen Instanz jBihHotmodeGR" /begin DEF_CHARACTERISTIC KL_MHOTMODEMAX_R /end DEF_CHARACTERISTIC /end FUNCTION
/begin FUNCTION jBihHotmodeG1_Fktn "Applikationesgroessen Instanz jBihHotmodeG1" /begin DEF_CHARACTERISTIC KL_MHOTMODEMAX_1 /end DEF_CHARACTERISTIC /end FUNCTION
/begin FUNCTION jBihHotmodeG2_Fktn "Applikationesgroessen Instanz jBihHotmodeG2" /begin DEF_CHARACTERISTIC KL_MHOTMODEMAX_2 /end DEF_CHARACTERISTIC /end FUNCTION
/begin FUNCTION jBihHotmodeG3_Fktn "Applikationesgroessen Instanz jBihHotmodeG3" /begin DEF_CHARACTERISTIC KL_MHOTMODEMAX_3 /end DEF_CHARACTERISTIC /end FUNCTION
/begin FUNCTION jBihHotmodeG4_Fktn "Applikationesgroessen Instanz jBihHotmodeG4" /begin DEF_CHARACTERISTIC KL_MHOTMODEMAX_4 /end DEF_CHARACTERISTIC /end FUNCTION
/begin FUNCTION jBihHotmodeG5_Fktn "Applikationesgroessen Instanz jBihHotmodeG5" /begin DEF_CHARACTERISTIC KL_MHOTMODEMAX_5 /end DEF_CHARACTERISTIC /end FUNCTION
/begin FUNCTION jBihHotmodeG6_Fktn "Applikationesgroessen Instanz jBihHotmodeG6" /begin DEF_CHARACTERISTIC KL_MHOTMODEMAX_6 /end DEF_CHARACTERISTIC /end FUNCTION
/begin FUNCTION jBihHotmodeG7_Fktn "Applikationesgroessen Instanz jBihHotmodeG7" /begin DEF_CHARACTERISTIC KL_MHOTMODEMAX_7 /end DEF_CHARACTERISTIC /end FUNCTION
/begin FUNCTION jBihHotmodeG8_Fktn "Applikationesgroessen Instanz jBihHotmodeG8" /begin DEF_CHARACTERISTIC KL_MHOTMODEMAX_8 /end DEF_CHARACTERISTIC /end FUNCTION
/begin FUNCTION dBihDrehz_Fktn "Applikationesgroessen der Komponente dBihDrehz" /begin SUB_FUNCTION jBihDrehz_Fktn /end SUB_FUNCTION /end FUNCTION
/begin FUNCTION jBihDrehz_Fktn "Applikationesgroessen Instanz jBihDrehz"
 /begin DEF_CHARACTERISTIC FI_NABALT FI_NABNEU FI_NTALT FI_NTNEU T_FNGAB T_FNGMOT T_FNGT T_FNUEG /end DEF_CHARACTERISTIC
/end FUNCTION
/begin FUNCTION dBihMobef_Fktn "Applikationesgroessen der Komponente dBihMobef" /begin SUB_FUNCTION jBihMobef_Fktn /end SUB_FUNCTION /end FUNCTION
/begin FUNCTION jBihMobef_Fktn "Applikationesgroessen Instanz jBihMobef"
 /begin DEF_CHARACTERISTIC DKIS_STALL J_MOT_GETRMAX KF_MESCHLUPFAS KF_MGETRMAXCK KL_KMMOTMAXCM KL_NDSYNMESCHLUPF KL_RGANGLIMIT M_ERSMOTMAXGE M_MOTMAXINC M_MOTMAXOFFSETOB M_MOTORMAX M_MOTSCHLUPF NS_ABMEDA NS_ABSCHLUPF NS_MOTSTALL NS_TSTALL SICH_MMOTMAX SWI_CONSIDER_EPB SWI_MEUW TAB_MGETRMAX TAB_MGETRMAXSHIFT TAB_MGETRMAXSTALL TAB_TRANSPORTMGETRMAX TS_SYNMESCHLUPF T_MEMAXGL T_MESCHLUPFASMMOT T_MESCHLUPFASMRED T_METOT T_MMOTMAXAB T_MMOTMAXAUF T_VSTALL /end DEF_CHARACTERISTIC
/end FUNCTION
/begin FUNCTION dBihMobefG_Fktn "Applikationesgroessen der Komponente dBihMobefG"
 /begin SUB_FUNCTION jBihMobefGR_Fktn jBihMobefG1_Fktn jBihMobefG2_Fktn jBihMobefG3_Fktn jBihMobefG4_Fktn jBihMobefG5_Fktn jBihMobefG6_Fktn jBihMobefG7_Fktn jBihMobefG8_Fktn /end SUB_FUNCTION
/end FUNCTION
/begin FUNCTION jBihMobefGR_Fktn "Applikationesgroessen Instanz jBihMobefGR" /begin DEF_CHARACTERISTIC KF_MMOTMAXGE_R KF_MMOTMAXGE_R_EL /end DEF_CHARACTERISTIC /end FUNCTION
/begin FUNCTION jBihMobefG1_Fktn "Applikationesgroessen Instanz jBihMobefG1" /begin DEF_CHARACTERISTIC KF_MMOTMAXGE_1 KF_MMOTMAXGE_1_EL /end DEF_CHARACTERISTIC /end FUNCTION
/begin FUNCTION jBihMobefG2_Fktn "Applikationesgroessen Instanz jBihMobefG2" /begin DEF_CHARACTERISTIC KF_MMOTMAXGE_2 KF_MMOTMAXGE_2_EL /end DEF_CHARACTERISTIC /end FUNCTION
/begin FUNCTION jBihMobefG3_Fktn "Applikationesgroessen Instanz jBihMobefG3" /begin DEF_CHARACTERISTIC KF_MMOTMAXGE_3 KF_MMOTMAXGE_3_EL /end DEF_CHARACTERISTIC /end FUNCTION
/begin FUNCTION jBihMobefG4_Fktn "Applikationesgroessen Instanz jBihMobefG4" /begin DEF_CHARACTERISTIC KF_MMOTMAXGE_4 KF_MMOTMAXGE_4_EL /end DEF_CHARACTERISTIC /end FUNCTION
/begin FUNCTION jBihMobefG5_Fktn "Applikationesgroessen Instanz jBihMobefG5" /begin DEF_CHARACTERISTIC KF_MMOTMAXGE_5 KF_MMOTMAXGE_5_EL /end DEF_CHARACTERISTIC /end FUNCTION
/begin FUNCTION jBihMobefG6_Fktn "Applikationesgroessen Instanz jBihMobefG6" /begin DEF_CHARACTERISTIC KF_MMOTMAXGE_6 KF_MMOTMAXGE_6_EL /end DEF_CHARACTERISTIC /end FUNCTION
/begin FUNCTION jBihMobefG7_Fktn "Applikationesgroessen Instanz jBihMobefG7" /begin DEF_CHARACTERISTIC KF_MMOTMAXGE_7 KF_MMOTMAXGE_7_EL /end DEF_CHARACTERISTIC /end FUNCTION
/begin FUNCTION jBihMobefG8_Fktn "Applikationesgroessen Instanz jBihMobefG8" /begin DEF_CHARACTERISTIC KF_MMOTMAXGE_8 KF_MMOTMAXGE_8_EL /end DEF_CHARACTERISTIC /end FUNCTION
/begin FUNCTION dBihMomen_Fktn "Applikationesgroessen der Komponente dBihMomen" /begin SUB_FUNCTION jBihMomen_Fktn /end SUB_FUNCTION /end FUNCTION
/begin FUNCTION jBihMomen_Fktn "Applikationesgroessen Instanz jBihMomen"
 /begin DEF_CHARACTERISTIC J_MOT J_MOT_EL KF_MVERLMTNT_K0 KL_FGMMOTMDMOTPSYS KL_FMMOTCM KL_F_MVERLCG MS_GETRVERL M_ABDYNERR TAB_JGETR T_FDKIG T_MVERL_K0 /end DEF_CHARACTERISTIC
/end FUNCTION
/begin FUNCTION dBihMomenG_Fktn "Applikationesgroessen der Komponente dBihMomenG"
 /begin SUB_FUNCTION jBihMomenGR_Fktn jBihMomenG1_Fktn jBihMomenG2_Fktn jBihMomenG3_Fktn jBihMomenG4_Fktn jBihMomenG5_Fktn jBihMomenG6_Fktn jBihMomenG7_Fktn jBihMomenG8_Fktn /end SUB_FUNCTION
/end FUNCTION
/begin FUNCTION jBihMomenGR_Fktn "Applikationesgroessen Instanz jBihMomenGR" /begin DEF_CHARACTERISTIC KF_MVERLMTNT_R KL_FGMMOTMDMOT_R /end DEF_CHARACTERISTIC /end FUNCTION
/begin FUNCTION jBihMomenG1_Fktn "Applikationesgroessen Instanz jBihMomenG1" /begin DEF_CHARACTERISTIC KF_MVERLMTNT_1 KL_FGMMOTMDMOT_1 /end DEF_CHARACTERISTIC /end FUNCTION
/begin FUNCTION jBihMomenG2_Fktn "Applikationesgroessen Instanz jBihMomenG2" /begin DEF_CHARACTERISTIC KF_MVERLMTNT_2 KL_FGMMOTMDMOT_2 /end DEF_CHARACTERISTIC /end FUNCTION
/begin FUNCTION jBihMomenG3_Fktn "Applikationesgroessen Instanz jBihMomenG3" /begin DEF_CHARACTERISTIC KF_MVERLMTNT_3 KL_FGMMOTMDMOT_3 /end DEF_CHARACTERISTIC /end FUNCTION
/begin FUNCTION jBihMomenG4_Fktn "Applikationesgroessen Instanz jBihMomenG4" /begin DEF_CHARACTERISTIC KF_MVERLMTNT_4 KL_FGMMOTMDMOT_4 /end DEF_CHARACTERISTIC /end FUNCTION
/begin FUNCTION jBihMomenG5_Fktn "Applikationesgroessen Instanz jBihMomenG5" /begin DEF_CHARACTERISTIC KF_MVERLMTNT_5 KL_FGMMOTMDMOT_5 /end DEF_CHARACTERISTIC /end FUNCTION
/begin FUNCTION jBihMomenG6_Fktn "Applikationesgroessen Instanz jBihMomenG6" /begin DEF_CHARACTERISTIC KF_MVERLMTNT_6 KL_FGMMOTMDMOT_6 /end DEF_CHARACTERISTIC /end FUNCTION
/begin FUNCTION jBihMomenG7_Fktn "Applikationesgroessen Instanz jBihMomenG7" /begin DEF_CHARACTERISTIC KF_MVERLMTNT_7 KL_FGMMOTMDMOT_7 /end DEF_CHARACTERISTIC /end FUNCTION
/begin FUNCTION jBihMomenG8_Fktn "Applikationesgroessen Instanz jBihMomenG8" /begin DEF_CHARACTERISTIC KF_MVERLMTNT_8 KL_FGMMOTMDMOT_8 /end DEF_CHARACTERISTIC /end FUNCTION
/begin FUNCTION dBihSigna_Fktn "Applikationesgroessen der Komponente dBihSigna" /begin SUB_FUNCTION jBihSigna_Fktn /end SUB_FUNCTION /end FUNCTION
/begin FUNCTION jBihSigna_Fktn "Applikationesgroessen Instanz jBihSigna"
 /begin DEF_CHARACTERISTIC HYS_NSMOTPUMPE KL_ZS KL_ZSHS KL_ZSOCMOT KL_ZSOCMOTMRS NEIGUNG_HYS_PAUS NEIGUNG_PAUS NS_AB_SBC_AKTIV NS_MOTIMIN NS_MOTPUMPE NS_TPUMPE PS_BREMS PS_BREMSHYS SWI_FSTBREMSE SWI_PBR SWI_PREADAPTION_START_STADA SWI_UMSCHALTDKI TAB_DEACT_IAE_DAMPG TAB_SBC_AKTIV_IAE T_DEACTVT_ACTV_DAMPG T_SBC_AKTIV ZS_HYS /end DEF_CHARACTERISTIC
/end FUNCTION
/begin FUNCTION dBihSignaRSS_Fktn "Applikationesgroessen der Komponente dBihSignaRSS"
 /begin SUB_FUNCTION jBihSignaRSS21_Fktn jBihSignaRSS32_Fktn jBihSignaRSS43_Fktn jBihSignaRSS54_Fktn jBihSignaRSS65_Fktn jBihSignaRSS76_Fktn jBihSignaRSS87_Fktn jBihSignaRSS31_Fktn jBihSignaRSS42_Fktn jBihSignaRSS51_Fktn jBihSignaRSS53_Fktn jBihSignaRSS63_Fktn jBihSignaRSS64_Fktn jBihSignaRSS71_Fktn jBihSignaRSS75_Fktn jBihSignaRSS82_Fktn jBihSignaRSS84_Fktn jBihSignaRSS86_Fktn /end SUB_FUNCTION
/end FUNCTION
/begin FUNCTION jBihSignaRSS21_Fktn "Applikationesgroessen Instanz jBihSignaRSS21" /begin DEF_CHARACTERISTIC KL_ZSRS21 /end DEF_CHARACTERISTIC /end FUNCTION
/begin FUNCTION jBihSignaRSS32_Fktn "Applikationesgroessen Instanz jBihSignaRSS32" /begin DEF_CHARACTERISTIC KL_ZSRS32 /end DEF_CHARACTERISTIC /end FUNCTION
/begin FUNCTION jBihSignaRSS43_Fktn "Applikationesgroessen Instanz jBihSignaRSS43" /begin DEF_CHARACTERISTIC KL_ZSRS43 /end DEF_CHARACTERISTIC /end FUNCTION
/begin FUNCTION jBihSignaRSS54_Fktn "Applikationesgroessen Instanz jBihSignaRSS54" /begin DEF_CHARACTERISTIC KL_ZSRS54 /end DEF_CHARACTERISTIC /end FUNCTION
/begin FUNCTION jBihSignaRSS65_Fktn "Applikationesgroessen Instanz jBihSignaRSS65" /begin DEF_CHARACTERISTIC KL_ZSRS65 /end DEF_CHARACTERISTIC /end FUNCTION
/begin FUNCTION jBihSignaRSS76_Fktn "Applikationesgroessen Instanz jBihSignaRSS76" /begin DEF_CHARACTERISTIC KL_ZSRS76 /end DEF_CHARACTERISTIC /end FUNCTION
/begin FUNCTION jBihSignaRSS87_Fktn "Applikationesgroessen Instanz jBihSignaRSS87" /begin DEF_CHARACTERISTIC KL_ZSRS87 /end DEF_CHARACTERISTIC /end FUNCTION
/begin FUNCTION jBihSignaRSS31_Fktn "Applikationesgroessen Instanz jBihSignaRSS31" /begin DEF_CHARACTERISTIC KL_ZSRSSP31 /end DEF_CHARACTERISTIC /end FUNCTION
/begin FUNCTION jBihSignaRSS42_Fktn "Applikationesgroessen Instanz jBihSignaRSS42" /begin DEF_CHARACTERISTIC KL_ZSRSSP42 /end DEF_CHARACTERISTIC /end FUNCTION
/begin FUNCTION jBihSignaRSS51_Fktn "Applikationesgroessen Instanz jBihSignaRSS51" /begin DEF_CHARACTERISTIC KL_ZSRSSP51 /end DEF_CHARACTERISTIC /end FUNCTION
/begin FUNCTION jBihSignaRSS53_Fktn "Applikationesgroessen Instanz jBihSignaRSS53" /begin DEF_CHARACTERISTIC KL_ZSRSSP53 /end DEF_CHARACTERISTIC /end FUNCTION
/begin FUNCTION jBihSignaRSS63_Fktn "Applikationesgroessen Instanz jBihSignaRSS63" /begin DEF_CHARACTERISTIC KL_ZSRSSP63 /end DEF_CHARACTERISTIC /end FUNCTION
/begin FUNCTION jBihSignaRSS64_Fktn "Applikationesgroessen Instanz jBihSignaRSS64" /begin DEF_CHARACTERISTIC KL_ZSRSSP64 /end DEF_CHARACTERISTIC /end FUNCTION
/begin FUNCTION jBihSignaRSS71_Fktn "Applikationesgroessen Instanz jBihSignaRSS71" /begin DEF_CHARACTERISTIC KL_ZSRSSP71 /end DEF_CHARACTERISTIC /end FUNCTION
/begin FUNCTION jBihSignaRSS75_Fktn "Applikationesgroessen Instanz jBihSignaRSS75" /begin DEF_CHARACTERISTIC KL_ZSRSSP75 /end DEF_CHARACTERISTIC /end FUNCTION
/begin FUNCTION jBihSignaRSS82_Fktn "Applikationesgroessen Instanz jBihSignaRSS82" /begin DEF_CHARACTERISTIC KL_ZSRSSP82 /end DEF_CHARACTERISTIC /end FUNCTION
/begin FUNCTION jBihSignaRSS84_Fktn "Applikationesgroessen Instanz jBihSignaRSS84" /begin DEF_CHARACTERISTIC KL_ZSRSSP84 /end DEF_CHARACTERISTIC /end FUNCTION
/begin FUNCTION jBihSignaRSS86_Fktn "Applikationesgroessen Instanz jBihSignaRSS86" /begin DEF_CHARACTERISTIC KL_ZSRSSP86 /end DEF_CHARACTERISTIC /end FUNCTION
/begin FUNCTION dBihHydra_Fktn "Applikationesgroessen der Komponente dBihHydra" /begin SUB_FUNCTION jBihHydra_Fktn /end SUB_FUNCTION /end FUNCTION
/begin FUNCTION jBihHydra_Fktn "Applikationesgroessen Instanz jBihHydra"
 /begin DEF_CHARACTERISTIC I_MAX I_MIN KF_POFNABCGKPLBINN KL_IEDSOFPSV P_OF1KPLBINN T_IEDSOFPSV T_IKABENTLEER T_POF1KPLBINN T_VGEINIT /end DEF_CHARACTERISTIC
/end FUNCTION
/begin FUNCTION dModAbglKorr_Fktn "Applikationesgroessen der Komponente dModAbglKorr" /begin SUB_FUNCTION jModAbglKorr_Fktn /end SUB_FUNCTION /end FUNCTION
/begin FUNCTION jModAbglKorr_Fktn "Applikationesgroessen Instanz jModAbglKorr" /begin DEF_CHARACTERISTIC KF_KIEDSCGFAACE KF_KIEDSCGSTACE /end DEF_CHARACTERISTIC /end FUNCTION
/begin FUNCTION dModHydlg_Fktn "Applikationesgroessen der Komponente dModHydlg" /begin SUB_FUNCTION jModHydlg_Fktn /end SUB_FUNCTION /end FUNCTION
/begin FUNCTION jModHydlg_Fktn "Applikationesgroessen Instanz jModHydlg"
 /begin DEF_CHARACTERISTIC I_EDSPOSV I_EDSPSV KF_KIEDSCGKOR KF_KIEDSPSYSKORFAACE KF_KIEDSPSYSKORSTACE KL_EDSKVA KL_EDSKVB KL_EDSKVC KL_EDSKVD KL_EDSKVE KL_EDSKVK0 KL_EDSKVPOS KL_EDSKVSYS SWI_ABGLDAT /end DEF_CHARACTERISTIC
/end FUNCTION
/begin FUNCTION dModHysKo_Fktn "Applikationesgroessen der Komponente dModHysKo" /begin SUB_FUNCTION jModHysKo_Fktn /end SUB_FUNCTION /end FUNCTION
/begin FUNCTION jModHysKo_Fktn "Applikationesgroessen Instanz jModHysKo"
 /begin DEF_CHARACTERISTIC KF_MUEKPL_IAE_HYSKOMP KF_MUEKPL_K0_HYSKOMP MDT_IGEDS_HYSKOMP MDT_PGABSSOLL_HYSKOMP MDT_V_HYSKOMP PS_MAX_K0_HYSKOMP /end DEF_CHARACTERISTIC
/end FUNCTION
/begin FUNCTION dModHysKoK_Fktn "Applikationesgroessen der Komponente dModHysKoK"
 /begin SUB_FUNCTION jModHysKoKA_Fktn jModHysKoKB_Fktn jModHysKoKC_Fktn jModHysKoKD_Fktn jModHysKoKE_Fktn jModHysKoKK0_Fktn /end SUB_FUNCTION
/end FUNCTION
/begin FUNCTION jModHysKoKA_Fktn "Applikationesgroessen Instanz jModHysKoKA"
 /begin DEF_CHARACTERISTIC IGS_A_HYSKOMP IS_IMAX_A_HYSKOMP IS_IMIN_A_HYSKOMP KF_F_GRAD_STG_A_HYSKOMP KF_F_V_A_HYSKOMP KF_T_RAMPE_V_A_HYSKOMP KL_F_GRAD_KPL_A_HYSKOMP KL_F_TRAJEK_KPL_A_HYSKOMP KL_F_TRAJEK_STG_A_HYSKOMP KL_HYSB_KPL_A_HYSKOMP KL_INIT_V_A_HYSKOMP KL_MUEKPL_A_HYSKOMP KL_T_KPL_A_HYSKOMP KL_T_STG_A_HYSKOMP PGS_A_HYSKOMP PO_MAX_V_A_HYSKOMP PO_MIN_V_A_HYSKOMP PS_INIT_HYS_V_A_HYSKOMP PS_INIT_V_A_HYSKOMP SWI_AKTIV_V_A_HYSKOMP TAB_SWI_AKTIV_A_HYSKOMP /end DEF_CHARACTERISTIC
/end FUNCTION
/begin FUNCTION jModHysKoKB_Fktn "Applikationesgroessen Instanz jModHysKoKB"
 /begin DEF_CHARACTERISTIC IGS_B_HYSKOMP IS_IMAX_B_HYSKOMP IS_IMIN_B_HYSKOMP KF_F_GRAD_STG_B_HYSKOMP KF_F_V_B_HYSKOMP KF_T_RAMPE_V_B_HYSKOMP KL_F_GRAD_KPL_B_HYSKOMP KL_F_TRAJEK_KPL_B_HYSKOMP KL_F_TRAJEK_STG_B_HYSKOMP KL_HYSB_KPL_B_HYSKOMP KL_INIT_V_B_HYSKOMP KL_MUEKPL_B_HYSKOMP KL_T_KPL_B_HYSKOMP KL_T_STG_B_HYSKOMP PGS_B_HYSKOMP PO_MAX_V_B_HYSKOMP PO_MIN_V_B_HYSKOMP PS_INIT_HYS_V_B_HYSKOMP PS_INIT_V_B_HYSKOMP SWI_AKTIV_V_B_HYSKOMP TAB_SWI_AKTIV_B_HYSKOMP /end DEF_CHARACTERISTIC
/end FUNCTION
/begin FUNCTION jModHysKoKC_Fktn "Applikationesgroessen Instanz jModHysKoKC"
 /begin DEF_CHARACTERISTIC IGS_C_HYSKOMP IS_IMAX_C_HYSKOMP IS_IMIN_C_HYSKOMP KF_F_GRAD_STG_C_HYSKOMP KF_F_V_C_HYSKOMP KF_T_RAMPE_V_C_HYSKOMP KL_F_GRAD_KPL_C_HYSKOMP KL_F_TRAJEK_KPL_C_HYSKOMP KL_F_TRAJEK_STG_C_HYSKOMP KL_HYSB_KPL_C_HYSKOMP KL_INIT_V_C_HYSKOMP KL_MUEKPL_C_HYSKOMP KL_T_KPL_C_HYSKOMP KL_T_STG_C_HYSKOMP PGS_C_HYSKOMP PO_MAX_V_C_HYSKOMP PO_MIN_V_C_HYSKOMP PS_INIT_HYS_V_C_HYSKOMP PS_INIT_V_C_HYSKOMP SWI_AKTIV_V_C_HYSKOMP TAB_SWI_AKTIV_C_HYSKOMP /end DEF_CHARACTERISTIC
/end FUNCTION
/begin FUNCTION jModHysKoKD_Fktn "Applikationesgroessen Instanz jModHysKoKD"
 /begin DEF_CHARACTERISTIC IGS_D_HYSKOMP IS_IMAX_D_HYSKOMP IS_IMIN_D_HYSKOMP KF_F_GRAD_STG_D_HYSKOMP KF_F_V_D_HYSKOMP KF_T_RAMPE_V_D_HYSKOMP KL_F_GRAD_KPL_D_HYSKOMP KL_F_TRAJEK_KPL_D_HYSKOMP KL_F_TRAJEK_STG_D_HYSKOMP KL_HYSB_KPL_D_HYSKOMP KL_INIT_V_D_HYSKOMP KL_MUEKPL_D_HYSKOMP KL_T_KPL_D_HYSKOMP KL_T_STG_D_HYSKOMP PGS_D_HYSKOMP PO_MAX_V_D_HYSKOMP PO_MIN_V_D_HYSKOMP PS_INIT_HYS_V_D_HYSKOMP PS_INIT_V_D_HYSKOMP SWI_AKTIV_V_D_HYSKOMP TAB_SWI_AKTIV_D_HYSKOMP /end DEF_CHARACTERISTIC
/end FUNCTION
/begin FUNCTION jModHysKoKE_Fktn "Applikationesgroessen Instanz jModHysKoKE"
 /begin DEF_CHARACTERISTIC IGS_E_HYSKOMP IS_IMAX_E_HYSKOMP IS_IMIN_E_HYSKOMP KF_F_GRAD_STG_E_HYSKOMP KF_F_V_E_HYSKOMP KF_T_RAMPE_V_E_HYSKOMP KL_F_GRAD_KPL_E_HYSKOMP KL_F_TRAJEK_KPL_E_HYSKOMP KL_F_TRAJEK_STG_E_HYSKOMP KL_HYSB_KPL_E_HYSKOMP KL_INIT_V_E_HYSKOMP KL_MUEKPL_E_HYSKOMP KL_T_KPL_E_HYSKOMP KL_T_STG_E_HYSKOMP PGS_E_HYSKOMP PO_MAX_V_E_HYSKOMP PO_MIN_V_E_HYSKOMP PS_INIT_HYS_V_E_HYSKOMP PS_INIT_V_E_HYSKOMP SWI_AKTIV_V_E_HYSKOMP TAB_SWI_AKTIV_E_HYSKOMP /end DEF_CHARACTERISTIC
/end FUNCTION
/begin FUNCTION jModHysKoKK0_Fktn "Applikationesgroessen Instanz jModHysKoKK0"
 /begin DEF_CHARACTERISTIC IGS_K0_HYSKOMP IS_IMAX_K0_HYSKOMP IS_IMIN_K0_HYSKOMP KF_F_GRAD_STG_K0_HYSKOMP KF_F_V_K0_HYSKOMP KF_T_RAMPE_V_K0_HYSKOMP KL_F_GRAD_KPL_K0_HYSKOMP KL_F_TRAJEK_KPL_K0_HYSKOMP KL_F_TRAJEK_STG_K0_HYSKOMP KL_HYSB_KPL_K0_HYSKOMP KL_INIT_V_K0_HYSKOMP KL_T_KPL_K0_HYSKOMP KL_T_STG_K0_HYSKOMP PGS_K0_HYSKOMP PO_MAX_V_K0_HYSKOMP PO_MIN_V_K0_HYSKOMP PS_INIT_HYS_V_K0_HYSKOMP PS_INIT_V_K0_HYSKOMP SWI_AKTIV_V_K0_HYSKOMP TAB_SWI_AKTIV_K0_HYSKOMP /end DEF_CHARACTERISTIC
/end FUNCTION
/begin FUNCTION dModKuppl_Fktn "Applikationesgroessen der Komponente dModKuppl" /begin SUB_FUNCTION jModKuppl_Fktn /end SUB_FUNCTION /end FUNCTION
/begin RECORD_LAYOUT kw_bool8_S6_S3 FNC_VALUES 1 UBYTE COLUMN_DIR DIRECT /end RECORD_LAYOUT
/begin RECORD_LAYOUT kw_ui8_S6_S3 FNC_VALUES 1 UBYTE COLUMN_DIR DIRECT /end RECORD_LAYOUT
/begin RECORD_LAYOUT kw_ui16_S6_S3 FNC_VALUES 1 UWORD COLUMN_DIR DIRECT /end RECORD_LAYOUT
/begin RECORD_LAYOUT kw_ui32_S6_S3 FNC_VALUES 1 ULONG COLUMN_DIR DIRECT /end RECORD_LAYOUT
/begin RECORD_LAYOUT kw_si16_S6_S3 FNC_VALUES 1 SWORD COLUMN_DIR DIRECT /end RECORD_LAYOUT
/begin RECORD_LAYOUT tab_bool8_S6_S3 FNC_VALUES 2 UBYTE COLUMN_DIR DIRECT NO_AXIS_PTS_X 1 ULONG /end RECORD_LAYOUT
/begin RECORD_LAYOUT tab_ui8_S6_S3 FNC_VALUES 2 UBYTE COLUMN_DIR DIRECT NO_AXIS_PTS_X 1 ULONG /end RECORD_LAYOUT
/begin RECORD_LAYOUT tab_ui16_S6_S3 FNC_VALUES 2 UWORD COLUMN_DIR DIRECT NO_AXIS_PTS_X 1 ULONG /end RECORD_LAYOUT
/begin RECORD_LAYOUT tab_si16_S6_S3 FNC_VALUES 2 SWORD COLUMN_DIR DIRECT NO_AXIS_PTS_X 1 ULONG /end RECORD_LAYOUT
/begin RECORD_LAYOUT tab2d_ui8_S6_S3 FNC_VALUES 3 UBYTE ROW_DIR DIRECT NO_AXIS_PTS_X 1 ULONG NO_AXIS_PTS_Y 2 ULONG /end RECORD_LAYOUT
/begin RECORD_LAYOUT tab2d_ui16_S6_S3 FNC_VALUES 3 UWORD ROW_DIR DIRECT NO_AXIS_PTS_X 1 ULONG NO_AXIS_PTS_Y 2 ULONG /end RECORD_LAYOUT
/begin RECORD_LAYOUT tab2d_si16_S6_S3 FNC_VALUES 3 SWORD ROW_DIR DIRECT NO_AXIS_PTS_X 1 ULONG NO_AXIS_PTS_Y 2 ULONG /end RECORD_LAYOUT
/begin RECORD_LAYOUT kl_ui8_S6_S3 FNC_VALUES 3 UBYTE COLUMN_DIR DIRECT AXIS_PTS_X 2 UBYTE INDEX_INCR DIRECT NO_AXIS_PTS_X 1 ULONG /end RECORD_LAYOUT
/begin RECORD_LAYOUT kl_ui16_S6_S3 FNC_VALUES 3 UWORD COLUMN_DIR DIRECT AXIS_PTS_X 2 UWORD INDEX_INCR DIRECT NO_AXIS_PTS_X 1 ULONG /end RECORD_LAYOUT
/begin RECORD_LAYOUT kl_si16_S6_S3 FNC_VALUES 3 SWORD COLUMN_DIR DIRECT AXIS_PTS_X 2 SWORD INDEX_INCR DIRECT NO_AXIS_PTS_X 1 ULONG /end RECORD_LAYOUT
/begin RECORD_LAYOUT kf_ui8_S6_S3 FNC_VALUES 5 UBYTE ROW_DIR DIRECT AXIS_PTS_X 3 UBYTE INDEX_INCR DIRECT AXIS_PTS_Y 4 UBYTE INDEX_INCR DIRECT NO_AXIS_PTS_X 1 ULONG NO_AXIS_PTS_Y 2 ULONG /end RECORD_LAYOUT
/begin RECORD_LAYOUT kf_ui16_S6_S3 FNC_VALUES 5 UWORD ROW_DIR DIRECT AXIS_PTS_X 3 UWORD INDEX_INCR DIRECT AXIS_PTS_Y 4 UWORD INDEX_INCR DIRECT NO_AXIS_PTS_X 1 ULONG NO_AXIS_PTS_Y 2 ULONG /end RECORD_LAYOUT
/begin RECORD_LAYOUT kf_si16_S6_S3 FNC_VALUES 5 SWORD ROW_DIR DIRECT AXIS_PTS_X 3 SWORD INDEX_INCR DIRECT AXIS_PTS_Y 4 SWORD INDEX_INCR DIRECT NO_AXIS_PTS_X 1 ULONG NO_AXIS_PTS_Y 2 ULONG /end RECORD_LAYOUT
/begin RECORD_LAYOUT kf_fl32_S6_S3 FNC_VALUES 5 FLOAT32_IEEE ROW_DIR DIRECT AXIS_PTS_X 3 FLOAT32_IEEE INDEX_INCR DIRECT AXIS_PTS_Y 4 FLOAT32_IEEE INDEX_INCR DIRECT NO_AXIS_PTS_X 1 ULONG NO_AXIS_PTS_Y 2 ULONG /end RECORD_LAYOUT
/begin RECORD_LAYOUT Parameter.ui16_S6_S3 FNC_VALUES 1 UWORD ROW_DIR DIRECT /end RECORD_LAYOUT
/begin RECORD_LAYOUT Parameter.ui8_S6_S3 FNC_VALUES 1 UBYTE ROW_DIR DIRECT /end RECORD_LAYOUT
/begin RECORD_LAYOUT Matrix.ui8_S6_S3 FNC_VALUES 1 UBYTE ROW_DIR DIRECT /end RECORD_LAYOUT
/begin RECORD_LAYOUT Table.fl32_S6_S3 FNC_VALUES 1 FLOAT32_IEEE ROW_DIR DIRECT /end RECORD_LAYOUT
/begin RECORD_LAYOUT Curve.si16.si16_S6_S3 FNC_VALUES 2 SWORD ROW_DIR DIRECT AXIS_PTS_X 1 SWORD INDEX_INCR DIRECT /end RECORD_LAYOUT
/begin RECORD_LAYOUT Map.fl32.fl32.fl32_S6_S3 FNC_VALUES 3 FLOAT32_IEEE ROW_DIR DIRECT AXIS_PTS_X 1 FLOAT32_IEEE INDEX_INCR DIRECT AXIS_PTS_Y 2 FLOAT32_IEEE INDEX_INCR DIRECT /end RECORD_LAYOUT
/begin RECORD_LAYOUT Parameter.fl32_S6_S3 FNC_VALUES 1 FLOAT32_IEEE ROW_DIR DIRECT /end RECORD_LAYOUT
/begin RECORD_LAYOUT Curve.fl32.fl32_S6_S3 FNC_VALUES 2 FLOAT32_IEEE ROW_DIR DIRECT AXIS_PTS_X 1 FLOAT32_IEEE INDEX_INCR DIRECT /end RECORD_LAYOUT
/begin RECORD_LAYOUT Table.ui8_S6_S3 FNC_VALUES 1 UBYTE ROW_DIR DIRECT /end RECORD_LAYOUT
/begin RECORD_LAYOUT Curve.si16.ui16_S6_S3 FNC_VALUES 2 UWORD ROW_DIR DIRECT AXIS_PTS_X 1 SWORD INDEX_INCR DIRECT /end RECORD_LAYOUT
/begin RECORD_LAYOUT Curve.ui16.ui16_S6_S3 FNC_VALUES 2 UWORD ROW_DIR DIRECT AXIS_PTS_X 1 UWORD INDEX_INCR DIRECT /end RECORD_LAYOUT
/begin RECORD_LAYOUT Classification.ui16_S6_S3 FNC_VALUES 1 UWORD ROW_DIR DIRECT /end RECORD_LAYOUT
/begin RECORD_LAYOUT Classification.si16_S6_S3 FNC_VALUES 1 SWORD ROW_DIR DIRECT /end RECORD_LAYOUT
/begin RECORD_LAYOUT Matrix.ui16_S6_S3 FNC_VALUES 1 UWORD ROW_DIR DIRECT /end RECORD_LAYOUT
/begin RECORD_LAYOUT Curve.ui8.ui8_S6_S3 FNC_VALUES 2 UBYTE ROW_DIR DIRECT AXIS_PTS_X 1 UBYTE INDEX_INCR DIRECT /end RECORD_LAYOUT
/end MODULE
/end PROJECT
