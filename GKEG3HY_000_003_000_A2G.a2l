ASAP2_VERSION 1 51
/begin PROJECT _929_929 "Gen2_BMW_System_Supplier_Lib"
/begin HEADER "" VERSION "C_03_03" PROJECT_NO _929_929 /end HEADER
/begin MODULE DIM ""
/begin MOD_COMMON "" BYTE_ORDER MSB_FIRST ALIGNMENT_BYTE 1 ALIGNMENT_WORD 2 ALIGNMENT_LONG 4 ALIGNMENT_FLOAT32_IEEE 4 /end MOD_COMMON
/begin MEASUREMENT ZFFSAB._.IgnitionKeyStatusIn.iv_KeyValid "Input value key valid from CAN" UBYTE SAB_STANDARD_S2_S3 1 100 0 3 DISPLAY_IDENTIFIER iv_KeyValid.IgnitionKeyStatusIn._.ZFFSAB ECU_ADDRESS 0xFFF9007E /end MEASUREMENT
/begin MEASUREMENT ZFFSAB._.IgnitionKeyStatusIn.iv_KeyValidSts "Input value message status of key valid" UBYTE SAB_STANDARD_S2_S3 1 100 0 255 DISPLAY_IDENTIFIER iv_KeyValidSts.IgnitionKeyStatusIn._.ZFFSAB ECU_ADDRESS 0xFFF9007F /end MEASUREMENT
/begin MEASUREMENT ZFFSAB._.IgnitionKeyStatusIn.sv_f_KeyValid "Output value of key valid" UBYTE SAB_STANDARD_S2_S3 1 100 0 1 DISPLAY_IDENTIFIER sv_f_KeyValid.IgnitionKeyStatusIn._.ZFFSAB ECU_ADDRESS 0xFFF90080 /end MEASUREMENT
/begin MEASUREMENT ZFFSAB._.IgnitionKeyStatusIn.sv_KeyValidSts "Output value signal status of key valid" UBYTE SAB_STANDARD_S2_S3 1 100 0 2 DISPLAY_IDENTIFIER sv_KeyValidSts.IgnitionKeyStatusIn._.ZFFSAB ECU_ADDRESS 0xFFF90081 /end MEASUREMENT
/begin MEASUREMENT ZFFSAB._.IgnitionKeyStatusIn.sv_f_KeyRemoteStart "Output value of Key Remote Start" UBYTE SAB_STANDARD_S2_S3 1 100 0 1 DISPLAY_IDENTIFIER sv_f_KeyRemoteStart.IgnitionKeyStatusIn._.ZFFSAB ECU_ADDRESS 0xFFF90082 /end MEASUREMENT
/begin MEASUREMENT ZFFSAB._.IgnitionKeyStatusIn.f_KeyValidErr "Error flag of key valid" UBYTE SAB_STANDARD_S2_S3 1 100 0 1 DISPLAY_IDENTIFIER f_KeyValidErr.IgnitionKeyStatusIn._.ZFFSAB ECU_ADDRESS 0xFFF90083 /end MEASUREMENT
/begin MEASUREMENT ZFFSAB._.DriverSeatStatusIn.iv_SeatBelt "Input value seatbelt detection" UBYTE SAB_STANDARD_S2_S3 1 100 0 3 DISPLAY_IDENTIFIER iv_SeatBelt.DriverSeatStatusIn._.ZFFSAB ECU_ADDRESS 0xFFF8F5F8 /end MEASUREMENT
/begin MEASUREMENT ZFFSAB._.DriverSeatStatusIn.iv_SeatBeltSts "Input value message status of seatbelt detection" UBYTE SAB_STANDARD_S2_S3 1 100 0 255 DISPLAY_IDENTIFIER iv_SeatBeltSts.DriverSeatStatusIn._.ZFFSAB ECU_ADDRESS 0xFFF8F5F9 /end MEASUREMENT
/begin MEASUREMENT ZFFSAB._.DriverSeatStatusIn.iv_SeatFL "Input value passenger detection" UBYTE SAB_STANDARD_S2_S3 1 100 0 7 DISPLAY_IDENTIFIER iv_SeatFL.DriverSeatStatusIn._.ZFFSAB ECU_ADDRESS 0xFFF8F5FA /end MEASUREMENT
/begin MEASUREMENT ZFFSAB._.DriverSeatStatusIn.iv_SeatFLSts "Input value message status of passenger detection" UBYTE SAB_STANDARD_S2_S3 1 100 0 255 DISPLAY_IDENTIFIER iv_SeatFLSts.DriverSeatStatusIn._.ZFFSAB ECU_ADDRESS 0xFFF8F5FB /end MEASUREMENT
/begin MEASUREMENT ZFFSAB._.DriverSeatStatusIn.sv_f_SeatBelt "Output value of seatbelt detection" UBYTE SAB_STANDARD_S2_S3 1 100 0 1 DISPLAY_IDENTIFIER sv_f_SeatBelt.DriverSeatStatusIn._.ZFFSAB ECU_ADDRESS 0xFFF8F5FC /end MEASUREMENT
/begin MEASUREMENT ZFFSAB._.DriverSeatStatusIn.sv_f_SeatFL "Output value of passenger detection" UBYTE SAB_STANDARD_S2_S3 1 100 0 1 DISPLAY_IDENTIFIER sv_f_SeatFL.DriverSeatStatusIn._.ZFFSAB ECU_ADDRESS 0xFFF8F5FD /end MEASUREMENT
/begin MEASUREMENT ZFFSAB._.DriverSeatStatusIn.sv_SeatBeltSts "Output value signal status of seatbelt detection" UBYTE SAB_STANDARD_S2_S3 1 100 0 2 DISPLAY_IDENTIFIER sv_SeatBeltSts.DriverSeatStatusIn._.ZFFSAB ECU_ADDRESS 0xFFF8F5FE /end MEASUREMENT
/begin MEASUREMENT ZFFSAB._.DriverSeatStatusIn.sv_SeatFLSts "Output value signal status of passenger detection" UBYTE SAB_STANDARD_S2_S3 1 100 0 2 DISPLAY_IDENTIFIER sv_SeatFLSts.DriverSeatStatusIn._.ZFFSAB ECU_ADDRESS 0xFFF8F5FF /end MEASUREMENT
/begin MEASUREMENT ZFFSAB._.DriverSeatStatusIn.f_SeatFLErr "Error flag of passenger detection" UBYTE SAB_STANDARD_S2_S3 1 100 0 1 DISPLAY_IDENTIFIER f_SeatFLErr.DriverSeatStatusIn._.ZFFSAB ECU_ADDRESS 0xFFF8F600 /end MEASUREMENT
/begin MEASUREMENT ZFFSAB._.DriverSeatStatusIn.f_SeatBeltErr "Error flag of seatbelt detection" UBYTE SAB_STANDARD_S2_S3 1 100 0 1 DISPLAY_IDENTIFIER f_SeatBeltErr.DriverSeatStatusIn._.ZFFSAB ECU_ADDRESS 0xFFF8F601 /end MEASUREMENT
/begin MEASUREMENT ZFFSAB._.SubstTempIn.iv_c_Chip1TransESts "Input raw signal EStatus Chiptemperature Sensor 1 (CG130)" UBYTE SAB_STANDARD_S2_S3 1 100 0 255 DISPLAY_IDENTIFIER iv_c_Chip1TransESts.SubstTempIn._.ZFFSAB ECU_ADDRESS 0xFFF8F670 /end MEASUREMENT
/begin MEASUREMENT ZFFSAB._.SubstTempIn.iv_c_Chip2TransESts "Input raw signal EStatus Chiptemperature Sensor 2 (LM71)" UBYTE SAB_STANDARD_S2_S3 1 100 0 255 DISPLAY_IDENTIFIER iv_c_Chip2TransESts.SubstTempIn._.ZFFSAB ECU_ADDRESS 0xFFF8F671 /end MEASUREMENT
/begin MEASUREMENT ZFFSAB._.SubstTempIn.iv_hot_modeLevel "Required temperaturmode from Gear transmission control by driving strategie" UBYTE SAB_STANDARD_S2_S3 1 100 0 2 DISPLAY_IDENTIFIER iv_hot_modeLevel.SubstTempIn._.ZFFSAB ECU_ADDRESS 0xFFF8F672 /end MEASUREMENT
/begin MEASUREMENT ZFFSAB._.SubstTempIn.iv_n_Eng "input signal engine speed" UWORD SAB_STANDARD_S2_S3 1 100 0 65535 DISPLAY_IDENTIFIER iv_n_Eng.SubstTempIn._.ZFFSAB ECU_ADDRESS 0xFFF8F674 /end MEASUREMENT
/begin MEASUREMENT ZFFSAB._.SubstTempIn.iv_n_EngSts "input signal engine speed" UBYTE SAB_STANDARD_S2_S3 1 100 0 255 DISPLAY_IDENTIFIER iv_n_EngSts.SubstTempIn._.ZFFSAB ECU_ADDRESS 0xFFF8F676 /end MEASUREMENT
/begin MEASUREMENT ZFFSAB._.SubstTempIn.PAK_counter_start "counter Pak calls in 10 ms Task" UBYTE SAB_STANDARD_S2_S3 1 100 0 19 DISPLAY_IDENTIFIER PAK_counter_start.SubstTempIn._.ZFFSAB ECU_ADDRESS 0xFFF8F677 /end MEASUREMENT
/begin MEASUREMENT ZFFSAB._.SubstTempIn.PAK_counter_start_ "complement of counter Pak calls in 10 ms Task" UBYTE SAB_STANDARD_S2_S3 1 100 0 19 DISPLAY_IDENTIFIER PAK_counter_start_.SubstTempIn._.ZFFSAB ECU_ADDRESS 0xFFF8F678 /end MEASUREMENT
/begin MEASUREMENT ZFFSAB._.SubstTempIn.PAK_counter_end "counter Pak calls in 10 ms Task" UBYTE SAB_STANDARD_S2_S3 1 100 0 19 DISPLAY_IDENTIFIER PAK_counter_end.SubstTempIn._.ZFFSAB ECU_ADDRESS 0xFFF8F679 /end MEASUREMENT
/begin MEASUREMENT ZFFSAB._.SubstTempIn.PAK_counter_end_ "complement of counter Pak calls in 10 ms Task" UBYTE SAB_STANDARD_S2_S3 1 100 0 19 DISPLAY_IDENTIFIER PAK_counter_end_.SubstTempIn._.ZFFSAB ECU_ADDRESS 0xFFF8F67A /end MEASUREMENT
/begin MEASUREMENT ZFFSAB._.AccelerationAcrossIn.iv_AyRef "Input value cross acceleration from CAN" UWORD SAB_A_2MPSS1000_M32500_S2_S3 1 100 -65 66.07 DISPLAY_IDENTIFIER iv_AyRef.AccelerationAcrossIn._.ZFFSAB ECU_ADDRESS 0xFFF8F858 /end MEASUREMENT
/begin MEASUREMENT ZFFSAB._.AccelerationAcrossIn.iv_AyRefErr "Input value qualifier of cross acceleration" UBYTE SAB_STANDARD_S2_S3 1 100 0 255 DISPLAY_IDENTIFIER iv_AyRefErr.AccelerationAcrossIn._.ZFFSAB ECU_ADDRESS 0xFFF8F85A /end MEASUREMENT
/begin MEASUREMENT ZFFSAB._.AccelerationAcrossIn.iv_AyRefSts "Input value message status of cross acceleration" UBYTE SAB_STANDARD_S2_S3 1 100 0 255 DISPLAY_IDENTIFIER iv_AyRefSts.AccelerationAcrossIn._.ZFFSAB ECU_ADDRESS 0xFFF8F85B /end MEASUREMENT
/begin MEASUREMENT ZFFSAB._.AccelerationAcrossIn.sv_AyRef "Output value cross acceleration" SWORD SAB_A_MPSS32_S2_S3 1 100 -65 66.0625 DISPLAY_IDENTIFIER sv_AyRef.AccelerationAcrossIn._.ZFFSAB ECU_ADDRESS 0xFFF8F85C /end MEASUREMENT
/begin MEASUREMENT ZFFSAB._.AccelerationAcrossIn.sv_AyRefSts "Output value signal status of cross acceleration" UBYTE SAB_STANDARD_S2_S3 1 100 0 2 DISPLAY_IDENTIFIER sv_AyRefSts.AccelerationAcrossIn._.ZFFSAB ECU_ADDRESS 0xFFF8F85E /end MEASUREMENT
/begin MEASUREMENT ZFFSAB._.AccelerationAcrossIn.f_AyRefErr "Error flag of cross acceleration" UBYTE SAB_STANDARD_S2_S3 1 100 0 1 DISPLAY_IDENTIFIER f_AyRefErr.AccelerationAcrossIn._.ZFFSAB ECU_ADDRESS 0xFFF8F85F /end MEASUREMENT
/begin MEASUREMENT ZFFSAB._.BrakeTorqueIn.iv_m_BrakeQF "qualifier signal for m_Brake" UBYTE SAB_STANDARD_S2_S3 1 100 0 15 DISPLAY_IDENTIFIER iv_m_BrakeQF.BrakeTorqueIn._.ZFFSAB ECU_ADDRESS 0xFFF8F874 /end MEASUREMENT
/begin MEASUREMENT ZFFSAB._.BrakeTorqueIn.iv_m_BrakeQF_ "complement qualifier signal for m_Brake" UBYTE SAB_STANDARD_S2_S3 1 100 0 255 DISPLAY_IDENTIFIER iv_m_BrakeQF_.BrakeTorqueIn._.ZFFSAB ECU_ADDRESS 0xFFF8F875 /end MEASUREMENT
/begin MEASUREMENT ZFFSAB._.BrakeTorqueIn.iv_m_Brake "The signal contains the sum of braketorque regarding the actual wheel. The signal is sent by the DSC-Controller. A negative braketorque corresponds to a frictional power of the vehicle movement." UWORD SAB_M_1NM_M32000_S2_S3 1 100 -32000 33535 DISPLAY_IDENTIFIER iv_m_Brake.BrakeTorqueIn._.ZFFSAB ECU_ADDRESS 0xFFF8F876 /end MEASUREMENT
/begin MEASUREMENT ZFFSAB._.BrakeTorqueIn.iv_m_Brake_ "complement of brake torque signal" UWORD SAB_STANDARD_S2_S3 1 100 0 65535 DISPLAY_IDENTIFIER iv_m_Brake_.BrakeTorqueIn._.ZFFSAB ECU_ADDRESS 0xFFF8F878 /end MEASUREMENT
/begin MEASUREMENT ZFFSAB._.BrakeTorqueIn.iv_m_BrakeSts "Input CAN message status of braketorque" UBYTE SAB_STANDARD_S2_S3 1 100 0 255 DISPLAY_IDENTIFIER iv_m_BrakeSts.BrakeTorqueIn._.ZFFSAB ECU_ADDRESS 0xFFF8F87A /end MEASUREMENT
/begin MEASUREMENT ZFFSAB._.BrakeTorqueIn.iv_m_BrakeSts_ "complement input CAN message status of braketorque" UBYTE SAB_STANDARD_S2_S3 1 100 0 255 DISPLAY_IDENTIFIER iv_m_BrakeSts_.BrakeTorqueIn._.ZFFSAB ECU_ADDRESS 0xFFF8F87B /end MEASUREMENT
/begin MEASUREMENT ZFFSAB._.BrakeTorqueIn.sv_m_Brake "Output signal of braketorque" UWORD SAB_M_1NM_M32000_S2_S3 1 100 -32000 33535 DISPLAY_IDENTIFIER sv_m_Brake.BrakeTorqueIn._.ZFFSAB ECU_ADDRESS 0xFFF8F87C /end MEASUREMENT
/begin MEASUREMENT ZFFSAB._.BrakeTorqueIn.sv_m_BrakeSts "Output status signal of braketorque" UBYTE SAB_STANDARD_S2_S3 1 100 0 2 DISPLAY_IDENTIFIER sv_m_BrakeSts.BrakeTorqueIn._.ZFFSAB ECU_ADDRESS 0xFFF8F87E /end MEASUREMENT
/begin MEASUREMENT ZFFSAB._.BrakeTorqueIn.sv_p_Brake "The calculated brakepressure output signal of braketorque" UWORD SAB_P_BAR2_S2_S3 1 100 0 255 DISPLAY_IDENTIFIER sv_p_Brake.BrakeTorqueIn._.ZFFSAB ECU_ADDRESS 0xFFF8F880 /end MEASUREMENT
/begin MEASUREMENT ZFFSAB._.BrakeTorqueIn.sv_p_Brake_ "The calculated complement brakepressure output signal of braketorque" UWORD SAB_STANDARD_S2_S3 1 100 0 65535 DISPLAY_IDENTIFIER sv_p_Brake_.BrakeTorqueIn._.ZFFSAB ECU_ADDRESS 0xFFF8F882 /end MEASUREMENT
/begin MEASUREMENT ZFFSAB._.BrakeTorqueIn.sv_p_BrakeSts "The calculated brakepressure output status signal of brakepressure" UBYTE SAB_STANDARD_S2_S3 1 100 0 2 DISPLAY_IDENTIFIER sv_p_BrakeSts.BrakeTorqueIn._.ZFFSAB ECU_ADDRESS 0xFFF8F884 /end MEASUREMENT
/begin MEASUREMENT ZFFSAB._.BrakeTorqueIn.sv_p_BrakeSts_ "The calculated complement brakepressure output status signal of brakepressure" UBYTE SAB_STANDARD_S2_S3 1 100 0 255 DISPLAY_IDENTIFIER sv_p_BrakeSts_.BrakeTorqueIn._.ZFFSAB ECU_ADDRESS 0xFFF8F885 /end MEASUREMENT
/begin MEASUREMENT ZFFSAB._.BrakeTorqueIn.f_p_BrakeErr "Error flag set by valid status and signal-error-value of brake pressure" UBYTE SAB_STANDARD_S2_S3 1 100 0 1 DISPLAY_IDENTIFIER f_p_BrakeErr.BrakeTorqueIn._.ZFFSAB ECU_ADDRESS 0xFFF8F886 /end MEASUREMENT
/begin MEASUREMENT ZFFSAB._.BrakeTorqueIn.f_m_BrakeErr "Error flag of m_Brake-signal" UBYTE SAB_STANDARD_S2_S3 1 100 0 1 DISPLAY_IDENTIFIER f_m_BrakeErr.BrakeTorqueIn._.ZFFSAB ECU_ADDRESS 0xFFF8F887 /end MEASUREMENT
/begin MEASUREMENT ZFFSAB._.CrankShaftCurTorqueIn.f_CrankErr "Error flag for current torque of crankshaft" UBYTE SAB_STANDARD_S2_S3 1 100 0 1 DISPLAY_IDENTIFIER f_CrankErr.CrankShaftCurTorqueIn._.ZFFSAB ECU_ADDRESS 0xFFF8F88C /end MEASUREMENT
/begin MEASUREMENT ZFFSAB._.CrankShaftCurTorqueIn.m_CrankCor "Intermediate value converted quantisation of current torque of crankshaft" SWORD SAB_M_1NM_S2_S3 1 100 -2048 2047.875 DISPLAY_IDENTIFIER m_CrankCor.CrankShaftCurTorqueIn._.ZFFSAB ECU_ADDRESS 0xFFF8F88E /end MEASUREMENT
/begin MEASUREMENT ZFFSAB._.CrankShaftCurTorqueIn.f_m_IstVMErr "Error flag for local diagnosis" UBYTE SAB_STANDARD_S2_S3 1 100 0 1 DISPLAY_IDENTIFIER f_m_IstVMErr.CrankShaftCurTorqueIn._.ZFFSAB ECU_ADDRESS 0xFFF8F890 /end MEASUREMENT
/begin MEASUREMENT ZFFSAB._.CrankShaftCurTorqueIn.f_m_IstEMErr "Error flag for local diagnosis" UBYTE SAB_STANDARD_S2_S3 1 100 0 1 DISPLAY_IDENTIFIER f_m_IstEMErr.CrankShaftCurTorqueIn._.ZFFSAB ECU_ADDRESS 0xFFF8F891 /end MEASUREMENT
/begin MEASUREMENT ZFFSAB._.CrankShaftCurTorqueIn.f_m_IstEMErr_ "Complement Error flag for local diagnosis" UBYTE SAB_STANDARD_S2_S3 1 100 0 1 DISPLAY_IDENTIFIER f_m_IstEMErr_.CrankShaftCurTorqueIn._.ZFFSAB ECU_ADDRESS 0xFFF8F892 /end MEASUREMENT
/begin MEASUREMENT ZFFSAB._.CrankShaftCurTorqueIn.m_IstVMCor "Intermediate value converted quantisation of current torque of crankshaft from combustion machine" SWORD SAB_M_1NM_S2_S3 1 100 -2048 2047 DISPLAY_IDENTIFIER m_IstVMCor.CrankShaftCurTorqueIn._.ZFFSAB ECU_ADDRESS 0xFFF8F894 /end MEASUREMENT
/begin MEASUREMENT ZFFSAB._.CrankShaftCurTorqueIn.m_IstEM1 "Intermediate value converted quantisation of current torque of crankshaft from electric machine" SWORD SAB_M_1NM_S2_S3 1 100 -2048 2047 DISPLAY_IDENTIFIER m_IstEM1.CrankShaftCurTorqueIn._.ZFFSAB ECU_ADDRESS 0xFFF8F896 /end MEASUREMENT
/begin MEASUREMENT ZFFSAB._.CrankShaftCurTorqueIn.m_IstEM1Lev2 "Intermediate value converted quantisation of current torque of crankshaft from electric machine" SWORD SAB_M_1NM_S2_S3 1 100 -2048 2047 DISPLAY_IDENTIFIER m_IstEM1Lev2.CrankShaftCurTorqueIn._.ZFFSAB ECU_ADDRESS 0xFFF8F898 /end MEASUREMENT
/begin MEASUREMENT ZFFSAB._.CrankShaftCurTorqueIn.f_m_IstVMLev2Err "Error flag for local diagnosis" UBYTE SAB_STANDARD_S2_S3 1 100 0 1 DISPLAY_IDENTIFIER f_m_IstVMLev2Err.CrankShaftCurTorqueIn._.ZFFSAB ECU_ADDRESS 0xFFF8F89A /end MEASUREMENT
/begin MEASUREMENT ZFFSAB._.CrankShaftCurTorqueIn.f_m_IstVMLev2Err_ "Complement Error flag for local diagnosis" UBYTE SAB_STANDARD_S2_S3 1 100 0 255 DISPLAY_IDENTIFIER f_m_IstVMLev2Err_.CrankShaftCurTorqueIn._.ZFFSAB ECU_ADDRESS 0xFFF8F89B /end MEASUREMENT
/begin MEASUREMENT ZFFSAB._.CrankShaftCurTorqueIn.f_m_IstEMLev2Err "Error flag for local diagnosis" UBYTE SAB_STANDARD_S2_S3 1 100 0 1 DISPLAY_IDENTIFIER f_m_IstEMLev2Err.CrankShaftCurTorqueIn._.ZFFSAB ECU_ADDRESS 0xFFF8F89C /end MEASUREMENT
/begin MEASUREMENT ZFFSAB._.CrankShaftCurTorqueIn.f_m_IstEMLev2Err_ "Complement Error flag for local diagnosis" UBYTE SAB_STANDARD_S2_S3 1 100 0 255 DISPLAY_IDENTIFIER f_m_IstEMLev2Err_.CrankShaftCurTorqueIn._.ZFFSAB ECU_ADDRESS 0xFFF8F89D /end MEASUREMENT
/begin MEASUREMENT ZFFSAB._.CrankShaftCurTorqueIn.iv_m_Crank "Input value of current torque of crankshaft from CAN" UWORD SAB_M_NM2_M2047_S2_S3 1 100 -1023.5 1023.5 DISPLAY_IDENTIFIER iv_m_Crank.CrankShaftCurTorqueIn._.ZFFSAB ECU_ADDRESS 0xFFF8F89E /end MEASUREMENT
/begin MEASUREMENT ZFFSAB._.CrankShaftCurTorqueIn.iv_m_Crank_ "Input value of current torque of crankshaft from CAN (Complement)" UWORD SAB_STANDARD_S2_S3 1 100 0 4094 DISPLAY_IDENTIFIER iv_m_Crank_.CrankShaftCurTorqueIn._.ZFFSAB ECU_ADDRESS 0xFFF8F8A0 /end MEASUREMENT
/begin MEASUREMENT ZFFSAB._.CrankShaftCurTorqueIn.iv_m_CrankSts "Input value message status of current torque of crankshaft" UBYTE SAB_STANDARD_S2_S3 1 100 0 255 DISPLAY_IDENTIFIER iv_m_CrankSts.CrankShaftCurTorqueIn._.ZFFSAB ECU_ADDRESS 0xFFF8F8A2 /end MEASUREMENT
/begin MEASUREMENT ZFFSAB._.CrankShaftCurTorqueIn.iv_m_CrankSts_ "Input value message status of current torque of crankshaft" UBYTE SAB_STANDARD_S2_S3 1 100 0 255 DISPLAY_IDENTIFIER iv_m_CrankSts_.CrankShaftCurTorqueIn._.ZFFSAB ECU_ADDRESS 0xFFF8F8A3 /end MEASUREMENT
/begin MEASUREMENT ZFFSAB._.CrankShaftCurTorqueIn.iv_m_PumpCensored "Input value of pump intake torque with coefficient from class PumpIntakeTorqueOut" SWORD SAB_M_1NM_S2_S3 1 100 0 30 DISPLAY_IDENTIFIER iv_m_PumpCensored.CrankShaftCurTorqueIn._.ZFFSAB ECU_ADDRESS 0xFFF8F8A4 /end MEASUREMENT
/begin MEASUREMENT ZFFSAB._.CrankShaftCurTorqueIn.iv_m_IstVM "Input value of current crankshaft torque from CAN - but only combustion machine is considered" UWORD SAB_M_NM2_M2047_S2_S3 1 100 -1023.5 1023.5 DISPLAY_IDENTIFIER iv_m_IstVM.CrankShaftCurTorqueIn._.ZFFSAB ECU_ADDRESS 0xFFF8F8A6 /end MEASUREMENT
/begin MEASUREMENT ZFFSAB._.CrankShaftCurTorqueIn.iv_m_IstVM_ "Input value of current crankshaft torque from CAN - but only combustion machine is considered" UWORD SAB_STANDARD_S2_S3 1 100 0 65535 DISPLAY_IDENTIFIER iv_m_IstVM_.CrankShaftCurTorqueIn._.ZFFSAB ECU_ADDRESS 0xFFF8F8A8 /end MEASUREMENT
/begin MEASUREMENT ZFFSAB._.CrankShaftCurTorqueIn.iv_m_IstVMSts "Input value of current torque of crankshaft from CAN - but only combustion machine is considered" UBYTE SAB_STANDARD_S2_S3 1 100 0 255 DISPLAY_IDENTIFIER iv_m_IstVMSts.CrankShaftCurTorqueIn._.ZFFSAB ECU_ADDRESS 0xFFF8F8AA /end MEASUREMENT
/begin MEASUREMENT ZFFSAB._.CrankShaftCurTorqueIn.iv_m_IstVMSts_ "Input value of current torque of crankshaft from CAN - but only combustion machine is considered" UBYTE SAB_STANDARD_S2_S3 1 100 0 255 DISPLAY_IDENTIFIER iv_m_IstVMSts_.CrankShaftCurTorqueIn._.ZFFSAB ECU_ADDRESS 0xFFF8F8AB /end MEASUREMENT
/begin MEASUREMENT ZFFSAB._.CrankShaftCurTorqueIn.iv_m_IstEM "Input value of current crankshaft torque from CAN - but only the electrical machine is considered" UWORD SAB_M_NM2_M2047_S2_S3 1 100 -1023.5 1023.5 DISPLAY_IDENTIFIER iv_m_IstEM.CrankShaftCurTorqueIn._.ZFFSAB ECU_ADDRESS 0xFFF8F8AC /end MEASUREMENT
/begin MEASUREMENT ZFFSAB._.CrankShaftCurTorqueIn.iv_m_IstEM_ "Input value of current crankshaft torque from CAN - but only the electrical machine is considered" UWORD SAB_STANDARD_S2_S3 1 100 0 65535 DISPLAY_IDENTIFIER iv_m_IstEM_.CrankShaftCurTorqueIn._.ZFFSAB ECU_ADDRESS 0xFFF8F8AE /end MEASUREMENT
/begin MEASUREMENT ZFFSAB._.CrankShaftCurTorqueIn.iv_m_IstEMSts "Input value of current crankshaft torque from CAN - but only the electrical machine is considered" UBYTE SAB_STANDARD_S2_S3 1 100 0 255 DISPLAY_IDENTIFIER iv_m_IstEMSts.CrankShaftCurTorqueIn._.ZFFSAB ECU_ADDRESS 0xFFF8F8B0 /end MEASUREMENT
/begin MEASUREMENT ZFFSAB._.CrankShaftCurTorqueIn.iv_m_IstEMSts_ "Input value of current crankshaft torque from CAN - but only the electrical machine is considered" UBYTE SAB_STANDARD_S2_S3 1 100 0 255 DISPLAY_IDENTIFIER iv_m_IstEMSts_.CrankShaftCurTorqueIn._.ZFFSAB ECU_ADDRESS 0xFFF8F8B1 /end MEASUREMENT
/begin MEASUREMENT ZFFSAB._.CrankShaftCurTorqueIn.sv_m_Crank "Output value of current torque of crankshaft corrected by the pump intake torque" SWORD SAB_M_1NM_S2_S3 1 100 -400 1640 DISPLAY_IDENTIFIER sv_m_Crank.CrankShaftCurTorqueIn._.ZFFSAB ECU_ADDRESS 0xFFF8F8B2 /end MEASUREMENT
/begin MEASUREMENT ZFFSAB._.CrankShaftCurTorqueIn.sv_m_CrankLev2 "Output value of current torque of crankshaft corrected by the pump intake torque (Complement)" SWORD SAB_M_1NM_S2_S3 1 100 -400 1640 DISPLAY_IDENTIFIER sv_m_CrankLev2.CrankShaftCurTorqueIn._.ZFFSAB ECU_ADDRESS 0xFFF8F8B4 /end MEASUREMENT
/begin MEASUREMENT ZFFSAB._.CrankShaftCurTorqueIn.sv_m_CrankLev2_ "Output value of current torque of crankshaft corrected by the pump intake torque (Complement)" SWORD SAB_STANDARD_S2_S3 1 100 -1024 1023 DISPLAY_IDENTIFIER sv_m_CrankLev2_.CrankShaftCurTorqueIn._.ZFFSAB ECU_ADDRESS 0xFFF8F8B6 /end MEASUREMENT
/begin MEASUREMENT ZFFSAB._.CrankShaftCurTorqueIn.sv_m_CrankSts "Output value signal status of current torque of crankshaft" UBYTE SAB_STANDARD_S2_S3 1 100 0 2 DISPLAY_IDENTIFIER sv_m_CrankSts.CrankShaftCurTorqueIn._.ZFFSAB ECU_ADDRESS 0xFFF8F8B8 /end MEASUREMENT
/begin MEASUREMENT ZFFSAB._.CrankShaftCurTorqueIn.sv_m_CrankSts_ "Output value signal status of current torque of crankshaft complement" UBYTE SAB_STANDARD_S2_S3 1 100 0 255 DISPLAY_IDENTIFIER sv_m_CrankSts_.CrankShaftCurTorqueIn._.ZFFSAB ECU_ADDRESS 0xFFF8F8B9 /end MEASUREMENT
/begin MEASUREMENT ZFFSAB._.CrankShaftCurTorqueIn.sv_m_Ind "Output value of current torque of crankshaft" UWORD SAB_M_1NM_S2_S3 1 100 0 3101 DISPLAY_IDENTIFIER sv_m_Ind.CrankShaftCurTorqueIn._.ZFFSAB ECU_ADDRESS 0xFFF8F8BA /end MEASUREMENT
/begin MEASUREMENT ZFFSAB._.CrankShaftCurTorqueIn.sv_m_IstVM "Output value of current torque of crankshaft - only combustion machine is considered" SWORD SAB_M_1NM_S2_S3 1 100 -400 1640 DISPLAY_IDENTIFIER sv_m_IstVM.CrankShaftCurTorqueIn._.ZFFSAB ECU_ADDRESS 0xFFF8F8BC /end MEASUREMENT
/begin MEASUREMENT ZFFSAB._.CrankShaftCurTorqueIn.sv_m_IstVMSts "Output status of current torque of crankshaft - but only combustion machine is considered" UBYTE SAB_STANDARD_S2_S3 1 100 0 2 DISPLAY_IDENTIFIER sv_m_IstVMSts.CrankShaftCurTorqueIn._.ZFFSAB ECU_ADDRESS 0xFFF8F8BE /end MEASUREMENT
/begin MEASUREMENT ZFFSAB._.CrankShaftCurTorqueIn.sv_m_IstEM "Output value of current torque - only electrical machine is considered" SWORD SAB_M_1NM_S2_S3 1 100 -400 1640 DISPLAY_IDENTIFIER sv_m_IstEM.CrankShaftCurTorqueIn._.ZFFSAB ECU_ADDRESS 0xFFF8F8C0 /end MEASUREMENT
/begin MEASUREMENT ZFFSAB._.CrankShaftCurTorqueIn.sv_m_IstEMSts "Output status of current torque from electrical machine" UBYTE SAB_STANDARD_S2_S3 1 100 0 2 DISPLAY_IDENTIFIER sv_m_IstEMSts.CrankShaftCurTorqueIn._.ZFFSAB ECU_ADDRESS 0xFFF8F8C2 /end MEASUREMENT
/begin MEASUREMENT ZFFSAB._.CrankShaftCurTorqueIn.sv_m_IstVMLev2 "Output value of current torque of crankshaft - only combustion machine is considered" SWORD SAB_M_1NM_S2_S3 1 100 -400 1640 DISPLAY_IDENTIFIER sv_m_IstVMLev2.CrankShaftCurTorqueIn._.ZFFSAB ECU_ADDRESS 0xFFF8F8C4 /end MEASUREMENT
/begin MEASUREMENT ZFFSAB._.CrankShaftCurTorqueIn.sv_m_IstVMLev2_ "Output value of current torque of crankshaft - only combustion machine is considered" SWORD SAB_STANDARD_S2_S3 1 100 -32768 32767 DISPLAY_IDENTIFIER sv_m_IstVMLev2_.CrankShaftCurTorqueIn._.ZFFSAB ECU_ADDRESS 0xFFF8F8C6 /end MEASUREMENT
/begin MEASUREMENT ZFFSAB._.CrankShaftCurTorqueIn.sv_m_IstVMLev2Sts "Output status of current torque of crankshaft - but only combustion machine is considered" UBYTE SAB_STANDARD_S2_S3 1 100 0 2 DISPLAY_IDENTIFIER sv_m_IstVMLev2Sts.CrankShaftCurTorqueIn._.ZFFSAB ECU_ADDRESS 0xFFF8F8C8 /end MEASUREMENT
/begin MEASUREMENT ZFFSAB._.CrankShaftCurTorqueIn.sv_m_IstVMLev2Sts_ "Output status of current torque of crankshaft - but only combustion machine is considered" UBYTE SAB_STANDARD_S2_S3 1 100 0 255 DISPLAY_IDENTIFIER sv_m_IstVMLev2Sts_.CrankShaftCurTorqueIn._.ZFFSAB ECU_ADDRESS 0xFFF8F8C9 /end MEASUREMENT
/begin MEASUREMENT ZFFSAB._.CrankShaftCurTorqueIn.sv_m_IstEMLev2 "Output value of current torque - only electrical machine is considered" SWORD SAB_M_1NM_S2_S3 1 100 -400 1640 DISPLAY_IDENTIFIER sv_m_IstEMLev2.CrankShaftCurTorqueIn._.ZFFSAB ECU_ADDRESS 0xFFF8F8CA /end MEASUREMENT
/begin MEASUREMENT ZFFSAB._.CrankShaftCurTorqueIn.sv_m_IstEMLev2_ "Output value of current torque - only electrical machine is considered" SWORD SAB_STANDARD_S2_S3 1 100 -32768 32767 DISPLAY_IDENTIFIER sv_m_IstEMLev2_.CrankShaftCurTorqueIn._.ZFFSAB ECU_ADDRESS 0xFFF8F8CC /end MEASUREMENT
/begin MEASUREMENT ZFFSAB._.CrankShaftCurTorqueIn.sv_m_IstEMLev2Sts "Output status of current torque from electrical machine" UBYTE SAB_STANDARD_S2_S3 1 100 0 2 DISPLAY_IDENTIFIER sv_m_IstEMLev2Sts.CrankShaftCurTorqueIn._.ZFFSAB ECU_ADDRESS 0xFFF8F8CE /end MEASUREMENT
/begin MEASUREMENT ZFFSAB._.CrankShaftCurTorqueIn.sv_m_IstEMLev2Sts_ "Output status of current torque from electrical machine" UBYTE SAB_STANDARD_S2_S3 1 100 0 255 DISPLAY_IDENTIFIER sv_m_IstEMLev2Sts_.CrankShaftCurTorqueIn._.ZFFSAB ECU_ADDRESS 0xFFF8F8CF /end MEASUREMENT
/begin MEASUREMENT ZFFSAB._.CrankShaftCurTorqueIn.sv_AGS_MVm "Output value of current torque of crankshaft for LayerAGS - only combustion machine is considered" SWORD SAB_M_NM2_S2_S3 1 100 -1023.5 1023.5 DISPLAY_IDENTIFIER sv_AGS_MVm.CrankShaftCurTorqueIn._.ZFFSAB ECU_ADDRESS 0xFFF8F8D0 /end MEASUREMENT
/begin MEASUREMENT ZFFSAB._.CrankShaftCurTorqueIn.sv_AGS_MMotIst "Output value of Actual engine torque of crankshaft for LayerAGS" SWORD SAB_M_1NM_S2_S3 1 100 -8192 8192 DISPLAY_IDENTIFIER sv_AGS_MMotIst.CrankShaftCurTorqueIn._.ZFFSAB ECU_ADDRESS 0xFFF8F8D2 /end MEASUREMENT
/begin MEASUREMENT ZFFSAB._.DesiredTorqueIn.iv_m_DriverDes "Input value for desired torque" UWORD SAB_M_NM2_M2047_S2_S3 1 100 -1023.5 1023.5 DISPLAY_IDENTIFIER iv_m_DriverDes.DesiredTorqueIn._.ZFFSAB ECU_ADDRESS 0xFFF8F8D8 /end MEASUREMENT
/begin MEASUREMENT ZFFSAB._.DesiredTorqueIn.iv_m_DriverDes_ "Complement input value for desired torque" UWORD SAB_STANDARD_S2_S3 1 100 0 65535 DISPLAY_IDENTIFIER iv_m_DriverDes_.DesiredTorqueIn._.ZFFSAB ECU_ADDRESS 0xFFF8F8DA /end MEASUREMENT
/begin MEASUREMENT ZFFSAB._.DesiredTorqueIn.iv_m_DriverDesSts "Input value for message status of CAN-message" UBYTE SAB_STANDARD_S2_S3 1 100 0 255 DISPLAY_IDENTIFIER iv_m_DriverDesSts.DesiredTorqueIn._.ZFFSAB ECU_ADDRESS 0xFFF8F8DC /end MEASUREMENT
/begin MEASUREMENT ZFFSAB._.DesiredTorqueIn.iv_m_DriverDesSts_ "Input value for message status of CAN-message" UBYTE SAB_STANDARD_S2_S3 1 100 0 255 DISPLAY_IDENTIFIER iv_m_DriverDesSts_.DesiredTorqueIn._.ZFFSAB ECU_ADDRESS 0xFFF8F8DD /end MEASUREMENT
/begin MEASUREMENT ZFFSAB._.DesiredTorqueIn.iv_m_EngMax "Input value from HPSYS for max torque" SWORD SAB_M_1NM_S2_S3 1 100 -32768 32767 DISPLAY_IDENTIFIER iv_m_EngMax.DesiredTorqueIn._.ZFFSAB ECU_ADDRESS 0xFFF8F8DE /end MEASUREMENT
/begin MEASUREMENT ZFFSAB._.DesiredTorqueIn.iv_m_PumpCensored "Input value of pump intake torque with coefficient from class PumpIntakeTorqueOut" SWORD SAB_M_1NM_S2_S3 1 100 -32768 32767 DISPLAY_IDENTIFIER iv_m_PumpCensored.DesiredTorqueIn._.ZFFSAB ECU_ADDRESS 0xFFF8F8E0 /end MEASUREMENT
/begin MEASUREMENT ZFFSAB._.DesiredTorqueIn.iv_m_DriverDesVM "Input value for desired torque from combustion engine" UWORD SAB_M_NM2_M2047_S2_S3 1 100 -1023.5 1023.5 DISPLAY_IDENTIFIER iv_m_DriverDesVM.DesiredTorqueIn._.ZFFSAB ECU_ADDRESS 0xFFF8F8E2 /end MEASUREMENT
/begin MEASUREMENT ZFFSAB._.DesiredTorqueIn.iv_m_DriverDesVMSts "Input value for message status of CAN-message desired torque from combustion engine" UBYTE SAB_STANDARD_S2_S3 1 100 0 2 DISPLAY_IDENTIFIER iv_m_DriverDesVMSts.DesiredTorqueIn._.ZFFSAB ECU_ADDRESS 0xFFF8F8E4 /end MEASUREMENT
/begin MEASUREMENT ZFFSAB._.DesiredTorqueIn.iv_m_DriverDesEM "Input value of desired torque from electrical machine" UWORD SAB_M_NM2_M2047_S2_S3 1 100 -1023.5 1023.5 DISPLAY_IDENTIFIER iv_m_DriverDesEM.DesiredTorqueIn._.ZFFSAB ECU_ADDRESS 0xFFF8F8E6 /end MEASUREMENT
/begin MEASUREMENT ZFFSAB._.DesiredTorqueIn.iv_m_DriverDesEMSts "Input value for message status of CAN-message desired torque from electrical machine" UBYTE SAB_STANDARD_S2_S3 1 100 0 2 DISPLAY_IDENTIFIER iv_m_DriverDesEMSts.DesiredTorqueIn._.ZFFSAB ECU_ADDRESS 0xFFF8F8E8 /end MEASUREMENT
/begin MEASUREMENT ZFFSAB._.DesiredTorqueIn.iv_m_MaxIncrVM "Input value setting range of torque from combustion engine" UWORD SAB_M_NM2_M2047_S2_S3 1 100 -1023.5 1023.5 DISPLAY_IDENTIFIER iv_m_MaxIncrVM.DesiredTorqueIn._.ZFFSAB ECU_ADDRESS 0xFFF8F8EA /end MEASUREMENT
/begin MEASUREMENT ZFFSAB._.DesiredTorqueIn.iv_m_MaxIncrVMSts "Input value for message status of CAN-message setting range of torque from combustion engine" UBYTE SAB_STANDARD_S2_S3 1 100 0 255 DISPLAY_IDENTIFIER iv_m_MaxIncrVMSts.DesiredTorqueIn._.ZFFSAB ECU_ADDRESS 0xFFF8F8EC /end MEASUREMENT
/begin MEASUREMENT ZFFSAB._.DesiredTorqueIn.sv_m_EngDes "Output value for desired engine torque" SWORD SAB_M_1NM_S2_S3 1 100 -1023 1023 DISPLAY_IDENTIFIER sv_m_EngDes.DesiredTorqueIn._.ZFFSAB ECU_ADDRESS 0xFFF8F8EE /end MEASUREMENT
/begin MEASUREMENT ZFFSAB._.DesiredTorqueIn.sv_m_EngDesLev2 "Output value for desired engine torque" SWORD SAB_M_1NM_S2_S3 1 100 -1023 1023 DISPLAY_IDENTIFIER sv_m_EngDesLev2.DesiredTorqueIn._.ZFFSAB ECU_ADDRESS 0xFFF8F8F0 /end MEASUREMENT
/begin MEASUREMENT ZFFSAB._.DesiredTorqueIn.sv_m_EngDesLev2_ "Complement output value for desired engine torque" SWORD SAB_STANDARD_S2_S3 1 100 -32767 32767 DISPLAY_IDENTIFIER sv_m_EngDesLev2_.DesiredTorqueIn._.ZFFSAB ECU_ADDRESS 0xFFF8F8F2 /end MEASUREMENT
/begin MEASUREMENT ZFFSAB._.DesiredTorqueIn.sv_m_EngDesSts "Output value for signal status of desired engine torque" UBYTE SAB_STANDARD_S2_S3 1 100 0 2 DISPLAY_IDENTIFIER sv_m_EngDesSts.DesiredTorqueIn._.ZFFSAB ECU_ADDRESS 0xFFF8F8F4 /end MEASUREMENT
/begin MEASUREMENT ZFFSAB._.DesiredTorqueIn.sv_m_EngDesLev2Sts "Output value for signal status of desired engine torque" UBYTE SAB_STANDARD_S2_S3 1 100 0 2 DISPLAY_IDENTIFIER sv_m_EngDesLev2Sts.DesiredTorqueIn._.ZFFSAB ECU_ADDRESS 0xFFF8F8F5 /end MEASUREMENT
/begin MEASUREMENT ZFFSAB._.DesiredTorqueIn.sv_m_EngDesLev2Sts_ "Output value for signal status of desired engine torque" UBYTE SAB_STANDARD_S2_S3 1 100 0 255 DISPLAY_IDENTIFIER sv_m_EngDesLev2Sts_.DesiredTorqueIn._.ZFFSAB ECU_ADDRESS 0xFFF8F8F6 /end MEASUREMENT
/begin MEASUREMENT ZFFSAB._.DesiredTorqueIn.sv_m_EngDesVM "Output value of desired engine torque from combustion machine" SWORD SAB_M_1NM_S2_S3 1 100 -1023 1023 DISPLAY_IDENTIFIER sv_m_EngDesVM.DesiredTorqueIn._.ZFFSAB ECU_ADDRESS 0xFFF8F8F8 /end MEASUREMENT
/begin MEASUREMENT ZFFSAB._.DesiredTorqueIn.sv_m_EngDesVMSts "Output status of desired torque signal from combustion machine" UBYTE SAB_STANDARD_S2_S3 1 100 0 2 DISPLAY_IDENTIFIER sv_m_EngDesVMSts.DesiredTorqueIn._.ZFFSAB ECU_ADDRESS 0xFFF8F8FA /end MEASUREMENT
/begin MEASUREMENT ZFFSAB._.DesiredTorqueIn.sv_m_EngDesEM "Output value of desired engine torque from electrical machine" SWORD SAB_M_1NM_S2_S3 1 100 -1023 1023 DISPLAY_IDENTIFIER sv_m_EngDesEM.DesiredTorqueIn._.ZFFSAB ECU_ADDRESS 0xFFF8F8FC /end MEASUREMENT
/begin MEASUREMENT ZFFSAB._.DesiredTorqueIn.sv_m_EngDesEMSts "Output status of desired torque signal from electrical machine" UBYTE SAB_STANDARD_S2_S3 1 100 0 2 DISPLAY_IDENTIFIER sv_m_EngDesEMSts.DesiredTorqueIn._.ZFFSAB ECU_ADDRESS 0xFFF8F8FE /end MEASUREMENT
/begin MEASUREMENT ZFFSAB._.DesiredTorqueIn.sv_m_MaxIncrVM "Output value setting range of torque from combustion machine" SWORD SAB_M_1NM_S2_S3 1 100 -400 1640 DISPLAY_IDENTIFIER sv_m_MaxIncrVM.DesiredTorqueIn._.ZFFSAB ECU_ADDRESS 0xFFF8F900 /end MEASUREMENT
/begin MEASUREMENT ZFFSAB._.DesiredTorqueIn.sv_m_MaxIncrVMSts "Output status of signal setting range of torque from combustion machine" UBYTE SAB_STANDARD_S2_S3 1 100 0 2 DISPLAY_IDENTIFIER sv_m_MaxIncrVMSts.DesiredTorqueIn._.ZFFSAB ECU_ADDRESS 0xFFF8F902 /end MEASUREMENT
/begin MEASUREMENT ZFFSAB._.DesiredTorqueIn.sv_AGS_MKwFW "Output value of desired engine torque for AGS-Layer" SWORD SAB_M_1NM_S2_S3 1 100 -8192 8192 DISPLAY_IDENTIFIER sv_AGS_MKwFW.DesiredTorqueIn._.ZFFSAB ECU_ADDRESS 0xFFF8F904 /end MEASUREMENT
/begin MEASUREMENT ZFFSAB._.DesiredTorqueIn.sv_m_DriverDesMod "Output value of modified desired engine torque" SWORD SAB_M_1NM_S2_S3 1 100 -400 1640 DISPLAY_IDENTIFIER sv_m_DriverDesMod.DesiredTorqueIn._.ZFFSAB ECU_ADDRESS 0xFFF8F906 /end MEASUREMENT
/begin MEASUREMENT ZFFSAB._.DesiredTorqueIn.f_m_DSCErr "Error flag for desired torque calculated from iv_m_DSCRangePositiveDesSts and iv_m_DSCDes and iv_m_DSCStsDes" UBYTE SAB_STANDARD_S2_S3 1 100 0 255 DISPLAY_IDENTIFIER f_m_DSCErr.DesiredTorqueIn._.ZFFSAB ECU_ADDRESS 0xFFF8F908 /end MEASUREMENT
/begin MEASUREMENT ZFFSAB._.DesiredTorqueIn.m_EngDesCor1 "REPRESENT_INTERMEDIATE value for desired torque" SWORD SAB_M_1NM_S2_S3 1 100 -1023 1023 DISPLAY_IDENTIFIER m_EngDesCor1.DesiredTorqueIn._.ZFFSAB ECU_ADDRESS 0xFFF8F90A /end MEASUREMENT
/begin MEASUREMENT ZFFSAB._.DesiredTorqueIn.m_DSCRangePositiveDesSts "Output Status value for desired torque range" UBYTE SAB_STANDARD_S2_S3 1 100 0 2 DISPLAY_IDENTIFIER m_DSCRangePositiveDesSts.DesiredTorqueIn._.ZFFSAB ECU_ADDRESS 0xFFF8F90C /end MEASUREMENT
/begin MEASUREMENT ZFFSAB._.DesiredTorqueIn.m_DSCStsDesSts "REPRESENT_INTERMEDIATE value for status of desired torque" UBYTE SAB_STANDARD_S2_S3 1 100 0 3 DISPLAY_IDENTIFIER m_DSCStsDesSts.DesiredTorqueIn._.ZFFSAB ECU_ADDRESS 0xFFF8F90D /end MEASUREMENT
/begin MEASUREMENT ZFFSAB._.DesiredTorqueIn.m_DriverDesSts "Status of desired torque" UBYTE SAB_STANDARD_S2_S3 1 100 0 2 DISPLAY_IDENTIFIER m_DriverDesSts.DesiredTorqueIn._.ZFFSAB ECU_ADDRESS 0xFFF8F90E /end MEASUREMENT
/begin MEASUREMENT ZFFSAB._.DesiredTorqueIn.m_EngDesVMCor1 "REPRESENT_INTERMEDIATE value for desired torque from combustion machine" SWORD SAB_M_1NM_S2_S3 1 100 -1023 1023 DISPLAY_IDENTIFIER m_EngDesVMCor1.DesiredTorqueIn._.ZFFSAB ECU_ADDRESS 0xFFF8F910 /end MEASUREMENT
/begin MEASUREMENT ZFFSAB._.DesiredTorqueIn.m_DriverDesVMSts "Status of desired torque from combustion machine" UBYTE SAB_STANDARD_S2_S3 1 100 0 2 DISPLAY_IDENTIFIER m_DriverDesVMSts.DesiredTorqueIn._.ZFFSAB ECU_ADDRESS 0xFFF8F912 /end MEASUREMENT
/begin MEASUREMENT ZFFSAB._.DesiredTorqueIn.m_EngDesEMCor1 "REPRESENT_INTERMEDIATE value for desired torque from electrical machine" SWORD SAB_M_1NM_S2_S3 1 100 -1023 1023 DISPLAY_IDENTIFIER m_EngDesEMCor1.DesiredTorqueIn._.ZFFSAB ECU_ADDRESS 0xFFF8F914 /end MEASUREMENT
/begin MEASUREMENT ZFFSAB._.DesiredTorqueIn.m_DriverDesEMSts "Status of desired torque from combustion electrical machine" UBYTE SAB_STANDARD_S2_S3 1 100 0 2 DISPLAY_IDENTIFIER m_DriverDesEMSts.DesiredTorqueIn._.ZFFSAB ECU_ADDRESS 0xFFF8F916 /end MEASUREMENT
/begin MEASUREMENT ZFFSAB._.DesiredTorqueIn.m_EngDesCor2 "Intermediate value for desired torque" SWORD SAB_M_1NM_S2_S3 1 100 -1023 1023 DISPLAY_IDENTIFIER m_EngDesCor2.DesiredTorqueIn._.ZFFSAB ECU_ADDRESS 0xFFF8F918 /end MEASUREMENT
/begin MEASUREMENT ZFFSAB._.DesiredTorqueIn.m_EngDesVMCor2 "Intermediate value for desired torque from combustion machine" SWORD SAB_M_1NM_S2_S3 1 100 -1023 1023 DISPLAY_IDENTIFIER m_EngDesVMCor2.DesiredTorqueIn._.ZFFSAB ECU_ADDRESS 0xFFF8F91A /end MEASUREMENT
/begin MEASUREMENT ZFFSAB._.DesiredTorqueIn.m_EngDesEMCor2 "Intermediate value for desired torque from electrical machine" SWORD SAB_M_1NM_S2_S3 1 100 -1023 1023 DISPLAY_IDENTIFIER m_EngDesEMCor2.DesiredTorqueIn._.ZFFSAB ECU_ADDRESS 0xFFF8F91C /end MEASUREMENT
/begin MEASUREMENT ZFFSAB._.DesiredTorqueIn.m_EngDesCor3 "REPRESENT_INTERMEDIATE value for desired torque" SWORD SAB_M_1NM_S2_S3 1 100 -1023 1023 DISPLAY_IDENTIFIER m_EngDesCor3.DesiredTorqueIn._.ZFFSAB ECU_ADDRESS 0xFFF8F91E /end MEASUREMENT
/begin MEASUREMENT ZFFSAB._.DesiredTorqueIn.f_m_EngDesLev2Err "Error flag for desired torque calculated from iv_m_DriverDes" UBYTE SAB_STANDARD_S2_S3 1 100 0 1 DISPLAY_IDENTIFIER f_m_EngDesLev2Err.DesiredTorqueIn._.ZFFSAB ECU_ADDRESS 0xFFF8F920 /end MEASUREMENT
/begin MEASUREMENT ZFFSAB._.DesiredTorqueIn.f_m_EngDesLev2Err_ "Complement Error flag for desired torque calculated from iv_m_DriverDes" UBYTE SAB_STANDARD_S2_S3 1 100 0 255 DISPLAY_IDENTIFIER f_m_EngDesLev2Err_.DesiredTorqueIn._.ZFFSAB ECU_ADDRESS 0xFFF8F921 /end MEASUREMENT
/begin MEASUREMENT ZFFSAB._.DesiredTorqueIn.m_EngDesCor2Lev2 "Intermediate value for desired torque" SWORD SAB_M_1NM_S2_S3 1 100 -1023 1023 DISPLAY_IDENTIFIER m_EngDesCor2Lev2.DesiredTorqueIn._.ZFFSAB ECU_ADDRESS 0xFFF8F922 /end MEASUREMENT
/begin MEASUREMENT ZFFSAB._.DesiredTorqueIn.m_EngDesCor3Lev2 "Intermediate value for desired torque" SWORD SAB_M_1NM_S2_S3 1 100 -1023 1023 DISPLAY_IDENTIFIER m_EngDesCor3Lev2.DesiredTorqueIn._.ZFFSAB ECU_ADDRESS 0xFFF8F924 /end MEASUREMENT
/begin MEASUREMENT ZFFSAB._.DesiredTorqueIn.m_EngDesCor3Lev2_ "Complement intermediate value for desired torque" SWORD SAB_M_1NM_S2_S3 1 100 -32768 32767 DISPLAY_IDENTIFIER m_EngDesCor3Lev2_.DesiredTorqueIn._.ZFFSAB ECU_ADDRESS 0xFFF8F926 /end MEASUREMENT
/begin MEASUREMENT ZFFSAB._.DesiredTorqueIn.f_m_EngDesErr_ "Complement of Error flag for desired torque calculated from iv_m_DriverDes" UBYTE SAB_STANDARD_S2_S3 1 100 254 255 DISPLAY_IDENTIFIER f_m_EngDesErr_.DesiredTorqueIn._.ZFFSAB ECU_ADDRESS 0xFFF8F928 /end MEASUREMENT
/begin MEASUREMENT ZFFSAB._.DesiredTorqueIn.f_m_EngDesVMErr "Error flag for desired torque calculated from iv_m_DriverDesVM" UBYTE SAB_STANDARD_S2_S3 1 100 0 1 DISPLAY_IDENTIFIER f_m_EngDesVMErr.DesiredTorqueIn._.ZFFSAB ECU_ADDRESS 0xFFF8F929 /end MEASUREMENT
/begin MEASUREMENT ZFFSAB._.DesiredTorqueIn.m_DriverDesVM "Intermediate value for desired torque from combustion machine" SWORD SAB_M_1NM_S2_S3 1 100 -1023 1023 DISPLAY_IDENTIFIER m_DriverDesVM.DesiredTorqueIn._.ZFFSAB ECU_ADDRESS 0xFFF8F92A /end MEASUREMENT
/begin MEASUREMENT ZFFSAB._.DesiredTorqueIn.f_m_EngDesEMErr "Error flag for desired torque calculated from iv_m_DriverDesEM" UBYTE SAB_STANDARD_S2_S3 1 100 0 1 DISPLAY_IDENTIFIER f_m_EngDesEMErr.DesiredTorqueIn._.ZFFSAB ECU_ADDRESS 0xFFF8F92C /end MEASUREMENT
/begin MEASUREMENT ZFFSAB._.DesiredTorqueIn.m_DriverDesEM "Intermediate value for desired torque from electrical machine" SWORD SAB_M_1NM_S2_S3 1 100 -1023 1023 DISPLAY_IDENTIFIER m_DriverDesEM.DesiredTorqueIn._.ZFFSAB ECU_ADDRESS 0xFFF8F92E /end MEASUREMENT
/begin MEASUREMENT ZFFSAB._.DesiredTorqueIn.f_m_MaxIncrVMErr "Error flag for setting range of torque from combustion engine" UBYTE SAB_STANDARD_S2_S3 1 100 0 1 DISPLAY_IDENTIFIER f_m_MaxIncrVMErr.DesiredTorqueIn._.ZFFSAB ECU_ADDRESS 0xFFF8F930 /end MEASUREMENT
/begin MEASUREMENT ZFFSAB._.DesiredTorqueIn.f_m_EngDesErr "Error flag for desired torque calculated from iv_m_DriverDes" UBYTE SAB_STANDARD_S2_S3 1 100 0 1 DISPLAY_IDENTIFIER f_m_EngDesErr.DesiredTorqueIn._.ZFFSAB ECU_ADDRESS 0xFFF8F931 /end MEASUREMENT
/begin MEASUREMENT ZFFSAB._.DesiredTorqueIn.m_DriverDes "Intermediate value for desired torque" SWORD SAB_M_1NM_S2_S3 1 100 -1023 1023 DISPLAY_IDENTIFIER m_DriverDes.DesiredTorqueIn._.ZFFSAB ECU_ADDRESS 0xFFF8F932 /end MEASUREMENT
/begin MEASUREMENT ZFFSAB._.DesiredTorqueIn.m_DriverDesCor "intermediate value for desired torque" SWORD SAB_M_1NM_S2_S3 1 100 -1023 1023 DISPLAY_IDENTIFIER m_DriverDesCor.DesiredTorqueIn._.ZFFSAB ECU_ADDRESS 0xFFF8F934 /end MEASUREMENT
/begin MEASUREMENT ZFFSAB._.ParkManeuverAssistant.iv_FASMode "Input value controlling state of FAS from CAN" UBYTE SAB_STANDARD_S2_S3 1 100 0 15 DISPLAY_IDENTIFIER iv_FASMode.ParkManeuverAssistant._.ZFFSAB ECU_ADDRESS 0xFFF8FA84 /end MEASUREMENT
/begin MEASUREMENT ZFFSAB._.ParkManeuverAssistant.iv_FASMode_ "Complement input value controlling state of FAS from CAN" UBYTE SAB_STANDARD_S2_S3 1 100 0 255 DISPLAY_IDENTIFIER iv_FASMode_.ParkManeuverAssistant._.ZFFSAB ECU_ADDRESS 0xFFF8FA85 /end MEASUREMENT
/begin MEASUREMENT ZFFSAB._.ParkManeuverAssistant.iv_FASModeSts "Input value message status of FAS CAN Message" UBYTE SAB_STANDARD_S2_S3 1 100 0 255 DISPLAY_IDENTIFIER iv_FASModeSts.ParkManeuverAssistant._.ZFFSAB ECU_ADDRESS 0xFFF8FA86 /end MEASUREMENT
/begin MEASUREMENT ZFFSAB._.ParkManeuverAssistant.iv_FASModeSts_ "Complement input value message status of FAS CAN Message" UBYTE SAB_STANDARD_S2_S3 1 100 0 255 DISPLAY_IDENTIFIER iv_FASModeSts_.ParkManeuverAssistant._.ZFFSAB ECU_ADDRESS 0xFFF8FA87 /end MEASUREMENT
/begin MEASUREMENT ZFFSAB._.ParkManeuverAssistant.iv_FASPos "Input value controlling state of FAS position from CAN" UBYTE SAB_STANDARD_S2_S3 1 100 0 15 DISPLAY_IDENTIFIER iv_FASPos.ParkManeuverAssistant._.ZFFSAB ECU_ADDRESS 0xFFF8FA88 /end MEASUREMENT
/begin MEASUREMENT ZFFSAB._.ParkManeuverAssistant.iv_FASPos_ "Complement input value controlling state of FAS position from CAN" UBYTE SAB_STANDARD_S2_S3 1 100 0 255 DISPLAY_IDENTIFIER iv_FASPos_.ParkManeuverAssistant._.ZFFSAB ECU_ADDRESS 0xFFF8FA89 /end MEASUREMENT
/begin MEASUREMENT ZFFSAB._.ParkManeuverAssistant.iv_FASPosSts "Input value message status of FAS CAN Message" UBYTE SAB_STANDARD_S2_S3 1 100 0 255 DISPLAY_IDENTIFIER iv_FASPosSts.ParkManeuverAssistant._.ZFFSAB ECU_ADDRESS 0xFFF8FA8A /end MEASUREMENT
/begin MEASUREMENT ZFFSAB._.ParkManeuverAssistant.iv_FASPosSts_ "Complement input value message status of FAS CAN Message" UBYTE SAB_STANDARD_S2_S3 1 100 0 255 DISPLAY_IDENTIFIER iv_FASPosSts_.ParkManeuverAssistant._.ZFFSAB ECU_ADDRESS 0xFFF8FA8B /end MEASUREMENT
/begin MEASUREMENT ZFFSAB._.ParkManeuverAssistant.iv_FASGearbox "Input value of FAS Gearbox from ABK" UBYTE SAB_STANDARD_S2_S3 1 100 0 255 DISPLAY_IDENTIFIER iv_FASGearbox.ParkManeuverAssistant._.ZFFSAB ECU_ADDRESS 0xFFF8FA8C /end MEASUREMENT
/begin MEASUREMENT ZFFSAB._.ParkManeuverAssistant.iv_FASGearbox_ "Complement input value of FAS Gearbox from ABK" UBYTE SAB_STANDARD_S2_S3 1 100 0 255 DISPLAY_IDENTIFIER iv_FASGearbox_.ParkManeuverAssistant._.ZFFSAB ECU_ADDRESS 0xFFF8FA8D /end MEASUREMENT
/begin MEASUREMENT ZFFSAB._.ParkManeuverAssistant.iv_Brake "Input value brake information signal from CAN" UBYTE SAB_STANDARD_S2_S3 1 100 0 63 DISPLAY_IDENTIFIER iv_Brake.ParkManeuverAssistant._.ZFFSAB ECU_ADDRESS 0xFFF8FA8E /end MEASUREMENT
/begin MEASUREMENT ZFFSAB._.ParkManeuverAssistant.iv_Brake_ "Input complement value brake information from CAN" UBYTE SAB_STANDARD_S2_S3 1 100 0 255 DISPLAY_IDENTIFIER iv_Brake_.ParkManeuverAssistant._.ZFFSAB ECU_ADDRESS 0xFFF8FA8F /end MEASUREMENT
/begin MEASUREMENT ZFFSAB._.ParkManeuverAssistant.iv_BrakeSts "Input value message status of brake information from CAN" UBYTE SAB_STANDARD_S2_S3 1 100 0 255 DISPLAY_IDENTIFIER iv_BrakeSts.ParkManeuverAssistant._.ZFFSAB ECU_ADDRESS 0xFFF8FA90 /end MEASUREMENT
/begin MEASUREMENT ZFFSAB._.ParkManeuverAssistant.iv_BrakeSts_ "Input complement value message status of brake information from CAN" UBYTE SAB_STANDARD_S2_S3 1 100 0 255 DISPLAY_IDENTIFIER iv_BrakeSts_.ParkManeuverAssistant._.ZFFSAB ECU_ADDRESS 0xFFF8FA91 /end MEASUREMENT
/begin MEASUREMENT ZFFSAB._.ParkManeuverAssistant.sv_FASGearbox "Output signal of sv_FASGearbox provided for CAN 0: gearbox intervention not allowed by driver request 1: allowance by gearbox 2: no allowance by gearbox 3: signal invalid" UBYTE SAB_STANDARD_S2_S3 1 100 0 255 DISPLAY_IDENTIFIER sv_FASGearbox.ParkManeuverAssistant._.ZFFSAB ECU_ADDRESS 0xFFF8FA92 /end MEASUREMENT
/begin MEASUREMENT ZFFSAB._.ParkManeuverAssistant.sv_FASGearbox_ "Complement output signal of sv_FASGearbox provided for CAN" UBYTE SAB_STANDARD_S2_S3 1 100 0 255 DISPLAY_IDENTIFIER sv_FASGearbox_.ParkManeuverAssistant._.ZFFSAB ECU_ADDRESS 0xFFF8FA93 /end MEASUREMENT
/begin MEASUREMENT ZFFSAB._.ParkManeuverAssistant.sv_FASMode "Output signal of sv_FASMode" UBYTE SAB_STANDARD_S2_S3 1 100 0 1 DISPLAY_IDENTIFIER sv_FASMode.ParkManeuverAssistant._.ZFFSAB ECU_ADDRESS 0xFFF8FA94 /end MEASUREMENT
/begin MEASUREMENT ZFFSAB._.ParkManeuverAssistant.sv_FASMode_ "Complement of sv_FASMode" UBYTE SAB_STANDARD_S2_S3 1 100 0 255 DISPLAY_IDENTIFIER sv_FASMode_.ParkManeuverAssistant._.ZFFSAB ECU_ADDRESS 0xFFF8FA95 /end MEASUREMENT
/begin MEASUREMENT ZFFSAB._.ParkManeuverAssistant.sv_FASModeSts "Output status signal of sv_FASModeSts" UBYTE SAB_STANDARD_S2_S3 1 100 0 2 DISPLAY_IDENTIFIER sv_FASModeSts.ParkManeuverAssistant._.ZFFSAB ECU_ADDRESS 0xFFF8FA96 /end MEASUREMENT
/begin MEASUREMENT ZFFSAB._.ParkManeuverAssistant.sv_FASModeSts_ "Complement of sv_FASModeSts" UBYTE SAB_STANDARD_S2_S3 1 100 0 255 DISPLAY_IDENTIFIER sv_FASModeSts_.ParkManeuverAssistant._.ZFFSAB ECU_ADDRESS 0xFFF8FA97 /end MEASUREMENT
/begin MEASUREMENT ZFFSAB._.ParkManeuverAssistant.sv_FASPos "Output signal of sv_FASPos" UBYTE SAB_STANDARD_S2_S3 1 100 0 8 DISPLAY_IDENTIFIER sv_FASPos.ParkManeuverAssistant._.ZFFSAB ECU_ADDRESS 0xFFF8FA98 /end MEASUREMENT
/begin MEASUREMENT ZFFSAB._.ParkManeuverAssistant.sv_FASPos_ "Complement of sv_FASPos" UBYTE SAB_STANDARD_S2_S3 1 100 0 255 DISPLAY_IDENTIFIER sv_FASPos_.ParkManeuverAssistant._.ZFFSAB ECU_ADDRESS 0xFFF8FA99 /end MEASUREMENT
/begin MEASUREMENT ZFFSAB._.ParkManeuverAssistant.sv_FASPosSts "Output status signal of sv_FASPosSts" UBYTE SAB_STANDARD_S2_S3 1 100 0 2 DISPLAY_IDENTIFIER sv_FASPosSts.ParkManeuverAssistant._.ZFFSAB ECU_ADDRESS 0xFFF8FA9A /end MEASUREMENT
/begin MEASUREMENT ZFFSAB._.ParkManeuverAssistant.sv_FASPosSts_ "Complement of sv_FASPosSts" UBYTE SAB_STANDARD_S2_S3 1 100 0 255 DISPLAY_IDENTIFIER sv_FASPosSts_.ParkManeuverAssistant._.ZFFSAB ECU_ADDRESS 0xFFF8FA9B /end MEASUREMENT
/begin MEASUREMENT ZFFSAB._.ParkManeuverAssistant.sv_FASBrake "Output signal of sv_FASBrake" UBYTE SAB_STANDARD_S2_S3 1 100 0 1 DISPLAY_IDENTIFIER sv_FASBrake.ParkManeuverAssistant._.ZFFSAB ECU_ADDRESS 0xFFF8FA9C /end MEASUREMENT
/begin MEASUREMENT ZFFSAB._.ParkManeuverAssistant.sv_FASBrake_ "Complement of sv_FASBrake" UBYTE SAB_STANDARD_S2_S3 1 100 0 255 DISPLAY_IDENTIFIER sv_FASBrake_.ParkManeuverAssistant._.ZFFSAB ECU_ADDRESS 0xFFF8FA9D /end MEASUREMENT
/begin MEASUREMENT ZFFSAB._.ParkManeuverAssistant.sv_FASBrakeSts "Output status signal of sv_FASBrakeSts" UBYTE SAB_STANDARD_S2_S3 1 100 0 2 DISPLAY_IDENTIFIER sv_FASBrakeSts.ParkManeuverAssistant._.ZFFSAB ECU_ADDRESS 0xFFF8FA9E /end MEASUREMENT
/begin MEASUREMENT ZFFSAB._.ParkManeuverAssistant.sv_FASBrakeSts_ "Complement of sv_FASBrakeSts" UBYTE SAB_STANDARD_S2_S3 1 100 0 255 DISPLAY_IDENTIFIER sv_FASBrakeSts_.ParkManeuverAssistant._.ZFFSAB ECU_ADDRESS 0xFFF8FA9F /end MEASUREMENT
/begin MEASUREMENT ZFFSAB._.ParkManeuverAssistant.f_PMAModeLearned "Learned flag of PMA mode" UBYTE SAB_STANDARD_S2_S3 1 100 0 1 DISPLAY_IDENTIFIER f_PMAModeLearned.ParkManeuverAssistant._.ZFFSAB ECU_ADDRESS 0xFFF8FAA1 /end MEASUREMENT
/begin MEASUREMENT ZFFSAB._.ParkManeuverAssistant.f_PMAModeLearned_ "complement learned flag of PMA mode" UBYTE SAB_STANDARD_S2_S3 1 100 0 1 DISPLAY_IDENTIFIER f_PMAModeLearned_.ParkManeuverAssistant._.ZFFSAB ECU_ADDRESS 0xFFF8FAA2 /end MEASUREMENT
/begin MEASUREMENT ZFFSAB._.ParkManeuverAssistant.f_FASPosErr "Error flag of FAS pos-signal" UBYTE SAB_STANDARD_S2_S3 1 100 0 1 DISPLAY_IDENTIFIER f_FASPosErr.ParkManeuverAssistant._.ZFFSAB ECU_ADDRESS 0xFFF8FAA3 /end MEASUREMENT
/begin MEASUREMENT ZFFSAB._.ParkManeuverAssistant.f_FASBrakeErr "Error flag of FAS brake-signal" UBYTE SAB_STANDARD_S2_S3 1 100 0 1 DISPLAY_IDENTIFIER f_FASBrakeErr.ParkManeuverAssistant._.ZFFSAB ECU_ADDRESS 0xFFF8FAA4 /end MEASUREMENT
/begin MEASUREMENT ZFFSAB._.ParkManeuverAssistant.FASModeRaw "Intermediate output signal of sv_FASMode" UBYTE SAB_STANDARD_S2_S3 1 100 0 1 DISPLAY_IDENTIFIER FASModeRaw.ParkManeuverAssistant._.ZFFSAB ECU_ADDRESS 0xFFF8FAA5 /end MEASUREMENT
/begin MEASUREMENT ZFFSAB._.ParkManeuverAssistant.FASModeRaw_ "Intermediate complement of sv_FASMode" UBYTE SAB_STANDARD_S2_S3 1 100 0 255 DISPLAY_IDENTIFIER FASModeRaw_.ParkManeuverAssistant._.ZFFSAB ECU_ADDRESS 0xFFF8FAA6 /end MEASUREMENT
/begin MEASUREMENT ZFFSAB._.SteeringWheelAngleIn.iv_SteerAngle "Input value steering-wheel angle from CAN" UWORD SAB_PHI_STEERING_ANGLE_2747GRAD1000000_M32763_S2_S3 1 100 -89.999961 90.024684 DISPLAY_IDENTIFIER iv_SteerAngle.SteeringWheelAngleIn._.ZFFSAB ECU_ADDRESS 0xFFF8FAE8 /end MEASUREMENT
/begin MEASUREMENT ZFFSAB._.SteeringWheelAngleIn.iv_SteerAngleErr "Input value steering-wheel angle error from CAN" UBYTE SAB_STANDARD_S2_S3 1 100 0 15 DISPLAY_IDENTIFIER iv_SteerAngleErr.SteeringWheelAngleIn._.ZFFSAB ECU_ADDRESS 0xFFF8FAEA /end MEASUREMENT
/begin MEASUREMENT ZFFSAB._.SteeringWheelAngleIn.iv_SteerAngleSts "Input value message status of steering-wheel angle" UBYTE SAB_STANDARD_S2_S3 1 100 0 255 DISPLAY_IDENTIFIER iv_SteerAngleSts.SteeringWheelAngleIn._.ZFFSAB ECU_ADDRESS 0xFFF8FAEB /end MEASUREMENT
/begin MEASUREMENT ZFFSAB._.SteeringWheelAngleIn.sv_AGS_LwVaEff "Output value of steering-wheel angle to AGS layer" UWORD SAB_PHI_STEERING_ANGLE_2747GRAD1000000_M32763_S2_S3 1 100 -89.999961 0.010988 DISPLAY_IDENTIFIER sv_AGS_LwVaEff.SteeringWheelAngleIn._.ZFFSAB ECU_ADDRESS 0xFFF8FAEC /end MEASUREMENT
/begin MEASUREMENT ZFFSAB._.SteeringWheelAngleIn.sv_AGS_LwVaStat "Output value of steering-wheel angle signal status to AGS layer" UBYTE SAB_STANDARD_S2_S3 1 100 0 2 DISPLAY_IDENTIFIER sv_AGS_LwVaStat.SteeringWheelAngleIn._.ZFFSAB ECU_ADDRESS 0xFFF8FAEE /end MEASUREMENT
/begin MEASUREMENT ZFFSAB._.SteeringWheelAngleIn.f_SteerAngleErr "Error flag steering-wheel angle" UBYTE SAB_STANDARD_S2_S3 1 100 0 1 DISPLAY_IDENTIFIER f_SteerAngleErr.SteeringWheelAngleIn._.ZFFSAB ECU_ADDRESS 0xFFF8FAEF /end MEASUREMENT
/begin MEASUREMENT ZFFSAB._.VehicleSpeedIn.VehicleSpeedInFL.iv_u_SensESts "electrical status of parklock sensor" FLOAT32_IEEE SAB_STANDARD_S2_S3 1 100 0 1 FORMAT "%5.3" DISPLAY_IDENTIFIER iv_u_SensESts.VehicleSpeedInFL.VehicleSpeedIn._.ZFFSAB ECU_ADDRESS 0xFFF8FAF8 /end MEASUREMENT
/begin MEASUREMENT ZFFSAB._.VehicleSpeedIn.VehicleSpeedInFL.v_Fzg "Intermediate size signal vehicle speed" FLOAT32_IEEE SAB_V_KMH16_S2_S3 1 100 0 4095.9375 DISPLAY_IDENTIFIER v_Fzg.VehicleSpeedInFL.VehicleSpeedIn._.ZFFSAB ECU_ADDRESS 0xFFF8FAFC /end MEASUREMENT
/begin MEASUREMENT ZFFSAB._.VehicleSpeedIn.VehicleSpeedInFL.v_FzgSts "Intermediate size signal status of vehicle speed" FLOAT32_IEEE SAB_STANDARD_S2_S3 1 100 0 1 FORMAT "%5.3" DISPLAY_IDENTIFIER v_FzgSts.VehicleSpeedInFL.VehicleSpeedIn._.ZFFSAB ECU_ADDRESS 0xFFF8FB00 /end MEASUREMENT
/begin MEASUREMENT ZFFSAB._.VehicleSpeedIn.VehicleSpeedInFL.sv_v_Ist "Intermediate value vehicle speed" FLOAT32_IEEE SAB_V_1KMH_S2_S3 1 100 0 65535 FORMAT "%5.3" DISPLAY_IDENTIFIER sv_v_Ist.VehicleSpeedInFL.VehicleSpeedIn._.ZFFSAB ECU_ADDRESS 0xFFF8FB04 /end MEASUREMENT
/begin MEASUREMENT ZFFSAB._.VehicleSpeedIn.VehicleSpeedInFL.sv_v_IstSts "Intermediate value signal status of vehicle speed" FLOAT32_IEEE SAB_STANDARD_S2_S3 1 100 0 1 FORMAT "%5.3" DISPLAY_IDENTIFIER sv_v_IstSts.VehicleSpeedInFL.VehicleSpeedIn._.ZFFSAB ECU_ADDRESS 0xFFF8FB08 /end MEASUREMENT
/begin MEASUREMENT ZFFSAB._.VehicleSpeedIn.VehicleSpeedInFL.sv_v_IstMax "Intermediate value vehicle speed maximum selection" FLOAT32_IEEE SAB_V_1KMH_S2_S3 1 100 0 65535 FORMAT "%5.3" DISPLAY_IDENTIFIER sv_v_IstMax.VehicleSpeedInFL.VehicleSpeedIn._.ZFFSAB ECU_ADDRESS 0xFFF8FB0C /end MEASUREMENT
/begin MEASUREMENT ZFFSAB._.VehicleSpeedIn.VehicleSpeedInFL.sv_v_IstMaxSts "Intermediate value signal status of vehicle speed maximum selection" FLOAT32_IEEE SAB_STANDARD_S2_S3 1 100 0 1 FORMAT "%5.3" DISPLAY_IDENTIFIER sv_v_IstMaxSts.VehicleSpeedInFL.VehicleSpeedIn._.ZFFSAB ECU_ADDRESS 0xFFF8FB10 /end MEASUREMENT
/begin MEASUREMENT ZFFSAB._.VehicleSpeedIn.VehicleSpeedInFL.v_FzgByNab "Intermediate value vehicle speed by nAb" FLOAT32_IEEE SAB_STANDARD_S2_S3 1 100 0 65535 FORMAT "%5.3" DISPLAY_IDENTIFIER v_FzgByNab.VehicleSpeedInFL.VehicleSpeedIn._.ZFFSAB ECU_ADDRESS 0xFFF8FB14 /end MEASUREMENT
/begin MEASUREMENT ZFFSAB._.VehicleSpeedIn.VehicleSpeedInFL.sv_v_FzgByNabFilt "Intermediate value vehicle speed by nAb filtered" FLOAT32_IEEE SAB_STANDARD_S2_S3 1 100 0 65535 FORMAT "%5.3" DISPLAY_IDENTIFIER sv_v_FzgByNabFilt.VehicleSpeedInFL.VehicleSpeedIn._.ZFFSAB ECU_ADDRESS 0xFFF8FB18 /end MEASUREMENT
/begin MEASUREMENT ZFFSAB._.VehicleSpeedIn.VehicleSpeedInFL.sv_v_FzgByNabSts "Intermediate value status of vehicle speed by nAb" FLOAT32_IEEE SAB_STANDARD_S2_S3 1 100 0 1 FORMAT "%5.3" DISPLAY_IDENTIFIER sv_v_FzgByNabSts.VehicleSpeedInFL.VehicleSpeedIn._.ZFFSAB ECU_ADDRESS 0xFFF8FB1C /end MEASUREMENT
/begin MEASUREMENT ZFFSAB._.VehicleSpeedIn.VehicleSpeedInFL.n_WheelAvg "Average Wheel rpm of all driven wheels" FLOAT32_IEEE SAB_N_RPM100_S2_S3 1 100 0 655.35 DISPLAY_IDENTIFIER n_WheelAvg.VehicleSpeedInFL.VehicleSpeedIn._.ZFFSAB ECU_ADDRESS 0xFFF8FB20 /end MEASUREMENT
/begin MEASUREMENT ZFFSAB._.VehicleSpeedIn.VehicleSpeedInFL.n_WheelAvgSts "Status of average Wheel rpm derived from driven wheels" FLOAT32_IEEE SAB_STANDARD_S2_S3 1 100 0 2 FORMAT "%5.3" DISPLAY_IDENTIFIER n_WheelAvgSts.VehicleSpeedInFL.VehicleSpeedIn._.ZFFSAB ECU_ADDRESS 0xFFF8FB24 /end MEASUREMENT
/begin MEASUREMENT ZFFSAB._.VehicleSpeedIn.VehicleSpeedInFL.v_IstByNWheel "vehicle speed computed by wheel rpm" FLOAT32_IEEE SAB_V_1KMH_S2_S3 1 100 0 65535 FORMAT "%5.3" DISPLAY_IDENTIFIER v_IstByNWheel.VehicleSpeedInFL.VehicleSpeedIn._.ZFFSAB ECU_ADDRESS 0xFFF8FB28 /end MEASUREMENT
/begin MEASUREMENT ZFFSAB._.VehicleSpeedIn.iv_v_Fzg "Input value vehicle speed" UWORD SAB_V_KMH64_S2_S3 1 100 0 1023.984375 DISPLAY_IDENTIFIER iv_v_Fzg.VehicleSpeedIn._.ZFFSAB ECU_ADDRESS 0xFFF8FB38 /end MEASUREMENT
/begin MEASUREMENT ZFFSAB._.VehicleSpeedIn.iv_v_FzgSts "Input value signal status of vehicle speed" UBYTE SAB_STANDARD_S2_S3 1 100 0 255 DISPLAY_IDENTIFIER iv_v_FzgSts.VehicleSpeedIn._.ZFFSAB ECU_ADDRESS 0xFFF8FB3A /end MEASUREMENT
/begin MEASUREMENT ZFFSAB._.VehicleSpeedIn.iv_v_FzgErr "Input value signal qualifier of vehicle speed" UBYTE SAB_STANDARD_S2_S3 1 100 0 255 DISPLAY_IDENTIFIER iv_v_FzgErr.VehicleSpeedIn._.ZFFSAB ECU_ADDRESS 0xFFF8FB3B /end MEASUREMENT
/begin MEASUREMENT ZFFSAB._.VehicleSpeedIn.iv_v_FzgErrSts "Input value signal status of qualifier of vehicle speed" UBYTE SAB_STANDARD_S2_S3 1 100 0 255 DISPLAY_IDENTIFIER iv_v_FzgErrSts.VehicleSpeedIn._.ZFFSAB ECU_ADDRESS 0xFFF8FB3C /end MEASUREMENT
/begin MEASUREMENT ZFFSAB._.VehicleSpeedIn.iv_u_SensESts "Input value electrical sensor status" UBYTE SAB_STANDARD_S2_S3 1 100 0 255 DISPLAY_IDENTIFIER iv_u_SensESts.VehicleSpeedIn._.ZFFSAB ECU_ADDRESS 0xFFF8FB3D /end MEASUREMENT
/begin MEASUREMENT ZFFSAB._.VehicleSpeedIn.sv_v_Ist "Output value vehicle speed" UWORD SAB_V_1KMH_S2_S3 1 100 0 65535 DISPLAY_IDENTIFIER sv_v_Ist.VehicleSpeedIn._.ZFFSAB ECU_ADDRESS 0xFFF8FB3E /end MEASUREMENT
/begin MEASUREMENT ZFFSAB._.VehicleSpeedIn.sv_v_IstSts "Output value signal status of vehicle speed" UBYTE SAB_STANDARD_S2_S3 1 100 0 2 DISPLAY_IDENTIFIER sv_v_IstSts.VehicleSpeedIn._.ZFFSAB ECU_ADDRESS 0xFFF8FB40 /end MEASUREMENT
/begin MEASUREMENT ZFFSAB._.VehicleSpeedIn.sv_v_Ist_ "Complement output value vehicle speed" UWORD SAB_STANDARD_S2_S3 1 100 0 65535 DISPLAY_IDENTIFIER sv_v_Ist_.VehicleSpeedIn._.ZFFSAB ECU_ADDRESS 0xFFF8FB42 /end MEASUREMENT
/begin MEASUREMENT ZFFSAB._.VehicleSpeedIn.sv_v_IstSts_ "Complement output value signal status of vehicle speed" UBYTE SAB_STANDARD_S2_S3 1 100 0 2 DISPLAY_IDENTIFIER sv_v_IstSts_.VehicleSpeedIn._.ZFFSAB ECU_ADDRESS 0xFFF8FB44 /end MEASUREMENT
/begin MEASUREMENT ZFFSAB._.VehicleSpeedIn.sv_v_IstMax "Output value vehicle speed maximum selection" UWORD SAB_V_1KMH_S2_S3 1 100 0 65535 DISPLAY_IDENTIFIER sv_v_IstMax.VehicleSpeedIn._.ZFFSAB ECU_ADDRESS 0xFFF8FB46 /end MEASUREMENT
/begin MEASUREMENT ZFFSAB._.VehicleSpeedIn.sv_v_IstMaxSts "Output value signal status of vehicle speed maximum selection" UBYTE SAB_STANDARD_S2_S3 1 100 0 2 DISPLAY_IDENTIFIER sv_v_IstMaxSts.VehicleSpeedIn._.ZFFSAB ECU_ADDRESS 0xFFF8FB48 /end MEASUREMENT
/begin MEASUREMENT ZFFSAB._.VehicleSpeedIn.sv_v_IstMax_ "Complement output value vehicle speed maximum selection" UWORD SAB_STANDARD_S2_S3 1 100 0 65535 DISPLAY_IDENTIFIER sv_v_IstMax_.VehicleSpeedIn._.ZFFSAB ECU_ADDRESS 0xFFF8FB4A /end MEASUREMENT
/begin MEASUREMENT ZFFSAB._.VehicleSpeedIn.sv_v_IstMaxSts_ "Complement output value signal status of vehicle speed maximum selection" UBYTE SAB_STANDARD_S2_S3 1 100 0 255 DISPLAY_IDENTIFIER sv_v_IstMaxSts_.VehicleSpeedIn._.ZFFSAB ECU_ADDRESS 0xFFF8FB4C /end MEASUREMENT
/begin MEASUREMENT ZFFSAB._.VehicleSpeedIn.sv_v_FzgRef "Output signal of vehicle ground speed" UWORD SAB_V_KMH100_S2_S3 1 100 0 655.35 DISPLAY_IDENTIFIER sv_v_FzgRef.VehicleSpeedIn._.ZFFSAB ECU_ADDRESS 0xFFF8FB4E /end MEASUREMENT
/begin MEASUREMENT ZFFSAB._.VehicleSpeedIn.sv_v_FzgRefSts "Output status signal of output signal vehicle ground speed" UBYTE SAB_STANDARD_S2_S3 1 100 0 2 DISPLAY_IDENTIFIER sv_v_FzgRefSts.VehicleSpeedIn._.ZFFSAB ECU_ADDRESS 0xFFF8FB50 /end MEASUREMENT
/begin MEASUREMENT ZFFSAB._.VehicleSpeedIn.sv_v_FzgByNabFilt "Output value vehicle speed derived from output rpm" UWORD SAB_V_KMH16_S2_S3 1 100 0 4095.9375 DISPLAY_IDENTIFIER sv_v_FzgByNabFilt.VehicleSpeedIn._.ZFFSAB ECU_ADDRESS 0xFFF8FB52 /end MEASUREMENT
/begin MEASUREMENT ZFFSAB._.VehicleSpeedIn.sv_v_FzgByNabSts "Output value Status of vehicle speed derived from output rpm" UBYTE SAB_STANDARD_S2_S3 1 100 0 2 DISPLAY_IDENTIFIER sv_v_FzgByNabSts.VehicleSpeedIn._.ZFFSAB ECU_ADDRESS 0xFFF8FB54 /end MEASUREMENT
/begin MEASUREMENT ZFFSAB._.VehicleSpeedIn.sv_v_FzgByNabFilt_ "Complement output value vehicle speed derived from output rpm" UWORD SAB_STANDARD_S2_S3 1 100 0 65535 DISPLAY_IDENTIFIER sv_v_FzgByNabFilt_.VehicleSpeedIn._.ZFFSAB ECU_ADDRESS 0xFFF8FB56 /end MEASUREMENT
/begin MEASUREMENT ZFFSAB._.VehicleSpeedIn.sv_v_FzgByNabSts_ "Complement output value Status of vehicle speed derived from output rpm" UBYTE SAB_STANDARD_S2_S3 1 100 0 2 DISPLAY_IDENTIFIER sv_v_FzgByNabSts_.VehicleSpeedIn._.ZFFSAB ECU_ADDRESS 0xFFF8FB58 /end MEASUREMENT
/begin MEASUREMENT ZFFSAB._.VehicleSpeedIn.f_v_FzgRefErr "Error flag of v_VehRef-signal" UBYTE SAB_STANDARD_S2_S3 1 100 0 1 DISPLAY_IDENTIFIER f_v_FzgRefErr.VehicleSpeedIn._.ZFFSAB ECU_ADDRESS 0xFFF8FB59 /end MEASUREMENT
/begin MEASUREMENT ZFFSAB._.VehicleSpeedIn.v_Fzg "Intermediate value signal vehicle speed" UWORD SAB_V_KMH16_S2_S3 1 100 0 4095.9375 DISPLAY_IDENTIFIER v_Fzg.VehicleSpeedIn._.ZFFSAB ECU_ADDRESS 0xFFF8FB5A /end MEASUREMENT
/begin MEASUREMENT ZFFSAB._.VehicleSpeedIn.v_FzgSts "Intermediate signal status of vehicle speed" UBYTE SAB_STANDARD_S2_S3 1 100 0 1 DISPLAY_IDENTIFIER v_FzgSts.VehicleSpeedIn._.ZFFSAB ECU_ADDRESS 0xFFF8FB5C /end MEASUREMENT
/begin MEASUREMENT ZFFSAB._.VehicleSpeedIn.v_Fzg_ "Complement of v_Fzg" UWORD SAB_STANDARD_S2_S3 1 100 0 65535 DISPLAY_IDENTIFIER v_Fzg_.VehicleSpeedIn._.ZFFSAB ECU_ADDRESS 0xFFF8FB5E /end MEASUREMENT
/begin MEASUREMENT ZFFSAB._.VehicleSpeedIn.v_FzgSts_ "Complement of v_FzgSts" UBYTE SAB_STANDARD_S2_S3 1 100 0 1 DISPLAY_IDENTIFIER v_FzgSts_.VehicleSpeedIn._.ZFFSAB ECU_ADDRESS 0xFFF8FB60 /end MEASUREMENT
/begin MEASUREMENT ZFFSAB._.VehicleSpeedIn.v_FzgByNab "Output value vehicle speed derived from output rpm" UWORD SAB_V_KMH16_S2_S3 1 100 0 4095.9375 DISPLAY_IDENTIFIER v_FzgByNab.VehicleSpeedIn._.ZFFSAB ECU_ADDRESS 0xFFF8FB62 /end MEASUREMENT
/begin MEASUREMENT ZFFSAB._.VehicleSpeedIn.v_FzgByNab_ "Complement output value vehicle speed" UWORD SAB_STANDARD_S2_S3 1 100 0 65535 DISPLAY_IDENTIFIER v_FzgByNab_.VehicleSpeedIn._.ZFFSAB ECU_ADDRESS 0xFFF8FB64 /end MEASUREMENT
/begin MEASUREMENT ZFFSAB._.VehicleSpeedIn.sv_AGS_VVehCog "Intermediate value signal vehicle speed" UWORD SAB_V_KMH64_S2_S3 1 100 0 1023.984375 DISPLAY_IDENTIFIER sv_AGS_VVehCog.VehicleSpeedIn._.ZFFSAB ECU_ADDRESS 0xFFF8FB66 /end MEASUREMENT
/begin MEASUREMENT ZFFSAB._.VehicleSpeedIn.sv_AGS_VVehCogStat "Intermediate value signal status of vehicle speed" UBYTE SAB_STANDARD_S2_S3 1 100 0 1 DISPLAY_IDENTIFIER sv_AGS_VVehCogStat.VehicleSpeedIn._.ZFFSAB ECU_ADDRESS 0xFFF8FB68 /end MEASUREMENT
/begin MEASUREMENT ZFFSAB._.VehicleSpeedIn.f_v_FzgErr "Error flag of v_Fzg-signal" UBYTE SAB_STANDARD_S2_S3 1 100 0 1 DISPLAY_IDENTIFIER f_v_FzgErr.VehicleSpeedIn._.ZFFSAB ECU_ADDRESS 0xFFF8FB69 /end MEASUREMENT
/begin MEASUREMENT ZFFSAB._.VehicleSpeedIn.n_WheelAvg "Average Wheel rpm of all driven wheels" ULONG SAB_N_RPM100_S2_S3 1 100 0 655.35 DISPLAY_IDENTIFIER n_WheelAvg.VehicleSpeedIn._.ZFFSAB ECU_ADDRESS 0xFFF8FB6C /end MEASUREMENT
/begin MEASUREMENT ZFFSAB._.VehicleSpeedIn.n_WheelAvgSts "Status of average Wheel rpm derived from driven wheels" UBYTE SAB_STANDARD_S2_S3 1 100 0 2 DISPLAY_IDENTIFIER n_WheelAvgSts.VehicleSpeedIn._.ZFFSAB ECU_ADDRESS 0xFFF8FB70 /end MEASUREMENT
/begin MEASUREMENT ZFFSAB._.VehicleSpeedIn.v_IstByNWheel "vehicle speed computed by wheel rpm" UWORD SAB_V_1KMH_S2_S3 1 100 0 65535 DISPLAY_IDENTIFIER v_IstByNWheel.VehicleSpeedIn._.ZFFSAB ECU_ADDRESS 0xFFF8FB72 /end MEASUREMENT
/begin MEASUREMENT ZFFSAB._.RearAxleRatioIn.f_IgnitionOff2On "Ignition Off to On" UBYTE SAB_STANDARD_S2_S3 1 100 0 1 DISPLAY_IDENTIFIER f_IgnitionOff2On.RearAxleRatioIn._.ZFFSAB ECU_ADDRESS 0xFFF8FB98 /end MEASUREMENT
/begin MEASUREMENT ZFFSAB._.RearAxleRatioIn.iv_Pos "position" UBYTE SAB_STANDARD_S2_S3 1 100 0 4 DISPLAY_IDENTIFIER iv_Pos.RearAxleRatioIn._.ZFFSAB ECU_ADDRESS 0xFFF8FC0A /end MEASUREMENT
/begin MEASUREMENT ZFFSAB._.RearAxleRatioIn.iv_Pos_ "Complement of Input value for position of Gear Lever" UBYTE SAB_STANDARD_S2_S3 1 100 0 255 DISPLAY_IDENTIFIER iv_Pos_.RearAxleRatioIn._.ZFFSAB ECU_ADDRESS 0xFFF8FC0B /end MEASUREMENT
/begin MEASUREMENT ZFFSAB._.RearAxleRatioIn.sv_RearAxleRatio_Value "Calculated value for rear axle ratio" UWORD SAB_K100_S2_S3 1 100 0 10 DISPLAY_IDENTIFIER sv_RearAxleRatio_Value.RearAxleRatioIn._.ZFFSAB ECU_ADDRESS 0xFFF8FC0C /end MEASUREMENT
/begin MEASUREMENT ZFFSAB._.RearAxleRatioIn.sv_RearAxleRatio_ValueNumact "Current number of learn cycles for rear axle ratio" UBYTE SAB_STANDARD_S2_S3 1 100 0 255 DISPLAY_IDENTIFIER sv_RearAxleRatio_ValueNumact.RearAxleRatioIn._.ZFFSAB ECU_ADDRESS 0xFFF8FC0E /end MEASUREMENT
/begin MEASUREMENT ZFFSAB._.RearAxleRatioIn.sv_RearAxleRatio_ValueLearnedFlag "Flag is set if the rear axle ratio is learned finally" UBYTE SAB_STANDARD_S2_S3 1 100 0 255 DISPLAY_IDENTIFIER sv_RearAxleRatio_ValueLearnedFlag.RearAxleRatioIn._.ZFFSAB ECU_ADDRESS 0xFFF8FC0F /end MEASUREMENT
/begin MEASUREMENT ZFFSAB._.RearAxleRatioIn.sv_RearAxleRatio_ValueLearnedFlag_ "Flag is set if the rear axle ratio is learned finally" UBYTE SAB_STANDARD_S2_S3 1 100 0 255 DISPLAY_IDENTIFIER sv_RearAxleRatio_ValueLearnedFlag_.RearAxleRatioIn._.ZFFSAB ECU_ADDRESS 0xFFF8FC10 /end MEASUREMENT
/begin MEASUREMENT ZFFSAB._.EngineTorqueIn.EngineTorqueInFl.iv_m_EngSts "Input value for message status" FLOAT32_IEEE SAB_STANDARD_S2_S3 1 100 0 255 FORMAT "%5.3" DISPLAY_IDENTIFIER iv_m_EngSts.EngineTorqueInFl.EngineTorqueIn._.ZFFSAB ECU_ADDRESS 0xFFF8FC38 /end MEASUREMENT
/begin MEASUREMENT ZFFSAB._.EngineTorqueIn.EngineTorqueInFl.iv_m_Eng "Input value for crankshaft torque" FLOAT32_IEEE SAB_M_NM2_M2047_S2_S3 1 100 -2047.5 0.5 DISPLAY_IDENTIFIER iv_m_Eng.EngineTorqueInFl.EngineTorqueIn._.ZFFSAB ECU_ADDRESS 0xFFF8FC3C /end MEASUREMENT
/begin MEASUREMENT ZFFSAB._.EngineTorqueIn.EngineTorqueInFl.iv_m_Eng_ "Input value for crankshaft torque" FLOAT32_IEEE SAB_STANDARD_S2_S3 1 100 -2048 2048 FORMAT "%5.3" DISPLAY_IDENTIFIER iv_m_Eng_.EngineTorqueInFl.EngineTorqueIn._.ZFFSAB ECU_ADDRESS 0xFFF8FC40 /end MEASUREMENT
/begin MEASUREMENT ZFFSAB._.EngineTorqueIn.EngineTorqueInFl.f_m_EngErr "Error flag" FLOAT32_IEEE SAB_STANDARD_S2_S3 1 100 0 1 FORMAT "%5.3" DISPLAY_IDENTIFIER f_m_EngErr.EngineTorqueInFl.EngineTorqueIn._.ZFFSAB ECU_ADDRESS 0xFFF8FC44 /end MEASUREMENT
/begin MEASUREMENT ZFFSAB._.EngineTorqueIn.EngineTorqueInFl.sv_m_EngSts "Output value signal status for GET_M_MOT_STATUS" FLOAT32_IEEE SAB_STANDARD_S2_S3 1 100 0 2 FORMAT "%5.3" DISPLAY_IDENTIFIER sv_m_EngSts.EngineTorqueInFl.EngineTorqueIn._.ZFFSAB ECU_ADDRESS 0xFFF8FC48 /end MEASUREMENT
/begin MEASUREMENT ZFFSAB._.EngineTorqueIn.EngineTorqueInFl.sv_m_EngLev2 "Output value for engine torque" FLOAT32_IEEE SAB_M_1NM_S2_S3 1 100 -2048 2047 FORMAT "%5.3" DISPLAY_IDENTIFIER sv_m_EngLev2.EngineTorqueInFl.EngineTorqueIn._.ZFFSAB ECU_ADDRESS 0xFFF8FC4C /end MEASUREMENT
/begin MEASUREMENT ZFFSAB._.EngineTorqueIn.EngineTorqueInFl.sv_m_EngLev2_ "Output value for engine torque" FLOAT32_IEEE SAB_STANDARD_S2_S3 1 100 -2048 2047 FORMAT "%5.3" DISPLAY_IDENTIFIER sv_m_EngLev2_.EngineTorqueInFl.EngineTorqueIn._.ZFFSAB ECU_ADDRESS 0xFFF8FC50 /end MEASUREMENT
/begin MEASUREMENT ZFFSAB._.EngineTorqueIn.EngineTorqueInFl.m_EngCor "Intermediate value for engine torque with quantisation 1Nm/Bit" FLOAT32_IEEE SAB_M_1NM_S2_S3 1 100 -2048 2047.875 FORMAT "%5.3" DISPLAY_IDENTIFIER m_EngCor.EngineTorqueInFl.EngineTorqueIn._.ZFFSAB ECU_ADDRESS 0xFFF8FC54 /end MEASUREMENT
/begin MEASUREMENT ZFFSAB._.EngineTorqueIn.iv_m_Eng "Input value for crankshaft torque" UWORD SAB_M_NM2_M2047_S2_S3 1 100 -1023.5 1023.5 DISPLAY_IDENTIFIER iv_m_Eng.EngineTorqueIn._.ZFFSAB ECU_ADDRESS 0xFFF8FC5C /end MEASUREMENT
/begin MEASUREMENT ZFFSAB._.EngineTorqueIn.iv_m_EngSts "Input value for message status" UBYTE SAB_STANDARD_S2_S3 1 100 0 255 DISPLAY_IDENTIFIER iv_m_EngSts.EngineTorqueIn._.ZFFSAB ECU_ADDRESS 0xFFF8FC5E /end MEASUREMENT
/begin MEASUREMENT ZFFSAB._.EngineTorqueIn.iv_m_EngSts_ "Input value for message status" UBYTE SAB_STANDARD_S2_S3 1 100 0 255 DISPLAY_IDENTIFIER iv_m_EngSts_.EngineTorqueIn._.ZFFSAB ECU_ADDRESS 0xFFF8FC5F /end MEASUREMENT
/begin MEASUREMENT ZFFSAB._.EngineTorqueIn.iv_m_PumpCensored "Input value of pump intake torque with coefficient from class PumpIntakeTorqueOut" SWORD SAB_M_1NM_S2_S3 1 100 -32768 32767 DISPLAY_IDENTIFIER iv_m_PumpCensored.EngineTorqueIn._.ZFFSAB ECU_ADDRESS 0xFFF8FC60 /end MEASUREMENT
/begin MEASUREMENT ZFFSAB._.EngineTorqueIn.iv_m_Eng_ "Input value for crankshaft torque" UWORD SAB_M_NM2_M2047_S2_S3 1 100 -1023.5 1023.5 DISPLAY_IDENTIFIER iv_m_Eng_.EngineTorqueIn._.ZFFSAB ECU_ADDRESS 0xFFF8FC62 /end MEASUREMENT
/begin MEASUREMENT ZFFSAB._.EngineTorqueIn.iv_m_K0AktModified "Input value for K0 max torque" SWORD SAB_M_1NM_S2_S3 1 100 -1000 1000 DISPLAY_IDENTIFIER iv_m_K0AktModified.EngineTorqueIn._.ZFFSAB ECU_ADDRESS 0xFFF8FC64 /end MEASUREMENT
/begin MEASUREMENT ZFFSAB._.EngineTorqueIn.sv_m_Eng "Output value for engine torque" SWORD SAB_M_1NM_S2_S3 1 100 -2048 2047 DISPLAY_IDENTIFIER sv_m_Eng.EngineTorqueIn._.ZFFSAB ECU_ADDRESS 0xFFF8FC66 /end MEASUREMENT
/begin MEASUREMENT ZFFSAB._.EngineTorqueIn.sv_AGS_MMot "Output value for engine torque" SWORD SAB_M_1NM_S2_S3 1 100 -8192 8192 DISPLAY_IDENTIFIER sv_AGS_MMot.EngineTorqueIn._.ZFFSAB ECU_ADDRESS 0xFFF8FC68 /end MEASUREMENT
/begin MEASUREMENT ZFFSAB._.EngineTorqueIn.sv_m_EngLev2 "Output value for engine torque" SWORD SAB_M_1NM_S2_S3 1 100 -2048 2047 DISPLAY_IDENTIFIER sv_m_EngLev2.EngineTorqueIn._.ZFFSAB ECU_ADDRESS 0xFFF8FC6A /end MEASUREMENT
/begin MEASUREMENT ZFFSAB._.EngineTorqueIn.sv_m_EngStsLev2 "Output value signal status for GET_M_MOT_LEV2_STATUS" UBYTE SAB_STANDARD_S2_S3 1 100 0 2 DISPLAY_IDENTIFIER sv_m_EngStsLev2.EngineTorqueIn._.ZFFSAB ECU_ADDRESS 0xFFF8FC6C /end MEASUREMENT
/begin MEASUREMENT ZFFSAB._.EngineTorqueIn.sv_m_EngSts "Output value signal status for GET_M_MOT_STATUS" UBYTE SAB_STANDARD_S2_S3 1 100 0 2 DISPLAY_IDENTIFIER sv_m_EngSts.EngineTorqueIn._.ZFFSAB ECU_ADDRESS 0xFFF8FC6D /end MEASUREMENT
/begin MEASUREMENT ZFFSAB._.EngineTorqueIn.sv_m_EngStsLev2_ "Output value signal status complement" UBYTE SAB_STANDARD_S2_S3 1 100 0 255 DISPLAY_IDENTIFIER sv_m_EngStsLev2_.EngineTorqueIn._.ZFFSAB ECU_ADDRESS 0xFFF8FC6E /end MEASUREMENT
/begin MEASUREMENT ZFFSAB._.EngineTorqueIn.f_m_EngErr "!!!NO DESCRIPTION AVAILABLE!!!" UBYTE SAB_STANDARD_S2_S3 1 100 0 1 DISPLAY_IDENTIFIER f_m_EngErr.EngineTorqueIn._.ZFFSAB ECU_ADDRESS 0xFFF8FC6F /end MEASUREMENT
/begin MEASUREMENT ZFFSAB._.EngineTorqueIn.sv_m_EngFilt "Output value for engine torque" SWORD SAB_M_1NM_S2_S3 1 100 -400 1640 DISPLAY_IDENTIFIER sv_m_EngFilt.EngineTorqueIn._.ZFFSAB ECU_ADDRESS 0xFFF8FC70 /end MEASUREMENT
/begin MEASUREMENT ZFFSAB._.EngineTorqueIn.sv_m_EngFiltSts "Output value signal status for engine torque" UBYTE SAB_STANDARD_S2_S3 1 100 0 2 DISPLAY_IDENTIFIER sv_m_EngFiltSts.EngineTorqueIn._.ZFFSAB ECU_ADDRESS 0xFFF8FC72 /end MEASUREMENT
/begin MEASUREMENT ZFFSAB._.EngineTorqueIn.sv_m_EngLev2_ "Output value for engine torque (complement)" SWORD SAB_STANDARD_S2_S3 1 100 -32768 32767 DISPLAY_IDENTIFIER sv_m_EngLev2_.EngineTorqueIn._.ZFFSAB ECU_ADDRESS 0xFFF8FC74 /end MEASUREMENT
/begin MEASUREMENT ZFFSAB._.EngineTorqueIn.m_EngCor "Intermediate value for engine torque with quantisation 1Nm/Bit" SWORD SAB_M_1NM_S2_S3 1 100 -2048 2047.875 DISPLAY_IDENTIFIER m_EngCor.EngineTorqueIn._.ZFFSAB ECU_ADDRESS 0xFFF8FC76 /end MEASUREMENT
/begin MEASUREMENT ZFFSAB._.EngineTorqueIn.m_EngCorSts "Intermediate value signal status Level 2" UBYTE SAB_STANDARD_S2_S3 1 100 0 2 DISPLAY_IDENTIFIER m_EngCorSts.EngineTorqueIn._.ZFFSAB ECU_ADDRESS 0xFFF8FC78 /end MEASUREMENT
/begin MEASUREMENT ZFFSAB._.EngineTorqueIn.m_EngCorSts_ "Complement of Intermediate value signal status Level 2" UBYTE SAB_STANDARD_S2_S3 1 100 0 2 DISPLAY_IDENTIFIER m_EngCorSts_.EngineTorqueIn._.ZFFSAB ECU_ADDRESS 0xFFF8FC79 /end MEASUREMENT
/begin MEASUREMENT ZFFSAB._.EngineTorqueIn.m_EngCor2 "Intermediate value for engine torque with quantisation 1Nm/Bit" SWORD SAB_M_1NM_S2_S3 1 100 -2048 2047 DISPLAY_IDENTIFIER m_EngCor2.EngineTorqueIn._.ZFFSAB ECU_ADDRESS 0xFFF8FC7A /end MEASUREMENT
/begin MEASUREMENT ZFFSAB._.EngineTorqueIn.m_EngCor2Sts "Intermediate value signal status" UBYTE SAB_STANDARD_S2_S3 1 100 0 2 DISPLAY_IDENTIFIER m_EngCor2Sts.EngineTorqueIn._.ZFFSAB ECU_ADDRESS 0xFFF8FC7C /end MEASUREMENT
/begin MEASUREMENT ZFFSAB._.TempDiagnosis_AT.TempDiagnosis_AT_Fl.iv_c_Chip2Trans "Input raw signal Chiptemperature Sensor 2(LM71)" FLOAT32_IEEE SAB_C_CGT_1CEL_M40_S2_S3 1 100 -40 215 FORMAT "%5.3" DISPLAY_IDENTIFIER iv_c_Chip2Trans.TempDiagnosis_AT_Fl.TempDiagnosis_AT._.ZFFSAB ECU_ADDRESS 0xFFF8FE5C /end MEASUREMENT
/begin MEASUREMENT ZFFSAB._.TempDiagnosis_AT.TempDiagnosis_AT_Fl.iv_c_Chip1TransESts "Input raw signal EStatus Chiptemperature Sensor 1 (CG130)" FLOAT32_IEEE SAB_STANDARD_S2_S3 1 100 0 255 FORMAT "%5.3" DISPLAY_IDENTIFIER iv_c_Chip1TransESts.TempDiagnosis_AT_Fl.TempDiagnosis_AT._.ZFFSAB ECU_ADDRESS 0xFFF8FE60 /end MEASUREMENT
/begin MEASUREMENT ZFFSAB._.TempDiagnosis_AT.TempDiagnosis_AT_Fl.iv_c_Chip2TransESts "Input raw signal EStatus Chiptemperature Sensor 1(LM71)" FLOAT32_IEEE SAB_STANDARD_S2_S3 1 100 0 255 FORMAT "%5.3" DISPLAY_IDENTIFIER iv_c_Chip2TransESts.TempDiagnosis_AT_Fl.TempDiagnosis_AT._.ZFFSAB ECU_ADDRESS 0xFFF8FE64 /end MEASUREMENT
/begin MEASUREMENT ZFFSAB._.TempDiagnosis_AT.TempDiagnosis_AT_Fl.iv_c_OilTrans "Input raw signal Oeltemperature Sensor" FLOAT32_IEEE SAB_C_CGT_1CEL_M40_S2_S3 1 100 -40 215 FORMAT "%5.3" DISPLAY_IDENTIFIER iv_c_OilTrans.TempDiagnosis_AT_Fl.TempDiagnosis_AT._.ZFFSAB ECU_ADDRESS 0xFFF8FE68 /end MEASUREMENT
/begin MEASUREMENT ZFFSAB._.TempDiagnosis_AT.TempDiagnosis_AT_Fl.iv_c_Chip1Trans "Input raw signal Chiptemperature Sensor 1 (CG130)" FLOAT32_IEEE SAB_C_CGT_1CEL_M40_S2_S3 1 100 -40 215 FORMAT "%5.3" DISPLAY_IDENTIFIER iv_c_Chip1Trans.TempDiagnosis_AT_Fl.TempDiagnosis_AT._.ZFFSAB ECU_ADDRESS 0xFFF8FE6C /end MEASUREMENT
/begin MEASUREMENT ZFFSAB._.TempDiagnosis_AT.TempDiagnosis_AT_Fl.iv_c_OilTransESts "Input raw signal EStatus Oeltemperature Sensor" FLOAT32_IEEE SAB_STANDARD_S2_S3 1 100 0 255 FORMAT "%5.3" DISPLAY_IDENTIFIER iv_c_OilTransESts.TempDiagnosis_AT_Fl.TempDiagnosis_AT._.ZFFSAB ECU_ADDRESS 0xFFF8FE70 /end MEASUREMENT
/begin MEASUREMENT ZFFSAB._.TempDiagnosis_AT.TempDiagnosis_AT_Fl.iv_c_OilTransESts_old "Input raw signal EStatus Oeltemperature Sensor previous cycle" FLOAT32_IEEE SAB_STANDARD_S2_S3 1 100 0 255 FORMAT "%5.3" DISPLAY_IDENTIFIER iv_c_OilTransESts_old.TempDiagnosis_AT_Fl.TempDiagnosis_AT._.ZFFSAB ECU_ADDRESS 0xFFF8FE74 /end MEASUREMENT
/begin MEASUREMENT ZFFSAB._.TempDiagnosis_AT.TempDiagnosis_AT_Fl.iv_c_OilTransESts_old_ "complement of input raw signal EStatus Oeltemperature Sensor previous cycle" FLOAT32_IEEE SAB_STANDARD_S2_S3 1 100 0 255 FORMAT "%5.3" DISPLAY_IDENTIFIER iv_c_OilTransESts_old_.TempDiagnosis_AT_Fl.TempDiagnosis_AT._.ZFFSAB ECU_ADDRESS 0xFFF8FE78 /end MEASUREMENT
/begin MEASUREMENT ZFFSAB._.TempDiagnosis_AT.TempDiagnosis_AT_Fl.c_OilTransCorInt "gear oil temperature for gradient limitation" FLOAT32_IEEE SAB_C_CGT_100CEL_M4000_S2_S3 1 100 -40 615.35 DISPLAY_IDENTIFIER c_OilTransCorInt.TempDiagnosis_AT_Fl.TempDiagnosis_AT._.ZFFSAB ECU_ADDRESS 0xFFF8FE7C /end MEASUREMENT
/begin MEASUREMENT ZFFSAB._.TempDiagnosis_AT.TempDiagnosis_AT_Fl.c_OilTransCor "corrected gear oil temperature" FLOAT32_IEEE SAB_C_CGT_1CEL_M40_S2_S3 1 100 -40 215 FORMAT "%5.3" DISPLAY_IDENTIFIER c_OilTransCor.TempDiagnosis_AT_Fl.TempDiagnosis_AT._.ZFFSAB ECU_ADDRESS 0xFFF8FE80 /end MEASUREMENT
/begin MEASUREMENT ZFFSAB._.TempDiagnosis_AT.TempDiagnosis_AT_Fl.iv_c_Chip2Trans_old "Input raw signal temperature chip2" FLOAT32_IEEE SAB_C_CGT_1CEL_M40_S2_S3 1 100 -40 215 FORMAT "%5.3" DISPLAY_IDENTIFIER iv_c_Chip2Trans_old.TempDiagnosis_AT_Fl.TempDiagnosis_AT._.ZFFSAB ECU_ADDRESS 0xFFF8FE84 /end MEASUREMENT
/begin MEASUREMENT ZFFSAB._.TempDiagnosis_AT.TempDiagnosis_AT_Fl.iv_c_Chip2Trans_old_ "complement of Input raw signal temperature chip2" FLOAT32_IEEE SAB_C_CGT_1CEL_M40_S2_S3 1 100 -40 215 FORMAT "%5.3" DISPLAY_IDENTIFIER iv_c_Chip2Trans_old_.TempDiagnosis_AT_Fl.TempDiagnosis_AT._.ZFFSAB ECU_ADDRESS 0xFFF8FE88 /end MEASUREMENT
/begin MEASUREMENT ZFFSAB._.TempDiagnosis_AT.TempDiagnosis_AT_Fl.c_OilTrans_old "Last plausible temperature measured" FLOAT32_IEEE SAB_C_CGT_1CEL_M40_S2_S3 1 100 -40 215 FORMAT "%5.3" DISPLAY_IDENTIFIER c_OilTrans_old.TempDiagnosis_AT_Fl.TempDiagnosis_AT._.ZFFSAB ECU_ADDRESS 0xFFF8FE8C /end MEASUREMENT
/begin MEASUREMENT ZFFSAB._.TempDiagnosis_AT.TempDiagnosis_AT_Fl.c_OilTrans_old_ "complement of last plausible temperature measured" FLOAT32_IEEE SAB_C_CGT_1CEL_M40_S2_S3 1 100 -40 215 FORMAT "%5.3" DISPLAY_IDENTIFIER c_OilTrans_old_.TempDiagnosis_AT_Fl.TempDiagnosis_AT._.ZFFSAB ECU_ADDRESS 0xFFF8FE90 /end MEASUREMENT
/begin MEASUREMENT ZFFSAB._.TempDiagnosis_AT.TempDiagnosis_AT_Fl.f_c_CGT_JumpErr "Error flag for Temperature Jump" FLOAT32_IEEE SAB_STANDARD_S2_S3 1 100 0 1 FORMAT "%5.3" DISPLAY_IDENTIFIER f_c_CGT_JumpErr.TempDiagnosis_AT_Fl.TempDiagnosis_AT._.ZFFSAB ECU_ADDRESS 0xFFF8FE94 /end MEASUREMENT
/begin MEASUREMENT ZFFSAB._.TempDiagnosis_AT.TempDiagnosis_AT_Fl.f_c_CGT_JumpErr_old "Error flag for Temperature Jump last cycle" FLOAT32_IEEE SAB_STANDARD_S2_S3 1 100 0 1 FORMAT "%5.3" DISPLAY_IDENTIFIER f_c_CGT_JumpErr_old.TempDiagnosis_AT_Fl.TempDiagnosis_AT._.ZFFSAB ECU_ADDRESS 0xFFF8FE98 /end MEASUREMENT
/begin MEASUREMENT ZFFSAB._.TempDiagnosis_AT.TempDiagnosis_AT_Fl.f_c_CGT_JumpErr_old_ "complement Error flag for Temperature Jump last cycle" FLOAT32_IEEE SAB_STANDARD_S2_S3 1 100 0 1 FORMAT "%5.3" DISPLAY_IDENTIFIER f_c_CGT_JumpErr_old_.TempDiagnosis_AT_Fl.TempDiagnosis_AT._.ZFFSAB ECU_ADDRESS 0xFFF8FE9C /end MEASUREMENT
/begin MEASUREMENT ZFFSAB._.TempDiagnosis_AT.TempDiagnosis_AT_Fl.f_CGT_Tolerance "Flag to switch close/wide tolerance" FLOAT32_IEEE SAB_STANDARD_S2_S3 1 100 0 1 FORMAT "%5.3" DISPLAY_IDENTIFIER f_CGT_Tolerance.TempDiagnosis_AT_Fl.TempDiagnosis_AT._.ZFFSAB ECU_ADDRESS 0xFFF8FEA0 /end MEASUREMENT
/begin MEASUREMENT ZFFSAB._.TempDiagnosis_AT.TempDiagnosis_AT_Fl.f_c_Chip1CGT "Error flag for Sensor Plausi Chip1CGT" FLOAT32_IEEE SAB_STANDARD_S2_S3 1 100 0 1 FORMAT "%5.3" DISPLAY_IDENTIFIER f_c_Chip1CGT.TempDiagnosis_AT_Fl.TempDiagnosis_AT._.ZFFSAB ECU_ADDRESS 0xFFF8FEA4 /end MEASUREMENT
/begin MEASUREMENT ZFFSAB._.TempDiagnosis_AT.TempDiagnosis_AT_Fl.f_c_Chip2CGT "Error flag for Sensor Plausi Chip2CGT" FLOAT32_IEEE SAB_STANDARD_S2_S3 1 100 0 1 FORMAT "%5.3" DISPLAY_IDENTIFIER f_c_Chip2CGT.TempDiagnosis_AT_Fl.TempDiagnosis_AT._.ZFFSAB ECU_ADDRESS 0xFFF8FEA8 /end MEASUREMENT
/begin MEASUREMENT ZFFSAB._.TempDiagnosis_AT.TempDiagnosis_AT_Fl.f_c_Chip1Chip2 "Error flag for Sensor Plausi Chip1Chip2" FLOAT32_IEEE SAB_STANDARD_S2_S3 1 100 0 1 FORMAT "%5.3" DISPLAY_IDENTIFIER f_c_Chip1Chip2.TempDiagnosis_AT_Fl.TempDiagnosis_AT._.ZFFSAB ECU_ADDRESS 0xFFF8FEAC /end MEASUREMENT
/begin MEASUREMENT ZFFSAB._.TempDiagnosis_AT.TempDiagnosis_AT_Fl.f_CChipdelta "flag for delta error previous cycle" FLOAT32_IEEE SAB_STANDARD_S2_S3 1 100 0 1 FORMAT "%5.3" DISPLAY_IDENTIFIER f_CChipdelta.TempDiagnosis_AT_Fl.TempDiagnosis_AT._.ZFFSAB ECU_ADDRESS 0xFFF8FEB0 /end MEASUREMENT
/begin MEASUREMENT ZFFSAB._.TempDiagnosis_AT.TempDiagnosis_AT_Fl.f_CChipdelta_old "complement flag for delta error previous cycle" FLOAT32_IEEE SAB_STANDARD_S2_S3 1 100 0 1 FORMAT "%5.3" DISPLAY_IDENTIFIER f_CChipdelta_old.TempDiagnosis_AT_Fl.TempDiagnosis_AT._.ZFFSAB ECU_ADDRESS 0xFFF8FEB4 /end MEASUREMENT
/begin MEASUREMENT ZFFSAB._.TempDiagnosis_AT.TempDiagnosis_AT_Fl.f_CChipdelta_old_ "complement flag for delta error previous cycle" FLOAT32_IEEE SAB_STANDARD_S2_S3 1 100 0 1 FORMAT "%5.3" DISPLAY_IDENTIFIER f_CChipdelta_old_.TempDiagnosis_AT_Fl.TempDiagnosis_AT._.ZFFSAB ECU_ADDRESS 0xFFF8FEB8 /end MEASUREMENT
/begin MEASUREMENT ZFFSAB._.TempDiagnosis_AT.TempDiagnosis_AT_Fl.f_c_Chip1PlausiErr "Error flag for Sensor Chip1" FLOAT32_IEEE SAB_STANDARD_S2_S3 1 100 0 1 FORMAT "%5.3" DISPLAY_IDENTIFIER f_c_Chip1PlausiErr.TempDiagnosis_AT_Fl.TempDiagnosis_AT._.ZFFSAB ECU_ADDRESS 0xFFF8FEBC /end MEASUREMENT
/begin MEASUREMENT ZFFSAB._.TempDiagnosis_AT.TempDiagnosis_AT_Fl.f_c_Chip2PlausiErr "Error flag for Sensor Chip2" FLOAT32_IEEE SAB_STANDARD_S2_S3 1 100 0 1 FORMAT "%5.3" DISPLAY_IDENTIFIER f_c_Chip2PlausiErr.TempDiagnosis_AT_Fl.TempDiagnosis_AT._.ZFFSAB ECU_ADDRESS 0xFFF8FEC0 /end MEASUREMENT
/begin MEASUREMENT ZFFSAB._.TempDiagnosis_AT.TempDiagnosis_AT_Fl.f_c_CgtPlausiErr "Error flag for Sensor CGT" FLOAT32_IEEE SAB_STANDARD_S2_S3 1 100 0 1 FORMAT "%5.3" DISPLAY_IDENTIFIER f_c_CgtPlausiErr.TempDiagnosis_AT_Fl.TempDiagnosis_AT._.ZFFSAB ECU_ADDRESS 0xFFF8FEC4 /end MEASUREMENT
/begin MEASUREMENT ZFFSAB._.TempDiagnosis_AT.TempDiagnosis_AT_Fl.f_c_PlausiErr "Error flag double Sensor Error" FLOAT32_IEEE SAB_STANDARD_S2_S3 1 100 0 1 FORMAT "%5.3" DISPLAY_IDENTIFIER f_c_PlausiErr.TempDiagnosis_AT_Fl.TempDiagnosis_AT._.ZFFSAB ECU_ADDRESS 0xFFF8FEC8 /end MEASUREMENT
/begin MEASUREMENT ZFFSAB._.TempDiagnosis_AT.iv_c_Chip1Trans "Input raw signal Chiptemperature Sensor 1 (CG130)" UBYTE SAB_C_CGT_1CEL_M40_S2_S3 1 100 -40 215 DISPLAY_IDENTIFIER iv_c_Chip1Trans.TempDiagnosis_AT._.ZFFSAB ECU_ADDRESS 0xFFF8FEF0 /end MEASUREMENT
/begin MEASUREMENT ZFFSAB._.TempDiagnosis_AT.iv_c_Chip1TransESts "Input raw signal EStatus Chiptemperature Sensor 1 (CG130)" UBYTE SAB_STANDARD_S2_S3 1 100 0 255 DISPLAY_IDENTIFIER iv_c_Chip1TransESts.TempDiagnosis_AT._.ZFFSAB ECU_ADDRESS 0xFFF8FEF1 /end MEASUREMENT
/begin MEASUREMENT ZFFSAB._.TempDiagnosis_AT.iv_c_Chip2Trans "Input raw signal Chiptemperature Sensor 2(LM71)" UBYTE SAB_C_CGT_1CEL_M40_S2_S3 1 100 -40 215 DISPLAY_IDENTIFIER iv_c_Chip2Trans.TempDiagnosis_AT._.ZFFSAB ECU_ADDRESS 0xFFF8FEF2 /end MEASUREMENT
/begin MEASUREMENT ZFFSAB._.TempDiagnosis_AT.iv_c_Chip2TransESts "Input raw signal EStatus Chiptemperature Sensor 1(LM71)" UBYTE SAB_STANDARD_S2_S3 1 100 0 255 DISPLAY_IDENTIFIER iv_c_Chip2TransESts.TempDiagnosis_AT._.ZFFSAB ECU_ADDRESS 0xFFF8FEF3 /end MEASUREMENT
/begin MEASUREMENT ZFFSAB._.TempDiagnosis_AT.iv_c_OilTrans "Input raw signal Oeltemperature Sensor" UBYTE SAB_C_CGT_1CEL_M40_S2_S3 1 100 -40 215 DISPLAY_IDENTIFIER iv_c_OilTrans.TempDiagnosis_AT._.ZFFSAB ECU_ADDRESS 0xFFF8FEF4 /end MEASUREMENT
/begin MEASUREMENT ZFFSAB._.TempDiagnosis_AT.iv_c_OilTransESts "Input raw signal EStatus Oeltemperature Sensor" UBYTE SAB_STANDARD_S2_S3 1 100 0 255 DISPLAY_IDENTIFIER iv_c_OilTransESts.TempDiagnosis_AT._.ZFFSAB ECU_ADDRESS 0xFFF8FEF5 /end MEASUREMENT
/begin MEASUREMENT ZFFSAB._.TempDiagnosis_AT.iv_c_OilTransESts_old "Input raw signal EStatus Oeltemperature Sensor previous cycle" UBYTE SAB_STANDARD_S2_S3 1 100 0 255 DISPLAY_IDENTIFIER iv_c_OilTransESts_old.TempDiagnosis_AT._.ZFFSAB ECU_ADDRESS 0xFFF8FEF6 /end MEASUREMENT
/begin MEASUREMENT ZFFSAB._.TempDiagnosis_AT.iv_c_OilTransESts_old_ "complement Input raw signal EStatus Oeltemperature Sensor previous cycle" UBYTE SAB_STANDARD_S2_S3 1 100 0 255 DISPLAY_IDENTIFIER iv_c_OilTransESts_old_.TempDiagnosis_AT._.ZFFSAB ECU_ADDRESS 0xFFF8FEF7 /end MEASUREMENT
/begin MEASUREMENT ZFFSAB._.TempDiagnosis_AT.c_OilTransCorInt "gear oil temperature for gradient limitation" UWORD SAB_C_CGT_100CEL_M4000_S2_S3 1 100 -40 615.35 DISPLAY_IDENTIFIER c_OilTransCorInt.TempDiagnosis_AT._.ZFFSAB ECU_ADDRESS 0xFFF8FEF8 /end MEASUREMENT
/begin MEASUREMENT ZFFSAB._.TempDiagnosis_AT.c_OilTransCor "corrected gear oil temperature" UBYTE SAB_C_CGT_1CEL_M40_S2_S3 1 100 -40 215 DISPLAY_IDENTIFIER c_OilTransCor.TempDiagnosis_AT._.ZFFSAB ECU_ADDRESS 0xFFF8FEFA /end MEASUREMENT
/begin MEASUREMENT ZFFSAB._.TempDiagnosis_AT.c_OilTransCor_ "corrected gear oil temperature" UBYTE SAB_C_CGT_1CEL_M40_S2_S3 1 100 -40 215 DISPLAY_IDENTIFIER c_OilTransCor_.TempDiagnosis_AT._.ZFFSAB ECU_ADDRESS 0xFFF8FEFB /end MEASUREMENT
/begin MEASUREMENT ZFFSAB._.TempDiagnosis_AT.iv_c_Chip2Trans_old "Input raw signal temperature chip2 last cycle" UBYTE SAB_C_CGT_1CEL_M40_S2_S3 1 100 -40 215 DISPLAY_IDENTIFIER iv_c_Chip2Trans_old.TempDiagnosis_AT._.ZFFSAB ECU_ADDRESS 0xFFF8FEFC /end MEASUREMENT
/begin MEASUREMENT ZFFSAB._.TempDiagnosis_AT.iv_c_Chip2Trans_old_ "complemnet Input raw signal temperature chip2 last cycle" UBYTE SAB_C_CGT_1CEL_M40_S2_S3 1 100 -40 215 DISPLAY_IDENTIFIER iv_c_Chip2Trans_old_.TempDiagnosis_AT._.ZFFSAB ECU_ADDRESS 0xFFF8FEFD /end MEASUREMENT
/begin MEASUREMENT ZFFSAB._.TempDiagnosis_AT.c_OilTrans_old "Last plausible temperature measured" UBYTE SAB_C_CGT_1CEL_M40_S2_S3 1 100 -40 215 DISPLAY_IDENTIFIER c_OilTrans_old.TempDiagnosis_AT._.ZFFSAB ECU_ADDRESS 0xFFF8FEFE /end MEASUREMENT
/begin MEASUREMENT ZFFSAB._.TempDiagnosis_AT.c_OilTrans_old_ "complement Last plausible temperature measured" UBYTE SAB_C_CGT_1CEL_M40_S2_S3 1 100 -40 215 DISPLAY_IDENTIFIER c_OilTrans_old_.TempDiagnosis_AT._.ZFFSAB ECU_ADDRESS 0xFFF8FEFF /end MEASUREMENT
/begin MEASUREMENT ZFFSAB._.TempDiagnosis_AT.f_c_CGT_JumpErr "Error flag for Temperature Jump" UBYTE SAB_STANDARD_S2_S3 1 100 0 1 DISPLAY_IDENTIFIER f_c_CGT_JumpErr.TempDiagnosis_AT._.ZFFSAB ECU_ADDRESS 0xFFF8FF00 /end MEASUREMENT
/begin MEASUREMENT ZFFSAB._.TempDiagnosis_AT.f_c_CGT_JumpErr_old "Error flag for Temperature Jump last cycle" UBYTE SAB_STANDARD_S2_S3 1 100 0 1 DISPLAY_IDENTIFIER f_c_CGT_JumpErr_old.TempDiagnosis_AT._.ZFFSAB ECU_ADDRESS 0xFFF8FF01 /end MEASUREMENT
/begin MEASUREMENT ZFFSAB._.TempDiagnosis_AT.f_c_CGT_JumpErr_old_ "complement Error flag for Temperature Jump last cycle" UBYTE SAB_STANDARD_S2_S3 1 100 0 1 DISPLAY_IDENTIFIER f_c_CGT_JumpErr_old_.TempDiagnosis_AT._.ZFFSAB ECU_ADDRESS 0xFFF8FF02 /end MEASUREMENT
/begin MEASUREMENT ZFFSAB._.TempDiagnosis_AT.f_CGT_Tolerance "Flag to switch close/wide tolerance" UBYTE SAB_STANDARD_S2_S3 1 100 0 1 DISPLAY_IDENTIFIER f_CGT_Tolerance.TempDiagnosis_AT._.ZFFSAB ECU_ADDRESS 0xFFF8FF03 /end MEASUREMENT
/begin MEASUREMENT ZFFSAB._.TempDiagnosis_AT.f_c_Chip1CGT "Error flag for Sensor Plausi Chip1CGT" UBYTE SAB_STANDARD_S2_S3 1 100 0 1 DISPLAY_IDENTIFIER f_c_Chip1CGT.TempDiagnosis_AT._.ZFFSAB ECU_ADDRESS 0xFFF8FF04 /end MEASUREMENT
/begin MEASUREMENT ZFFSAB._.TempDiagnosis_AT.f_c_Chip2CGT "Error flag for Sensor Plausi Chip2CGT" UBYTE SAB_STANDARD_S2_S3 1 100 0 1 DISPLAY_IDENTIFIER f_c_Chip2CGT.TempDiagnosis_AT._.ZFFSAB ECU_ADDRESS 0xFFF8FF05 /end MEASUREMENT
/begin MEASUREMENT ZFFSAB._.TempDiagnosis_AT.f_c_Chip1Chip2 "Error flag for Sensor Plausi Chip1Chip2" UBYTE SAB_STANDARD_S2_S3 1 100 0 1 DISPLAY_IDENTIFIER f_c_Chip1Chip2.TempDiagnosis_AT._.ZFFSAB ECU_ADDRESS 0xFFF8FF06 /end MEASUREMENT
/begin MEASUREMENT ZFFSAB._.TempDiagnosis_AT.f_CChipdelta "flag for delta error previous cycle" UBYTE SAB_STANDARD_S2_S3 1 100 0 1 DISPLAY_IDENTIFIER f_CChipdelta.TempDiagnosis_AT._.ZFFSAB ECU_ADDRESS 0xFFF8FF07 /end MEASUREMENT
/begin MEASUREMENT ZFFSAB._.TempDiagnosis_AT.f_CChipdelta_old "complement flag for delta error previous cycle" UBYTE SAB_STANDARD_S2_S3 1 100 0 1 DISPLAY_IDENTIFIER f_CChipdelta_old.TempDiagnosis_AT._.ZFFSAB ECU_ADDRESS 0xFFF8FF08 /end MEASUREMENT
/begin MEASUREMENT ZFFSAB._.TempDiagnosis_AT.f_CChipdelta_old_ "complement flag for delta error previous cycle" UBYTE SAB_STANDARD_S2_S3 1 100 0 1 DISPLAY_IDENTIFIER f_CChipdelta_old_.TempDiagnosis_AT._.ZFFSAB ECU_ADDRESS 0xFFF8FF09 /end MEASUREMENT
/begin MEASUREMENT ZFFSAB._.TempDiagnosis_AT.f_c_Chip1PlausiErr "Error flag for Sensor Chip1" UBYTE SAB_STANDARD_S2_S3 1 100 0 1 DISPLAY_IDENTIFIER f_c_Chip1PlausiErr.TempDiagnosis_AT._.ZFFSAB ECU_ADDRESS 0xFFF8FF0A /end MEASUREMENT
/begin MEASUREMENT ZFFSAB._.TempDiagnosis_AT.f_c_Chip2PlausiErr "Error flag for Sensor Chip2" UBYTE SAB_STANDARD_S2_S3 1 100 0 1 DISPLAY_IDENTIFIER f_c_Chip2PlausiErr.TempDiagnosis_AT._.ZFFSAB ECU_ADDRESS 0xFFF8FF0B /end MEASUREMENT
/begin MEASUREMENT ZFFSAB._.TempDiagnosis_AT.f_c_Chip2PlausiErr_ "complement Error flag for Sensor Chip2" UBYTE SAB_STANDARD_S2_S3 1 100 0 1 DISPLAY_IDENTIFIER f_c_Chip2PlausiErr_.TempDiagnosis_AT._.ZFFSAB ECU_ADDRESS 0xFFF8FF0C /end MEASUREMENT
/begin MEASUREMENT ZFFSAB._.TempDiagnosis_AT.f_c_CgtPlausiErr "Error flag for Sensor CGT" UBYTE SAB_STANDARD_S2_S3 1 100 0 1 DISPLAY_IDENTIFIER f_c_CgtPlausiErr.TempDiagnosis_AT._.ZFFSAB ECU_ADDRESS 0xFFF8FF0D /end MEASUREMENT
/begin MEASUREMENT ZFFSAB._.TempDiagnosis_AT.f_c_CgtPlausiErr_ "complement Error flag for Sensor CGT" UBYTE SAB_STANDARD_S2_S3 1 100 0 1 DISPLAY_IDENTIFIER f_c_CgtPlausiErr_.TempDiagnosis_AT._.ZFFSAB ECU_ADDRESS 0xFFF8FF0E /end MEASUREMENT
/begin MEASUREMENT ZFFSAB._.TempDiagnosis_AT.f_c_PlausiErr "Error flag double Sensor Error" UBYTE SAB_STANDARD_S2_S3 1 100 0 1 DISPLAY_IDENTIFIER f_c_PlausiErr.TempDiagnosis_AT._.ZFFSAB ECU_ADDRESS 0xFFF8FF0F /end MEASUREMENT
/begin MEASUREMENT ZFFSAB._.TempDiagnosis_AT.f_c_PlausiErr_ "complement Error flag double Sensor Error" UBYTE SAB_STANDARD_S2_S3 1 100 0 1 DISPLAY_IDENTIFIER f_c_PlausiErr_.TempDiagnosis_AT._.ZFFSAB ECU_ADDRESS 0xFFF8FF10 /end MEASUREMENT
/begin MEASUREMENT ZFFSAB._.TempDiagnosis_AT.PAK_counter_start "counter Pak calls in 10 ms Task" UBYTE SAB_STANDARD_S2_S3 1 100 0 19 DISPLAY_IDENTIFIER PAK_counter_start.TempDiagnosis_AT._.ZFFSAB ECU_ADDRESS 0xFFF8FF11 /end MEASUREMENT
/begin MEASUREMENT ZFFSAB._.TempDiagnosis_AT.PAK_counter_start_ "complement of counter Pak calls in 10 ms Task" UBYTE SAB_STANDARD_S2_S3 1 100 0 19 DISPLAY_IDENTIFIER PAK_counter_start_.TempDiagnosis_AT._.ZFFSAB ECU_ADDRESS 0xFFF8FF12 /end MEASUREMENT
/begin MEASUREMENT ZFFSAB._.TempDiagnosis_AT.PAK_counter_end "counter Pak calls in 10 ms Task" UBYTE SAB_STANDARD_S2_S3 1 100 0 19 DISPLAY_IDENTIFIER PAK_counter_end.TempDiagnosis_AT._.ZFFSAB ECU_ADDRESS 0xFFF8FF13 /end MEASUREMENT
/begin MEASUREMENT ZFFSAB._.TempDiagnosis_AT.PAK_counter_end_ "complement of counter Pak calls in 10 ms Task" UBYTE SAB_STANDARD_S2_S3 1 100 0 19 DISPLAY_IDENTIFIER PAK_counter_end_.TempDiagnosis_AT._.ZFFSAB ECU_ADDRESS 0xFFF8FF14 /end MEASUREMENT
/begin MEASUREMENT ZFFSAB._.TransmissionOutputSpeedIn.TransmissionOutputSpeedIn_Fl.iv_n_Ab "Input signal from RPM_Sensing GetImV_n_Ab" FLOAT32_IEEE SAB_N_1RPM_S2_S3 1 100 0 65535 FORMAT "%5.3" DISPLAY_IDENTIFIER iv_n_Ab.TransmissionOutputSpeedIn_Fl.TransmissionOutputSpeedIn._.ZFFSAB ECU_ADDRESS 0xFFF8FF24 /end MEASUREMENT
/begin MEASUREMENT ZFFSAB._.TransmissionOutputSpeedIn.TransmissionOutputSpeedIn_Fl.iv_n_AbESts "Status of Input signal from RPM_Sensing GetImV_n_AbSts" FLOAT32_IEEE SAB_STANDARD_S2_S3 1 100 0 2 FORMAT "%5.3" DISPLAY_IDENTIFIER iv_n_AbESts.TransmissionOutputSpeedIn_Fl.TransmissionOutputSpeedIn._.ZFFSAB ECU_ADDRESS 0xFFF8FF28 /end MEASUREMENT
/begin MEASUREMENT ZFFSAB._.TransmissionOutputSpeedIn.TransmissionOutputSpeedIn_Fl.iv_n_Ab_ "Input signal from RPM_Sensing GetImV_n_Ab complement" FLOAT32_IEEE SAB_N_1RPM_S2_S3 1 100 0 65535 FORMAT "%5.3" DISPLAY_IDENTIFIER iv_n_Ab_.TransmissionOutputSpeedIn_Fl.TransmissionOutputSpeedIn._.ZFFSAB ECU_ADDRESS 0xFFF8FF2C /end MEASUREMENT
/begin MEASUREMENT ZFFSAB._.TransmissionOutputSpeedIn.TransmissionOutputSpeedIn_Fl.iv_n_AbESts_ "Status of Input signal from RPM_Sensing GetImV_n_AbSts complement" FLOAT32_IEEE SAB_STANDARD_S2_S3 1 100 0 1 FORMAT "%5.3" DISPLAY_IDENTIFIER iv_n_AbESts_.TransmissionOutputSpeedIn_Fl.TransmissionOutputSpeedIn._.ZFFSAB ECU_ADDRESS 0xFFF8FF30 /end MEASUREMENT
/begin MEASUREMENT ZFFSAB._.TransmissionOutputSpeedIn.TransmissionOutputSpeedIn_Fl.iv_u_SensESts "voltage sensor status" FLOAT32_IEEE SAB_STANDARD_S2_S3 1 100 0 255 FORMAT "%5.3" DISPLAY_IDENTIFIER iv_u_SensESts.TransmissionOutputSpeedIn_Fl.TransmissionOutputSpeedIn._.ZFFSAB ECU_ADDRESS 0xFFF8FF34 /end MEASUREMENT
/begin MEASUREMENT ZFFSAB._.TransmissionOutputSpeedIn.TransmissionOutputSpeedIn_Fl.iv_u_SensESts_ "voltage sensor status" FLOAT32_IEEE SAB_STANDARD_S2_S3 1 100 0 255 FORMAT "%5.3" DISPLAY_IDENTIFIER iv_u_SensESts_.TransmissionOutputSpeedIn_Fl.TransmissionOutputSpeedIn._.ZFFSAB ECU_ADDRESS 0xFFF8FF38 /end MEASUREMENT
/begin MEASUREMENT ZFFSAB._.TransmissionOutputSpeedIn.TransmissionOutputSpeedIn_Fl.sv_n_Ab "Output signal of transmission output speed" FLOAT32_IEEE SAB_N_1RPM_S2_S3 1 100 0 65535 FORMAT "%5.3" DISPLAY_IDENTIFIER sv_n_Ab.TransmissionOutputSpeedIn_Fl.TransmissionOutputSpeedIn._.ZFFSAB ECU_ADDRESS 0xFFF8FF3C /end MEASUREMENT
/begin MEASUREMENT ZFFSAB._.TransmissionOutputSpeedIn.TransmissionOutputSpeedIn_Fl.sv_n_AbSts "Output signal of Transmission Output Speed" FLOAT32_IEEE SAB_STANDARD_S2_S3 1 100 0 2 FORMAT "%5.3" DISPLAY_IDENTIFIER sv_n_AbSts.TransmissionOutputSpeedIn_Fl.TransmissionOutputSpeedIn._.ZFFSAB ECU_ADDRESS 0xFFF8FF40 /end MEASUREMENT
/begin MEASUREMENT ZFFSAB._.TransmissionOutputSpeedIn.TransmissionOutputSpeedIn_Fl.sv_n_AbMax "Output signal of MAX selection between sv_n_Ab and n_AbByNWheel" FLOAT32_IEEE SAB_N_1RPM_S2_S3 1 100 0 65535 FORMAT "%5.3" DISPLAY_IDENTIFIER sv_n_AbMax.TransmissionOutputSpeedIn_Fl.TransmissionOutputSpeedIn._.ZFFSAB ECU_ADDRESS 0xFFF8FF44 /end MEASUREMENT
/begin MEASUREMENT ZFFSAB._.TransmissionOutputSpeedIn.TransmissionOutputSpeedIn_Fl.sv_n_AbMaxSts "Stauts signal of MAX selection between sv_n_Ab and n_AbByNWheel" FLOAT32_IEEE SAB_STANDARD_S2_S3 1 100 0 2 FORMAT "%5.3" DISPLAY_IDENTIFIER sv_n_AbMaxSts.TransmissionOutputSpeedIn_Fl.TransmissionOutputSpeedIn._.ZFFSAB ECU_ADDRESS 0xFFF8FF48 /end MEASUREMENT
/begin MEASUREMENT ZFFSAB._.TransmissionOutputSpeedIn.TransmissionOutputSpeedIn_Fl.loc_RearAxleRatio "Output signal from module RearAxleRatioIn" FLOAT32_IEEE SAB_K100_S2_S3 1 100 0 655.35 DISPLAY_IDENTIFIER loc_RearAxleRatio.TransmissionOutputSpeedIn_Fl.TransmissionOutputSpeedIn._.ZFFSAB ECU_ADDRESS 0xFFF8FF4C /end MEASUREMENT
/begin MEASUREMENT ZFFSAB._.TransmissionOutputSpeedIn.TransmissionOutputSpeedIn_Fl.iGang "local variable to check if transmission is in a gear or not" FLOAT32_IEEE SAB_STANDARD_S2_S3 1 100 0 4294967295 FORMAT "%5.3" DISPLAY_IDENTIFIER iGang.TransmissionOutputSpeedIn_Fl.TransmissionOutputSpeedIn._.ZFFSAB ECU_ADDRESS 0xFFF8FF54 /end MEASUREMENT
/begin MEASUREMENT ZFFSAB._.TransmissionOutputSpeedIn.TransmissionOutputSpeedIn_Fl.f_n_AbWheelErr "local variable for f_n_AbWheelErr from GearRatioByCurrentsAT" FLOAT32_IEEE SAB_STANDARD_S2_S3 1 100 0 4294967295 FORMAT "%5.3" DISPLAY_IDENTIFIER f_n_AbWheelErr.TransmissionOutputSpeedIn_Fl.TransmissionOutputSpeedIn._.ZFFSAB ECU_ADDRESS 0xFFF8FF58 /end MEASUREMENT
/begin MEASUREMENT ZFFSAB._.TransmissionOutputSpeedIn.TransmissionOutputSpeedIn_Fl.n_AbByNWheel "calculated n_ab value by wheel rpm" FLOAT32_IEEE SAB_N_1RPM_S2_S3 1 100 0 65535 FORMAT "%5.3" DISPLAY_IDENTIFIER n_AbByNWheel.TransmissionOutputSpeedIn_Fl.TransmissionOutputSpeedIn._.ZFFSAB ECU_ADDRESS 0xFFF8FF5C /end MEASUREMENT
/begin MEASUREMENT ZFFSAB._.TransmissionOutputSpeedIn.TransmissionOutputSpeedIn_Fl.f_n_AbPlausiErr "local variable for the transmission outputspeed value plausibility flag" FLOAT32_IEEE SAB_STANDARD_S2_S3 1 100 0 1 FORMAT "%5.3" DISPLAY_IDENTIFIER f_n_AbPlausiErr.TransmissionOutputSpeedIn_Fl.TransmissionOutputSpeedIn._.ZFFSAB ECU_ADDRESS 0xFFF8FF60 /end MEASUREMENT
/begin MEASUREMENT ZFFSAB._.TransmissionOutputSpeedIn.TransmissionOutputSpeedIn_Fl.f_n_WheelPlausiErr "local variable for Wheel plausibility flag from module GearRatioByCurrents" FLOAT32_IEEE SAB_STANDARD_S2_S3 1 100 0 1 FORMAT "%5.3" DISPLAY_IDENTIFIER f_n_WheelPlausiErr.TransmissionOutputSpeedIn_Fl.TransmissionOutputSpeedIn._.ZFFSAB ECU_ADDRESS 0xFFF8FF64 /end MEASUREMENT
/begin MEASUREMENT ZFFSAB._.TransmissionOutputSpeedIn.TransmissionOutputSpeedIn_Fl.n_WheelAvg "Average Wheel rpm of all driven wheels" FLOAT32_IEEE SAB_N_RPM100_S2_S3 1 100 0 42949672.95 DISPLAY_IDENTIFIER n_WheelAvg.TransmissionOutputSpeedIn_Fl.TransmissionOutputSpeedIn._.ZFFSAB ECU_ADDRESS 0xFFF8FF68 /end MEASUREMENT
/begin MEASUREMENT ZFFSAB._.TransmissionOutputSpeedIn.TransmissionOutputSpeedIn_Fl.n_WheelAvgSts "Status of average Wheel rpm derived from driven wheels" FLOAT32_IEEE SAB_STANDARD_S2_S3 1 100 0 2 FORMAT "%5.3" DISPLAY_IDENTIFIER n_WheelAvgSts.TransmissionOutputSpeedIn_Fl.TransmissionOutputSpeedIn._.ZFFSAB ECU_ADDRESS 0xFFF8FF6C /end MEASUREMENT
/begin MEASUREMENT ZFFSAB._.TransmissionOutputSpeedIn.iv_u_SensESts "state of iv_PSens1" UBYTE SAB_STANDARD_S2_S3 1 100 0 255 DISPLAY_IDENTIFIER iv_u_SensESts.TransmissionOutputSpeedIn._.ZFFSAB ECU_ADDRESS 0xFFF8FF84 /end MEASUREMENT
/begin MEASUREMENT ZFFSAB._.TransmissionOutputSpeedIn.iv_u_SensESts_ "state of iv_PSens1 complement" UBYTE SAB_STANDARD_S2_S3 1 100 0 255 DISPLAY_IDENTIFIER iv_u_SensESts_.TransmissionOutputSpeedIn._.ZFFSAB ECU_ADDRESS 0xFFF8FF85 /end MEASUREMENT
/begin MEASUREMENT ZFFSAB._.TransmissionOutputSpeedIn.sv_n_Ab "Output signal of transmission output speed" UWORD SAB_N_1RPM_S2_S3 1 100 0 65535 DISPLAY_IDENTIFIER sv_n_Ab.TransmissionOutputSpeedIn._.ZFFSAB ECU_ADDRESS 0xFFF8FF86 /end MEASUREMENT
/begin MEASUREMENT ZFFSAB._.TransmissionOutputSpeedIn.sv_n_Ab_ "Output signal of transmission outputspeed complement" UWORD SAB_N_1RPM_S2_S3 1 100 0 65535 DISPLAY_IDENTIFIER sv_n_Ab_.TransmissionOutputSpeedIn._.ZFFSAB ECU_ADDRESS 0xFFF8FF88 /end MEASUREMENT
/begin MEASUREMENT ZFFSAB._.TransmissionOutputSpeedIn.sv_n_Ab_Tx "Output value for n_Ab to CAN" UWORD SAB_N_RPM_M2000_S2_S3 1 100 -2000 63535 DISPLAY_IDENTIFIER sv_n_Ab_Tx.TransmissionOutputSpeedIn._.ZFFSAB ECU_ADDRESS 0xFFF8FF8A /end MEASUREMENT
/begin MEASUREMENT ZFFSAB._.TransmissionOutputSpeedIn.sv_n_Ab_Tx_ "Output value for n_Ab to CAN" UWORD SAB_STANDARD_S2_S3 1 100 0 65535 DISPLAY_IDENTIFIER sv_n_Ab_Tx_.TransmissionOutputSpeedIn._.ZFFSAB ECU_ADDRESS 0xFFF8FF8C /end MEASUREMENT
/begin MEASUREMENT ZFFSAB._.TransmissionOutputSpeedIn.sv_n_AbFilt "Output value for filtered n_Ab" UWORD SAB_N_1RPM_S2_S3 1 100 0 65535 DISPLAY_IDENTIFIER sv_n_AbFilt.TransmissionOutputSpeedIn._.ZFFSAB ECU_ADDRESS 0xFFF8FF8E /end MEASUREMENT
/begin MEASUREMENT ZFFSAB._.TransmissionOutputSpeedIn.sv_n_AbSts "Output signal of Transmission Output Speed" UBYTE SAB_STANDARD_S2_S3 1 100 0 2 DISPLAY_IDENTIFIER sv_n_AbSts.TransmissionOutputSpeedIn._.ZFFSAB ECU_ADDRESS 0xFFF8FF90 /end MEASUREMENT
/begin MEASUREMENT ZFFSAB._.TransmissionOutputSpeedIn.sv_n_AbSts_ "Output signal of Transmission Output Speed" UBYTE SAB_STANDARD_S2_S3 1 100 0 2 DISPLAY_IDENTIFIER sv_n_AbSts_.TransmissionOutputSpeedIn._.ZFFSAB ECU_ADDRESS 0xFFF8FF91 /end MEASUREMENT
/begin MEASUREMENT ZFFSAB._.TransmissionOutputSpeedIn.sv_n_AbMax "Output signal of the max selection between n_Ab and n_WheelAvg" UWORD SAB_N_1RPM_S2_S3 1 100 0 65535 DISPLAY_IDENTIFIER sv_n_AbMax.TransmissionOutputSpeedIn._.ZFFSAB ECU_ADDRESS 0xFFF8FF92 /end MEASUREMENT
/begin MEASUREMENT ZFFSAB._.TransmissionOutputSpeedIn.sv_n_AbMax_ "Output signal of the max selection between n_Ab and n_WheelAvg" UWORD SAB_N_1RPM_S2_S3 1 100 0 65535 DISPLAY_IDENTIFIER sv_n_AbMax_.TransmissionOutputSpeedIn._.ZFFSAB ECU_ADDRESS 0xFFF8FF94 /end MEASUREMENT
/begin MEASUREMENT ZFFSAB._.TransmissionOutputSpeedIn.sv_n_AbMaxSts "Output signal of the max selection status" UBYTE SAB_STANDARD_S2_S3 1 100 0 2 DISPLAY_IDENTIFIER sv_n_AbMaxSts.TransmissionOutputSpeedIn._.ZFFSAB ECU_ADDRESS 0xFFF8FF96 /end MEASUREMENT
/begin MEASUREMENT ZFFSAB._.TransmissionOutputSpeedIn.sv_n_AbMaxSts_ "Output signal of the max selection status" UBYTE SAB_STANDARD_S2_S3 1 100 0 2 DISPLAY_IDENTIFIER sv_n_AbMaxSts_.TransmissionOutputSpeedIn._.ZFFSAB ECU_ADDRESS 0xFFF8FF97 /end MEASUREMENT
/begin MEASUREMENT ZFFSAB._.TransmissionOutputSpeedIn.Ab_f_DirectionErr "Error flag of the direction-detection" UBYTE SAB_STANDARD_S2_S3 1 100 0 1 DISPLAY_IDENTIFIER Ab_f_DirectionErr.TransmissionOutputSpeedIn._.ZFFSAB ECU_ADDRESS 0xFFF8FF98 /end MEASUREMENT
/begin MEASUREMENT ZFFSAB._.TransmissionOutputSpeedIn.iv_n_Ab "Input signal from RPM_Sensing GetImV_n_Ab" UWORD SAB_N_1RPM_S2_S3 1 100 0 65535 DISPLAY_IDENTIFIER iv_n_Ab.TransmissionOutputSpeedIn._.ZFFSAB ECU_ADDRESS 0xFFF8FF9A /end MEASUREMENT
/begin MEASUREMENT ZFFSAB._.TransmissionOutputSpeedIn.iv_n_AbESts "Status of Input signal from RPM_Sensing GetImV_n_AbSts" UBYTE SAB_STANDARD_S2_S3 1 100 0 2 DISPLAY_IDENTIFIER iv_n_AbESts.TransmissionOutputSpeedIn._.ZFFSAB ECU_ADDRESS 0xFFF8FF9C /end MEASUREMENT
/begin MEASUREMENT ZFFSAB._.TransmissionOutputSpeedIn.iv_n_Ab_ "Input signal from RPM_Sensing GetImV_n_Ab complement" UWORD SAB_N_1RPM_S2_S3 1 100 0 65535 DISPLAY_IDENTIFIER iv_n_Ab_.TransmissionOutputSpeedIn._.ZFFSAB ECU_ADDRESS 0xFFF8FF9E /end MEASUREMENT
/begin MEASUREMENT ZFFSAB._.TransmissionOutputSpeedIn.iv_n_AbESts_ "Status of Input signal from RPM_Sensing GetImV_n_AbSts complement" UBYTE SAB_STANDARD_S2_S3 1 100 0 1 DISPLAY_IDENTIFIER iv_n_AbESts_.TransmissionOutputSpeedIn._.ZFFSAB ECU_ADDRESS 0xFFF8FFA0 /end MEASUREMENT
/begin MEASUREMENT ZFFSAB._.TransmissionOutputSpeedIn.n_AbByNWheel "calculated n_ab value by wheel rpm" UWORD SAB_N_1RPM_S2_S3 1 100 0 65535 DISPLAY_IDENTIFIER n_AbByNWheel.TransmissionOutputSpeedIn._.ZFFSAB ECU_ADDRESS 0xFFF8FFA2 /end MEASUREMENT
/begin MEASUREMENT ZFFSAB._.TransmissionOutputSpeedIn.loc_RearAxleRatio "Output signal from module RearAxleRatioIn" UWORD SAB_K100_S2_S3 1 100 0 655.35 DISPLAY_IDENTIFIER loc_RearAxleRatio.TransmissionOutputSpeedIn._.ZFFSAB ECU_ADDRESS 0xFFF8FFA4 /end MEASUREMENT
/begin MEASUREMENT ZFFSAB._.TransmissionOutputSpeedIn.f_n_AbPlausiErr "local variable for the transmission outputspeed value plausibility flag" UBYTE SAB_STANDARD_S2_S3 1 100 0 1 DISPLAY_IDENTIFIER f_n_AbPlausiErr.TransmissionOutputSpeedIn._.ZFFSAB ECU_ADDRESS 0xFFF8FFA6 /end MEASUREMENT
/begin MEASUREMENT ZFFSAB._.TransmissionOutputSpeedIn.f_n_AbPlausiErr_ "local variable for the transmission outputspeed value plausibility flag complement" UBYTE SAB_STANDARD_S2_S3 1 100 0 1 DISPLAY_IDENTIFIER f_n_AbPlausiErr_.TransmissionOutputSpeedIn._.ZFFSAB ECU_ADDRESS 0xFFF8FFA7 /end MEASUREMENT
/begin MEASUREMENT ZFFSAB._.TransmissionOutputSpeedIn.f_n_WheelPlausiErr "local variable for Wheel plausibility flag from module GearRatioByCurrents" UBYTE SAB_STANDARD_S2_S3 1 100 0 1 DISPLAY_IDENTIFIER f_n_WheelPlausiErr.TransmissionOutputSpeedIn._.ZFFSAB ECU_ADDRESS 0xFFF8FFA8 /end MEASUREMENT
/begin MEASUREMENT ZFFSAB._.TransmissionOutputSpeedIn.n_WheelAvg "Average Wheel rpm of all driven wheels" ULONG SAB_N_RPM100_S2_S3 1 100 0 42949672.95 DISPLAY_IDENTIFIER n_WheelAvg.TransmissionOutputSpeedIn._.ZFFSAB ECU_ADDRESS 0xFFF8FFAC /end MEASUREMENT
/begin MEASUREMENT ZFFSAB._.TransmissionOutputSpeedIn.n_WheelAvgSts "Status of average Wheel rpm derived from driven wheels" UBYTE SAB_STANDARD_S2_S3 1 100 0 2 DISPLAY_IDENTIFIER n_WheelAvgSts.TransmissionOutputSpeedIn._.ZFFSAB ECU_ADDRESS 0xFFF8FFB0 /end MEASUREMENT
/begin MEASUREMENT ZFFSAB._.TransmissionOutputSpeedIn.iGang "local variable to check if transmission is in a gear or not" UWORD SAB_STANDARD_S2_S3 1 100 0 65535 DISPLAY_IDENTIFIER iGang.TransmissionOutputSpeedIn._.ZFFSAB ECU_ADDRESS 0xFFF8FFB4 /end MEASUREMENT
/begin MEASUREMENT ZFFSAB._.TransmissionOutputSpeedIn.f_n_AbWheelErr "local variable for f_n_AbWheelErr from GearRatioByCurrentsAT" UBYTE SAB_STANDARD_S2_S3 1 100 0 255 DISPLAY_IDENTIFIER f_n_AbWheelErr.TransmissionOutputSpeedIn._.ZFFSAB ECU_ADDRESS 0xFFF8FFB6 /end MEASUREMENT
/begin MEASUREMENT ZFFSAB._.TransmissionOutputSpeedIn.n_AbFilt_CAN "filtered signal derived from iv_n_Ab" UWORD SAB_N_1RPM_S2_S3 1 100 0 65535 DISPLAY_IDENTIFIER n_AbFilt_CAN.TransmissionOutputSpeedIn._.ZFFSAB ECU_ADDRESS 0xFFF8FFB8 /end MEASUREMENT
/begin MEASUREMENT ZFFSAB._.TransmissionOutputSpeedIn.n_AbFilt_CAN_ "filtered signal derived from iv_n_Ab_ complement" UWORD SAB_N_1RPM_S2_S3 1 100 0 65535 DISPLAY_IDENTIFIER n_AbFilt_CAN_.TransmissionOutputSpeedIn._.ZFFSAB ECU_ADDRESS 0xFFF8FFBA /end MEASUREMENT
/begin MEASUREMENT ZFFSAB._.TorqueReserveIn.f_m_ReserveErr "Errorflag for torque reserve" UBYTE SAB_STANDARD_S2_S3 1 100 0 1 DISPLAY_IDENTIFIER f_m_ReserveErr.TorqueReserveIn._.ZFFSAB ECU_ADDRESS 0xFFF9765C /end MEASUREMENT
/begin MEASUREMENT ZFFSAB._.TorqueReserveIn.iv_m_Reserve "Input value torque reserve from CAN" UWORD SAB_M_NM2_M2047_S2_S3 1 100 -1023.5 1023.5 DISPLAY_IDENTIFIER iv_m_Reserve.TorqueReserveIn._.ZFFSAB ECU_ADDRESS 0xFFF9765E /end MEASUREMENT
/begin MEASUREMENT ZFFSAB._.TorqueReserveIn.iv_m_ReserveSts "Input value message status of torque reserve" UBYTE SAB_STANDARD_S2_S3 1 100 0 255 DISPLAY_IDENTIFIER iv_m_ReserveSts.TorqueReserveIn._.ZFFSAB ECU_ADDRESS 0xFFF97660 /end MEASUREMENT
/begin MEASUREMENT ZFFSAB._.TorqueReserveIn.sv_m_Reserve "Output value of torque reserve" SWORD SAB_M_1NM_S2_S3 1 100 -32768 32767 DISPLAY_IDENTIFIER sv_m_Reserve.TorqueReserveIn._.ZFFSAB ECU_ADDRESS 0xFFF97662 /end MEASUREMENT
/begin MEASUREMENT ZFFSAB._.TorqueReserveIn.sv_m_ReserveSts "Output value of signal status of torque reserve signal" UBYTE SAB_STANDARD_S2_S3 1 100 0 2 DISPLAY_IDENTIFIER sv_m_ReserveSts.TorqueReserveIn._.ZFFSAB ECU_ADDRESS 0xFFF97664 /end MEASUREMENT
/begin MEASUREMENT ZFFSAB._.FuelCutoffActiveIn.iv_FuelCutoffActive "Input value for fuel cutoff active message" UBYTE SAB_STANDARD_S2_S3 1 100 0 3 DISPLAY_IDENTIFIER iv_FuelCutoffActive.FuelCutoffActiveIn._.ZFFSAB ECU_ADDRESS 0xFFF983C0 /end MEASUREMENT
/begin MEASUREMENT ZFFSAB._.FuelCutoffActiveIn.iv_FuelCutoffActiveSts "Input value for fuel cutoff active message status" UBYTE SAB_STANDARD_S2_S3 1 100 0 255 DISPLAY_IDENTIFIER iv_FuelCutoffActiveSts.FuelCutoffActiveIn._.ZFFSAB ECU_ADDRESS 0xFFF983C1 /end MEASUREMENT
/begin MEASUREMENT ZFFSAB._.FuelCutoffActiveIn.sv_f_FuelCutoffActive "Output value for fuel cutoff active message" UBYTE SAB_STANDARD_S2_S3 1 100 0 1 DISPLAY_IDENTIFIER sv_f_FuelCutoffActive.FuelCutoffActiveIn._.ZFFSAB ECU_ADDRESS 0xFFF983C2 /end MEASUREMENT
/begin MEASUREMENT ZFFSAB._.FuelCutoffActiveIn.sv_FuelCutoffActiveSts "Output value for fuel cutoff active message status" UBYTE SAB_STANDARD_S2_S3 1 100 0 2 DISPLAY_IDENTIFIER sv_FuelCutoffActiveSts.FuelCutoffActiveIn._.ZFFSAB ECU_ADDRESS 0xFFF983C3 /end MEASUREMENT
/begin MEASUREMENT ZFFSAB._.FuelCutoffActiveIn.sv_AGS_StatINFS "Output value for fuel cutoff active signal for LayerAGS" UBYTE SAB_STANDARD_S2_S3 1 100 0 1 DISPLAY_IDENTIFIER sv_AGS_StatINFS.FuelCutoffActiveIn._.ZFFSAB ECU_ADDRESS 0xFFF983C4 /end MEASUREMENT
/begin MEASUREMENT ZFFSAB._.EngineIdleSpeedReqIn.iv_n_EngIdle "Input value for engine idle speed" UBYTE SAB_N_5RPM_S2_S3 1 100 0 1270 DISPLAY_IDENTIFIER iv_n_EngIdle.EngineIdleSpeedReqIn._.ZFFSAB ECU_ADDRESS 0xFFF9766C /end MEASUREMENT
/begin MEASUREMENT ZFFSAB._.EngineIdleSpeedReqIn.iv_n_EngIdleSts "Input value for CAN message status of engine idle speed" UBYTE SAB_STANDARD_S2_S3 1 100 0 255 DISPLAY_IDENTIFIER iv_n_EngIdleSts.EngineIdleSpeedReqIn._.ZFFSAB ECU_ADDRESS 0xFFF9766D /end MEASUREMENT
/begin MEASUREMENT ZFFSAB._.EngineIdleSpeedReqIn.iv_n_EngIdleExt "Input value for engine idle speed (EXT)" UBYTE SAB_N_10RPM_S2_S3 1 100 0 2540 DISPLAY_IDENTIFIER iv_n_EngIdleExt.EngineIdleSpeedReqIn._.ZFFSAB ECU_ADDRESS 0xFFF9766E /end MEASUREMENT
/begin MEASUREMENT ZFFSAB._.EngineIdleSpeedReqIn.iv_n_EngIdleExtSts "Input value for CAN message status" UBYTE SAB_STANDARD_S2_S3 1 100 0 255 DISPLAY_IDENTIFIER iv_n_EngIdleExtSts.EngineIdleSpeedReqIn._.ZFFSAB ECU_ADDRESS 0xFFF9766F /end MEASUREMENT
/begin MEASUREMENT ZFFSAB._.EngineIdleSpeedReqIn.sv_n_EngIdle "Output value for engine idle speed" UWORD SAB_N_1RPM_S2_S3 1 100 0 2540 DISPLAY_IDENTIFIER sv_n_EngIdle.EngineIdleSpeedReqIn._.ZFFSAB ECU_ADDRESS 0xFFF97670 /end MEASUREMENT
/begin MEASUREMENT ZFFSAB._.EngineIdleSpeedReqIn.sv_n_EngIdleSts "Output value status of signal engine idle speed" UBYTE SAB_STANDARD_S2_S3 1 100 0 2 DISPLAY_IDENTIFIER sv_n_EngIdleSts.EngineIdleSpeedReqIn._.ZFFSAB ECU_ADDRESS 0xFFF97672 /end MEASUREMENT
/begin MEASUREMENT ZFFSAB._.EngineIdleSpeedReqIn.f_n_EngIdleErr "Error flag signal engine idle speed" UBYTE SAB_STANDARD_S2_S3 1 100 0 255 DISPLAY_IDENTIFIER f_n_EngIdleErr.EngineIdleSpeedReqIn._.ZFFSAB ECU_ADDRESS 0xFFF97673 /end MEASUREMENT
/begin MEASUREMENT ZFFSAB._.BaroPressureIn.iv_p_Air "Input value barometric pressure from CAN" UBYTE SAB_P_BARO_2HPA_P598_S2_S3 1 100 598 1108 DISPLAY_IDENTIFIER iv_p_Air.BaroPressureIn._.ZFFSAB ECU_ADDRESS 0xFFF9847E /end MEASUREMENT
/begin MEASUREMENT ZFFSAB._.BaroPressureIn.iv_p_AirSts "Input value message status of barometric pressure" UBYTE SAB_STANDARD_S2_S3 1 100 0 255 DISPLAY_IDENTIFIER iv_p_AirSts.BaroPressureIn._.ZFFSAB ECU_ADDRESS 0xFFF9847F /end MEASUREMENT
/begin MEASUREMENT ZFFSAB._.BaroPressureIn.sv_p_Air "Output value of barometric pressure" UWORD SAB_P_1HPA_S2_S3 1 100 0 65535 DISPLAY_IDENTIFIER sv_p_Air.BaroPressureIn._.ZFFSAB ECU_ADDRESS 0xFFF98480 /end MEASUREMENT
/begin MEASUREMENT ZFFSAB._.BaroPressureIn.sv_p_AirSts "Output value signal status of barometric pressure" UBYTE SAB_STANDARD_S2_S3 1 100 0 2 DISPLAY_IDENTIFIER sv_p_AirSts.BaroPressureIn._.ZFFSAB ECU_ADDRESS 0xFFF98482 /end MEASUREMENT
/begin MEASUREMENT ZFFSAB._.BaroPressureIn.f_p_AirErr "Error flag barometric pressure" UBYTE SAB_STANDARD_S2_S3 1 100 0 1 DISPLAY_IDENTIFIER f_p_AirErr.BaroPressureIn._.ZFFSAB ECU_ADDRESS 0xFFF98483 /end MEASUREMENT
/begin MEASUREMENT ZFFSAB._.HybridSignalsIn.iv_CrankshaftStopPosition "Input CAN message. Angular displacement of crankshaft." UBYTE SAB_PHI_GRAD_S2_S3 1 100 0 255 DISPLAY_IDENTIFIER iv_CrankshaftStopPosition.HybridSignalsIn._.ZFFSAB ECU_ADDRESS 0xFFF97678 /end MEASUREMENT
/begin MEASUREMENT ZFFSAB._.HybridSignalsIn.iv_CrankshaftStopPositionSts "Input CAN message status. Angular displacement of crankshaft." UBYTE SAB_STANDARD_S2_S3 1 100 0 255 DISPLAY_IDENTIFIER iv_CrankshaftStopPositionSts.HybridSignalsIn._.ZFFSAB ECU_ADDRESS 0xFFF97679 /end MEASUREMENT
/begin MEASUREMENT ZFFSAB._.HybridSignalsIn.iv_m_AntSumRekupGearb "Input raw signal SollRadmomentAntriebstrangSummeRek_Getr_Hybrid" UWORD SAB_M_1NM_M32000_S2_S3 1 100 -32000 33535 DISPLAY_IDENTIFIER iv_m_AntSumRekupGearb.HybridSignalsIn._.ZFFSAB ECU_ADDRESS 0xFFF9767A /end MEASUREMENT
/begin MEASUREMENT ZFFSAB._.HybridSignalsIn.iv_m_AntSumRekupGearbSts "Input CAN message status SollRadmomentAntriebstrangSummeRek_Getr_Hybrid" UBYTE SAB_STANDARD_S2_S3 1 100 0 255 DISPLAY_IDENTIFIER iv_m_AntSumRekupGearbSts.HybridSignalsIn._.ZFFSAB ECU_ADDRESS 0xFFF9767C /end MEASUREMENT
/begin MEASUREMENT ZFFSAB._.HybridSignalsIn.iv_m_AntSumSchleppUnten "Input raw signal IstRadmomentAntriebstrangSummeSchleppmoment_unten_Hybrid" UWORD SAB_M_1NM_M32000_S2_S3 1 100 -32000 33535 DISPLAY_IDENTIFIER iv_m_AntSumSchleppUnten.HybridSignalsIn._.ZFFSAB ECU_ADDRESS 0xFFF9767E /end MEASUREMENT
/begin MEASUREMENT ZFFSAB._.HybridSignalsIn.iv_m_AntSumSchleppUntenSts "Input CAN message status IstRadmomentAntriebstrangSummeSchleppmoment_unten_Hybrid" UBYTE SAB_STANDARD_S2_S3 1 100 0 255 DISPLAY_IDENTIFIER iv_m_AntSumSchleppUntenSts.HybridSignalsIn._.ZFFSAB ECU_ADDRESS 0xFFF97680 /end MEASUREMENT
/begin MEASUREMENT ZFFSAB._.HybridSignalsIn.iv_m_AntSumRekupMax "Input raw signal IstRadmomentAntriebstrangSumme_Rekuperation_Maximal_Hybrid" UWORD SAB_M_1NM_M32000_S2_S3 1 100 -32000 33535 DISPLAY_IDENTIFIER iv_m_AntSumRekupMax.HybridSignalsIn._.ZFFSAB ECU_ADDRESS 0xFFF97682 /end MEASUREMENT
/begin MEASUREMENT ZFFSAB._.HybridSignalsIn.iv_m_AntSumRekupMaxSts "Input CAN message status IstRadmomentAntriebstrangSumme_Rekuperation_Maximal_Hybrid" UBYTE SAB_STANDARD_S2_S3 1 100 0 255 DISPLAY_IDENTIFIER iv_m_AntSumRekupMaxSts.HybridSignalsIn._.ZFFSAB ECU_ADDRESS 0xFFF97684 /end MEASUREMENT
/begin MEASUREMENT ZFFSAB._.HybridSignalsIn.iv_Vor_m_Ant_Sum_Rekup_Max "Input raw signal VorausIstRadmomentAntriebstrangSumme_Rekuperation_Maximal_Hybrid" UWORD SAB_M_1NM_M32000_S2_S3 1 100 -32000 33535 DISPLAY_IDENTIFIER iv_Vor_m_Ant_Sum_Rekup_Max.HybridSignalsIn._.ZFFSAB ECU_ADDRESS 0xFFF97686 /end MEASUREMENT
/begin MEASUREMENT ZFFSAB._.HybridSignalsIn.iv_Vor_m_Ant_Sum_Rekup_MaxSts "Input CAN message status VorausIstRadmomentAntriebstrangSumme_Rekuperation_Maximal_Hybrid" UBYTE SAB_STANDARD_S2_S3 1 100 0 255 DISPLAY_IDENTIFIER iv_Vor_m_Ant_Sum_Rekup_MaxSts.HybridSignalsIn._.ZFFSAB ECU_ADDRESS 0xFFF97688 /end MEASUREMENT
/begin MEASUREMENT ZFFSAB._.HybridSignalsIn.iv_Vor_Kurz_m_crsh_Max "Input raw signal Voraussage_Drehmoment_Kurbelwelle_Max_EMotor_Hybrid" UWORD SAB_M_NM2_M2047_S2_S3 1 100 -1023.5 31744 DISPLAY_IDENTIFIER iv_Vor_Kurz_m_crsh_Max.HybridSignalsIn._.ZFFSAB ECU_ADDRESS 0xFFF9768A /end MEASUREMENT
/begin MEASUREMENT ZFFSAB._.HybridSignalsIn.iv_Vor_Kurz_m_crsh_MaxSts "Input CAN message status Voraussage_Drehmoment_Kurbelwelle_Max_EMotor_Hybrid" UBYTE SAB_STANDARD_S2_S3 1 100 0 255 DISPLAY_IDENTIFIER iv_Vor_Kurz_m_crsh_MaxSts.HybridSignalsIn._.ZFFSAB ECU_ADDRESS 0xFFF9768C /end MEASUREMENT
/begin MEASUREMENT ZFFSAB._.HybridSignalsIn.iv_Vor_Kurz_m_crsh_Min "Input raw signal Voraussage_Drehmoment_Kurbelwelle_Min_EMotor_Hybrid" UWORD SAB_M_NM2_M2047_S2_S3 1 100 -1023.5 31744 DISPLAY_IDENTIFIER iv_Vor_Kurz_m_crsh_Min.HybridSignalsIn._.ZFFSAB ECU_ADDRESS 0xFFF9768E /end MEASUREMENT
/begin MEASUREMENT ZFFSAB._.HybridSignalsIn.iv_Vor_Kurz_m_crsh_MinSts "Input CAN message status Voraussage_Drehmoment_Kurbelwelle_Min_EMotor_Hybrid" UBYTE SAB_STANDARD_S2_S3 1 100 0 255 DISPLAY_IDENTIFIER iv_Vor_Kurz_m_crsh_MinSts.HybridSignalsIn._.ZFFSAB ECU_ADDRESS 0xFFF97690 /end MEASUREMENT
/begin MEASUREMENT ZFFSAB._.HybridSignalsIn.iv_STAT_Drv "Input raw signal Status MSA" UBYTE SAB_STANDARD_S2_S3 1 100 0 255 DISPLAY_IDENTIFIER iv_STAT_Drv.HybridSignalsIn._.ZFFSAB ECU_ADDRESS 0xFFF97691 /end MEASUREMENT
/begin MEASUREMENT ZFFSAB._.HybridSignalsIn.iv_STAT_DrvSts "Input CAN message status Status MSA" UBYTE SAB_STANDARD_S2_S3 1 100 0 255 DISPLAY_IDENTIFIER iv_STAT_DrvSts.HybridSignalsIn._.ZFFSAB ECU_ADDRESS 0xFFF97692 /end MEASUREMENT
/begin MEASUREMENT ZFFSAB._.HybridSignalsIn.iv_n_SollEM "Input raw signal of desired RPM electric motor" UWORD SAB_N_RPM2_M5000_S2_S3 1 100 -5000 27767.5 DISPLAY_IDENTIFIER iv_n_SollEM.HybridSignalsIn._.ZFFSAB ECU_ADDRESS 0xFFF97694 /end MEASUREMENT
/begin MEASUREMENT ZFFSAB._.HybridSignalsIn.iv_n_SollEMSts "Input CAN message status desired RPM electric motor" UBYTE SAB_STANDARD_S2_S3 1 100 0 255 DISPLAY_IDENTIFIER iv_n_SollEMSts.HybridSignalsIn._.ZFFSAB ECU_ADDRESS 0xFFF97696 /end MEASUREMENT
/begin MEASUREMENT ZFFSAB._.HybridSignalsIn.iv_m_EngStart "Input raw signal of starting torque of combustion engine" UWORD SAB_M_NM2_M2047_S2_S3 1 100 -1023.5 31744 DISPLAY_IDENTIFIER iv_m_EngStart.HybridSignalsIn._.ZFFSAB ECU_ADDRESS 0xFFF97698 /end MEASUREMENT
/begin MEASUREMENT ZFFSAB._.HybridSignalsIn.iv_m_EngStartSts "Input CAN message status starting torque of combustion engine" UBYTE SAB_STANDARD_S2_S3 1 100 0 255 DISPLAY_IDENTIFIER iv_m_EngStartSts.HybridSignalsIn._.ZFFSAB ECU_ADDRESS 0xFFF9769A /end MEASUREMENT
/begin MEASUREMENT ZFFSAB._.HybridSignalsIn.iv_AepReq "Input CAN message Request Gear shift in from AEP" UBYTE SAB_STANDARD_S2_S3 1 100 0 3 DISPLAY_IDENTIFIER iv_AepReq.HybridSignalsIn._.ZFFSAB ECU_ADDRESS 0xFFF9769B /end MEASUREMENT
/begin MEASUREMENT ZFFSAB._.HybridSignalsIn.iv_AepReqSts "Input CAN message Status Request Gear shift in from AEP" UBYTE SAB_STANDARD_S2_S3 1 100 0 255 DISPLAY_IDENTIFIER iv_AepReqSts.HybridSignalsIn._.ZFFSAB ECU_ADDRESS 0xFFF9769C /end MEASUREMENT
/begin MEASUREMENT ZFFSAB._.HybridSignalsIn.iv_EgsReaktNRed "Input CAN message signal emergency operation to AGS" UBYTE SAB_STANDARD_S2_S3 1 100 0 255 DISPLAY_IDENTIFIER iv_EgsReaktNRed.HybridSignalsIn._.ZFFSAB ECU_ADDRESS 0xFFF9769D /end MEASUREMENT
/begin MEASUREMENT ZFFSAB._.HybridSignalsIn.iv_EgsReaktNRedSts "Input CAN message Status emergency operation to AGS" UBYTE SAB_STANDARD_S2_S3 1 100 0 255 DISPLAY_IDENTIFIER iv_EgsReaktNRedSts.HybridSignalsIn._.ZFFSAB ECU_ADDRESS 0xFFF9769E /end MEASUREMENT
/begin MEASUREMENT ZFFSAB._.HybridSignalsIn.sv_CrankshaftStopPosition "Output signal. Angular displacement of crankshaft." UBYTE SAB_PHI_2GRAD_S2_S3 1 100 0 360 DISPLAY_IDENTIFIER sv_CrankshaftStopPosition.HybridSignalsIn._.ZFFSAB ECU_ADDRESS 0xFFF9769F /end MEASUREMENT
/begin MEASUREMENT ZFFSAB._.HybridSignalsIn.sv_CrankshaftStopPositionSts "Output signal status. Angular displacement of crankshaft." UBYTE SAB_STANDARD_S2_S3 1 100 0 2 DISPLAY_IDENTIFIER sv_CrankshaftStopPositionSts.HybridSignalsIn._.ZFFSAB ECU_ADDRESS 0xFFF976A0 /end MEASUREMENT
/begin MEASUREMENT ZFFSAB._.HybridSignalsIn.sv_m_AntSumRekupGearb "Output signal of SollRadmomentAntriebstrangSummeRek_Getr_Hybrid" UWORD SAB_M_1NM_M32000_S2_S3 1 100 -32000 33535 DISPLAY_IDENTIFIER sv_m_AntSumRekupGearb.HybridSignalsIn._.ZFFSAB ECU_ADDRESS 0xFFF976A2 /end MEASUREMENT
/begin MEASUREMENT ZFFSAB._.HybridSignalsIn.sv_m_AntSumSchleppUnten "Output signal of IstRadmomentAntriebstrangSummeSchleppmoment_unten_Hybrid" UWORD SAB_M_1NM_M32000_S2_S3 1 100 -32000 33535 DISPLAY_IDENTIFIER sv_m_AntSumSchleppUnten.HybridSignalsIn._.ZFFSAB ECU_ADDRESS 0xFFF976A4 /end MEASUREMENT
/begin MEASUREMENT ZFFSAB._.HybridSignalsIn.sv_m_AntSumRekupMax "Output signal of IstRadmomentAntriebstrangSumme_Rekuperation_Maximal_Hybrid" UWORD SAB_M_1NM_M32000_S2_S3 1 100 -32000 33535 DISPLAY_IDENTIFIER sv_m_AntSumRekupMax.HybridSignalsIn._.ZFFSAB ECU_ADDRESS 0xFFF976A6 /end MEASUREMENT
/begin MEASUREMENT ZFFSAB._.HybridSignalsIn.sv_Vor_m_Ant_Sum_Rekup_Max "Output signal of VorausIstRadmomentAntriebstrangSumme_Rekuperation_Maximal_Hybrid" UWORD SAB_M_1NM_M32000_S2_S3 1 100 -32000 33535 DISPLAY_IDENTIFIER sv_Vor_m_Ant_Sum_Rekup_Max.HybridSignalsIn._.ZFFSAB ECU_ADDRESS 0xFFF976A8 /end MEASUREMENT
/begin MEASUREMENT ZFFSAB._.HybridSignalsIn.sv_Vor_Kurz_m_crsh_Max "Output signal of Voraussage_Drehmoment_Kurbelwelle_Max_EMotor_Hybrid" UWORD SAB_M_NM2_M2047_S2_S3 1 100 -1023.5 31744 DISPLAY_IDENTIFIER sv_Vor_Kurz_m_crsh_Max.HybridSignalsIn._.ZFFSAB ECU_ADDRESS 0xFFF976AA /end MEASUREMENT
/begin MEASUREMENT ZFFSAB._.HybridSignalsIn.sv_Vor_Kurz_m_crsh_Min "Output signal of Voraussage_Drehmoment_Kurbelwelle_Max_EMotor_Hybrid" UWORD SAB_M_NM2_M2047_S2_S3 1 100 -1023.5 31744 DISPLAY_IDENTIFIER sv_Vor_Kurz_m_crsh_Min.HybridSignalsIn._.ZFFSAB ECU_ADDRESS 0xFFF976AC /end MEASUREMENT
/begin MEASUREMENT ZFFSAB._.HybridSignalsIn.sv_AGS_StatusAntriebFzg "Output signal of Status MSA" UBYTE SAB_STANDARD_S2_S3 1 100 0 255 DISPLAY_IDENTIFIER sv_AGS_StatusAntriebFzg.HybridSignalsIn._.ZFFSAB ECU_ADDRESS 0xFFF976AE /end MEASUREMENT
/begin MEASUREMENT ZFFSAB._.HybridSignalsIn.sv_n_SollEM "Output signal of desired RPM electric engine" UWORD SAB_N_1RPM_S2_S3 1 100 0 12000 DISPLAY_IDENTIFIER sv_n_SollEM.HybridSignalsIn._.ZFFSAB ECU_ADDRESS 0xFFF976B0 /end MEASUREMENT
/begin MEASUREMENT ZFFSAB._.HybridSignalsIn.sv_n_SollEMSts "Output status of desired RPM electric engine" UBYTE SAB_STANDARD_S2_S3 1 100 0 255 DISPLAY_IDENTIFIER sv_n_SollEMSts.HybridSignalsIn._.ZFFSAB ECU_ADDRESS 0xFFF976B2 /end MEASUREMENT
/begin MEASUREMENT ZFFSAB._.HybridSignalsIn.sv_m_EngStart "Output signal of starting torque of combustion engine" SWORD SAB_M_1NM_S2_S3 1 100 -32768 32767 DISPLAY_IDENTIFIER sv_m_EngStart.HybridSignalsIn._.ZFFSAB ECU_ADDRESS 0xFFF976B4 /end MEASUREMENT
/begin MEASUREMENT ZFFSAB._.HybridSignalsIn.sv_m_EngStartSts "Output status of starting torque of combustion engine" UBYTE SAB_STANDARD_S2_S3 1 100 0 255 DISPLAY_IDENTIFIER sv_m_EngStartSts.HybridSignalsIn._.ZFFSAB ECU_ADDRESS 0xFFF976B6 /end MEASUREMENT
/begin MEASUREMENT ZFFSAB._.HybridSignalsIn.sv_AGS_AepReq "Output Request Gear shift in from AEP" UBYTE SAB_STANDARD_S2_S3 1 100 0 1 DISPLAY_IDENTIFIER sv_AGS_AepReq.HybridSignalsIn._.ZFFSAB ECU_ADDRESS 0xFFF976B7 /end MEASUREMENT
/begin MEASUREMENT ZFFSAB._.HybridSignalsIn.sv_AepReqSts "Output status of Request Gear shift in from AEP" UBYTE SAB_STANDARD_S2_S3 1 100 0 255 DISPLAY_IDENTIFIER sv_AepReqSts.HybridSignalsIn._.ZFFSAB ECU_ADDRESS 0xFFF976B8 /end MEASUREMENT
/begin MEASUREMENT ZFFSAB._.HybridSignalsIn.sv_AGS_EgsReaktNRed "Output signal emergency operation to AGS" UBYTE SAB_STANDARD_S2_S3 1 100 0 3 DISPLAY_IDENTIFIER sv_AGS_EgsReaktNRed.HybridSignalsIn._.ZFFSAB ECU_ADDRESS 0xFFF976B9 /end MEASUREMENT
/begin MEASUREMENT ZFFSAB._.HybridSignalsIn.sv_EgsReaktNRedSts "Output status of signal emergency operation to AGS" UBYTE SAB_STANDARD_S2_S3 1 100 0 255 DISPLAY_IDENTIFIER sv_EgsReaktNRedSts.HybridSignalsIn._.ZFFSAB ECU_ADDRESS 0xFFF976BA /end MEASUREMENT
/begin MEASUREMENT ZFFSAB._.HybridSignalsIn.f_n_SollEMErr "Error flag for desired RPM of electric motor" UBYTE SAB_STANDARD_S2_S3 1 100 0 1 DISPLAY_IDENTIFIER f_n_SollEMErr.HybridSignalsIn._.ZFFSAB ECU_ADDRESS 0xFFF976BB /end MEASUREMENT
/begin MEASUREMENT ZFFSAB._.HybridSignalsIn.f_m_EngStartErr "Error flag for start torque of combustion engine" UBYTE SAB_STANDARD_S2_S3 1 100 0 1 DISPLAY_IDENTIFIER f_m_EngStartErr.HybridSignalsIn._.ZFFSAB ECU_ADDRESS 0xFFF976BC /end MEASUREMENT
/begin MEASUREMENT ZFFSAB._.HybridSignalsIn.f_AepReq "Error flag for Request Gear shift in from AEP" UBYTE SAB_STANDARD_S2_S3 1 100 0 1 DISPLAY_IDENTIFIER f_AepReq.HybridSignalsIn._.ZFFSAB ECU_ADDRESS 0xFFF976BD /end MEASUREMENT
/begin MEASUREMENT ZFFSAB._.HybridSignalsIn.f_EgsReaktNRedErr "Error flag for emergency operation to AGS" UBYTE SAB_STANDARD_S2_S3 1 100 0 1 DISPLAY_IDENTIFIER f_EgsReaktNRedErr.HybridSignalsIn._.ZFFSAB ECU_ADDRESS 0xFFF976BE /end MEASUREMENT
/begin MEASUREMENT ZFFSAB._.ExtBrakeInterventionIn.iv_BrakeTorq "input value iv_BrakeTorq" UWORD SAB_M_1NM_M32000_S2_S3 1 100 -32000 33535 DISPLAY_IDENTIFIER iv_BrakeTorq.ExtBrakeInterventionIn._.ZFFSAB ECU_ADDRESS 0xFFF976C4 /end MEASUREMENT
/begin MEASUREMENT ZFFSAB._.ExtBrakeInterventionIn.iv_BrakeTorqSts "input value iv_BrakeTorqSts" UBYTE SAB_STANDARD_S2_S3 1 100 0 255 DISPLAY_IDENTIFIER iv_BrakeTorqSts.ExtBrakeInterventionIn._.ZFFSAB ECU_ADDRESS 0xFFF976C6 /end MEASUREMENT
/begin MEASUREMENT ZFFSAB._.ExtBrakeInterventionIn.iv_BrakeTorqDvch "input value iv_BrakeTorqDvch" UWORD SAB_M_1NM_M32000_S2_S3 1 100 -32000 33535 DISPLAY_IDENTIFIER iv_BrakeTorqDvch.ExtBrakeInterventionIn._.ZFFSAB ECU_ADDRESS 0xFFF976C8 /end MEASUREMENT
/begin MEASUREMENT ZFFSAB._.ExtBrakeInterventionIn.iv_BrakeTorqDvchSts "input value iv_BrakeTorqDvchSts" UBYTE SAB_STANDARD_S2_S3 1 100 0 255 DISPLAY_IDENTIFIER iv_BrakeTorqDvchSts.ExtBrakeInterventionIn._.ZFFSAB ECU_ADDRESS 0xFFF976CA /end MEASUREMENT
/begin MEASUREMENT ZFFSAB._.ExtBrakeInterventionIn.iv_StBrakeTorq "input value iv_StBrake" UBYTE SAB_STANDARD_S2_S3 1 100 0 255 DISPLAY_IDENTIFIER iv_StBrakeTorq.ExtBrakeInterventionIn._.ZFFSAB ECU_ADDRESS 0xFFF976CB /end MEASUREMENT
/begin MEASUREMENT ZFFSAB._.ExtBrakeInterventionIn.iv_StBrake "input value iv_StBrake" UBYTE SAB_STANDARD_S2_S3 1 100 0 255 DISPLAY_IDENTIFIER iv_StBrake.ExtBrakeInterventionIn._.ZFFSAB ECU_ADDRESS 0xFFF976CC /end MEASUREMENT
/begin MEASUREMENT ZFFSAB._.ExtBrakeInterventionIn.iv_StBrakeSts "input value iv_StBrakeSts" UBYTE SAB_STANDARD_S2_S3 1 100 0 255 DISPLAY_IDENTIFIER iv_StBrakeSts.ExtBrakeInterventionIn._.ZFFSAB ECU_ADDRESS 0xFFF976CD /end MEASUREMENT
/begin MEASUREMENT ZFFSAB._.ExtBrakeInterventionIn.sv_ExtBrakeInterventionSts "Output value signal status of external brake interventeion" UBYTE SAB_STANDARD_S2_S3 1 100 0 2 DISPLAY_IDENTIFIER sv_ExtBrakeInterventionSts.ExtBrakeInterventionIn._.ZFFSAB ECU_ADDRESS 0xFFF976CE /end MEASUREMENT
/begin MEASUREMENT ZFFSAB._.ExtBrakeInterventionIn.sv_f_ExtBrakeIntervention "Output variable for GET_BRAKE_INTER" UBYTE SAB_STANDARD_S2_S3 1 100 0 1 DISPLAY_IDENTIFIER sv_f_ExtBrakeIntervention.ExtBrakeInterventionIn._.ZFFSAB ECU_ADDRESS 0xFFF976CF /end MEASUREMENT
/begin MEASUREMENT ZFFSAB._.ExtBrakeInterventionIn.BrakeTorq "calculated value of BrakeTorq" UWORD SAB_STANDARD_S2_S3 1 100 0 1 DISPLAY_IDENTIFIER BrakeTorq.ExtBrakeInterventionIn._.ZFFSAB ECU_ADDRESS 0xFFF976D0 /end MEASUREMENT
/begin MEASUREMENT ZFFSAB._.ExtBrakeInterventionIn.BrakeTorqSts "Status of Brake-signal" UBYTE SAB_STANDARD_S2_S3 1 100 0 1 DISPLAY_IDENTIFIER BrakeTorqSts.ExtBrakeInterventionIn._.ZFFSAB ECU_ADDRESS 0xFFF976D2 /end MEASUREMENT
/begin MEASUREMENT ZFFSAB._.ExtBrakeInterventionIn.f_BrakeTorq "Error flag of Brake-signal" UBYTE SAB_STANDARD_S2_S3 1 100 0 1 DISPLAY_IDENTIFIER f_BrakeTorq.ExtBrakeInterventionIn._.ZFFSAB ECU_ADDRESS 0xFFF976D3 /end MEASUREMENT
/begin MEASUREMENT ZFFSAB._.ExtBrakeInterventionIn.BrakeTorqDvch "calculated value of BrakeTorqDvch" UWORD SAB_STANDARD_S2_S3 1 100 0 1 DISPLAY_IDENTIFIER BrakeTorqDvch.ExtBrakeInterventionIn._.ZFFSAB ECU_ADDRESS 0xFFF976D4 /end MEASUREMENT
/begin MEASUREMENT ZFFSAB._.ExtBrakeInterventionIn.BrakeTorqDvchSts "Status of BrakeDvch-signal" UBYTE SAB_STANDARD_S2_S3 1 100 0 1 DISPLAY_IDENTIFIER BrakeTorqDvchSts.ExtBrakeInterventionIn._.ZFFSAB ECU_ADDRESS 0xFFF976D6 /end MEASUREMENT
/begin MEASUREMENT ZFFSAB._.ExtBrakeInterventionIn.f_BrakeTorqDvch "Error flag of BrakeDvch-signal" UBYTE SAB_STANDARD_S2_S3 1 100 0 1 DISPLAY_IDENTIFIER f_BrakeTorqDvch.ExtBrakeInterventionIn._.ZFFSAB ECU_ADDRESS 0xFFF976D7 /end MEASUREMENT
/begin MEASUREMENT ZFFSAB._.ExtBrakeInterventionIn.StBrake "calculated value of StBrake" UBYTE SAB_STANDARD_S2_S3 1 100 0 1 DISPLAY_IDENTIFIER StBrake.ExtBrakeInterventionIn._.ZFFSAB ECU_ADDRESS 0xFFF976D8 /end MEASUREMENT
/begin MEASUREMENT ZFFSAB._.ExtBrakeInterventionIn.StBrakeSts "Status of StBrake-signal" UBYTE SAB_STANDARD_S2_S3 1 100 0 1 DISPLAY_IDENTIFIER StBrakeSts.ExtBrakeInterventionIn._.ZFFSAB ECU_ADDRESS 0xFFF976D9 /end MEASUREMENT
/begin MEASUREMENT ZFFSAB._.ExtBrakeInterventionIn.f_StBrake "Error flag of StBrake-signal" UBYTE SAB_STANDARD_S2_S3 1 100 0 1 DISPLAY_IDENTIFIER f_StBrake.ExtBrakeInterventionIn._.ZFFSAB ECU_ADDRESS 0xFFF976DA /end MEASUREMENT
/begin MEASUREMENT ZFFSAB._.AfuReqIn.iv_AfuReq "Input value start assistance from CAN" UBYTE SAB_STANDARD_S2_S3 1 100 0 255 DISPLAY_IDENTIFIER iv_AfuReq.AfuReqIn._.ZFFSAB ECU_ADDRESS 0xFFF983C5 /end MEASUREMENT
/begin MEASUREMENT ZFFSAB._.AfuReqIn.iv_AfuReqSts "Input value message status of start assistance" UBYTE SAB_STANDARD_S2_S3 1 100 0 255 DISPLAY_IDENTIFIER iv_AfuReqSts.AfuReqIn._.ZFFSAB ECU_ADDRESS 0xFFF983C6 /end MEASUREMENT
/begin MEASUREMENT ZFFSAB._.AfuReqIn.sv_AfuReq "Output value start assistance" UBYTE SAB_STANDARD_S2_S3 1 100 0 255 DISPLAY_IDENTIFIER sv_AfuReq.AfuReqIn._.ZFFSAB ECU_ADDRESS 0xFFF983C7 /end MEASUREMENT
/begin MEASUREMENT ZFFSAB._.AfuReqIn.sv_AfuReqSts "Output value signal status of start assistance" UBYTE SAB_STANDARD_S2_S3 1 100 0 255 DISPLAY_IDENTIFIER sv_AfuReqSts.AfuReqIn._.ZFFSAB ECU_ADDRESS 0xFFF983C8 /end MEASUREMENT
/begin MEASUREMENT ZFFSAB._.AfuReqIn.f_AfuReqErr "Error flag of start assistance" UBYTE SAB_STANDARD_S2_S3 1 100 0 255 DISPLAY_IDENTIFIER f_AfuReqErr.AfuReqIn._.ZFFSAB ECU_ADDRESS 0xFFF983C9 /end MEASUREMENT
/begin MEASUREMENT ZFFSAB._.DynRunRadiusIn.sv_rd_Dyn "Intermediate value dynamic rolling radius" UWORD SAB_L_1MM_S2_S3 1 100 0 65535 DISPLAY_IDENTIFIER sv_rd_Dyn.DynRunRadiusIn._.ZFFSAB ECU_ADDRESS 0xFFF98484 /end MEASUREMENT
/begin MEASUREMENT ZFFSAB._.WarmUpIn.iv_WarmUpSwitch "Input value engine warm up phase from CAN" UBYTE SAB_STANDARD_S2_S3 1 100 0 3 DISPLAY_IDENTIFIER iv_WarmUpSwitch.WarmUpIn._.ZFFSAB ECU_ADDRESS 0xFFF983CA /end MEASUREMENT
/begin MEASUREMENT ZFFSAB._.WarmUpIn.iv_WarmUpSwitchSts "Input value message status of engine warm up phase" UBYTE SAB_STANDARD_S2_S3 1 100 0 255 DISPLAY_IDENTIFIER iv_WarmUpSwitchSts.WarmUpIn._.ZFFSAB ECU_ADDRESS 0xFFF983CB /end MEASUREMENT
/begin MEASUREMENT ZFFSAB._.WarmUpIn.sv_WarmUpSwitch "Output value engine warm up phase" UBYTE SAB_STANDARD_S2_S3 1 100 0 2 DISPLAY_IDENTIFIER sv_WarmUpSwitch.WarmUpIn._.ZFFSAB ECU_ADDRESS 0xFFF983CC /end MEASUREMENT
/begin MEASUREMENT ZFFSAB._.WarmUpIn.sv_WarmUpSwitchSts "Output value signal status of engine warm up phase" UBYTE SAB_STANDARD_S2_S3 1 100 0 2 DISPLAY_IDENTIFIER sv_WarmUpSwitchSts.WarmUpIn._.ZFFSAB ECU_ADDRESS 0xFFF983CD /end MEASUREMENT
/begin MEASUREMENT ZFFSAB._.WarmUpIn.f_WarmUpSwitchErr "Error flag of WarmUpSwitch-signal" UBYTE SAB_STANDARD_S2_S3 1 100 0 1 DISPLAY_IDENTIFIER f_WarmUpSwitchErr.WarmUpIn._.ZFFSAB ECU_ADDRESS 0xFFF983CE /end MEASUREMENT
/begin MEASUREMENT ZFFSAB._.WheelIn.FL.iv_v_Wheel "Input raw signal of wheel speed from CAN" UWORD SAB_N_RADPS64_M32767_S2_S3 1 100 -511.984375 512 DISPLAY_IDENTIFIER iv_v_Wheel.FL.WheelIn._.ZFFSAB ECU_ADDRESS 0xFFF97724 /end MEASUREMENT
/begin MEASUREMENT ZFFSAB._.WheelIn.FL.iv_v_WheelSts "Input signal message status of wheel speed from CAN" UBYTE SAB_STANDARD_S2_S3 1 100 0 255 DISPLAY_IDENTIFIER iv_v_WheelSts.FL.WheelIn._.ZFFSAB ECU_ADDRESS 0xFFF97726 /end MEASUREMENT
/begin MEASUREMENT ZFFSAB._.WheelIn.FL.n_Wheel "Wheel rpm derived from driven wheels" SLONG SAB_N_RPM100_S2_S3 1 100 -21474836.48 21474836.47 DISPLAY_IDENTIFIER n_Wheel.FL.WheelIn._.ZFFSAB ECU_ADDRESS 0xFFF97728 /end MEASUREMENT
/begin MEASUREMENT ZFFSAB._.WheelIn.FL.n_WheelSts "Status of Wheel rpm derived from driven wheels" UBYTE SAB_STANDARD_S2_S3 1 100 0 2 DISPLAY_IDENTIFIER n_WheelSts.FL.WheelIn._.ZFFSAB ECU_ADDRESS 0xFFF9772C /end MEASUREMENT
/begin MEASUREMENT ZFFSAB._.WheelIn.FL.f_n_WheelErr "Error flag of Wheel rpm derived from driven wheels" UBYTE SAB_STANDARD_S2_S3 1 100 0 1 DISPLAY_IDENTIFIER f_n_WheelErr.FL.WheelIn._.ZFFSAB ECU_ADDRESS 0xFFF9772D /end MEASUREMENT
/begin MEASUREMENT ZFFSAB._.WheelIn.FL.sv_v_Wheel "computed wheel speed with substitute value in error case" UWORD SAB_V_KMH16_S2_S3 1 100 0 4095.9375 DISPLAY_IDENTIFIER sv_v_Wheel.FL.WheelIn._.ZFFSAB ECU_ADDRESS 0xFFF9772E /end MEASUREMENT
/begin MEASUREMENT ZFFSAB._.WheelIn.FL.sv_v_WheelSts "status signal of computed wheel speed with substitute value in error case" UBYTE SAB_STANDARD_S2_S3 1 100 0 2 DISPLAY_IDENTIFIER sv_v_WheelSts.FL.WheelIn._.ZFFSAB ECU_ADDRESS 0xFFF97730 /end MEASUREMENT
/begin MEASUREMENT ZFFSAB._.WheelIn.FL.v_WheelBalanced "computed wheel speed" UWORD SAB_V_KMH16_S2_S3 1 100 0 4095.9375 DISPLAY_IDENTIFIER v_WheelBalanced.FL.WheelIn._.ZFFSAB ECU_ADDRESS 0xFFF97732 /end MEASUREMENT
/begin MEASUREMENT ZFFSAB._.WheelIn.FL.f_v_WheelErr "Error flag of v_Wheel-signal" UBYTE SAB_STANDARD_S2_S3 1 100 0 1 DISPLAY_IDENTIFIER f_v_WheelErr.FL.WheelIn._.ZFFSAB ECU_ADDRESS 0xFFF97734 /end MEASUREMENT
/begin MEASUREMENT ZFFSAB._.WheelIn.FR.iv_v_Wheel "Input raw signal of wheel speed from CAN" UWORD SAB_N_RADPS64_M32767_S2_S3 1 100 -511.984375 512 DISPLAY_IDENTIFIER iv_v_Wheel.FR.WheelIn._.ZFFSAB ECU_ADDRESS 0xFFF97738 /end MEASUREMENT
/begin MEASUREMENT ZFFSAB._.WheelIn.FR.iv_v_WheelSts "Input signal message status of wheel speed from CAN" UBYTE SAB_STANDARD_S2_S3 1 100 0 255 DISPLAY_IDENTIFIER iv_v_WheelSts.FR.WheelIn._.ZFFSAB ECU_ADDRESS 0xFFF9773A /end MEASUREMENT
/begin MEASUREMENT ZFFSAB._.WheelIn.FR.n_Wheel "Wheel rpm derived from driven wheels" SLONG SAB_N_RPM100_S2_S3 1 100 -21474836.48 21474836.47 DISPLAY_IDENTIFIER n_Wheel.FR.WheelIn._.ZFFSAB ECU_ADDRESS 0xFFF9773C /end MEASUREMENT
/begin MEASUREMENT ZFFSAB._.WheelIn.FR.n_WheelSts "Status of Wheel rpm derived from driven wheels" UBYTE SAB_STANDARD_S2_S3 1 100 0 2 DISPLAY_IDENTIFIER n_WheelSts.FR.WheelIn._.ZFFSAB ECU_ADDRESS 0xFFF97740 /end MEASUREMENT
/begin MEASUREMENT ZFFSAB._.WheelIn.FR.f_n_WheelErr "Error flag of Wheel rpm derived from driven wheels" UBYTE SAB_STANDARD_S2_S3 1 100 0 1 DISPLAY_IDENTIFIER f_n_WheelErr.FR.WheelIn._.ZFFSAB ECU_ADDRESS 0xFFF97741 /end MEASUREMENT
/begin MEASUREMENT ZFFSAB._.WheelIn.FR.sv_v_Wheel "computed wheel speed with substitute value in error case" UWORD SAB_V_KMH16_S2_S3 1 100 0 4095.9375 DISPLAY_IDENTIFIER sv_v_Wheel.FR.WheelIn._.ZFFSAB ECU_ADDRESS 0xFFF97742 /end MEASUREMENT
/begin MEASUREMENT ZFFSAB._.WheelIn.FR.sv_v_WheelSts "status signal of computed wheel speed with substitute value in error case" UBYTE SAB_STANDARD_S2_S3 1 100 0 2 DISPLAY_IDENTIFIER sv_v_WheelSts.FR.WheelIn._.ZFFSAB ECU_ADDRESS 0xFFF97744 /end MEASUREMENT
/begin MEASUREMENT ZFFSAB._.WheelIn.FR.v_WheelBalanced "computed wheel speed" UWORD SAB_V_KMH16_S2_S3 1 100 0 4095.9375 DISPLAY_IDENTIFIER v_WheelBalanced.FR.WheelIn._.ZFFSAB ECU_ADDRESS 0xFFF97746 /end MEASUREMENT
/begin MEASUREMENT ZFFSAB._.WheelIn.FR.f_v_WheelErr "Error flag of v_Wheel-signal" UBYTE SAB_STANDARD_S2_S3 1 100 0 1 DISPLAY_IDENTIFIER f_v_WheelErr.FR.WheelIn._.ZFFSAB ECU_ADDRESS 0xFFF97748 /end MEASUREMENT
/begin MEASUREMENT ZFFSAB._.WheelIn.RL.iv_v_Wheel "Input raw signal of wheel speed from CAN" UWORD SAB_N_RADPS64_M32767_S2_S3 1 100 -511.984375 512 DISPLAY_IDENTIFIER iv_v_Wheel.RL.WheelIn._.ZFFSAB ECU_ADDRESS 0xFFF9774C /end MEASUREMENT
/begin MEASUREMENT ZFFSAB._.WheelIn.RL.iv_v_WheelSts "Input signal message status of wheel speed from CAN" UBYTE SAB_STANDARD_S2_S3 1 100 0 255 DISPLAY_IDENTIFIER iv_v_WheelSts.RL.WheelIn._.ZFFSAB ECU_ADDRESS 0xFFF9774E /end MEASUREMENT
/begin MEASUREMENT ZFFSAB._.WheelIn.RL.n_Wheel "Wheel rpm derived from driven wheels" SLONG SAB_N_RPM100_S2_S3 1 100 -21474836.48 21474836.47 DISPLAY_IDENTIFIER n_Wheel.RL.WheelIn._.ZFFSAB ECU_ADDRESS 0xFFF97750 /end MEASUREMENT
/begin MEASUREMENT ZFFSAB._.WheelIn.RL.n_WheelSts "Status of Wheel rpm derived from driven wheels" UBYTE SAB_STANDARD_S2_S3 1 100 0 2 DISPLAY_IDENTIFIER n_WheelSts.RL.WheelIn._.ZFFSAB ECU_ADDRESS 0xFFF97754 /end MEASUREMENT
/begin MEASUREMENT ZFFSAB._.WheelIn.RL.f_n_WheelErr "Error flag of Wheel rpm derived from driven wheels" UBYTE SAB_STANDARD_S2_S3 1 100 0 1 DISPLAY_IDENTIFIER f_n_WheelErr.RL.WheelIn._.ZFFSAB ECU_ADDRESS 0xFFF97755 /end MEASUREMENT
/begin MEASUREMENT ZFFSAB._.WheelIn.RL.sv_v_Wheel "computed wheel speed with substitute value in error case" UWORD SAB_V_KMH16_S2_S3 1 100 0 4095.9375 DISPLAY_IDENTIFIER sv_v_Wheel.RL.WheelIn._.ZFFSAB ECU_ADDRESS 0xFFF97756 /end MEASUREMENT
/begin MEASUREMENT ZFFSAB._.WheelIn.RL.sv_v_WheelSts "status signal of computed wheel speed with substitute value in error case" UBYTE SAB_STANDARD_S2_S3 1 100 0 2 DISPLAY_IDENTIFIER sv_v_WheelSts.RL.WheelIn._.ZFFSAB ECU_ADDRESS 0xFFF97758 /end MEASUREMENT
/begin MEASUREMENT ZFFSAB._.WheelIn.RL.v_WheelBalanced "computed wheel speed" UWORD SAB_V_KMH16_S2_S3 1 100 0 4095.9375 DISPLAY_IDENTIFIER v_WheelBalanced.RL.WheelIn._.ZFFSAB ECU_ADDRESS 0xFFF9775A /end MEASUREMENT
/begin MEASUREMENT ZFFSAB._.WheelIn.RL.f_v_WheelErr "Error flag of v_Wheel-signal" UBYTE SAB_STANDARD_S2_S3 1 100 0 1 DISPLAY_IDENTIFIER f_v_WheelErr.RL.WheelIn._.ZFFSAB ECU_ADDRESS 0xFFF9775C /end MEASUREMENT
/begin MEASUREMENT ZFFSAB._.WheelIn.RR.iv_v_Wheel "Input raw signal of wheel speed from CAN" UWORD SAB_N_RADPS64_M32767_S2_S3 1 100 -511.984375 512 DISPLAY_IDENTIFIER iv_v_Wheel.RR.WheelIn._.ZFFSAB ECU_ADDRESS 0xFFF97760 /end MEASUREMENT
/begin MEASUREMENT ZFFSAB._.WheelIn.RR.iv_v_WheelSts "Input signal message status of wheel speed from CAN" UBYTE SAB_STANDARD_S2_S3 1 100 0 255 DISPLAY_IDENTIFIER iv_v_WheelSts.RR.WheelIn._.ZFFSAB ECU_ADDRESS 0xFFF97762 /end MEASUREMENT
/begin MEASUREMENT ZFFSAB._.WheelIn.RR.n_Wheel "Wheel rpm derived from driven wheels" SLONG SAB_N_RPM100_S2_S3 1 100 -21474836.48 21474836.47 DISPLAY_IDENTIFIER n_Wheel.RR.WheelIn._.ZFFSAB ECU_ADDRESS 0xFFF97764 /end MEASUREMENT
/begin MEASUREMENT ZFFSAB._.WheelIn.RR.n_WheelSts "Status of Wheel rpm derived from driven wheels" UBYTE SAB_STANDARD_S2_S3 1 100 0 2 DISPLAY_IDENTIFIER n_WheelSts.RR.WheelIn._.ZFFSAB ECU_ADDRESS 0xFFF97768 /end MEASUREMENT
/begin MEASUREMENT ZFFSAB._.WheelIn.RR.f_n_WheelErr "Error flag of Wheel rpm derived from driven wheels" UBYTE SAB_STANDARD_S2_S3 1 100 0 1 DISPLAY_IDENTIFIER f_n_WheelErr.RR.WheelIn._.ZFFSAB ECU_ADDRESS 0xFFF97769 /end MEASUREMENT
/begin MEASUREMENT ZFFSAB._.WheelIn.RR.sv_v_Wheel "computed wheel speed with substitute value in error case" UWORD SAB_V_KMH16_S2_S3 1 100 0 4095.9375 DISPLAY_IDENTIFIER sv_v_Wheel.RR.WheelIn._.ZFFSAB ECU_ADDRESS 0xFFF9776A /end MEASUREMENT
/begin MEASUREMENT ZFFSAB._.WheelIn.RR.sv_v_WheelSts "status signal of computed wheel speed with substitute value in error case" UBYTE SAB_STANDARD_S2_S3 1 100 0 2 DISPLAY_IDENTIFIER sv_v_WheelSts.RR.WheelIn._.ZFFSAB ECU_ADDRESS 0xFFF9776C /end MEASUREMENT
/begin MEASUREMENT ZFFSAB._.WheelIn.RR.v_WheelBalanced "computed wheel speed" UWORD SAB_V_KMH16_S2_S3 1 100 0 4095.9375 DISPLAY_IDENTIFIER v_WheelBalanced.RR.WheelIn._.ZFFSAB ECU_ADDRESS 0xFFF9776E /end MEASUREMENT
/begin MEASUREMENT ZFFSAB._.WheelIn.RR.f_v_WheelErr "Error flag of v_Wheel-signal" UBYTE SAB_STANDARD_S2_S3 1 100 0 1 DISPLAY_IDENTIFIER f_v_WheelErr.RR.WheelIn._.ZFFSAB ECU_ADDRESS 0xFFF97770 /end MEASUREMENT
/begin MEASUREMENT ZFFSAB._.WheelIn.sv_v_WheelActiveAvgSts "REPRESENT_INTERMEDIATE value signal status of derived average speed of driven axle" UBYTE SAB_STANDARD_S2_S3 1 100 0 255 DISPLAY_IDENTIFIER sv_v_WheelActiveAvgSts.WheelIn._.ZFFSAB ECU_ADDRESS 0xFFF976F2 /end MEASUREMENT
/begin MEASUREMENT ZFFSAB._.WheelIn.sv_v_WheelActiveAvg "REPRESENT_INTERMEDIATE value of derived average speed of driven axle" UWORD SAB_V_KMH16_S2_S3 1 100 0 4095.9375 DISPLAY_IDENTIFIER sv_v_WheelActiveAvg.WheelIn._.ZFFSAB ECU_ADDRESS 0xFFF976F4 /end MEASUREMENT
/begin MEASUREMENT ZFFSAB._.WheelIn.sv_n_Ab_ByWheelActiveAvgFilt "REPRESENT_INTERMEDIATE value filtered average output rpm derived from driven wheels" UWORD SAB_N_1RPM_S2_S3 1 100 0 65535 DISPLAY_IDENTIFIER sv_n_Ab_ByWheelActiveAvgFilt.WheelIn._.ZFFSAB ECU_ADDRESS 0xFFF976F6 /end MEASUREMENT
/begin MEASUREMENT ZFFSAB._.WheelIn.sv_AGS_FourWheelDrive "Intermediate value of driven axle" UBYTE SAB_STANDARD_S2_S3 1 100 0 2 DISPLAY_IDENTIFIER sv_AGS_FourWheelDrive.WheelIn._.ZFFSAB ECU_ADDRESS 0xFFF976F8 /end MEASUREMENT
/begin MEASUREMENT ZFFSAB._.WheelIn.lfz_Wheel "REPRESENT_INTERMEDIATE value of calculated dynamic wheel circumference" UWORD SAB_L_1MM_S2_S3 1 100 0 4095 DISPLAY_IDENTIFIER lfz_Wheel.WheelIn._.ZFFSAB ECU_ADDRESS 0xFFF976FA /end MEASUREMENT
/begin MEASUREMENT ZFFSAB._.WheelIn.lfz_WheelSts "REPRESENT_INTERMEDIATE value signal status of calculated lfz_Wheel" UBYTE SAB_STANDARD_S2_S3 1 100 0 2 DISPLAY_IDENTIFIER lfz_WheelSts.WheelIn._.ZFFSAB ECU_ADDRESS 0xFFF976FC /end MEASUREMENT
/begin MEASUREMENT ZFFSAB._.WheelIn.cod_SWI_WheelActivePassive "Intermediate value switch for selection of driven axle" UBYTE SAB_STANDARD_S2_S3 1 100 0 3 DISPLAY_IDENTIFIER cod_SWI_WheelActivePassive.WheelIn._.ZFFSAB ECU_ADDRESS 0xFFF976FD /end MEASUREMENT
/begin MEASUREMENT ZFFSAB._.WheelIn.sv_n_Ab_ByWheelActiveBalancedAvg "Intermediate value balanced output rpm derived from driven wheels" UWORD SAB_N_1RPM_S2_S3 1 100 0 65535 DISPLAY_IDENTIFIER sv_n_Ab_ByWheelActiveBalancedAvg.WheelIn._.ZFFSAB ECU_ADDRESS 0xFFF976FE /end MEASUREMENT
/begin MEASUREMENT ZFFSAB._.WheelIn.n_Ab_ByWheelActL "Output rpm value derived from left driven wheel" UWORD SAB_N_1RPM_S2_S3 1 100 0 65535 DISPLAY_IDENTIFIER n_Ab_ByWheelActL.WheelIn._.ZFFSAB ECU_ADDRESS 0xFFF97700 /end MEASUREMENT
/begin MEASUREMENT ZFFSAB._.WheelIn.n_Ab_ByWheelActR "Output rpm value derived from right driven wheel" UWORD SAB_N_1RPM_S2_S3 1 100 0 65535 DISPLAY_IDENTIFIER n_Ab_ByWheelActR.WheelIn._.ZFFSAB ECU_ADDRESS 0xFFF97702 /end MEASUREMENT
/begin MEASUREMENT ZFFSAB._.WheelIn.v_WheelDiagSts "Input signal message status of wheel speed from CAN" UBYTE SAB_STANDARD_S2_S3 1 100 0 255 DISPLAY_IDENTIFIER v_WheelDiagSts.WheelIn._.ZFFSAB ECU_ADDRESS 0xFFF97704 /end MEASUREMENT
/begin MEASUREMENT ZFFSAB._.WheelIn.v_WheelActiveBalancedAvg "Intermediate value derived balanced wheel speed from driven wheels" UWORD SAB_V_KMH16_S2_S3 1 100 0 4095.9375 DISPLAY_IDENTIFIER v_WheelActiveBalancedAvg.WheelIn._.ZFFSAB ECU_ADDRESS 0xFFF97706 /end MEASUREMENT
/begin MEASUREMENT ZFFSAB._.WheelIn.v_WheelPassiveAvgSts "Intermediate value signal status of average wheel speed of not driven axle (front)" UBYTE SAB_STANDARD_S2_S3 1 100 0 255 DISPLAY_IDENTIFIER v_WheelPassiveAvgSts.WheelIn._.ZFFSAB ECU_ADDRESS 0xFFF97708 /end MEASUREMENT
/begin MEASUREMENT ZFFSAB._.WheelIn.v_WheelPassiveAvg "Intermediate value average wheel speed of not driven axle (front)" UWORD SAB_V_KMH16_S2_S3 1 100 0 4095.9375 DISPLAY_IDENTIFIER v_WheelPassiveAvg.WheelIn._.ZFFSAB ECU_ADDRESS 0xFFF9770A /end MEASUREMENT
/begin MEASUREMENT ZFFSAB._.WheelIn.n_Ab_ByWheelActiveAvg "Intermediate value output rpm derived from driven wheels" UWORD SAB_N_1RPM_S2_S3 1 100 0 65535 DISPLAY_IDENTIFIER n_Ab_ByWheelActiveAvg.WheelIn._.ZFFSAB ECU_ADDRESS 0xFFF9770C /end MEASUREMENT
/begin MEASUREMENT ZFFSAB._.WheelIn.n_Ab_ByWheelPassiveAvg "Intermediate value output rpm derived from not driven wheels" UWORD SAB_N_1RPM_S2_S3 1 100 0 65535 DISPLAY_IDENTIFIER n_Ab_ByWheelPassiveAvg.WheelIn._.ZFFSAB ECU_ADDRESS 0xFFF9770E /end MEASUREMENT
/begin MEASUREMENT ZFFSAB._.WheelIn.v_WheelFSts "Intermediate value signal status of wheel speed front" UBYTE SAB_STANDARD_S2_S3 1 100 0 255 DISPLAY_IDENTIFIER v_WheelFSts.WheelIn._.ZFFSAB ECU_ADDRESS 0xFFF97710 /end MEASUREMENT
/begin MEASUREMENT ZFFSAB._.WheelIn.v_WheelRSts "Intermediate value signal status of wheel speed rear" UBYTE SAB_STANDARD_S2_S3 1 100 0 255 DISPLAY_IDENTIFIER v_WheelRSts.WheelIn._.ZFFSAB ECU_ADDRESS 0xFFF97711 /end MEASUREMENT
/begin MEASUREMENT ZFFSAB._.WheelIn.v_WheelAvgSts "Intermediate value signal status of average wheel speed of all four wheels" UWORD SAB_STANDARD_S2_S3 1 100 0 65535 DISPLAY_IDENTIFIER v_WheelAvgSts.WheelIn._.ZFFSAB ECU_ADDRESS 0xFFF97712 /end MEASUREMENT
/begin MEASUREMENT ZFFSAB._.WheelIn.v_WheelAvg "Intermediate value of average wheel speed of all four wheels" UWORD SAB_V_KMH16_S2_S3 1 100 0 4095.9375 DISPLAY_IDENTIFIER v_WheelAvg.WheelIn._.ZFFSAB ECU_ADDRESS 0xFFF97714 /end MEASUREMENT
/begin MEASUREMENT ZFFSAB._.WheelIn.n_WheelAvg "Average Wheel rpm of all driven wheels" ULONG SAB_N_RPM100_S2_S3 1 100 0 42949672.95 DISPLAY_IDENTIFIER n_WheelAvg.WheelIn._.ZFFSAB ECU_ADDRESS 0xFFF97718 /end MEASUREMENT
/begin MEASUREMENT ZFFSAB._.WheelIn.n_WheelAvgSts "Status of average Wheel rpm derived from driven wheels" UBYTE SAB_STANDARD_S2_S3 1 100 0 2 DISPLAY_IDENTIFIER n_WheelAvgSts.WheelIn._.ZFFSAB ECU_ADDRESS 0xFFF9771C /end MEASUREMENT
/begin MEASUREMENT ZFFSAB._.WheelIn.f_n_WheelAvgErr "Error flag of average Wheel rpm derived from driven wheels" UBYTE SAB_STANDARD_S2_S3 1 100 0 1 DISPLAY_IDENTIFIER f_n_WheelAvgErr.WheelIn._.ZFFSAB ECU_ADDRESS 0xFFF9771D /end MEASUREMENT
/begin MEASUREMENT ZFFSAB._.WheelIn.n_AbFilt1 "Intermediate value output rpm (filtered with PT1)" UWORD SAB_N_1RPM_S2_S3 1 100 0 65535 DISPLAY_IDENTIFIER n_AbFilt1.WheelIn._.ZFFSAB ECU_ADDRESS 0xFFF9771E /end MEASUREMENT
/begin MEASUREMENT ZFFSAB._.WheelIn.DriveDirWheelSts "Intermediate value signal status of driving direction of active driven wheels" UBYTE SAB_STANDARD_S2_S3 1 100 0 255 DISPLAY_IDENTIFIER DriveDirWheelSts.WheelIn._.ZFFSAB ECU_ADDRESS 0xFFF97720 /end MEASUREMENT
/begin MEASUREMENT ZFFSAB._.WheelIn.DriveDirWheel "Intermediate value of driving direction of active driven wheels" UBYTE SAB_STANDARD_S2_S3 1 100 0 255 DISPLAY_IDENTIFIER DriveDirWheel.WheelIn._.ZFFSAB ECU_ADDRESS 0xFFF97721 /end MEASUREMENT
/begin MEASUREMENT ZFFSAB._.RollPreventIn.iv_FzgRollPreventActive "Input value from CAN" UBYTE SAB_STANDARD_S2_S3 1 100 0 255 DISPLAY_IDENTIFIER iv_FzgRollPreventActive.RollPreventIn._.ZFFSAB ECU_ADDRESS 0xFFF97819 /end MEASUREMENT
/begin MEASUREMENT ZFFSAB._.RollPreventIn.iv_FzgRollPreventActiveSts "Input value message status of RollPreventIn" UBYTE SAB_STANDARD_S2_S3 1 100 0 255 DISPLAY_IDENTIFIER iv_FzgRollPreventActiveSts.RollPreventIn._.ZFFSAB ECU_ADDRESS 0xFFF9781A /end MEASUREMENT
/begin MEASUREMENT ZFFSAB._.RollPreventIn.iv_FzgRollPreventActive2 "Input value No 2 from CAN" UBYTE SAB_STANDARD_S2_S3 1 100 0 255 DISPLAY_IDENTIFIER iv_FzgRollPreventActive2.RollPreventIn._.ZFFSAB ECU_ADDRESS 0xFFF9781B /end MEASUREMENT
/begin MEASUREMENT ZFFSAB._.RollPreventIn.iv_FzgRollPreventActive2Sts "Input value message status of RollPreventIn" UBYTE SAB_STANDARD_S2_S3 1 100 0 255 DISPLAY_IDENTIFIER iv_FzgRollPreventActive2Sts.RollPreventIn._.ZFFSAB ECU_ADDRESS 0xFFF9781C /end MEASUREMENT
/begin MEASUREMENT ZFFSAB._.RollPreventIn.iv_Brake "Input value brake information signal from CAN" UBYTE SAB_STANDARD_S2_S3 1 100 0 63 DISPLAY_IDENTIFIER iv_Brake.RollPreventIn._.ZFFSAB ECU_ADDRESS 0xFFF9781D /end MEASUREMENT
/begin MEASUREMENT ZFFSAB._.RollPreventIn.iv_BrakeSts "Input value message status of brake information from CAN" UBYTE SAB_STANDARD_S2_S3 1 100 0 255 DISPLAY_IDENTIFIER iv_BrakeSts.RollPreventIn._.ZFFSAB ECU_ADDRESS 0xFFF9781E /end MEASUREMENT
/begin MEASUREMENT ZFFSAB._.RollPreventIn.sv_FzgRollPreventActive "Output value" UBYTE SAB_STANDARD_S2_S3 1 100 0 3 DISPLAY_IDENTIFIER sv_FzgRollPreventActive.RollPreventIn._.ZFFSAB ECU_ADDRESS 0xFFF9781F /end MEASUREMENT
/begin MEASUREMENT ZFFSAB._.RollPreventIn.sv_FzgRollPreventActiveSts "Output value signal status" UBYTE SAB_STANDARD_S2_S3 1 100 0 2 DISPLAY_IDENTIFIER sv_FzgRollPreventActiveSts.RollPreventIn._.ZFFSAB ECU_ADDRESS 0xFFF97820 /end MEASUREMENT
/begin MEASUREMENT ZFFSAB._.RollPreventIn.f_FzgRollPreventActiveErr "Errorflag" UBYTE SAB_STANDARD_S2_S3 1 100 0 1 DISPLAY_IDENTIFIER f_FzgRollPreventActiveErr.RollPreventIn._.ZFFSAB ECU_ADDRESS 0xFFF97821 /end MEASUREMENT
/begin MEASUREMENT ZFFSAB._.RollPreventIn.f_HillHolderOrAutoHoldactive "Internal flag for HillHolder or AutoHold (0: not active 1: active)" UBYTE SAB_STANDARD_S2_S3 1 100 0 1 DISPLAY_IDENTIFIER f_HillHolderOrAutoHoldactive.RollPreventIn._.ZFFSAB ECU_ADDRESS 0xFFF97822 /end MEASUREMENT
/begin MEASUREMENT ZFFSAB._.RollPreventIn.FzgRollPreventActiveFilt "filtered Input value of signal rollprevent active" UBYTE SAB_STANDARD_S2_S3 1 100 0 255 DISPLAY_IDENTIFIER FzgRollPreventActiveFilt.RollPreventIn._.ZFFSAB ECU_ADDRESS 0xFFF97823 /end MEASUREMENT
/begin MEASUREMENT ZFFSAB._.ParkingBrakeIn.iv_ParkingBrake "Input variable for current condition of the parking brake light" UBYTE SAB_STANDARD_S2_S3 1 100 0 255 DISPLAY_IDENTIFIER iv_ParkingBrake.ParkingBrakeIn._.ZFFSAB ECU_ADDRESS 0xFFF983CF /end MEASUREMENT
/begin MEASUREMENT ZFFSAB._.ParkingBrakeIn.iv_ParkingBrakeSts "Input variable for the parking brake light electrical status" UBYTE SAB_STANDARD_S2_S3 1 100 0 255 DISPLAY_IDENTIFIER iv_ParkingBrakeSts.ParkingBrakeIn._.ZFFSAB ECU_ADDRESS 0xFFF983D0 /end MEASUREMENT
/begin MEASUREMENT ZFFSAB._.ParkingBrakeIn.iv_ParkingBrake1 "Input variable for current condition of the parking brake" UBYTE SAB_STANDARD_S2_S3 1 100 0 255 DISPLAY_IDENTIFIER iv_ParkingBrake1.ParkingBrakeIn._.ZFFSAB ECU_ADDRESS 0xFFF983D1 /end MEASUREMENT
/begin MEASUREMENT ZFFSAB._.ParkingBrakeIn.iv_ParkingBrake1Sts "Input variable for the parking brake electrical status" UBYTE SAB_STANDARD_S2_S3 1 100 0 255 DISPLAY_IDENTIFIER iv_ParkingBrake1Sts.ParkingBrakeIn._.ZFFSAB ECU_ADDRESS 0xFFF983D2 /end MEASUREMENT
/begin MEASUREMENT ZFFSAB._.ParkingBrakeIn.iv_ParkingBrake2 "Input variable for filtered condition of the parking brake" UBYTE SAB_STANDARD_S2_S3 1 100 0 3 DISPLAY_IDENTIFIER iv_ParkingBrake2.ParkingBrakeIn._.ZFFSAB ECU_ADDRESS 0xFFF983D3 /end MEASUREMENT
/begin MEASUREMENT ZFFSAB._.ParkingBrakeIn.iv_ParkingBrake2Sts "Input variable for filtered condition of the parking brake electrical status" UBYTE SAB_STANDARD_S2_S3 1 100 0 255 DISPLAY_IDENTIFIER iv_ParkingBrake2Sts.ParkingBrakeIn._.ZFFSAB ECU_ADDRESS 0xFFF983D4 /end MEASUREMENT
/begin MEASUREMENT ZFFSAB._.ParkingBrakeIn.sv_f_ParkingBrake "Output variable for condition of the parking brake light" UBYTE SAB_STANDARD_S2_S3 1 100 0 1 DISPLAY_IDENTIFIER sv_f_ParkingBrake.ParkingBrakeIn._.ZFFSAB ECU_ADDRESS 0xFFF983D5 /end MEASUREMENT
/begin MEASUREMENT ZFFSAB._.ParkingBrakeIn.sv_ParkingBrakeSts "Output variable for the parking brake light status" UBYTE SAB_STANDARD_S2_S3 1 100 0 2 DISPLAY_IDENTIFIER sv_ParkingBrakeSts.ParkingBrakeIn._.ZFFSAB ECU_ADDRESS 0xFFF983D6 /end MEASUREMENT
/begin MEASUREMENT ZFFSAB._.RegPartFilterIn.iv_PartfiltAktiv "Input value providing the information if the particlefilter is regenerating" UBYTE SAB_STANDARD_S2_S3 1 100 0 3 DISPLAY_IDENTIFIER iv_PartfiltAktiv.RegPartFilterIn._.ZFFSAB ECU_ADDRESS 0xFFF983D8 /end MEASUREMENT
/begin MEASUREMENT ZFFSAB._.RegPartFilterIn.iv_PartfiltAktivSts "Input value for iv_PartfiltAktiv signal status" UBYTE SAB_STANDARD_S2_S3 1 100 0 255 DISPLAY_IDENTIFIER iv_PartfiltAktivSts.RegPartFilterIn._.ZFFSAB ECU_ADDRESS 0xFFF983D9 /end MEASUREMENT
/begin MEASUREMENT ZFFSAB._.RegPartFilterIn.sv_PartfiltAktiv "Output value of RegPartFilterIn:" UBYTE SAB_STANDARD_S2_S3 1 100 0 2 DISPLAY_IDENTIFIER sv_PartfiltAktiv.RegPartFilterIn._.ZFFSAB ECU_ADDRESS 0xFFF983DA /end MEASUREMENT
/begin MEASUREMENT ZFFSAB._.RegPartFilterIn.sv_PartfiltAktivSts "Output signal status of RegPartFilterIn:" UBYTE SAB_STANDARD_S2_S3 1 100 0 2 DISPLAY_IDENTIFIER sv_PartfiltAktivSts.RegPartFilterIn._.ZFFSAB ECU_ADDRESS 0xFFF983DB /end MEASUREMENT
/begin MEASUREMENT ZFFSAB._.RegPartFilterIn.f_PartfiltAktivErr "Error flag of PartfiltAktiv-signal" UBYTE SAB_STANDARD_S2_S3 1 100 0 1 DISPLAY_IDENTIFIER f_PartfiltAktivErr.RegPartFilterIn._.ZFFSAB ECU_ADDRESS 0xFFF983DC /end MEASUREMENT
/begin MEASUREMENT ZFFSAB._.DrivingDirectionIn.sv_DrivingDirection "Output signal of driving direction wheel" UBYTE SAB_STANDARD_S2_S3 1 100 0 2 DISPLAY_IDENTIFIER sv_DrivingDirection.DrivingDirectionIn._.ZFFSAB ECU_ADDRESS 0xFFF9783D /end MEASUREMENT
/begin MEASUREMENT ZFFSAB._.DrivingDirectionIn.sv_DrivingDirectionSts "Output status of signal" UBYTE SAB_STANDARD_S2_S3 1 100 0 2 DISPLAY_IDENTIFIER sv_DrivingDirectionSts.DrivingDirectionIn._.ZFFSAB ECU_ADDRESS 0xFFF9783E /end MEASUREMENT
/begin MEASUREMENT ZFFSAB._.DrivingDirectionIn.sv_DriveDirectionAGS "Output signal of driving direction wheel AGS" UBYTE SAB_STANDARD_S2_S3 1 100 0 2 DISPLAY_IDENTIFIER sv_DriveDirectionAGS.DrivingDirectionIn._.ZFFSAB ECU_ADDRESS 0xFFF9783F /end MEASUREMENT
/begin MEASUREMENT ZFFSAB._.DrivingDirectionIn.DrivingDirectionRaw "Intermediate signal of driving direction" UBYTE SAB_STANDARD_S2_S3 1 100 0 2 DISPLAY_IDENTIFIER DrivingDirectionRaw.DrivingDirectionIn._.ZFFSAB ECU_ADDRESS 0xFFF97840 /end MEASUREMENT
/begin MEASUREMENT ZFFSAB._.DrivingDirectionIn.DrivingDirectionRawSts "Intermediate status of driving direction" UBYTE SAB_STANDARD_S2_S3 1 100 0 255 DISPLAY_IDENTIFIER DrivingDirectionRawSts.DrivingDirectionIn._.ZFFSAB ECU_ADDRESS 0xFFF97841 /end MEASUREMENT
/begin MEASUREMENT ZFFSAB._.DrivingDirectionIn.DriveDirWheel "Intermediate signal of driving direction wheel" UBYTE SAB_STANDARD_S2_S3 1 100 0 2 DISPLAY_IDENTIFIER DriveDirWheel.DrivingDirectionIn._.ZFFSAB ECU_ADDRESS 0xFFF97842 /end MEASUREMENT
/begin MEASUREMENT ZFFSAB._.DrivingDirectionIn.DriveDirWheelSts "Intermediate status of driving direction wheel" UBYTE SAB_STANDARD_S2_S3 1 100 0 255 DISPLAY_IDENTIFIER DriveDirWheelSts.DrivingDirectionIn._.ZFFSAB ECU_ADDRESS 0xFFF97843 /end MEASUREMENT
/begin MEASUREMENT ZFFSAB._.ShiftlockRequestExternalIn.iv_PN "Input value shiftlock request from CAN" UBYTE SAB_STANDARD_S2_S3 1 100 0 3 DISPLAY_IDENTIFIER iv_PN.ShiftlockRequestExternalIn._.ZFFSAB ECU_ADDRESS 0xFFF983DD /end MEASUREMENT
/begin MEASUREMENT ZFFSAB._.ShiftlockRequestExternalIn.iv_PNSts "Input value message status of shiftlock request" UBYTE SAB_STANDARD_S2_S3 1 100 0 255 DISPLAY_IDENTIFIER iv_PNSts.ShiftlockRequestExternalIn._.ZFFSAB ECU_ADDRESS 0xFFF983DE /end MEASUREMENT
/begin MEASUREMENT ZFFSAB._.ShiftlockRequestExternalIn.sv_f_PN "Output value of shiftlock request" UBYTE SAB_STANDARD_S2_S3 1 100 0 1 DISPLAY_IDENTIFIER sv_f_PN.ShiftlockRequestExternalIn._.ZFFSAB ECU_ADDRESS 0xFFF983DF /end MEASUREMENT
/begin MEASUREMENT ZFFSAB._.ShiftlockRequestExternalIn.sv_PNSts "Output value signal status of shiftlock request" UBYTE SAB_STANDARD_S2_S3 1 100 0 2 DISPLAY_IDENTIFIER sv_PNSts.ShiftlockRequestExternalIn._.ZFFSAB ECU_ADDRESS 0xFFF983E0 /end MEASUREMENT
/begin MEASUREMENT ZFFSAB._.ShiftlockRequestExternalIn.f_PNErr "Error flag of shiftlock request" UBYTE SAB_STANDARD_S2_S3 1 100 0 1 DISPLAY_IDENTIFIER f_PNErr.ShiftlockRequestExternalIn._.ZFFSAB ECU_ADDRESS 0xFFF983E1 /end MEASUREMENT
/begin MEASUREMENT ZFFSAB._.EngineInterventionLimitIn.iv_m_EngInterventionLimit "Input raw signal of max. allowed engine torque" UWORD SAB_M_NM2_M2047_S2_S3 1 100 -1023.5 1024 DISPLAY_IDENTIFIER iv_m_EngInterventionLimit.EngineInterventionLimitIn._.ZFFSAB ECU_ADDRESS 0xFFF97844 /end MEASUREMENT
/begin MEASUREMENT ZFFSAB._.EngineInterventionLimitIn.iv_m_EngInterventionLimitSts "Input raw signal of max. allowed engine torque status" UBYTE SAB_STANDARD_S2_S3 1 100 0 255 DISPLAY_IDENTIFIER iv_m_EngInterventionLimitSts.EngineInterventionLimitIn._.ZFFSAB ECU_ADDRESS 0xFFF97846 /end MEASUREMENT
/begin MEASUREMENT ZFFSAB._.EngineInterventionLimitIn.sv_m_EngInterventionLimit "Output signal of max. allowed engine torque" SWORD SAB_M_1NM_S2_S3 1 100 -32768 32767 DISPLAY_IDENTIFIER sv_m_EngInterventionLimit.EngineInterventionLimitIn._.ZFFSAB ECU_ADDRESS 0xFFF97848 /end MEASUREMENT
/begin MEASUREMENT ZFFSAB._.EngineInterventionLimitIn.m_EngInterventionLimitSts "Intermediate signal status of max. allowed engine torque" UBYTE SAB_STANDARD_S2_S3 1 100 0 1 DISPLAY_IDENTIFIER m_EngInterventionLimitSts.EngineInterventionLimitIn._.ZFFSAB ECU_ADDRESS 0xFFF9784A /end MEASUREMENT
/begin MEASUREMENT ZFFSAB._.EngineInterventionLimitIn.f_m_EngInterventionLimitErr "Error flag of m_EngInterventionLimit-signal" UBYTE SAB_STANDARD_S2_S3 1 100 0 1 DISPLAY_IDENTIFIER f_m_EngInterventionLimitErr.EngineInterventionLimitIn._.ZFFSAB ECU_ADDRESS 0xFFF9784B /end MEASUREMENT
/begin MEASUREMENT ZFFSAB._.TempExternIn.iv_c_Ambient "Input value ambient temperature from CAN" UBYTE SAB_C_TEMPEXTERN_CEL2_M40_S2_S3 1 100 -40 87.5 DISPLAY_IDENTIFIER iv_c_Ambient.TempExternIn._.ZFFSAB ECU_ADDRESS 0xFFF983E7 /end MEASUREMENT
/begin MEASUREMENT ZFFSAB._.TempExternIn.iv_c_AmbientSts "Input value of ambient temperature message status" UBYTE SAB_STANDARD_S2_S3 1 100 0 255 DISPLAY_IDENTIFIER iv_c_AmbientSts.TempExternIn._.ZFFSAB ECU_ADDRESS 0xFFF983E8 /end MEASUREMENT
/begin MEASUREMENT ZFFSAB._.TempExternIn.sv_c_Ambient "Output value for ambient temperature" UBYTE SAB_C_TEMPEXTERN_CEL2_M40_S2_S3 1 100 -40 87.5 DISPLAY_IDENTIFIER sv_c_Ambient.TempExternIn._.ZFFSAB ECU_ADDRESS 0xFFF983E9 /end MEASUREMENT
/begin MEASUREMENT ZFFSAB._.TempExternIn.sv_c_AmbientSts "Output value for of ambient temperature signal status" UBYTE SAB_STANDARD_S2_S3 1 100 0 2 DISPLAY_IDENTIFIER sv_c_AmbientSts.TempExternIn._.ZFFSAB ECU_ADDRESS 0xFFF983EA /end MEASUREMENT
/begin MEASUREMENT ZFFSAB._.TempExternIn.f_c_AmbientErr "Error flag of c_Ambient-signal" UBYTE SAB_STANDARD_S2_S3 1 100 0 1 DISPLAY_IDENTIFIER f_c_AmbientErr.TempExternIn._.ZFFSAB ECU_ADDRESS 0xFFF983EB /end MEASUREMENT
/begin MEASUREMENT ZFFSAB._.MaxTorquePredictionEMIn.iv_m_MaxPredEM "Input signal for maximum torque prediction of the electrical machine" UWORD SAB_M_NM2_M2047_S2_S3 1 100 -1023.5 1024 DISPLAY_IDENTIFIER iv_m_MaxPredEM.MaxTorquePredictionEMIn._.ZFFSAB ECU_ADDRESS 0xFFF98486 /end MEASUREMENT
/begin MEASUREMENT ZFFSAB._.MaxTorquePredictionEMIn.iv_m_MaxPredEMSts "Status of the input signal for maximum torque prediction of the electrical machine" UBYTE SAB_STANDARD_S2_S3 1 100 0 255 DISPLAY_IDENTIFIER iv_m_MaxPredEMSts.MaxTorquePredictionEMIn._.ZFFSAB ECU_ADDRESS 0xFFF98488 /end MEASUREMENT
/begin MEASUREMENT ZFFSAB._.MaxTorquePredictionEMIn.iv_m_MinPredEM "Input signal for minimum torque prediction of the electrical machine" UWORD SAB_M_NM2_M2047_S2_S3 1 100 -1023.5 1024 DISPLAY_IDENTIFIER iv_m_MinPredEM.MaxTorquePredictionEMIn._.ZFFSAB ECU_ADDRESS 0xFFF9848A /end MEASUREMENT
/begin MEASUREMENT ZFFSAB._.MaxTorquePredictionEMIn.iv_m_MinPredEMSts "Status of the input signal for minimum torque prediction of the electrical machine" UBYTE SAB_STANDARD_S2_S3 1 100 0 255 DISPLAY_IDENTIFIER iv_m_MinPredEMSts.MaxTorquePredictionEMIn._.ZFFSAB ECU_ADDRESS 0xFFF9848C /end MEASUREMENT
/begin MEASUREMENT ZFFSAB._.MaxTorquePredictionEMIn.sv_m_MaxPredEM "Output signal of the predicted maximum torque of the electrical machine" SWORD SAB_M_1NM_S2_S3 1 100 -400 1640 DISPLAY_IDENTIFIER sv_m_MaxPredEM.MaxTorquePredictionEMIn._.ZFFSAB ECU_ADDRESS 0xFFF9848E /end MEASUREMENT
/begin MEASUREMENT ZFFSAB._.MaxTorquePredictionEMIn.sv_m_MaxPredEMSts "Output status signal of the predicted maximum torque of the electrical machine" UBYTE SAB_STANDARD_S2_S3 1 100 0 2 DISPLAY_IDENTIFIER sv_m_MaxPredEMSts.MaxTorquePredictionEMIn._.ZFFSAB ECU_ADDRESS 0xFFF98490 /end MEASUREMENT
/begin MEASUREMENT ZFFSAB._.MaxTorquePredictionEMIn.sv_m_MinPredEM "Output signal of the predicted minimum torque of the electrical machine" SWORD SAB_M_1NM_S2_S3 1 100 -400 1640 DISPLAY_IDENTIFIER sv_m_MinPredEM.MaxTorquePredictionEMIn._.ZFFSAB ECU_ADDRESS 0xFFF98492 /end MEASUREMENT
/begin MEASUREMENT ZFFSAB._.MaxTorquePredictionEMIn.sv_m_MinPredEMSts "Output status signal of the predicted minimum torque of the electrical machine" UBYTE SAB_STANDARD_S2_S3 1 100 0 2 DISPLAY_IDENTIFIER sv_m_MinPredEMSts.MaxTorquePredictionEMIn._.ZFFSAB ECU_ADDRESS 0xFFF98494 /end MEASUREMENT
/begin MEASUREMENT ZFFSAB._.MaxTorquePredictionEMIn.f_m_maxPredEMErr "Error flag of predicted maximum Torque-signal" UBYTE SAB_STANDARD_S2_S3 1 100 0 1 DISPLAY_IDENTIFIER f_m_maxPredEMErr.MaxTorquePredictionEMIn._.ZFFSAB ECU_ADDRESS 0xFFF98495 /end MEASUREMENT
/begin MEASUREMENT ZFFSAB._.MaxTorquePredictionEMIn.f_m_minPredEMErr "Error flag of predicted minimum Torque-signal" UBYTE SAB_STANDARD_S2_S3 1 100 0 1 DISPLAY_IDENTIFIER f_m_minPredEMErr.MaxTorquePredictionEMIn._.ZFFSAB ECU_ADDRESS 0xFFF98496 /end MEASUREMENT
/begin COMPU_METHOD UMR_PROZENT_1_10_M300_S1_S3 "int = ((phys * 10) / 1) - (-3000) %" RAT_FUNC "%5.3" "%" COEFFS 0 10 3000 0 0 1 /end COMPU_METHOD
/begin COMPU_METHOD UMR_PROZENT_1_1_0_S1_S3 "int = ((phys * 1) / 1) - (0) %" RAT_FUNC "%2.0" "%" COEFFS 0 1 -0 0 0 1 /end COMPU_METHOD
/begin COMPU_METHOD UMR_A_CAN_1_32_0_S1_S3 "int = ((phys * 32) / 1) - (0) [m/s^2]" RAT_FUNC "%5.3" "[m/s^2]" COEFFS 0 32 -0 0 0 1 /end COMPU_METHOD
/begin COMPU_METHOD UMR_N_1_M_S1_S3 "int = ((phys * 1) / 1) - (0) [1/min]" RAT_FUNC "%2.0" "[1/min]" COEFFS 0 1 -0 0 0 1 /end COMPU_METHOD
/begin COMPU_METHOD SAB_STANDARD_S2_S3 "int = ((phys * 1) / 1) - (0) -" RAT_FUNC "%2.0" "-" COEFFS 0 1 -0 0 0 1 /end COMPU_METHOD
/begin COMPU_METHOD SAB_L_1MM_S2_S3 "int = ((phys * 1) / 1) - (0) mm" RAT_FUNC "%2.0" "mm" COEFFS 0 1 -0 0 0 1 /end COMPU_METHOD
/begin COMPU_METHOD SAB_N_RPM2_M5000_S2_S3 "int = ((phys * 2) / 1) - (-10000) 1/min" RAT_FUNC "%5.3" "1/min" COEFFS 0 2 10000 0 0 1 /end COMPU_METHOD
/begin COMPU_METHOD SAB_A_2MPSS1000_M32500_S2_S3 "int = ((phys * 1000) / 2) - (-32500) m/s^2" RAT_FUNC "%5.3" "m/s^2" COEFFS 0 1000 65000 0 0 2 /end COMPU_METHOD
/begin COMPU_METHOD SAB_A_MPSS32_S2_S3 "int = ((phys * 32) / 1) - (0) m/s^2" RAT_FUNC "%5.3" "m/s^2" COEFFS 0 32 -0 0 0 1 /end COMPU_METHOD
/begin COMPU_METHOD SAB_N_RADPS64_M32767_S2_S3 "int = ((phys * 64) / 1) - (-32767) rad/s" RAT_FUNC "%5.3" "rad/s" COEFFS 0 64 32767 0 0 1 /end COMPU_METHOD
/begin COMPU_METHOD SAB_N_1RPM_S2_S3 "int = ((phys * 1) / 1) - (0) 1/min" RAT_FUNC "%2.0" "1/min" COEFFS 0 1 -0 0 0 1 /end COMPU_METHOD
/begin COMPU_METHOD SAB_N_RPM_M2000_S2_S3 "int = ((phys * 1) / 1) - (-2000) 1/min" RAT_FUNC "%2.0" "1/min" COEFFS 0 1 2000 0 0 1 /end COMPU_METHOD
/begin COMPU_METHOD SAB_C_CGT_1CEL_M40_S2_S3 "int = ((phys * 1) / 1) - (-40) Grad Celsius" RAT_FUNC "%2.0" "Grad Celsius" COEFFS 0 1 40 0 0 1 /end COMPU_METHOD
/begin COMPU_METHOD SAB_C_CGT_100CEL_M4000_S2_S3 "int = ((phys * 100) / 1) - (-4000) Grad Celsius" RAT_FUNC "%5.3" "Grad Celsius" COEFFS 0 100 4000 0 0 1 /end COMPU_METHOD
/begin COMPU_METHOD SAB_C_TEMPEXTERN_CEL2_M40_S2_S3 "int = ((phys * 2) / 1) - (-80) Grad Celsius" RAT_FUNC "%5.3" "Grad Celsius" COEFFS 0 2 80 0 0 1 /end COMPU_METHOD
/begin COMPU_METHOD SAB_M_1NM_S2_S3 "int = ((phys * 1) / 1) - (0) Nm" RAT_FUNC "%2.0" "Nm" COEFFS 0 1 -0 0 0 1 /end COMPU_METHOD
/begin COMPU_METHOD SAB_M_NM2_S2_S3 "int = ((phys * 2) / 1) - (0) Nm" RAT_FUNC "%5.3" "Nm" COEFFS 0 2 -0 0 0 1 /end COMPU_METHOD
/begin COMPU_METHOD SAB_P_BARO_2HPA_P598_S2_S3 "int = ((phys * 1) / 2) - (299) hPa" RAT_FUNC "%5.3" "hPa" COEFFS 0 1 -598 0 0 2 /end COMPU_METHOD
/begin COMPU_METHOD SAB_P_1HPA_S2_S3 "int = ((phys * 1) / 1) - (0) hPa" RAT_FUNC "%2.0" "hPa" COEFFS 0 1 -0 0 0 1 /end COMPU_METHOD
/begin COMPU_METHOD SAB_P_BAR2_S2_S3 "int = ((phys * 2) / 1) - (0) bar" RAT_FUNC "%5.3" "bar" COEFFS 0 2 -0 0 0 1 /end COMPU_METHOD
/begin COMPU_METHOD SAB_PHI_STEERING_ANGLE_2747GRAD1000000_M32763_S2_S3 "int = ((phys * 1.0E6) / 2747) - (-32763) grad" RAT_FUNC "%5.3" "grad" COEFFS 0 1000000 89999961 0 0 2747 /end COMPU_METHOD
/begin COMPU_METHOD SAB_PHI_2GRAD_S2_S3 "int = ((phys * 1) / 2) - (0) grad" RAT_FUNC "%5.3" "grad" COEFFS 0 1 -0 0 0 2 /end COMPU_METHOD
/begin COMPU_METHOD SAB_N_10RPM_S2_S3 "int = ((phys * 1) / 10) - (0) 1/min" RAT_FUNC "%5.3" "1/min" COEFFS 0 1 -0 0 0 10 /end COMPU_METHOD
/begin COMPU_METHOD SAB_N_5RPM_S2_S3 "int = ((phys * 1) / 5) - (0) 1/min" RAT_FUNC "%5.3" "1/min" COEFFS 0 1 -0 0 0 5 /end COMPU_METHOD
/begin COMPU_METHOD SAB_V_1KMH_S2_S3 "int = ((phys * 1) / 1) - (0) km/h" RAT_FUNC "%2.0" "km/h" COEFFS 0 1 -0 0 0 1 /end COMPU_METHOD
/begin COMPU_METHOD SAB_V_KMH64_S2_S3 "int = ((phys * 64) / 1) - (0) km/h" RAT_FUNC "%5.3" "km/h" COEFFS 0 64 -0 0 0 1 /end COMPU_METHOD
/begin COMPU_METHOD SAB_V_KMH100_S2_S3 "int = ((phys * 100) / 1) - (0) km/h" RAT_FUNC "%5.3" "km/h" COEFFS 0 100 -0 0 0 1 /end COMPU_METHOD
/begin COMPU_METHOD SAB_V_KMH16_S2_S3 "int = ((phys * 16) / 1) - (0) km/h" RAT_FUNC "%5.3" "km/h" COEFFS 0 16 -0 0 0 1 /end COMPU_METHOD
/begin COMPU_METHOD SAB_K100_S2_S3 "int = ((phys * 100) / 1) - (0) -" RAT_FUNC "%5.3" "-" COEFFS 0 100 -0 0 0 1 /end COMPU_METHOD
/begin COMPU_METHOD SAB_M_1NM_M32000_S2_S3 "int = ((phys * 1) / 1) - (-32000) Nm" RAT_FUNC "%2.0" "Nm" COEFFS 0 1 32000 0 0 1 /end COMPU_METHOD
/begin COMPU_METHOD SAB_N_RPM100_S2_S3 "int = ((phys * 100) / 1) - (0) 1/min" RAT_FUNC "%5.3" "1/min" COEFFS 0 100 -0 0 0 1 /end COMPU_METHOD
/begin COMPU_METHOD SAB_M_NM2_M2047_S2_S3 "int = ((phys * 2) / 1) - (-2047) Nm" RAT_FUNC "%5.3" "Nm" COEFFS 0 2 2047 0 0 1 /end COMPU_METHOD
/begin COMPU_METHOD SAB_PHI_GRAD_S2_S3 "int = ((phys * 1) / 1) - (0) grad" RAT_FUNC "%2.0" "grad" COEFFS 0 1 -0 0 0 1 /end COMPU_METHOD
/begin FUNCTION zf_SAB_CrankShaftCurTorqueIn "desc_en"
 /begin LOC_MEASUREMENT ZFFSAB._.CrankShaftCurTorqueIn.f_CrankErr ZFFSAB._.CrankShaftCurTorqueIn.f_m_IstEMErr ZFFSAB._.CrankShaftCurTorqueIn.f_m_IstEMErr_ ZFFSAB._.CrankShaftCurTorqueIn.f_m_IstEMLev2Err ZFFSAB._.CrankShaftCurTorqueIn.f_m_IstEMLev2Err_ ZFFSAB._.CrankShaftCurTorqueIn.f_m_IstVMErr ZFFSAB._.CrankShaftCurTorqueIn.f_m_IstVMLev2Err ZFFSAB._.CrankShaftCurTorqueIn.f_m_IstVMLev2Err_ ZFFSAB._.CrankShaftCurTorqueIn.iv_m_Crank ZFFSAB._.CrankShaftCurTorqueIn.iv_m_CrankSts ZFFSAB._.CrankShaftCurTorqueIn.iv_m_CrankSts_ ZFFSAB._.CrankShaftCurTorqueIn.iv_m_Crank_ ZFFSAB._.CrankShaftCurTorqueIn.iv_m_IstEM ZFFSAB._.CrankShaftCurTorqueIn.iv_m_IstEMSts ZFFSAB._.CrankShaftCurTorqueIn.iv_m_IstEMSts_ ZFFSAB._.CrankShaftCurTorqueIn.iv_m_IstEM_ ZFFSAB._.CrankShaftCurTorqueIn.iv_m_IstVM ZFFSAB._.CrankShaftCurTorqueIn.iv_m_IstVMSts ZFFSAB._.CrankShaftCurTorqueIn.iv_m_IstVMSts_ ZFFSAB._.CrankShaftCurTorqueIn.iv_m_IstVM_ ZFFSAB._.CrankShaftCurTorqueIn.iv_m_PumpCensored ZFFSAB._.CrankShaftCurTorqueIn.m_CrankCor ZFFSAB._.CrankShaftCurTorqueIn.m_IstEM1 ZFFSAB._.CrankShaftCurTorqueIn.m_IstEM1Lev2 ZFFSAB._.CrankShaftCurTorqueIn.m_IstVMCor ZFFSAB._.CrankShaftCurTorqueIn.sv_AGS_MMotIst ZFFSAB._.CrankShaftCurTorqueIn.sv_AGS_MVm ZFFSAB._.CrankShaftCurTorqueIn.sv_m_Crank ZFFSAB._.CrankShaftCurTorqueIn.sv_m_CrankLev2 ZFFSAB._.CrankShaftCurTorqueIn.sv_m_CrankLev2_ ZFFSAB._.CrankShaftCurTorqueIn.sv_m_CrankSts ZFFSAB._.CrankShaftCurTorqueIn.sv_m_CrankSts_ ZFFSAB._.CrankShaftCurTorqueIn.sv_m_Ind ZFFSAB._.CrankShaftCurTorqueIn.sv_m_IstEM ZFFSAB._.CrankShaftCurTorqueIn.sv_m_IstEMLev2 ZFFSAB._.CrankShaftCurTorqueIn.sv_m_IstEMLev2Sts ZFFSAB._.CrankShaftCurTorqueIn.sv_m_IstEMLev2Sts_ ZFFSAB._.CrankShaftCurTorqueIn.sv_m_IstEMLev2_ ZFFSAB._.CrankShaftCurTorqueIn.sv_m_IstEMSts ZFFSAB._.CrankShaftCurTorqueIn.sv_m_IstVM ZFFSAB._.CrankShaftCurTorqueIn.sv_m_IstVMLev2 ZFFSAB._.CrankShaftCurTorqueIn.sv_m_IstVMLev2Sts ZFFSAB._.CrankShaftCurTorqueIn.sv_m_IstVMLev2Sts_ ZFFSAB._.CrankShaftCurTorqueIn.sv_m_IstVMLev2_ ZFFSAB._.CrankShaftCurTorqueIn.sv_m_IstVMSts /end LOC_MEASUREMENT
/end FUNCTION
/begin FUNCTION zf_SAB_EngineTorqueInFl "desc_en"
 /begin LOC_MEASUREMENT ZFFSAB._.EngineTorqueIn.EngineTorqueInFl.f_m_EngErr ZFFSAB._.EngineTorqueIn.EngineTorqueInFl.iv_m_Eng ZFFSAB._.EngineTorqueIn.EngineTorqueInFl.iv_m_EngSts ZFFSAB._.EngineTorqueIn.EngineTorqueInFl.m_EngCor ZFFSAB._.EngineTorqueIn.EngineTorqueInFl.sv_m_EngLev2 ZFFSAB._.EngineTorqueIn.EngineTorqueInFl.sv_m_EngLev2_ ZFFSAB._.EngineTorqueIn.EngineTorqueInFl.sv_m_EngSts /end LOC_MEASUREMENT
/end FUNCTION
/begin FUNCTION zf_SAB_EngineTorqueIn "desc_en"
 /begin LOC_MEASUREMENT ZFFSAB._.EngineTorqueIn.EngineTorqueInFl.iv_m_Eng_ ZFFSAB._.EngineTorqueIn.f_m_EngErr ZFFSAB._.EngineTorqueIn.iv_m_Eng ZFFSAB._.EngineTorqueIn.iv_m_EngSts ZFFSAB._.EngineTorqueIn.iv_m_EngSts_ ZFFSAB._.EngineTorqueIn.iv_m_Eng_ ZFFSAB._.EngineTorqueIn.iv_m_K0AktModified ZFFSAB._.EngineTorqueIn.iv_m_PumpCensored ZFFSAB._.EngineTorqueIn.m_EngCor ZFFSAB._.EngineTorqueIn.m_EngCor2 ZFFSAB._.EngineTorqueIn.m_EngCor2Sts ZFFSAB._.EngineTorqueIn.m_EngCorSts ZFFSAB._.EngineTorqueIn.m_EngCorSts_ ZFFSAB._.EngineTorqueIn.sv_AGS_MMot ZFFSAB._.EngineTorqueIn.sv_m_Eng ZFFSAB._.EngineTorqueIn.sv_m_EngFilt ZFFSAB._.EngineTorqueIn.sv_m_EngFiltSts ZFFSAB._.EngineTorqueIn.sv_m_EngLev2 ZFFSAB._.EngineTorqueIn.sv_m_EngLev2_ ZFFSAB._.EngineTorqueIn.sv_m_EngSts ZFFSAB._.EngineTorqueIn.sv_m_EngStsLev2 ZFFSAB._.EngineTorqueIn.sv_m_EngStsLev2_ /end LOC_MEASUREMENT
/end FUNCTION
/begin FUNCTION zf_SAB_TorqueReserveIn "desc_en"
 /begin LOC_MEASUREMENT ZFFSAB._.TorqueReserveIn.f_m_ReserveErr ZFFSAB._.TorqueReserveIn.iv_m_Reserve ZFFSAB._.TorqueReserveIn.iv_m_ReserveSts ZFFSAB._.TorqueReserveIn.sv_m_Reserve ZFFSAB._.TorqueReserveIn.sv_m_ReserveSts /end LOC_MEASUREMENT
/end FUNCTION
/begin FUNCTION zf_SAB_DesiredTorqueIn "desc_en"
 /begin LOC_MEASUREMENT ZFFSAB._.DesiredTorqueIn.f_m_DSCErr ZFFSAB._.DesiredTorqueIn.f_m_EngDesEMErr ZFFSAB._.DesiredTorqueIn.f_m_EngDesErr ZFFSAB._.DesiredTorqueIn.f_m_EngDesErr_ ZFFSAB._.DesiredTorqueIn.f_m_EngDesLev2Err ZFFSAB._.DesiredTorqueIn.f_m_EngDesLev2Err_ ZFFSAB._.DesiredTorqueIn.f_m_EngDesVMErr ZFFSAB._.DesiredTorqueIn.f_m_MaxIncrVMErr ZFFSAB._.DesiredTorqueIn.iv_m_DriverDes ZFFSAB._.DesiredTorqueIn.iv_m_DriverDesEM ZFFSAB._.DesiredTorqueIn.iv_m_DriverDesEMSts ZFFSAB._.DesiredTorqueIn.iv_m_DriverDesSts ZFFSAB._.DesiredTorqueIn.iv_m_DriverDesSts_ ZFFSAB._.DesiredTorqueIn.iv_m_DriverDesVM ZFFSAB._.DesiredTorqueIn.iv_m_DriverDesVMSts ZFFSAB._.DesiredTorqueIn.iv_m_DriverDes_ ZFFSAB._.DesiredTorqueIn.iv_m_EngMax ZFFSAB._.DesiredTorqueIn.iv_m_MaxIncrVM ZFFSAB._.DesiredTorqueIn.iv_m_MaxIncrVMSts ZFFSAB._.DesiredTorqueIn.iv_m_PumpCensored ZFFSAB._.DesiredTorqueIn.m_DSCRangePositiveDesSts ZFFSAB._.DesiredTorqueIn.m_DSCStsDesSts ZFFSAB._.DesiredTorqueIn.m_DriverDes ZFFSAB._.DesiredTorqueIn.m_DriverDesCor ZFFSAB._.DesiredTorqueIn.m_DriverDesEM ZFFSAB._.DesiredTorqueIn.m_DriverDesEMSts ZFFSAB._.DesiredTorqueIn.m_DriverDesSts ZFFSAB._.DesiredTorqueIn.m_DriverDesVM ZFFSAB._.DesiredTorqueIn.m_DriverDesVMSts ZFFSAB._.DesiredTorqueIn.m_EngDesCor1 ZFFSAB._.DesiredTorqueIn.m_EngDesCor2 ZFFSAB._.DesiredTorqueIn.m_EngDesCor2Lev2 ZFFSAB._.DesiredTorqueIn.m_EngDesCor3 ZFFSAB._.DesiredTorqueIn.m_EngDesCor3Lev2 ZFFSAB._.DesiredTorqueIn.m_EngDesCor3Lev2_ ZFFSAB._.DesiredTorqueIn.m_EngDesEMCor1 ZFFSAB._.DesiredTorqueIn.m_EngDesEMCor2 ZFFSAB._.DesiredTorqueIn.m_EngDesVMCor1 ZFFSAB._.DesiredTorqueIn.m_EngDesVMCor2 ZFFSAB._.DesiredTorqueIn.sv_AGS_MKwFW ZFFSAB._.DesiredTorqueIn.sv_m_DriverDesMod ZFFSAB._.DesiredTorqueIn.sv_m_EngDes ZFFSAB._.DesiredTorqueIn.sv_m_EngDesEM ZFFSAB._.DesiredTorqueIn.sv_m_EngDesEMSts ZFFSAB._.DesiredTorqueIn.sv_m_EngDesLev2 ZFFSAB._.DesiredTorqueIn.sv_m_EngDesLev2Sts ZFFSAB._.DesiredTorqueIn.sv_m_EngDesLev2Sts_ ZFFSAB._.DesiredTorqueIn.sv_m_EngDesLev2_ ZFFSAB._.DesiredTorqueIn.sv_m_EngDesSts ZFFSAB._.DesiredTorqueIn.sv_m_EngDesVM ZFFSAB._.DesiredTorqueIn.sv_m_EngDesVMSts ZFFSAB._.DesiredTorqueIn.sv_m_MaxIncrVM ZFFSAB._.DesiredTorqueIn.sv_m_MaxIncrVMSts /end LOC_MEASUREMENT
/end FUNCTION
/begin FUNCTION zf_SAB_FuelCutoffActiveIn "desc_en"
 /begin LOC_MEASUREMENT ZFFSAB._.FuelCutoffActiveIn.iv_FuelCutoffActive ZFFSAB._.FuelCutoffActiveIn.iv_FuelCutoffActiveSts ZFFSAB._.FuelCutoffActiveIn.sv_AGS_StatINFS ZFFSAB._.FuelCutoffActiveIn.sv_FuelCutoffActiveSts ZFFSAB._.FuelCutoffActiveIn.sv_f_FuelCutoffActive /end LOC_MEASUREMENT
/end FUNCTION
/begin FUNCTION zf_SAB_EngineIdleSpeedReqIn "desc_en"
 /begin LOC_MEASUREMENT ZFFSAB._.EngineIdleSpeedReqIn.f_n_EngIdleErr ZFFSAB._.EngineIdleSpeedReqIn.iv_n_EngIdle ZFFSAB._.EngineIdleSpeedReqIn.iv_n_EngIdleExt ZFFSAB._.EngineIdleSpeedReqIn.iv_n_EngIdleExtSts ZFFSAB._.EngineIdleSpeedReqIn.iv_n_EngIdleSts ZFFSAB._.EngineIdleSpeedReqIn.sv_n_EngIdle ZFFSAB._.EngineIdleSpeedReqIn.sv_n_EngIdleSts /end LOC_MEASUREMENT
/end FUNCTION
/begin FUNCTION zf_SAB_BaroPressureIn "desc_en"
 /begin LOC_MEASUREMENT ZFFSAB._.BaroPressureIn.f_p_AirErr ZFFSAB._.BaroPressureIn.iv_p_Air ZFFSAB._.BaroPressureIn.iv_p_AirSts ZFFSAB._.BaroPressureIn.sv_p_Air ZFFSAB._.BaroPressureIn.sv_p_AirSts /end LOC_MEASUREMENT
/end FUNCTION
/begin FUNCTION zf_SAB_HybridSignalsIn "desc_en"
 /begin LOC_MEASUREMENT ZFFSAB._.HybridSignalsIn.f_AepReq ZFFSAB._.HybridSignalsIn.f_EgsReaktNRedErr ZFFSAB._.HybridSignalsIn.f_m_EngStartErr ZFFSAB._.HybridSignalsIn.f_n_SollEMErr ZFFSAB._.HybridSignalsIn.iv_AepReq ZFFSAB._.HybridSignalsIn.iv_AepReqSts ZFFSAB._.HybridSignalsIn.iv_CrankshaftStopPosition ZFFSAB._.HybridSignalsIn.iv_CrankshaftStopPositionSts ZFFSAB._.HybridSignalsIn.iv_EgsReaktNRed ZFFSAB._.HybridSignalsIn.iv_EgsReaktNRedSts ZFFSAB._.HybridSignalsIn.iv_STAT_Drv ZFFSAB._.HybridSignalsIn.iv_STAT_DrvSts ZFFSAB._.HybridSignalsIn.iv_Vor_Kurz_m_crsh_Max ZFFSAB._.HybridSignalsIn.iv_Vor_Kurz_m_crsh_MaxSts ZFFSAB._.HybridSignalsIn.iv_Vor_Kurz_m_crsh_Min ZFFSAB._.HybridSignalsIn.iv_Vor_Kurz_m_crsh_MinSts ZFFSAB._.HybridSignalsIn.iv_Vor_m_Ant_Sum_Rekup_Max ZFFSAB._.HybridSignalsIn.iv_Vor_m_Ant_Sum_Rekup_MaxSts ZFFSAB._.HybridSignalsIn.iv_m_AntSumRekupGearb ZFFSAB._.HybridSignalsIn.iv_m_AntSumRekupGearbSts ZFFSAB._.HybridSignalsIn.iv_m_AntSumRekupMax ZFFSAB._.HybridSignalsIn.iv_m_AntSumRekupMaxSts ZFFSAB._.HybridSignalsIn.iv_m_AntSumSchleppUnten ZFFSAB._.HybridSignalsIn.iv_m_AntSumSchleppUntenSts ZFFSAB._.HybridSignalsIn.iv_m_EngStart ZFFSAB._.HybridSignalsIn.iv_m_EngStartSts ZFFSAB._.HybridSignalsIn.iv_n_SollEM ZFFSAB._.HybridSignalsIn.iv_n_SollEMSts ZFFSAB._.HybridSignalsIn.sv_AGS_AepReq ZFFSAB._.HybridSignalsIn.sv_AGS_EgsReaktNRed ZFFSAB._.HybridSignalsIn.sv_AGS_StatusAntriebFzg ZFFSAB._.HybridSignalsIn.sv_AepReqSts ZFFSAB._.HybridSignalsIn.sv_CrankshaftStopPosition ZFFSAB._.HybridSignalsIn.sv_CrankshaftStopPositionSts ZFFSAB._.HybridSignalsIn.sv_EgsReaktNRedSts ZFFSAB._.HybridSignalsIn.sv_Vor_Kurz_m_crsh_Max ZFFSAB._.HybridSignalsIn.sv_Vor_Kurz_m_crsh_Min ZFFSAB._.HybridSignalsIn.sv_Vor_m_Ant_Sum_Rekup_Max ZFFSAB._.HybridSignalsIn.sv_m_AntSumRekupGearb ZFFSAB._.HybridSignalsIn.sv_m_AntSumRekupMax ZFFSAB._.HybridSignalsIn.sv_m_AntSumSchleppUnten ZFFSAB._.HybridSignalsIn.sv_m_EngStart ZFFSAB._.HybridSignalsIn.sv_m_EngStartSts ZFFSAB._.HybridSignalsIn.sv_n_SollEM ZFFSAB._.HybridSignalsIn.sv_n_SollEMSts /end LOC_MEASUREMENT
/end FUNCTION
/begin FUNCTION zf_SAB_ExtBrakeInterventionIn "desc_en"
 /begin LOC_MEASUREMENT ZFFSAB._.ExtBrakeInterventionIn.BrakeTorq ZFFSAB._.ExtBrakeInterventionIn.BrakeTorqDvch ZFFSAB._.ExtBrakeInterventionIn.BrakeTorqDvchSts ZFFSAB._.ExtBrakeInterventionIn.BrakeTorqSts ZFFSAB._.ExtBrakeInterventionIn.StBrake ZFFSAB._.ExtBrakeInterventionIn.StBrakeSts ZFFSAB._.ExtBrakeInterventionIn.f_BrakeTorq ZFFSAB._.ExtBrakeInterventionIn.f_BrakeTorqDvch ZFFSAB._.ExtBrakeInterventionIn.f_StBrake ZFFSAB._.ExtBrakeInterventionIn.iv_BrakeTorq ZFFSAB._.ExtBrakeInterventionIn.iv_BrakeTorqDvch ZFFSAB._.ExtBrakeInterventionIn.iv_BrakeTorqDvchSts ZFFSAB._.ExtBrakeInterventionIn.iv_BrakeTorqSts ZFFSAB._.ExtBrakeInterventionIn.iv_StBrake ZFFSAB._.ExtBrakeInterventionIn.iv_StBrakeSts ZFFSAB._.ExtBrakeInterventionIn.iv_StBrakeTorq ZFFSAB._.ExtBrakeInterventionIn.sv_ExtBrakeInterventionSts ZFFSAB._.ExtBrakeInterventionIn.sv_f_ExtBrakeIntervention /end LOC_MEASUREMENT
/end FUNCTION
/begin FUNCTION zf_SAB_BrakeTorqueIn "desc_en"
 /begin LOC_MEASUREMENT ZFFSAB._.BrakeTorqueIn.f_m_BrakeErr ZFFSAB._.BrakeTorqueIn.f_p_BrakeErr ZFFSAB._.BrakeTorqueIn.iv_m_Brake ZFFSAB._.BrakeTorqueIn.iv_m_BrakeQF ZFFSAB._.BrakeTorqueIn.iv_m_BrakeQF_ ZFFSAB._.BrakeTorqueIn.iv_m_BrakeSts ZFFSAB._.BrakeTorqueIn.iv_m_BrakeSts_ ZFFSAB._.BrakeTorqueIn.iv_m_Brake_ ZFFSAB._.BrakeTorqueIn.sv_m_Brake ZFFSAB._.BrakeTorqueIn.sv_m_BrakeSts ZFFSAB._.BrakeTorqueIn.sv_p_Brake ZFFSAB._.BrakeTorqueIn.sv_p_BrakeSts ZFFSAB._.BrakeTorqueIn.sv_p_BrakeSts_ ZFFSAB._.BrakeTorqueIn.sv_p_Brake_ /end LOC_MEASUREMENT
/end FUNCTION
/begin FUNCTION zf_SAB_AccelerationAcrossIn "desc_en"
 /begin LOC_MEASUREMENT ZFFSAB._.AccelerationAcrossIn.f_AyRefErr ZFFSAB._.AccelerationAcrossIn.iv_AyRef ZFFSAB._.AccelerationAcrossIn.iv_AyRefErr ZFFSAB._.AccelerationAcrossIn.iv_AyRefSts ZFFSAB._.AccelerationAcrossIn.sv_AyRef ZFFSAB._.AccelerationAcrossIn.sv_AyRefSts /end LOC_MEASUREMENT
/end FUNCTION
/begin FUNCTION zf_SAB_AfuReqIn "desc_en"
 /begin LOC_MEASUREMENT ZFFSAB._.AfuReqIn.f_AfuReqErr ZFFSAB._.AfuReqIn.iv_AfuReq ZFFSAB._.AfuReqIn.iv_AfuReqSts ZFFSAB._.AfuReqIn.sv_AfuReq ZFFSAB._.AfuReqIn.sv_AfuReqSts /end LOC_MEASUREMENT
/end FUNCTION
/begin FUNCTION zf_SAB_RearAxleRatioIn "desc_en"
 /begin LOC_MEASUREMENT ZFFSAB._.RearAxleRatioIn.f_IgnitionOff2On ZFFSAB._.RearAxleRatioIn.iv_Pos ZFFSAB._.RearAxleRatioIn.iv_Pos_ ZFFSAB._.RearAxleRatioIn.sv_RearAxleRatio_Value ZFFSAB._.RearAxleRatioIn.sv_RearAxleRatio_ValueLearnedFlag ZFFSAB._.RearAxleRatioIn.sv_RearAxleRatio_ValueLearnedFlag_ ZFFSAB._.RearAxleRatioIn.sv_RearAxleRatio_ValueNumact /end LOC_MEASUREMENT
/end FUNCTION
/begin FUNCTION zf_SAB_DynRunRadiusIn "desc_en" /begin LOC_MEASUREMENT ZFFSAB._.DynRunRadiusIn.sv_rd_Dyn /end LOC_MEASUREMENT /end FUNCTION
/begin FUNCTION zf_SAB_WarmUpIn "desc_en"
 /begin LOC_MEASUREMENT ZFFSAB._.WarmUpIn.f_WarmUpSwitchErr ZFFSAB._.WarmUpIn.iv_WarmUpSwitch ZFFSAB._.WarmUpIn.iv_WarmUpSwitchSts ZFFSAB._.WarmUpIn.sv_WarmUpSwitch ZFFSAB._.WarmUpIn.sv_WarmUpSwitchSts /end LOC_MEASUREMENT
/end FUNCTION
/begin FUNCTION zf_SAB_VehicleSpeedIn "desc_en"
 /begin LOC_MEASUREMENT ZFFSAB._.VehicleSpeedIn.VehicleSpeedInFL.iv_u_SensESts ZFFSAB._.VehicleSpeedIn.VehicleSpeedInFL.n_WheelAvg ZFFSAB._.VehicleSpeedIn.VehicleSpeedInFL.n_WheelAvgSts ZFFSAB._.VehicleSpeedIn.VehicleSpeedInFL.sv_v_FzgByNabFilt ZFFSAB._.VehicleSpeedIn.VehicleSpeedInFL.sv_v_FzgByNabSts ZFFSAB._.VehicleSpeedIn.VehicleSpeedInFL.sv_v_Ist ZFFSAB._.VehicleSpeedIn.VehicleSpeedInFL.sv_v_IstMax ZFFSAB._.VehicleSpeedIn.VehicleSpeedInFL.sv_v_IstMaxSts ZFFSAB._.VehicleSpeedIn.VehicleSpeedInFL.sv_v_IstSts ZFFSAB._.VehicleSpeedIn.VehicleSpeedInFL.v_Fzg ZFFSAB._.VehicleSpeedIn.VehicleSpeedInFL.v_FzgByNab ZFFSAB._.VehicleSpeedIn.VehicleSpeedInFL.v_FzgSts ZFFSAB._.VehicleSpeedIn.VehicleSpeedInFL.v_IstByNWheel ZFFSAB._.VehicleSpeedIn.f_v_FzgErr ZFFSAB._.VehicleSpeedIn.f_v_FzgRefErr ZFFSAB._.VehicleSpeedIn.iv_u_SensESts ZFFSAB._.VehicleSpeedIn.iv_v_Fzg ZFFSAB._.VehicleSpeedIn.iv_v_FzgErr ZFFSAB._.VehicleSpeedIn.iv_v_FzgErrSts ZFFSAB._.VehicleSpeedIn.iv_v_FzgSts ZFFSAB._.VehicleSpeedIn.n_WheelAvg ZFFSAB._.VehicleSpeedIn.n_WheelAvgSts ZFFSAB._.VehicleSpeedIn.sv_AGS_VVehCog ZFFSAB._.VehicleSpeedIn.sv_AGS_VVehCogStat ZFFSAB._.VehicleSpeedIn.sv_v_FzgByNabFilt ZFFSAB._.VehicleSpeedIn.sv_v_FzgByNabFilt_ ZFFSAB._.VehicleSpeedIn.sv_v_FzgByNabSts ZFFSAB._.VehicleSpeedIn.sv_v_FzgByNabSts_ ZFFSAB._.VehicleSpeedIn.sv_v_FzgRef ZFFSAB._.VehicleSpeedIn.sv_v_FzgRefSts ZFFSAB._.VehicleSpeedIn.sv_v_Ist ZFFSAB._.VehicleSpeedIn.sv_v_IstMax ZFFSAB._.VehicleSpeedIn.sv_v_IstMaxSts ZFFSAB._.VehicleSpeedIn.sv_v_IstMaxSts_ ZFFSAB._.VehicleSpeedIn.sv_v_IstMax_ ZFFSAB._.VehicleSpeedIn.sv_v_IstSts ZFFSAB._.VehicleSpeedIn.sv_v_IstSts_ ZFFSAB._.VehicleSpeedIn.sv_v_Ist_ ZFFSAB._.VehicleSpeedIn.v_Fzg ZFFSAB._.VehicleSpeedIn.v_FzgByNab ZFFSAB._.VehicleSpeedIn.v_FzgByNab_ ZFFSAB._.VehicleSpeedIn.v_FzgSts ZFFSAB._.VehicleSpeedIn.v_FzgSts_ ZFFSAB._.VehicleSpeedIn.v_Fzg_ ZFFSAB._.VehicleSpeedIn.v_IstByNWheel /end LOC_MEASUREMENT
/end FUNCTION
/begin FUNCTION zf_SAB_MaxTorquePredictionEMIn "desc_en"
 /begin LOC_MEASUREMENT ZFFSAB._.MaxTorquePredictionEMIn.f_m_maxPredEMErr ZFFSAB._.MaxTorquePredictionEMIn.f_m_minPredEMErr ZFFSAB._.MaxTorquePredictionEMIn.iv_m_MaxPredEM ZFFSAB._.MaxTorquePredictionEMIn.iv_m_MaxPredEMSts ZFFSAB._.MaxTorquePredictionEMIn.iv_m_MinPredEM ZFFSAB._.MaxTorquePredictionEMIn.iv_m_MinPredEMSts ZFFSAB._.MaxTorquePredictionEMIn.sv_m_MaxPredEM ZFFSAB._.MaxTorquePredictionEMIn.sv_m_MaxPredEMSts ZFFSAB._.MaxTorquePredictionEMIn.sv_m_MinPredEM ZFFSAB._.MaxTorquePredictionEMIn.sv_m_MinPredEMSts /end LOC_MEASUREMENT
/end FUNCTION
/begin FUNCTION zf_SAB_SteeringWheelAngleIn "desc_en"
 /begin LOC_MEASUREMENT ZFFSAB._.SteeringWheelAngleIn.f_SteerAngleErr ZFFSAB._.SteeringWheelAngleIn.iv_SteerAngle ZFFSAB._.SteeringWheelAngleIn.iv_SteerAngleErr ZFFSAB._.SteeringWheelAngleIn.iv_SteerAngleSts ZFFSAB._.SteeringWheelAngleIn.sv_AGS_LwVaEff ZFFSAB._.SteeringWheelAngleIn.sv_AGS_LwVaStat /end LOC_MEASUREMENT
/end FUNCTION
/begin FUNCTION zf_SAB_SubstTempIn "desc_en"
 /begin LOC_MEASUREMENT ZFFSAB._.SubstTempIn.PAK_counter_end ZFFSAB._.SubstTempIn.PAK_counter_end_ ZFFSAB._.SubstTempIn.PAK_counter_start ZFFSAB._.SubstTempIn.PAK_counter_start_ ZFFSAB._.SubstTempIn.iv_c_Chip1TransESts ZFFSAB._.SubstTempIn.iv_c_Chip2TransESts ZFFSAB._.SubstTempIn.iv_hot_modeLevel ZFFSAB._.SubstTempIn.iv_n_Eng ZFFSAB._.SubstTempIn.iv_n_EngSts /end LOC_MEASUREMENT
/end FUNCTION
/begin FUNCTION zf_SAB_TransmissionOutputSpeedIn "desc_en"
 /begin LOC_MEASUREMENT ZFFSAB._.TransmissionOutputSpeedIn.Ab_f_DirectionErr ZFFSAB._.TransmissionOutputSpeedIn.TransmissionOutputSpeedIn_Fl.f_n_AbPlausiErr ZFFSAB._.TransmissionOutputSpeedIn.TransmissionOutputSpeedIn_Fl.f_n_AbWheelErr ZFFSAB._.TransmissionOutputSpeedIn.TransmissionOutputSpeedIn_Fl.f_n_WheelPlausiErr ZFFSAB._.TransmissionOutputSpeedIn.TransmissionOutputSpeedIn_Fl.iGang ZFFSAB._.TransmissionOutputSpeedIn.TransmissionOutputSpeedIn_Fl.iv_n_Ab ZFFSAB._.TransmissionOutputSpeedIn.TransmissionOutputSpeedIn_Fl.iv_n_AbESts ZFFSAB._.TransmissionOutputSpeedIn.TransmissionOutputSpeedIn_Fl.iv_n_AbESts_ ZFFSAB._.TransmissionOutputSpeedIn.TransmissionOutputSpeedIn_Fl.iv_n_Ab_ ZFFSAB._.TransmissionOutputSpeedIn.TransmissionOutputSpeedIn_Fl.iv_u_SensESts ZFFSAB._.TransmissionOutputSpeedIn.TransmissionOutputSpeedIn_Fl.iv_u_SensESts_ ZFFSAB._.TransmissionOutputSpeedIn.TransmissionOutputSpeedIn_Fl.loc_RearAxleRatio ZFFSAB._.TransmissionOutputSpeedIn.TransmissionOutputSpeedIn_Fl.n_AbByNWheel ZFFSAB._.TransmissionOutputSpeedIn.TransmissionOutputSpeedIn_Fl.n_WheelAvg ZFFSAB._.TransmissionOutputSpeedIn.TransmissionOutputSpeedIn_Fl.n_WheelAvgSts ZFFSAB._.TransmissionOutputSpeedIn.TransmissionOutputSpeedIn_Fl.sv_n_Ab ZFFSAB._.TransmissionOutputSpeedIn.TransmissionOutputSpeedIn_Fl.sv_n_AbMax ZFFSAB._.TransmissionOutputSpeedIn.TransmissionOutputSpeedIn_Fl.sv_n_AbMaxSts ZFFSAB._.TransmissionOutputSpeedIn.TransmissionOutputSpeedIn_Fl.sv_n_AbSts ZFFSAB._.TransmissionOutputSpeedIn.f_n_AbPlausiErr ZFFSAB._.TransmissionOutputSpeedIn.f_n_AbPlausiErr_ ZFFSAB._.TransmissionOutputSpeedIn.f_n_AbWheelErr ZFFSAB._.TransmissionOutputSpeedIn.f_n_WheelPlausiErr ZFFSAB._.TransmissionOutputSpeedIn.iGang ZFFSAB._.TransmissionOutputSpeedIn.iv_n_Ab ZFFSAB._.TransmissionOutputSpeedIn.iv_n_AbESts ZFFSAB._.TransmissionOutputSpeedIn.iv_n_AbESts_ ZFFSAB._.TransmissionOutputSpeedIn.iv_n_Ab_ ZFFSAB._.TransmissionOutputSpeedIn.iv_u_SensESts ZFFSAB._.TransmissionOutputSpeedIn.iv_u_SensESts_ ZFFSAB._.TransmissionOutputSpeedIn.loc_RearAxleRatio ZFFSAB._.TransmissionOutputSpeedIn.n_AbByNWheel ZFFSAB._.TransmissionOutputSpeedIn.n_AbFilt_CAN ZFFSAB._.TransmissionOutputSpeedIn.n_AbFilt_CAN_ ZFFSAB._.TransmissionOutputSpeedIn.n_WheelAvg ZFFSAB._.TransmissionOutputSpeedIn.n_WheelAvgSts ZFFSAB._.TransmissionOutputSpeedIn.sv_n_Ab ZFFSAB._.TransmissionOutputSpeedIn.sv_n_AbFilt ZFFSAB._.TransmissionOutputSpeedIn.sv_n_AbMax ZFFSAB._.TransmissionOutputSpeedIn.sv_n_AbMaxSts ZFFSAB._.TransmissionOutputSpeedIn.sv_n_AbMaxSts_ ZFFSAB._.TransmissionOutputSpeedIn.sv_n_AbMax_ ZFFSAB._.TransmissionOutputSpeedIn.sv_n_AbSts ZFFSAB._.TransmissionOutputSpeedIn.sv_n_AbSts_ ZFFSAB._.TransmissionOutputSpeedIn.sv_n_Ab_ ZFFSAB._.TransmissionOutputSpeedIn.sv_n_Ab_Tx ZFFSAB._.TransmissionOutputSpeedIn.sv_n_Ab_Tx_ /end LOC_MEASUREMENT
/end FUNCTION
/begin FUNCTION zf_SAB_WheelIn "desc_en"
 /begin LOC_MEASUREMENT ZFFSAB._.WheelIn.DriveDirWheel ZFFSAB._.WheelIn.DriveDirWheelSts ZFFSAB._.WheelIn.FL.f_n_WheelErr ZFFSAB._.WheelIn.FL.f_v_WheelErr ZFFSAB._.WheelIn.FL.iv_v_Wheel ZFFSAB._.WheelIn.FL.iv_v_WheelSts ZFFSAB._.WheelIn.FL.n_Wheel ZFFSAB._.WheelIn.FL.n_WheelSts ZFFSAB._.WheelIn.FL.sv_v_Wheel ZFFSAB._.WheelIn.FL.sv_v_WheelSts ZFFSAB._.WheelIn.FL.v_WheelBalanced ZFFSAB._.WheelIn.FR.f_n_WheelErr ZFFSAB._.WheelIn.FR.f_v_WheelErr ZFFSAB._.WheelIn.FR.iv_v_Wheel ZFFSAB._.WheelIn.FR.iv_v_WheelSts ZFFSAB._.WheelIn.FR.n_Wheel ZFFSAB._.WheelIn.FR.n_WheelSts ZFFSAB._.WheelIn.FR.sv_v_Wheel ZFFSAB._.WheelIn.FR.sv_v_WheelSts ZFFSAB._.WheelIn.FR.v_WheelBalanced ZFFSAB._.WheelIn.RL.f_n_WheelErr ZFFSAB._.WheelIn.RL.f_v_WheelErr ZFFSAB._.WheelIn.RL.iv_v_Wheel ZFFSAB._.WheelIn.RL.iv_v_WheelSts ZFFSAB._.WheelIn.RL.n_Wheel ZFFSAB._.WheelIn.RL.n_WheelSts ZFFSAB._.WheelIn.RL.sv_v_Wheel ZFFSAB._.WheelIn.RL.sv_v_WheelSts ZFFSAB._.WheelIn.RL.v_WheelBalanced ZFFSAB._.WheelIn.RR.f_n_WheelErr ZFFSAB._.WheelIn.RR.f_v_WheelErr ZFFSAB._.WheelIn.RR.iv_v_Wheel ZFFSAB._.WheelIn.RR.iv_v_WheelSts ZFFSAB._.WheelIn.RR.n_Wheel ZFFSAB._.WheelIn.RR.n_WheelSts ZFFSAB._.WheelIn.RR.sv_v_Wheel ZFFSAB._.WheelIn.RR.sv_v_WheelSts ZFFSAB._.WheelIn.RR.v_WheelBalanced ZFFSAB._.WheelIn.cod_SWI_WheelActivePassive ZFFSAB._.WheelIn.f_n_WheelAvgErr ZFFSAB._.WheelIn.lfz_Wheel ZFFSAB._.WheelIn.lfz_WheelSts ZFFSAB._.WheelIn.n_AbFilt1 ZFFSAB._.WheelIn.n_Ab_ByWheelActL ZFFSAB._.WheelIn.n_Ab_ByWheelActR ZFFSAB._.WheelIn.n_Ab_ByWheelActiveAvg ZFFSAB._.WheelIn.n_Ab_ByWheelPassiveAvg ZFFSAB._.WheelIn.n_WheelAvg ZFFSAB._.WheelIn.n_WheelAvgSts ZFFSAB._.WheelIn.sv_AGS_FourWheelDrive ZFFSAB._.WheelIn.sv_n_Ab_ByWheelActiveAvgFilt ZFFSAB._.WheelIn.sv_n_Ab_ByWheelActiveBalancedAvg ZFFSAB._.WheelIn.sv_v_WheelActiveAvg ZFFSAB._.WheelIn.sv_v_WheelActiveAvgSts ZFFSAB._.WheelIn.v_WheelActiveBalancedAvg ZFFSAB._.WheelIn.v_WheelAvg ZFFSAB._.WheelIn.v_WheelAvgSts ZFFSAB._.WheelIn.v_WheelDiagSts ZFFSAB._.WheelIn.v_WheelFSts ZFFSAB._.WheelIn.v_WheelPassiveAvg ZFFSAB._.WheelIn.v_WheelPassiveAvgSts ZFFSAB._.WheelIn.v_WheelRSts /end LOC_MEASUREMENT
/end FUNCTION
/begin FUNCTION zf_SAB_RollPreventIn "desc_en"
 /begin LOC_MEASUREMENT ZFFSAB._.RollPreventIn.FzgRollPreventActiveFilt ZFFSAB._.RollPreventIn.f_FzgRollPreventActiveErr ZFFSAB._.RollPreventIn.f_HillHolderOrAutoHoldactive ZFFSAB._.RollPreventIn.iv_Brake ZFFSAB._.RollPreventIn.iv_BrakeSts ZFFSAB._.RollPreventIn.iv_FzgRollPreventActive ZFFSAB._.RollPreventIn.iv_FzgRollPreventActive2 ZFFSAB._.RollPreventIn.iv_FzgRollPreventActive2Sts ZFFSAB._.RollPreventIn.iv_FzgRollPreventActiveSts ZFFSAB._.RollPreventIn.sv_FzgRollPreventActive ZFFSAB._.RollPreventIn.sv_FzgRollPreventActiveSts /end LOC_MEASUREMENT
/end FUNCTION
/begin FUNCTION zf_SAB_ParkingBrakeIn "desc_en"
 /begin LOC_MEASUREMENT ZFFSAB._.ParkingBrakeIn.iv_ParkingBrake ZFFSAB._.ParkingBrakeIn.iv_ParkingBrake1 ZFFSAB._.ParkingBrakeIn.iv_ParkingBrake1Sts ZFFSAB._.ParkingBrakeIn.iv_ParkingBrake2 ZFFSAB._.ParkingBrakeIn.iv_ParkingBrake2Sts ZFFSAB._.ParkingBrakeIn.iv_ParkingBrakeSts ZFFSAB._.ParkingBrakeIn.sv_ParkingBrakeSts ZFFSAB._.ParkingBrakeIn.sv_f_ParkingBrake /end LOC_MEASUREMENT
/end FUNCTION
/begin FUNCTION zf_SAB_ParkManeuverAssistant "desc_en"
 /begin LOC_MEASUREMENT ZFFSAB._.ParkManeuverAssistant.FASModeRaw ZFFSAB._.ParkManeuverAssistant.FASModeRaw_ ZFFSAB._.ParkManeuverAssistant.f_FASBrakeErr ZFFSAB._.ParkManeuverAssistant.f_FASPosErr ZFFSAB._.ParkManeuverAssistant.f_PMAModeLearned ZFFSAB._.ParkManeuverAssistant.f_PMAModeLearned_ ZFFSAB._.ParkManeuverAssistant.iv_Brake ZFFSAB._.ParkManeuverAssistant.iv_BrakeSts ZFFSAB._.ParkManeuverAssistant.iv_BrakeSts_ ZFFSAB._.ParkManeuverAssistant.iv_Brake_ ZFFSAB._.ParkManeuverAssistant.iv_FASGearbox ZFFSAB._.ParkManeuverAssistant.iv_FASGearbox_ ZFFSAB._.ParkManeuverAssistant.iv_FASMode ZFFSAB._.ParkManeuverAssistant.iv_FASModeSts ZFFSAB._.ParkManeuverAssistant.iv_FASModeSts_ ZFFSAB._.ParkManeuverAssistant.iv_FASMode_ ZFFSAB._.ParkManeuverAssistant.iv_FASPos ZFFSAB._.ParkManeuverAssistant.iv_FASPosSts ZFFSAB._.ParkManeuverAssistant.iv_FASPosSts_ ZFFSAB._.ParkManeuverAssistant.iv_FASPos_ ZFFSAB._.ParkManeuverAssistant.sv_FASBrake ZFFSAB._.ParkManeuverAssistant.sv_FASBrakeSts ZFFSAB._.ParkManeuverAssistant.sv_FASBrakeSts_ ZFFSAB._.ParkManeuverAssistant.sv_FASBrake_ ZFFSAB._.ParkManeuverAssistant.sv_FASGearbox ZFFSAB._.ParkManeuverAssistant.sv_FASGearbox_ ZFFSAB._.ParkManeuverAssistant.sv_FASMode ZFFSAB._.ParkManeuverAssistant.sv_FASModeSts ZFFSAB._.ParkManeuverAssistant.sv_FASModeSts_ ZFFSAB._.ParkManeuverAssistant.sv_FASMode_ ZFFSAB._.ParkManeuverAssistant.sv_FASPos ZFFSAB._.ParkManeuverAssistant.sv_FASPosSts ZFFSAB._.ParkManeuverAssistant.sv_FASPosSts_ ZFFSAB._.ParkManeuverAssistant.sv_FASPos_ /end LOC_MEASUREMENT
/end FUNCTION
/begin FUNCTION zf_SAB_RegPartFilterIn "desc_en"
 /begin LOC_MEASUREMENT ZFFSAB._.RegPartFilterIn.f_PartfiltAktivErr ZFFSAB._.RegPartFilterIn.iv_PartfiltAktiv ZFFSAB._.RegPartFilterIn.iv_PartfiltAktivSts ZFFSAB._.RegPartFilterIn.sv_PartfiltAktiv ZFFSAB._.RegPartFilterIn.sv_PartfiltAktivSts /end LOC_MEASUREMENT
/end FUNCTION
/begin FUNCTION zf_SAB_DrivingDirectionIn "desc_en"
 /begin LOC_MEASUREMENT ZFFSAB._.DrivingDirectionIn.DriveDirWheel ZFFSAB._.DrivingDirectionIn.DriveDirWheelSts ZFFSAB._.DrivingDirectionIn.DrivingDirectionRaw ZFFSAB._.DrivingDirectionIn.DrivingDirectionRawSts ZFFSAB._.DrivingDirectionIn.sv_DriveDirectionAGS ZFFSAB._.DrivingDirectionIn.sv_DrivingDirection ZFFSAB._.DrivingDirectionIn.sv_DrivingDirectionSts /end LOC_MEASUREMENT
/end FUNCTION
/begin FUNCTION zf_SAB_TempDiagnosis_Fl "desc_en"
 /begin LOC_MEASUREMENT ZFFSAB._.TempDiagnosis_AT.TempDiagnosis_AT_Fl.c_OilTransCor ZFFSAB._.TempDiagnosis_AT.TempDiagnosis_AT_Fl.c_OilTransCorInt ZFFSAB._.TempDiagnosis_AT.TempDiagnosis_AT_Fl.c_OilTrans_old ZFFSAB._.TempDiagnosis_AT.TempDiagnosis_AT_Fl.c_OilTrans_old_ ZFFSAB._.TempDiagnosis_AT.TempDiagnosis_AT_Fl.f_CChipdelta ZFFSAB._.TempDiagnosis_AT.TempDiagnosis_AT_Fl.f_CChipdelta_old ZFFSAB._.TempDiagnosis_AT.TempDiagnosis_AT_Fl.f_CChipdelta_old_ ZFFSAB._.TempDiagnosis_AT.TempDiagnosis_AT_Fl.f_CGT_Tolerance ZFFSAB._.TempDiagnosis_AT.TempDiagnosis_AT_Fl.f_c_CGT_JumpErr ZFFSAB._.TempDiagnosis_AT.TempDiagnosis_AT_Fl.f_c_CGT_JumpErr_old ZFFSAB._.TempDiagnosis_AT.TempDiagnosis_AT_Fl.f_c_CGT_JumpErr_old_ ZFFSAB._.TempDiagnosis_AT.TempDiagnosis_AT_Fl.f_c_CgtPlausiErr ZFFSAB._.TempDiagnosis_AT.TempDiagnosis_AT_Fl.f_c_Chip1CGT ZFFSAB._.TempDiagnosis_AT.TempDiagnosis_AT_Fl.f_c_Chip1Chip2 ZFFSAB._.TempDiagnosis_AT.TempDiagnosis_AT_Fl.f_c_Chip1PlausiErr ZFFSAB._.TempDiagnosis_AT.TempDiagnosis_AT_Fl.f_c_Chip2CGT ZFFSAB._.TempDiagnosis_AT.TempDiagnosis_AT_Fl.f_c_Chip2PlausiErr ZFFSAB._.TempDiagnosis_AT.TempDiagnosis_AT_Fl.f_c_PlausiErr ZFFSAB._.TempDiagnosis_AT.TempDiagnosis_AT_Fl.iv_c_Chip1Trans ZFFSAB._.TempDiagnosis_AT.TempDiagnosis_AT_Fl.iv_c_Chip1TransESts ZFFSAB._.TempDiagnosis_AT.TempDiagnosis_AT_Fl.iv_c_Chip2Trans ZFFSAB._.TempDiagnosis_AT.TempDiagnosis_AT_Fl.iv_c_Chip2TransESts ZFFSAB._.TempDiagnosis_AT.TempDiagnosis_AT_Fl.iv_c_Chip2Trans_old ZFFSAB._.TempDiagnosis_AT.TempDiagnosis_AT_Fl.iv_c_Chip2Trans_old_ ZFFSAB._.TempDiagnosis_AT.TempDiagnosis_AT_Fl.iv_c_OilTrans ZFFSAB._.TempDiagnosis_AT.TempDiagnosis_AT_Fl.iv_c_OilTransESts ZFFSAB._.TempDiagnosis_AT.TempDiagnosis_AT_Fl.iv_c_OilTransESts_old ZFFSAB._.TempDiagnosis_AT.TempDiagnosis_AT_Fl.iv_c_OilTransESts_old_ /end LOC_MEASUREMENT
/end FUNCTION
/begin FUNCTION zf_SAB_TempDiagnosis "desc_en"
 /begin LOC_MEASUREMENT ZFFSAB._.TempDiagnosis_AT.PAK_counter_end ZFFSAB._.TempDiagnosis_AT.PAK_counter_end_ ZFFSAB._.TempDiagnosis_AT.PAK_counter_start ZFFSAB._.TempDiagnosis_AT.PAK_counter_start_ ZFFSAB._.TempDiagnosis_AT.c_OilTransCor ZFFSAB._.TempDiagnosis_AT.c_OilTransCorInt ZFFSAB._.TempDiagnosis_AT.c_OilTransCor_ ZFFSAB._.TempDiagnosis_AT.c_OilTrans_old ZFFSAB._.TempDiagnosis_AT.c_OilTrans_old_ ZFFSAB._.TempDiagnosis_AT.f_CChipdelta ZFFSAB._.TempDiagnosis_AT.f_CChipdelta_old ZFFSAB._.TempDiagnosis_AT.f_CChipdelta_old_ ZFFSAB._.TempDiagnosis_AT.f_CGT_Tolerance ZFFSAB._.TempDiagnosis_AT.f_c_CGT_JumpErr ZFFSAB._.TempDiagnosis_AT.f_c_CGT_JumpErr_old ZFFSAB._.TempDiagnosis_AT.f_c_CGT_JumpErr_old_ ZFFSAB._.TempDiagnosis_AT.f_c_CgtPlausiErr ZFFSAB._.TempDiagnosis_AT.f_c_CgtPlausiErr_ ZFFSAB._.TempDiagnosis_AT.f_c_Chip1CGT ZFFSAB._.TempDiagnosis_AT.f_c_Chip1Chip2 ZFFSAB._.TempDiagnosis_AT.f_c_Chip1PlausiErr ZFFSAB._.TempDiagnosis_AT.f_c_Chip2CGT ZFFSAB._.TempDiagnosis_AT.f_c_Chip2PlausiErr ZFFSAB._.TempDiagnosis_AT.f_c_Chip2PlausiErr_ ZFFSAB._.TempDiagnosis_AT.f_c_PlausiErr ZFFSAB._.TempDiagnosis_AT.f_c_PlausiErr_ ZFFSAB._.TempDiagnosis_AT.iv_c_Chip1Trans ZFFSAB._.TempDiagnosis_AT.iv_c_Chip1TransESts ZFFSAB._.TempDiagnosis_AT.iv_c_Chip2Trans ZFFSAB._.TempDiagnosis_AT.iv_c_Chip2TransESts ZFFSAB._.TempDiagnosis_AT.iv_c_Chip2Trans_old ZFFSAB._.TempDiagnosis_AT.iv_c_Chip2Trans_old_ ZFFSAB._.TempDiagnosis_AT.iv_c_OilTrans ZFFSAB._.TempDiagnosis_AT.iv_c_OilTransESts ZFFSAB._.TempDiagnosis_AT.iv_c_OilTransESts_old ZFFSAB._.TempDiagnosis_AT.iv_c_OilTransESts_old_ /end LOC_MEASUREMENT
/end FUNCTION
/begin FUNCTION zf_SAB_TempExternIn "desc_en"
 /begin LOC_MEASUREMENT ZFFSAB._.TempExternIn.f_c_AmbientErr ZFFSAB._.TempExternIn.iv_c_Ambient ZFFSAB._.TempExternIn.iv_c_AmbientSts ZFFSAB._.TempExternIn.sv_c_Ambient ZFFSAB._.TempExternIn.sv_c_AmbientSts /end LOC_MEASUREMENT
/end FUNCTION
/begin FUNCTION zf_SAB_IgnitionKeyStatusIn "desc_en"
 /begin LOC_MEASUREMENT ZFFSAB._.IgnitionKeyStatusIn.f_KeyValidErr ZFFSAB._.IgnitionKeyStatusIn.iv_KeyValid ZFFSAB._.IgnitionKeyStatusIn.iv_KeyValidSts ZFFSAB._.IgnitionKeyStatusIn.sv_KeyValidSts ZFFSAB._.IgnitionKeyStatusIn.sv_f_KeyRemoteStart ZFFSAB._.IgnitionKeyStatusIn.sv_f_KeyValid /end LOC_MEASUREMENT
/end FUNCTION
/begin FUNCTION zf_SAB_DriverSeatStatusIn "desc_en"
 /begin LOC_MEASUREMENT ZFFSAB._.DriverSeatStatusIn.f_SeatBeltErr ZFFSAB._.DriverSeatStatusIn.f_SeatFLErr ZFFSAB._.DriverSeatStatusIn.iv_SeatBelt ZFFSAB._.DriverSeatStatusIn.iv_SeatBeltSts ZFFSAB._.DriverSeatStatusIn.iv_SeatFL ZFFSAB._.DriverSeatStatusIn.iv_SeatFLSts ZFFSAB._.DriverSeatStatusIn.sv_SeatBeltSts ZFFSAB._.DriverSeatStatusIn.sv_SeatFLSts ZFFSAB._.DriverSeatStatusIn.sv_f_SeatBelt ZFFSAB._.DriverSeatStatusIn.sv_f_SeatFL /end LOC_MEASUREMENT
/end FUNCTION
/begin FUNCTION zf_SAB_ShiftlockRequestExternalIn "desc_en"
 /begin LOC_MEASUREMENT ZFFSAB._.ShiftlockRequestExternalIn.f_PNErr ZFFSAB._.ShiftlockRequestExternalIn.iv_PN ZFFSAB._.ShiftlockRequestExternalIn.iv_PNSts ZFFSAB._.ShiftlockRequestExternalIn.sv_PNSts ZFFSAB._.ShiftlockRequestExternalIn.sv_f_PN /end LOC_MEASUREMENT
/end FUNCTION
/begin FUNCTION zf_SAB_EngineInterventionLimitIn "desc_en"
 /begin LOC_MEASUREMENT ZFFSAB._.EngineInterventionLimitIn.f_m_EngInterventionLimitErr ZFFSAB._.EngineInterventionLimitIn.iv_m_EngInterventionLimit ZFFSAB._.EngineInterventionLimitIn.iv_m_EngInterventionLimitSts ZFFSAB._.EngineInterventionLimitIn.m_EngInterventionLimitSts ZFFSAB._.EngineInterventionLimitIn.sv_m_EngInterventionLimit /end LOC_MEASUREMENT
/end FUNCTION
/end MODULE
/end PROJECT
