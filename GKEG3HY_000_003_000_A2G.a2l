ASAP2_VERSION 1 51
/begin PROJECT _929_929 "Gen2_BMW_System_Supplier_Lib"
/begin HEADER "" VERSION "C_03_03" PROJECT_NO _929_929 /end HEADER
/begin MODULE DIM ""
/begin MOD_COMMON "" BYTE_ORDER MSB_FIRST ALIGNMENT_BYTE 1 ALIGNMENT_WORD 2 ALIGNMENT_LONG 4 ALIGNMENT_FLOAT32_IEEE 4 /end MOD_COMMON
/begin MEASUREMENT ZFFSAB._.EEpromZentralHandler.eepromChannel[1].ZFFSAB._.cEEpromChannel._.cnt_GetEEpromValid "Call counter off function" UBYTE SAB_STANDARD_S2_S3 1 100 0 255 DISPLAY_IDENTIFIER cnt_GetEEpromValid._.cEEpromChannel._.ZFFSAB.eepromChannel[1].EEpromZentralHandler._.ZFFSAB ECU_ADDRESS 0xFFF97B3A /end MEASUREMENT
/begin MEASUREMENT ZFFSAB._.EEpromZentralHandler.eepromChannel[1].ZFFSAB._.cEEpromChannel._.ret_GetEEpromValid "Return value off function" UBYTE SAB_STANDARD_S2_S3 1 100 0 255 DISPLAY_IDENTIFIER ret_GetEEpromValid._.cEEpromChannel._.ZFFSAB.eepromChannel[1].EEpromZentralHandler._.ZFFSAB ECU_ADDRESS 0xFFF97B3B /end MEASUREMENT
/begin MEASUREMENT ZFFSAB._.EEpromZentralHandler.eepromChannel[1].ZFFSAB._.cEEpromChannel._.cnt_GetEEpromUpdate "Call counter off function" UBYTE SAB_STANDARD_S2_S3 1 100 0 255 DISPLAY_IDENTIFIER cnt_GetEEpromUpdate._.cEEpromChannel._.ZFFSAB.eepromChannel[1].EEpromZentralHandler._.ZFFSAB ECU_ADDRESS 0xFFF97B3C /end MEASUREMENT
/begin MEASUREMENT ZFFSAB._.EEpromZentralHandler.eepromChannel[1].ZFFSAB._.cEEpromChannel._.ret_GetEEpromUpdate "Return value off function" UBYTE SAB_STANDARD_S2_S3 1 100 0 255 DISPLAY_IDENTIFIER ret_GetEEpromUpdate._.cEEpromChannel._.ZFFSAB.eepromChannel[1].EEpromZentralHandler._.ZFFSAB ECU_ADDRESS 0xFFF97B3D /end MEASUREMENT
/begin MEASUREMENT ZFFSAB._.EEpromZentralHandler.eepromChannel[1].ZFFSAB._.cEEpromChannel._.cnt_SetEEpromInitZyklisch "Call counter off function" UBYTE SAB_STANDARD_S2_S3 1 100 0 255 DISPLAY_IDENTIFIER cnt_SetEEpromInitZyklisch._.cEEpromChannel._.ZFFSAB.eepromChannel[1].EEpromZentralHandler._.ZFFSAB ECU_ADDRESS 0xFFF97B3E /end MEASUREMENT
/begin MEASUREMENT ZFFSAB._.EEpromZentralHandler.eepromChannel[1].ZFFSAB._.cEEpromChannel._.ret_SetEEpromInitZyklisch "Return value off function" UBYTE SAB_STANDARD_S2_S3 1 100 0 255 DISPLAY_IDENTIFIER ret_SetEEpromInitZyklisch._.cEEpromChannel._.ZFFSAB.eepromChannel[1].EEpromZentralHandler._.ZFFSAB ECU_ADDRESS 0xFFF97B3F /end MEASUREMENT
/begin MEASUREMENT ZFFSAB._.EEpromZentralHandler.eepromChannel[1].ZFFSAB._.cEEpromChannel._.eeprom_info "argument of SetEEpromInitZyklisch" UBYTE SAB_STANDARD_S2_S3 1 100 0 255 DISPLAY_IDENTIFIER eeprom_info._.cEEpromChannel._.ZFFSAB.eepromChannel[1].EEpromZentralHandler._.ZFFSAB ECU_ADDRESS 0xFFF97B40 /end MEASUREMENT
/begin MEASUREMENT ZFFSAB._.EEpromZentralHandler.eepromChannel[1].ZFFSAB._.cEEpromChannel._.cnt_GetSizeofEEpromData "Call counter off function" UBYTE SAB_STANDARD_S2_S3 1 100 0 255 DISPLAY_IDENTIFIER cnt_GetSizeofEEpromData._.cEEpromChannel._.ZFFSAB.eepromChannel[1].EEpromZentralHandler._.ZFFSAB ECU_ADDRESS 0xFFF97B41 /end MEASUREMENT
/begin MEASUREMENT ZFFSAB._.EEpromZentralHandler.eepromChannel[1].ZFFSAB._.cEEpromChannel._.ret_GetSizeofEEpromData "Return value off function" UWORD SAB_STANDARD_S2_S3 1 100 0 65535 DISPLAY_IDENTIFIER ret_GetSizeofEEpromData._.cEEpromChannel._.ZFFSAB.eepromChannel[1].EEpromZentralHandler._.ZFFSAB ECU_ADDRESS 0xFFF97B42 /end MEASUREMENT
/begin MEASUREMENT ZFFSAB._.EEpromZentralHandler.eepromChannel[1].cnt_CallEEpromStoreImmediate "Call counter off function" UBYTE SAB_STANDARD_S2_S3 1 100 0 255 DISPLAY_IDENTIFIER cnt_CallEEpromStoreImmediate.eepromChannel[1].EEpromZentralHandler._.ZFFSAB ECU_ADDRESS 0xFFF97B44 /end MEASUREMENT
/begin MEASUREMENT ZFFSAB._.EEpromZentralHandler.eepromChannel[1].ret_CallEEpromStoreImmediate "Return value off function" UBYTE SAB_STANDARD_S2_S3 1 100 0 255 DISPLAY_IDENTIFIER ret_CallEEpromStoreImmediate.eepromChannel[1].EEpromZentralHandler._.ZFFSAB ECU_ADDRESS 0xFFF97B45 /end MEASUREMENT
/begin MEASUREMENT ZFFSAB._.EEpromZentralHandler.eepromChannel[1].cnt_CallEEpromLoadData "Call counter off function" UBYTE SAB_STANDARD_S2_S3 1 100 0 255 DISPLAY_IDENTIFIER cnt_CallEEpromLoadData.eepromChannel[1].EEpromZentralHandler._.ZFFSAB ECU_ADDRESS 0xFFF97B46 /end MEASUREMENT
/begin MEASUREMENT ZFFSAB._.EEpromZentralHandler.eepromChannel[1].ret_CallEEpromLoadData "Return value off function" UBYTE SAB_STANDARD_S2_S3 1 100 0 255 DISPLAY_IDENTIFIER ret_CallEEpromLoadData.eepromChannel[1].EEpromZentralHandler._.ZFFSAB ECU_ADDRESS 0xFFF97B47 /end MEASUREMENT
/begin MEASUREMENT ZFFSAB._.EEpromZentralHandler.eepromChannel[1].cnt_CallEEpromLoadDataState "Call counter off function" UBYTE SAB_STANDARD_S2_S3 1 100 0 255 DISPLAY_IDENTIFIER cnt_CallEEpromLoadDataState.eepromChannel[1].EEpromZentralHandler._.ZFFSAB ECU_ADDRESS 0xFFF97B48 /end MEASUREMENT
/begin MEASUREMENT ZFFSAB._.EEpromZentralHandler.eepromChannel[1].ret_CallEEpromLoadDataState "Return value off function" UBYTE SAB_STANDARD_S2_S3 1 100 0 255 DISPLAY_IDENTIFIER ret_CallEEpromLoadDataState.eepromChannel[1].EEpromZentralHandler._.ZFFSAB ECU_ADDRESS 0xFFF97B49 /end MEASUREMENT
/begin MEASUREMENT ZFFSAB._.EEpromZentralHandler.eepromChannel[1].mode "argument of SetEEpromInitZyklisch" UBYTE SAB_STANDARD_S2_S3 1 100 0 255 DISPLAY_IDENTIFIER mode.eepromChannel[1].EEpromZentralHandler._.ZFFSAB ECU_ADDRESS 0xFFF97B4A /end MEASUREMENT
/begin MEASUREMENT ZFFSAB._.EEpromZentralHandler.eepromChannel[1].cnt_SetEEpromWriteProtect "Call counter off function" UBYTE SAB_STANDARD_S2_S3 1 100 0 255 DISPLAY_IDENTIFIER cnt_SetEEpromWriteProtect.eepromChannel[1].EEpromZentralHandler._.ZFFSAB ECU_ADDRESS 0xFFF97B4B /end MEASUREMENT
/begin MEASUREMENT ZFFSAB._.EEpromZentralHandler.eepromChannel[2].ZFFSAB._.cEEpromChannel._.cnt_GetEEpromValid "Call counter off function" UBYTE SAB_STANDARD_S2_S3 1 100 0 255 DISPLAY_IDENTIFIER cnt_GetEEpromValid._.cEEpromChannel._.ZFFSAB.eepromChannel[2].EEpromZentralHandler._.ZFFSAB ECU_ADDRESS 0xFFF97B4C /end MEASUREMENT
/begin MEASUREMENT ZFFSAB._.EEpromZentralHandler.eepromChannel[2].ZFFSAB._.cEEpromChannel._.ret_GetEEpromValid "Return value off function" UBYTE SAB_STANDARD_S2_S3 1 100 0 255 DISPLAY_IDENTIFIER ret_GetEEpromValid._.cEEpromChannel._.ZFFSAB.eepromChannel[2].EEpromZentralHandler._.ZFFSAB ECU_ADDRESS 0xFFF97B4D /end MEASUREMENT
/begin MEASUREMENT ZFFSAB._.EEpromZentralHandler.eepromChannel[2].ZFFSAB._.cEEpromChannel._.cnt_GetEEpromUpdate "Call counter off function" UBYTE SAB_STANDARD_S2_S3 1 100 0 255 DISPLAY_IDENTIFIER cnt_GetEEpromUpdate._.cEEpromChannel._.ZFFSAB.eepromChannel[2].EEpromZentralHandler._.ZFFSAB ECU_ADDRESS 0xFFF97B4E /end MEASUREMENT
/begin MEASUREMENT ZFFSAB._.EEpromZentralHandler.eepromChannel[2].ZFFSAB._.cEEpromChannel._.ret_GetEEpromUpdate "Return value off function" UBYTE SAB_STANDARD_S2_S3 1 100 0 255 DISPLAY_IDENTIFIER ret_GetEEpromUpdate._.cEEpromChannel._.ZFFSAB.eepromChannel[2].EEpromZentralHandler._.ZFFSAB ECU_ADDRESS 0xFFF97B4F /end MEASUREMENT
/begin MEASUREMENT ZFFSAB._.EEpromZentralHandler.eepromChannel[2].ZFFSAB._.cEEpromChannel._.cnt_SetEEpromInitZyklisch "Call counter off function" UBYTE SAB_STANDARD_S2_S3 1 100 0 255 DISPLAY_IDENTIFIER cnt_SetEEpromInitZyklisch._.cEEpromChannel._.ZFFSAB.eepromChannel[2].EEpromZentralHandler._.ZFFSAB ECU_ADDRESS 0xFFF97B50 /end MEASUREMENT
/begin MEASUREMENT ZFFSAB._.EEpromZentralHandler.eepromChannel[2].ZFFSAB._.cEEpromChannel._.ret_SetEEpromInitZyklisch "Return value off function" UBYTE SAB_STANDARD_S2_S3 1 100 0 255 DISPLAY_IDENTIFIER ret_SetEEpromInitZyklisch._.cEEpromChannel._.ZFFSAB.eepromChannel[2].EEpromZentralHandler._.ZFFSAB ECU_ADDRESS 0xFFF97B51 /end MEASUREMENT
/begin MEASUREMENT ZFFSAB._.EEpromZentralHandler.eepromChannel[2].ZFFSAB._.cEEpromChannel._.eeprom_info "argument of SetEEpromInitZyklisch" UBYTE SAB_STANDARD_S2_S3 1 100 0 255 DISPLAY_IDENTIFIER eeprom_info._.cEEpromChannel._.ZFFSAB.eepromChannel[2].EEpromZentralHandler._.ZFFSAB ECU_ADDRESS 0xFFF97B52 /end MEASUREMENT
/begin MEASUREMENT ZFFSAB._.EEpromZentralHandler.eepromChannel[2].ZFFSAB._.cEEpromChannel._.cnt_GetSizeofEEpromData "Call counter off function" UBYTE SAB_STANDARD_S2_S3 1 100 0 255 DISPLAY_IDENTIFIER cnt_GetSizeofEEpromData._.cEEpromChannel._.ZFFSAB.eepromChannel[2].EEpromZentralHandler._.ZFFSAB ECU_ADDRESS 0xFFF97B53 /end MEASUREMENT
/begin MEASUREMENT ZFFSAB._.EEpromZentralHandler.eepromChannel[2].ZFFSAB._.cEEpromChannel._.ret_GetSizeofEEpromData "Return value off function" UWORD SAB_STANDARD_S2_S3 1 100 0 65535 DISPLAY_IDENTIFIER ret_GetSizeofEEpromData._.cEEpromChannel._.ZFFSAB.eepromChannel[2].EEpromZentralHandler._.ZFFSAB ECU_ADDRESS 0xFFF97B54 /end MEASUREMENT
/begin MEASUREMENT ZFFSAB._.EEpromZentralHandler.eepromChannel[2].cnt_CallEEpromStoreImmediate "Call counter off function" UBYTE SAB_STANDARD_S2_S3 1 100 0 255 DISPLAY_IDENTIFIER cnt_CallEEpromStoreImmediate.eepromChannel[2].EEpromZentralHandler._.ZFFSAB ECU_ADDRESS 0xFFF97B56 /end MEASUREMENT
/begin MEASUREMENT ZFFSAB._.EEpromZentralHandler.eepromChannel[2].ret_CallEEpromStoreImmediate "Return value off function" UBYTE SAB_STANDARD_S2_S3 1 100 0 255 DISPLAY_IDENTIFIER ret_CallEEpromStoreImmediate.eepromChannel[2].EEpromZentralHandler._.ZFFSAB ECU_ADDRESS 0xFFF97B57 /end MEASUREMENT
/begin MEASUREMENT ZFFSAB._.EEpromZentralHandler.eepromChannel[2].cnt_CallEEpromLoadData "Call counter off function" UBYTE SAB_STANDARD_S2_S3 1 100 0 255 DISPLAY_IDENTIFIER cnt_CallEEpromLoadData.eepromChannel[2].EEpromZentralHandler._.ZFFSAB ECU_ADDRESS 0xFFF97B58 /end MEASUREMENT
/begin MEASUREMENT ZFFSAB._.EEpromZentralHandler.eepromChannel[2].ret_CallEEpromLoadData "Return value off function" UBYTE SAB_STANDARD_S2_S3 1 100 0 255 DISPLAY_IDENTIFIER ret_CallEEpromLoadData.eepromChannel[2].EEpromZentralHandler._.ZFFSAB ECU_ADDRESS 0xFFF97B59 /end MEASUREMENT
/begin MEASUREMENT ZFFSAB._.EEpromZentralHandler.eepromChannel[2].cnt_CallEEpromLoadDataState "Call counter off function" UBYTE SAB_STANDARD_S2_S3 1 100 0 255 DISPLAY_IDENTIFIER cnt_CallEEpromLoadDataState.eepromChannel[2].EEpromZentralHandler._.ZFFSAB ECU_ADDRESS 0xFFF97B5A /end MEASUREMENT
/begin MEASUREMENT ZFFSAB._.EEpromZentralHandler.eepromChannel[2].ret_CallEEpromLoadDataState "Return value off function" UBYTE SAB_STANDARD_S2_S3 1 100 0 255 DISPLAY_IDENTIFIER ret_CallEEpromLoadDataState.eepromChannel[2].EEpromZentralHandler._.ZFFSAB ECU_ADDRESS 0xFFF97B5B /end MEASUREMENT
/begin MEASUREMENT ZFFSAB._.EEpromZentralHandler.eepromChannel[2].mode "argument of SetEEpromInitZyklisch" UBYTE SAB_STANDARD_S2_S3 1 100 0 255 DISPLAY_IDENTIFIER mode.eepromChannel[2].EEpromZentralHandler._.ZFFSAB ECU_ADDRESS 0xFFF97B5C /end MEASUREMENT
/begin MEASUREMENT ZFFSAB._.EEpromZentralHandler.eepromChannel[2].cnt_SetEEpromWriteProtect "Call counter off function" UBYTE SAB_STANDARD_S2_S3 1 100 0 255 DISPLAY_IDENTIFIER cnt_SetEEpromWriteProtect.eepromChannel[2].EEpromZentralHandler._.ZFFSAB ECU_ADDRESS 0xFFF97B5D /end MEASUREMENT
/begin MEASUREMENT ZFFSAB._.EEpromZentralHandler.eepromChannel[3].ZFFSAB._.cEEpromChannel._.cnt_GetEEpromValid "Call counter off function" UBYTE SAB_STANDARD_S2_S3 1 100 0 255 DISPLAY_IDENTIFIER cnt_GetEEpromValid._.cEEpromChannel._.ZFFSAB.eepromChannel[3].EEpromZentralHandler._.ZFFSAB ECU_ADDRESS 0xFFF97B5E /end MEASUREMENT
/begin MEASUREMENT ZFFSAB._.EEpromZentralHandler.eepromChannel[3].ZFFSAB._.cEEpromChannel._.ret_GetEEpromValid "Return value off function" UBYTE SAB_STANDARD_S2_S3 1 100 0 255 DISPLAY_IDENTIFIER ret_GetEEpromValid._.cEEpromChannel._.ZFFSAB.eepromChannel[3].EEpromZentralHandler._.ZFFSAB ECU_ADDRESS 0xFFF97B5F /end MEASUREMENT
/begin MEASUREMENT ZFFSAB._.EEpromZentralHandler.eepromChannel[3].ZFFSAB._.cEEpromChannel._.cnt_GetEEpromUpdate "Call counter off function" UBYTE SAB_STANDARD_S2_S3 1 100 0 255 DISPLAY_IDENTIFIER cnt_GetEEpromUpdate._.cEEpromChannel._.ZFFSAB.eepromChannel[3].EEpromZentralHandler._.ZFFSAB ECU_ADDRESS 0xFFF97B60 /end MEASUREMENT
/begin MEASUREMENT ZFFSAB._.EEpromZentralHandler.eepromChannel[3].ZFFSAB._.cEEpromChannel._.ret_GetEEpromUpdate "Return value off function" UBYTE SAB_STANDARD_S2_S3 1 100 0 255 DISPLAY_IDENTIFIER ret_GetEEpromUpdate._.cEEpromChannel._.ZFFSAB.eepromChannel[3].EEpromZentralHandler._.ZFFSAB ECU_ADDRESS 0xFFF97B61 /end MEASUREMENT
/begin MEASUREMENT ZFFSAB._.EEpromZentralHandler.eepromChannel[3].ZFFSAB._.cEEpromChannel._.cnt_SetEEpromInitZyklisch "Call counter off function" UBYTE SAB_STANDARD_S2_S3 1 100 0 255 DISPLAY_IDENTIFIER cnt_SetEEpromInitZyklisch._.cEEpromChannel._.ZFFSAB.eepromChannel[3].EEpromZentralHandler._.ZFFSAB ECU_ADDRESS 0xFFF97B62 /end MEASUREMENT
/begin MEASUREMENT ZFFSAB._.EEpromZentralHandler.eepromChannel[3].ZFFSAB._.cEEpromChannel._.ret_SetEEpromInitZyklisch "Return value off function" UBYTE SAB_STANDARD_S2_S3 1 100 0 255 DISPLAY_IDENTIFIER ret_SetEEpromInitZyklisch._.cEEpromChannel._.ZFFSAB.eepromChannel[3].EEpromZentralHandler._.ZFFSAB ECU_ADDRESS 0xFFF97B63 /end MEASUREMENT
/begin MEASUREMENT ZFFSAB._.EEpromZentralHandler.eepromChannel[3].ZFFSAB._.cEEpromChannel._.eeprom_info "argument of SetEEpromInitZyklisch" UBYTE SAB_STANDARD_S2_S3 1 100 0 255 DISPLAY_IDENTIFIER eeprom_info._.cEEpromChannel._.ZFFSAB.eepromChannel[3].EEpromZentralHandler._.ZFFSAB ECU_ADDRESS 0xFFF97B64 /end MEASUREMENT
/begin MEASUREMENT ZFFSAB._.EEpromZentralHandler.eepromChannel[3].ZFFSAB._.cEEpromChannel._.cnt_GetSizeofEEpromData "Call counter off function" UBYTE SAB_STANDARD_S2_S3 1 100 0 255 DISPLAY_IDENTIFIER cnt_GetSizeofEEpromData._.cEEpromChannel._.ZFFSAB.eepromChannel[3].EEpromZentralHandler._.ZFFSAB ECU_ADDRESS 0xFFF97B65 /end MEASUREMENT
/begin MEASUREMENT ZFFSAB._.EEpromZentralHandler.eepromChannel[3].ZFFSAB._.cEEpromChannel._.ret_GetSizeofEEpromData "Return value off function" UWORD SAB_STANDARD_S2_S3 1 100 0 65535 DISPLAY_IDENTIFIER ret_GetSizeofEEpromData._.cEEpromChannel._.ZFFSAB.eepromChannel[3].EEpromZentralHandler._.ZFFSAB ECU_ADDRESS 0xFFF97B66 /end MEASUREMENT
/begin MEASUREMENT ZFFSAB._.EEpromZentralHandler.eepromChannel[3].cnt_CallEEpromStoreImmediate "Call counter off function" UBYTE SAB_STANDARD_S2_S3 1 100 0 255 DISPLAY_IDENTIFIER cnt_CallEEpromStoreImmediate.eepromChannel[3].EEpromZentralHandler._.ZFFSAB ECU_ADDRESS 0xFFF97B68 /end MEASUREMENT
/begin MEASUREMENT ZFFSAB._.EEpromZentralHandler.eepromChannel[3].ret_CallEEpromStoreImmediate "Return value off function" UBYTE SAB_STANDARD_S2_S3 1 100 0 255 DISPLAY_IDENTIFIER ret_CallEEpromStoreImmediate.eepromChannel[3].EEpromZentralHandler._.ZFFSAB ECU_ADDRESS 0xFFF97B69 /end MEASUREMENT
/begin MEASUREMENT ZFFSAB._.EEpromZentralHandler.eepromChannel[3].cnt_CallEEpromLoadData "Call counter off function" UBYTE SAB_STANDARD_S2_S3 1 100 0 255 DISPLAY_IDENTIFIER cnt_CallEEpromLoadData.eepromChannel[3].EEpromZentralHandler._.ZFFSAB ECU_ADDRESS 0xFFF97B6A /end MEASUREMENT
/begin MEASUREMENT ZFFSAB._.EEpromZentralHandler.eepromChannel[3].ret_CallEEpromLoadData "Return value off function" UBYTE SAB_STANDARD_S2_S3 1 100 0 255 DISPLAY_IDENTIFIER ret_CallEEpromLoadData.eepromChannel[3].EEpromZentralHandler._.ZFFSAB ECU_ADDRESS 0xFFF97B6B /end MEASUREMENT
/begin MEASUREMENT ZFFSAB._.EEpromZentralHandler.eepromChannel[3].cnt_CallEEpromLoadDataState "Call counter off function" UBYTE SAB_STANDARD_S2_S3 1 100 0 255 DISPLAY_IDENTIFIER cnt_CallEEpromLoadDataState.eepromChannel[3].EEpromZentralHandler._.ZFFSAB ECU_ADDRESS 0xFFF97B6C /end MEASUREMENT
/begin MEASUREMENT ZFFSAB._.EEpromZentralHandler.eepromChannel[3].ret_CallEEpromLoadDataState "Return value off function" UBYTE SAB_STANDARD_S2_S3 1 100 0 255 DISPLAY_IDENTIFIER ret_CallEEpromLoadDataState.eepromChannel[3].EEpromZentralHandler._.ZFFSAB ECU_ADDRESS 0xFFF97B6D /end MEASUREMENT
/begin MEASUREMENT ZFFSAB._.EEpromZentralHandler.eepromChannel[3].mode "argument of SetEEpromInitZyklisch" UBYTE SAB_STANDARD_S2_S3 1 100 0 255 DISPLAY_IDENTIFIER mode.eepromChannel[3].EEpromZentralHandler._.ZFFSAB ECU_ADDRESS 0xFFF97B6E /end MEASUREMENT
/begin MEASUREMENT ZFFSAB._.EEpromZentralHandler.eepromChannel[3].cnt_SetEEpromWriteProtect "Call counter off function" UBYTE SAB_STANDARD_S2_S3 1 100 0 255 DISPLAY_IDENTIFIER cnt_SetEEpromWriteProtect.eepromChannel[3].EEpromZentralHandler._.ZFFSAB ECU_ADDRESS 0xFFF97B6F /end MEASUREMENT
/begin MEASUREMENT ZFFSAB._.EEpromZentralHandler.eepromChannel[14].ZFFSAB._.cEEpromChannel._.ret_GetEEpromValid "Return value off function" UBYTE SAB_STANDARD_S2_S3 1 100 0 255 DISPLAY_IDENTIFIER ret_GetEEpromValid._.cEEpromChannel._.ZFFSAB.eepromChannel[14].EEpromZentralHandler._.ZFFSAB ECU_ADDRESS 0xFFF97C25 /end MEASUREMENT
/begin MEASUREMENT ZFFSAB._.EEpromZentralHandler.eepromChannel[14].ZFFSAB._.cEEpromChannel._.ret_SetEEpromInitZyklisch "Return value off function" UBYTE SAB_STANDARD_S2_S3 1 100 0 255 DISPLAY_IDENTIFIER ret_SetEEpromInitZyklisch._.cEEpromChannel._.ZFFSAB.eepromChannel[14].EEpromZentralHandler._.ZFFSAB ECU_ADDRESS 0xFFF97C29 /end MEASUREMENT
/begin MEASUREMENT ZFFSAB._.EEpromZentralHandler.eepromChannel[14].ZFFSAB._.cEEpromChannel._.ret_GetSizeofEEpromData "Return value off function" UWORD SAB_STANDARD_S2_S3 1 100 0 65535 DISPLAY_IDENTIFIER ret_GetSizeofEEpromData._.cEEpromChannel._.ZFFSAB.eepromChannel[14].EEpromZentralHandler._.ZFFSAB ECU_ADDRESS 0xFFF97C2C /end MEASUREMENT
/begin MEASUREMENT ZFFSAB._.EEpromZentralHandler.eepromChannel[14].cnt_CallEEpromStoreImmediate "Call counter off function" UBYTE SAB_STANDARD_S2_S3 1 100 0 255 DISPLAY_IDENTIFIER cnt_CallEEpromStoreImmediate.eepromChannel[14].EEpromZentralHandler._.ZFFSAB ECU_ADDRESS 0xFFF97C2E /end MEASUREMENT
/begin MEASUREMENT ZFFSAB._.EEpromZentralHandler.eepromChannel[14].ret_CallEEpromStoreImmediate "Return value off function" UBYTE SAB_STANDARD_S2_S3 1 100 0 255 DISPLAY_IDENTIFIER ret_CallEEpromStoreImmediate.eepromChannel[14].EEpromZentralHandler._.ZFFSAB ECU_ADDRESS 0xFFF97C2F /end MEASUREMENT
/begin MEASUREMENT ZFFSAB._.EEpromZentralHandler.eepromChannel[14].cnt_CallEEpromLoadData "Call counter off function" UBYTE SAB_STANDARD_S2_S3 1 100 0 255 DISPLAY_IDENTIFIER cnt_CallEEpromLoadData.eepromChannel[14].EEpromZentralHandler._.ZFFSAB ECU_ADDRESS 0xFFF97C30 /end MEASUREMENT
/begin MEASUREMENT ZFFSAB._.EEpromZentralHandler.eepromChannel[14].ret_CallEEpromLoadData "Return value off function" UBYTE SAB_STANDARD_S2_S3 1 100 0 255 DISPLAY_IDENTIFIER ret_CallEEpromLoadData.eepromChannel[14].EEpromZentralHandler._.ZFFSAB ECU_ADDRESS 0xFFF97C31 /end MEASUREMENT
/begin MEASUREMENT ZFFSAB._.EEpromZentralHandler.eepromChannel[14].cnt_CallEEpromLoadDataState "Call counter off function" UBYTE SAB_STANDARD_S2_S3 1 100 0 255 DISPLAY_IDENTIFIER cnt_CallEEpromLoadDataState.eepromChannel[14].EEpromZentralHandler._.ZFFSAB ECU_ADDRESS 0xFFF97C32 /end MEASUREMENT
/begin MEASUREMENT ZFFSAB._.EEpromZentralHandler.eepromChannel[14].ret_CallEEpromLoadDataState "Return value off function" UBYTE SAB_STANDARD_S2_S3 1 100 0 255 DISPLAY_IDENTIFIER ret_CallEEpromLoadDataState.eepromChannel[14].EEpromZentralHandler._.ZFFSAB ECU_ADDRESS 0xFFF97C33 /end MEASUREMENT
/begin MEASUREMENT ZFFSAB._.EEpromZentralHandler.eepromChannel[14].mode "argument of SetEEpromInitZyklisch" UBYTE SAB_STANDARD_S2_S3 1 100 0 255 DISPLAY_IDENTIFIER mode.eepromChannel[14].EEpromZentralHandler._.ZFFSAB ECU_ADDRESS 0xFFF97C34 /end MEASUREMENT
/begin MEASUREMENT ZFFSAB._.EEpromZentralHandler.eepromChannel[14].cnt_SetEEpromWriteProtect "Call counter off function" UBYTE SAB_STANDARD_S2_S3 1 100 0 255 DISPLAY_IDENTIFIER cnt_SetEEpromWriteProtect.eepromChannel[14].EEpromZentralHandler._.ZFFSAB ECU_ADDRESS 0xFFF97C35 /end MEASUREMENT
/begin MEASUREMENT ZFFSAB._.EEpromZentralHandler.eepromChannel[15].ZFFSAB._.cEEpromChannel._.cnt_GetEEpromValid "Call counter off function" UBYTE SAB_STANDARD_S2_S3 1 100 0 255 DISPLAY_IDENTIFIER cnt_GetEEpromValid._.cEEpromChannel._.ZFFSAB.eepromChannel[15].EEpromZentralHandler._.ZFFSAB ECU_ADDRESS 0xFFF97C36 /end MEASUREMENT
/begin MEASUREMENT ZFFSAB._.EEpromZentralHandler.eepromChannel[15].ZFFSAB._.cEEpromChannel._.ret_GetEEpromValid "Return value off function" UBYTE SAB_STANDARD_S2_S3 1 100 0 255 DISPLAY_IDENTIFIER ret_GetEEpromValid._.cEEpromChannel._.ZFFSAB.eepromChannel[15].EEpromZentralHandler._.ZFFSAB ECU_ADDRESS 0xFFF97C37 /end MEASUREMENT
/begin MEASUREMENT ZFFSAB._.EEpromZentralHandler.eepromChannel[15].ZFFSAB._.cEEpromChannel._.cnt_GetEEpromUpdate "Call counter off function" UBYTE SAB_STANDARD_S2_S3 1 100 0 255 DISPLAY_IDENTIFIER cnt_GetEEpromUpdate._.cEEpromChannel._.ZFFSAB.eepromChannel[15].EEpromZentralHandler._.ZFFSAB ECU_ADDRESS 0xFFF97C38 /end MEASUREMENT
/begin MEASUREMENT ZFFSAB._.EEpromZentralHandler.eepromChannel[15].ZFFSAB._.cEEpromChannel._.ret_GetEEpromUpdate "Return value off function" UBYTE SAB_STANDARD_S2_S3 1 100 0 255 DISPLAY_IDENTIFIER ret_GetEEpromUpdate._.cEEpromChannel._.ZFFSAB.eepromChannel[15].EEpromZentralHandler._.ZFFSAB ECU_ADDRESS 0xFFF97C39 /end MEASUREMENT
/begin MEASUREMENT ZFFSAB._.EEpromZentralHandler.eepromChannel[15].ZFFSAB._.cEEpromChannel._.cnt_SetEEpromInitZyklisch "Call counter off function" UBYTE SAB_STANDARD_S2_S3 1 100 0 255 DISPLAY_IDENTIFIER cnt_SetEEpromInitZyklisch._.cEEpromChannel._.ZFFSAB.eepromChannel[15].EEpromZentralHandler._.ZFFSAB ECU_ADDRESS 0xFFF97C3A /end MEASUREMENT
/begin MEASUREMENT ZFFSAB._.EEpromZentralHandler.eepromChannel[15].ZFFSAB._.cEEpromChannel._.ret_SetEEpromInitZyklisch "Return value off function" UBYTE SAB_STANDARD_S2_S3 1 100 0 255 DISPLAY_IDENTIFIER ret_SetEEpromInitZyklisch._.cEEpromChannel._.ZFFSAB.eepromChannel[15].EEpromZentralHandler._.ZFFSAB ECU_ADDRESS 0xFFF97C3B /end MEASUREMENT
/begin MEASUREMENT ZFFSAB._.EEpromZentralHandler.eepromChannel[15].ZFFSAB._.cEEpromChannel._.eeprom_info "argument of SetEEpromInitZyklisch" UBYTE SAB_STANDARD_S2_S3 1 100 0 255 DISPLAY_IDENTIFIER eeprom_info._.cEEpromChannel._.ZFFSAB.eepromChannel[15].EEpromZentralHandler._.ZFFSAB ECU_ADDRESS 0xFFF97C3C /end MEASUREMENT
/begin MEASUREMENT ZFFSAB._.EEpromZentralHandler.eepromChannel[15].ZFFSAB._.cEEpromChannel._.cnt_GetSizeofEEpromData "Call counter off function" UBYTE SAB_STANDARD_S2_S3 1 100 0 255 DISPLAY_IDENTIFIER cnt_GetSizeofEEpromData._.cEEpromChannel._.ZFFSAB.eepromChannel[15].EEpromZentralHandler._.ZFFSAB ECU_ADDRESS 0xFFF97C3D /end MEASUREMENT
/begin MEASUREMENT ZFFSAB._.EEpromZentralHandler.eepromChannel[15].ZFFSAB._.cEEpromChannel._.ret_GetSizeofEEpromData "Return value off function" UWORD SAB_STANDARD_S2_S3 1 100 0 65535 DISPLAY_IDENTIFIER ret_GetSizeofEEpromData._.cEEpromChannel._.ZFFSAB.eepromChannel[15].EEpromZentralHandler._.ZFFSAB ECU_ADDRESS 0xFFF97C3E /end MEASUREMENT
/begin MEASUREMENT ZFFSAB._.EEpromZentralHandler.eepromChannel[15].cnt_CallEEpromStoreImmediate "Call counter off function" UBYTE SAB_STANDARD_S2_S3 1 100 0 255 DISPLAY_IDENTIFIER cnt_CallEEpromStoreImmediate.eepromChannel[15].EEpromZentralHandler._.ZFFSAB ECU_ADDRESS 0xFFF97C40 /end MEASUREMENT
/begin MEASUREMENT ZFFSAB._.EEpromZentralHandler.eepromChannel[15].ret_CallEEpromStoreImmediate "Return value off function" UBYTE SAB_STANDARD_S2_S3 1 100 0 255 DISPLAY_IDENTIFIER ret_CallEEpromStoreImmediate.eepromChannel[15].EEpromZentralHandler._.ZFFSAB ECU_ADDRESS 0xFFF97C41 /end MEASUREMENT
/begin MEASUREMENT ZFFSAB._.EEpromZentralHandler.eepromChannel[15].cnt_CallEEpromLoadData "Call counter off function" UBYTE SAB_STANDARD_S2_S3 1 100 0 255 DISPLAY_IDENTIFIER cnt_CallEEpromLoadData.eepromChannel[15].EEpromZentralHandler._.ZFFSAB ECU_ADDRESS 0xFFF97C42 /end MEASUREMENT
/begin MEASUREMENT ZFFSAB._.EEpromZentralHandler.eepromChannel[15].ret_CallEEpromLoadData "Return value off function" UBYTE SAB_STANDARD_S2_S3 1 100 0 255 DISPLAY_IDENTIFIER ret_CallEEpromLoadData.eepromChannel[15].EEpromZentralHandler._.ZFFSAB ECU_ADDRESS 0xFFF97C43 /end MEASUREMENT
/begin MEASUREMENT ZFFSAB._.EEpromZentralHandler.eepromChannel[15].cnt_CallEEpromLoadDataState "Call counter off function" UBYTE SAB_STANDARD_S2_S3 1 100 0 255 DISPLAY_IDENTIFIER cnt_CallEEpromLoadDataState.eepromChannel[15].EEpromZentralHandler._.ZFFSAB ECU_ADDRESS 0xFFF97C44 /end MEASUREMENT
/begin MEASUREMENT ZFFSAB._.EEpromZentralHandler.eepromChannel[15].ret_CallEEpromLoadDataState "Return value off function" UBYTE SAB_STANDARD_S2_S3 1 100 0 255 DISPLAY_IDENTIFIER ret_CallEEpromLoadDataState.eepromChannel[15].EEpromZentralHandler._.ZFFSAB ECU_ADDRESS 0xFFF97C45 /end MEASUREMENT
/begin MEASUREMENT ZFFSAB._.EEpromZentralHandler.eepromChannel[15].mode "argument of SetEEpromInitZyklisch" UBYTE SAB_STANDARD_S2_S3 1 100 0 255 DISPLAY_IDENTIFIER mode.eepromChannel[15].EEpromZentralHandler._.ZFFSAB ECU_ADDRESS 0xFFF97C46 /end MEASUREMENT
/begin MEASUREMENT ZFFSAB._.EEpromZentralHandler.eepromChannel[15].cnt_SetEEpromWriteProtect "Call counter off function" UBYTE SAB_STANDARD_S2_S3 1 100 0 255 DISPLAY_IDENTIFIER cnt_SetEEpromWriteProtect.eepromChannel[15].EEpromZentralHandler._.ZFFSAB ECU_ADDRESS 0xFFF97C47 /end MEASUREMENT
/begin MEASUREMENT ZFFSAB._.EEpromZentralHandler.eepromChannel[16].ZFFSAB._.cEEpromChannel._.cnt_GetEEpromValid "Call counter off function" UBYTE SAB_STANDARD_S2_S3 1 100 0 255 DISPLAY_IDENTIFIER cnt_GetEEpromValid._.cEEpromChannel._.ZFFSAB.eepromChannel[16].EEpromZentralHandler._.ZFFSAB ECU_ADDRESS 0xFFF97C48 /end MEASUREMENT
/begin MEASUREMENT ZFFSAB._.EEpromZentralHandler.eepromChannel[16].ZFFSAB._.cEEpromChannel._.ret_GetEEpromValid "Return value off function" UBYTE SAB_STANDARD_S2_S3 1 100 0 255 DISPLAY_IDENTIFIER ret_GetEEpromValid._.cEEpromChannel._.ZFFSAB.eepromChannel[16].EEpromZentralHandler._.ZFFSAB ECU_ADDRESS 0xFFF97C49 /end MEASUREMENT
/begin MEASUREMENT ZFFSAB._.EEpromZentralHandler.eepromChannel[16].ZFFSAB._.cEEpromChannel._.cnt_GetEEpromUpdate "Call counter off function" UBYTE SAB_STANDARD_S2_S3 1 100 0 255 DISPLAY_IDENTIFIER cnt_GetEEpromUpdate._.cEEpromChannel._.ZFFSAB.eepromChannel[16].EEpromZentralHandler._.ZFFSAB ECU_ADDRESS 0xFFF97C4A /end MEASUREMENT
/begin MEASUREMENT ZFFSAB._.EEpromZentralHandler.eepromChannel[16].ZFFSAB._.cEEpromChannel._.ret_GetEEpromUpdate "Return value off function" UBYTE SAB_STANDARD_S2_S3 1 100 0 255 DISPLAY_IDENTIFIER ret_GetEEpromUpdate._.cEEpromChannel._.ZFFSAB.eepromChannel[16].EEpromZentralHandler._.ZFFSAB ECU_ADDRESS 0xFFF97C4B /end MEASUREMENT
/begin MEASUREMENT ZFFSAB._.EEpromZentralHandler.eepromChannel[16].ZFFSAB._.cEEpromChannel._.cnt_SetEEpromInitZyklisch "Call counter off function" UBYTE SAB_STANDARD_S2_S3 1 100 0 255 DISPLAY_IDENTIFIER cnt_SetEEpromInitZyklisch._.cEEpromChannel._.ZFFSAB.eepromChannel[16].EEpromZentralHandler._.ZFFSAB ECU_ADDRESS 0xFFF97C4C /end MEASUREMENT
/begin MEASUREMENT ZFFSAB._.EEpromZentralHandler.eepromChannel[16].ZFFSAB._.cEEpromChannel._.ret_SetEEpromInitZyklisch "Return value off function" UBYTE SAB_STANDARD_S2_S3 1 100 0 255 DISPLAY_IDENTIFIER ret_SetEEpromInitZyklisch._.cEEpromChannel._.ZFFSAB.eepromChannel[16].EEpromZentralHandler._.ZFFSAB ECU_ADDRESS 0xFFF97C4D /end MEASUREMENT
/begin MEASUREMENT ZFFSAB._.EEpromZentralHandler.eepromChannel[16].ZFFSAB._.cEEpromChannel._.eeprom_info "argument of SetEEpromInitZyklisch" UBYTE SAB_STANDARD_S2_S3 1 100 0 255 DISPLAY_IDENTIFIER eeprom_info._.cEEpromChannel._.ZFFSAB.eepromChannel[16].EEpromZentralHandler._.ZFFSAB ECU_ADDRESS 0xFFF97C4E /end MEASUREMENT
/begin MEASUREMENT ZFFSAB._.EEpromZentralHandler.eepromChannel[16].ZFFSAB._.cEEpromChannel._.cnt_GetSizeofEEpromData "Call counter off function" UBYTE SAB_STANDARD_S2_S3 1 100 0 255 DISPLAY_IDENTIFIER cnt_GetSizeofEEpromData._.cEEpromChannel._.ZFFSAB.eepromChannel[16].EEpromZentralHandler._.ZFFSAB ECU_ADDRESS 0xFFF97C4F /end MEASUREMENT
/begin MEASUREMENT ZFFSAB._.EEpromZentralHandler.eepromChannel[16].ZFFSAB._.cEEpromChannel._.ret_GetSizeofEEpromData "Return value off function" UWORD SAB_STANDARD_S2_S3 1 100 0 65535 DISPLAY_IDENTIFIER ret_GetSizeofEEpromData._.cEEpromChannel._.ZFFSAB.eepromChannel[16].EEpromZentralHandler._.ZFFSAB ECU_ADDRESS 0xFFF97C50 /end MEASUREMENT
/begin MEASUREMENT ZFFSAB._.EEpromZentralHandler.eepromChannel[16].cnt_CallEEpromStoreImmediate "Call counter off function" UBYTE SAB_STANDARD_S2_S3 1 100 0 255 DISPLAY_IDENTIFIER cnt_CallEEpromStoreImmediate.eepromChannel[16].EEpromZentralHandler._.ZFFSAB ECU_ADDRESS 0xFFF97C52 /end MEASUREMENT
/begin MEASUREMENT ZFFSAB._.EEpromZentralHandler.eepromChannel[16].ret_CallEEpromStoreImmediate "Return value off function" UBYTE SAB_STANDARD_S2_S3 1 100 0 255 DISPLAY_IDENTIFIER ret_CallEEpromStoreImmediate.eepromChannel[16].EEpromZentralHandler._.ZFFSAB ECU_ADDRESS 0xFFF97C53 /end MEASUREMENT
/begin MEASUREMENT ZFFSAB._.EEpromZentralHandler.eepromChannel[16].cnt_CallEEpromLoadData "Call counter off function" UBYTE SAB_STANDARD_S2_S3 1 100 0 255 DISPLAY_IDENTIFIER cnt_CallEEpromLoadData.eepromChannel[16].EEpromZentralHandler._.ZFFSAB ECU_ADDRESS 0xFFF97C54 /end MEASUREMENT
/begin MEASUREMENT ZFFSAB._.EEpromZentralHandler.eepromChannel[16].ret_CallEEpromLoadData "Return value off function" UBYTE SAB_STANDARD_S2_S3 1 100 0 255 DISPLAY_IDENTIFIER ret_CallEEpromLoadData.eepromChannel[16].EEpromZentralHandler._.ZFFSAB ECU_ADDRESS 0xFFF97C55 /end MEASUREMENT
/begin MEASUREMENT ZFFSAB._.EEpromZentralHandler.eepromChannel[16].cnt_CallEEpromLoadDataState "Call counter off function" UBYTE SAB_STANDARD_S2_S3 1 100 0 255 DISPLAY_IDENTIFIER cnt_CallEEpromLoadDataState.eepromChannel[16].EEpromZentralHandler._.ZFFSAB ECU_ADDRESS 0xFFF97C56 /end MEASUREMENT
/begin MEASUREMENT ZFFSAB._.EEpromZentralHandler.eepromChannel[16].ret_CallEEpromLoadDataState "Return value off function" UBYTE SAB_STANDARD_S2_S3 1 100 0 255 DISPLAY_IDENTIFIER ret_CallEEpromLoadDataState.eepromChannel[16].EEpromZentralHandler._.ZFFSAB ECU_ADDRESS 0xFFF97C57 /end MEASUREMENT
/begin MEASUREMENT ZFFSAB._.EEpromZentralHandler.eepromChannel[16].mode "argument of SetEEpromInitZyklisch" UBYTE SAB_STANDARD_S2_S3 1 100 0 255 DISPLAY_IDENTIFIER mode.eepromChannel[16].EEpromZentralHandler._.ZFFSAB ECU_ADDRESS 0xFFF97C58 /end MEASUREMENT
/begin MEASUREMENT ZFFSAB._.EEpromZentralHandler.eepromChannel[16].cnt_SetEEpromWriteProtect "Call counter off function" UBYTE SAB_STANDARD_S2_S3 1 100 0 255 DISPLAY_IDENTIFIER cnt_SetEEpromWriteProtect.eepromChannel[16].EEpromZentralHandler._.ZFFSAB ECU_ADDRESS 0xFFF97C59 /end MEASUREMENT
/begin MEASUREMENT ZFFSAB._.EEpromZentralHandler.eepromChannel[17].ZFFSAB._.cEEpromChannel._.cnt_GetEEpromValid "Call counter off function" UBYTE SAB_STANDARD_S2_S3 1 100 0 255 DISPLAY_IDENTIFIER cnt_GetEEpromValid._.cEEpromChannel._.ZFFSAB.eepromChannel[17].EEpromZentralHandler._.ZFFSAB ECU_ADDRESS 0xFFF97C5A /end MEASUREMENT
/begin MEASUREMENT ZFFSAB._.EEpromZentralHandler.eepromChannel[17].ZFFSAB._.cEEpromChannel._.ret_GetEEpromValid "Return value off function" UBYTE SAB_STANDARD_S2_S3 1 100 0 255 DISPLAY_IDENTIFIER ret_GetEEpromValid._.cEEpromChannel._.ZFFSAB.eepromChannel[17].EEpromZentralHandler._.ZFFSAB ECU_ADDRESS 0xFFF97C5B /end MEASUREMENT
/begin MEASUREMENT ZFFSAB._.EEpromZentralHandler.eepromChannel[17].ZFFSAB._.cEEpromChannel._.cnt_GetEEpromUpdate "Call counter off function" UBYTE SAB_STANDARD_S2_S3 1 100 0 255 DISPLAY_IDENTIFIER cnt_GetEEpromUpdate._.cEEpromChannel._.ZFFSAB.eepromChannel[17].EEpromZentralHandler._.ZFFSAB ECU_ADDRESS 0xFFF97C5C /end MEASUREMENT
/begin MEASUREMENT ZFFSAB._.EEpromZentralHandler.eepromChannel[17].ZFFSAB._.cEEpromChannel._.ret_GetEEpromUpdate "Return value off function" UBYTE SAB_STANDARD_S2_S3 1 100 0 255 DISPLAY_IDENTIFIER ret_GetEEpromUpdate._.cEEpromChannel._.ZFFSAB.eepromChannel[17].EEpromZentralHandler._.ZFFSAB ECU_ADDRESS 0xFFF97C5D /end MEASUREMENT
/begin MEASUREMENT ZFFSAB._.EEpromZentralHandler.eepromChannel[17].ZFFSAB._.cEEpromChannel._.cnt_SetEEpromInitZyklisch "Call counter off function" UBYTE SAB_STANDARD_S2_S3 1 100 0 255 DISPLAY_IDENTIFIER cnt_SetEEpromInitZyklisch._.cEEpromChannel._.ZFFSAB.eepromChannel[17].EEpromZentralHandler._.ZFFSAB ECU_ADDRESS 0xFFF97C5E /end MEASUREMENT
/begin MEASUREMENT ZFFSAB._.EEpromZentralHandler.eepromChannel[17].ZFFSAB._.cEEpromChannel._.ret_SetEEpromInitZyklisch "Return value off function" UBYTE SAB_STANDARD_S2_S3 1 100 0 255 DISPLAY_IDENTIFIER ret_SetEEpromInitZyklisch._.cEEpromChannel._.ZFFSAB.eepromChannel[17].EEpromZentralHandler._.ZFFSAB ECU_ADDRESS 0xFFF97C5F /end MEASUREMENT
/begin MEASUREMENT ZFFSAB._.EEpromZentralHandler.eepromChannel[17].ZFFSAB._.cEEpromChannel._.eeprom_info "argument of SetEEpromInitZyklisch" UBYTE SAB_STANDARD_S2_S3 1 100 0 255 DISPLAY_IDENTIFIER eeprom_info._.cEEpromChannel._.ZFFSAB.eepromChannel[17].EEpromZentralHandler._.ZFFSAB ECU_ADDRESS 0xFFF97C60 /end MEASUREMENT
/begin MEASUREMENT ZFFSAB._.EEpromZentralHandler.eepromChannel[17].ZFFSAB._.cEEpromChannel._.cnt_GetSizeofEEpromData "Call counter off function" UBYTE SAB_STANDARD_S2_S3 1 100 0 255 DISPLAY_IDENTIFIER cnt_GetSizeofEEpromData._.cEEpromChannel._.ZFFSAB.eepromChannel[17].EEpromZentralHandler._.ZFFSAB ECU_ADDRESS 0xFFF97C61 /end MEASUREMENT
/begin MEASUREMENT ZFFSAB._.EEpromZentralHandler.eepromChannel[17].ZFFSAB._.cEEpromChannel._.ret_GetSizeofEEpromData "Return value off function" UWORD SAB_STANDARD_S2_S3 1 100 0 65535 DISPLAY_IDENTIFIER ret_GetSizeofEEpromData._.cEEpromChannel._.ZFFSAB.eepromChannel[17].EEpromZentralHandler._.ZFFSAB ECU_ADDRESS 0xFFF97C62 /end MEASUREMENT
/begin MEASUREMENT ZFFSAB._.EEpromZentralHandler.eepromChannel[17].cnt_CallEEpromStoreImmediate "Call counter off function" UBYTE SAB_STANDARD_S2_S3 1 100 0 255 DISPLAY_IDENTIFIER cnt_CallEEpromStoreImmediate.eepromChannel[17].EEpromZentralHandler._.ZFFSAB ECU_ADDRESS 0xFFF97C64 /end MEASUREMENT
/begin MEASUREMENT ZFFSAB._.EEpromZentralHandler.eepromChannel[17].ret_CallEEpromStoreImmediate "Return value off function" UBYTE SAB_STANDARD_S2_S3 1 100 0 255 DISPLAY_IDENTIFIER ret_CallEEpromStoreImmediate.eepromChannel[17].EEpromZentralHandler._.ZFFSAB ECU_ADDRESS 0xFFF97C65 /end MEASUREMENT
/begin MEASUREMENT ZFFSAB._.EEpromZentralHandler.eepromChannel[17].cnt_CallEEpromLoadData "Call counter off function" UBYTE SAB_STANDARD_S2_S3 1 100 0 255 DISPLAY_IDENTIFIER cnt_CallEEpromLoadData.eepromChannel[17].EEpromZentralHandler._.ZFFSAB ECU_ADDRESS 0xFFF97C66 /end MEASUREMENT
/begin MEASUREMENT ZFFSAB._.EEpromZentralHandler.eepromChannel[17].ret_CallEEpromLoadData "Return value off function" UBYTE SAB_STANDARD_S2_S3 1 100 0 255 DISPLAY_IDENTIFIER ret_CallEEpromLoadData.eepromChannel[17].EEpromZentralHandler._.ZFFSAB ECU_ADDRESS 0xFFF97C67 /end MEASUREMENT
/begin MEASUREMENT ZFFSAB._.EEpromZentralHandler.eepromChannel[17].cnt_CallEEpromLoadDataState "Call counter off function" UBYTE SAB_STANDARD_S2_S3 1 100 0 255 DISPLAY_IDENTIFIER cnt_CallEEpromLoadDataState.eepromChannel[17].EEpromZentralHandler._.ZFFSAB ECU_ADDRESS 0xFFF97C68 /end MEASUREMENT
/begin MEASUREMENT ZFFSAB._.EEpromZentralHandler.eepromChannel[17].ret_CallEEpromLoadDataState "Return value off function" UBYTE SAB_STANDARD_S2_S3 1 100 0 255 DISPLAY_IDENTIFIER ret_CallEEpromLoadDataState.eepromChannel[17].EEpromZentralHandler._.ZFFSAB ECU_ADDRESS 0xFFF97C69 /end MEASUREMENT
/begin MEASUREMENT ZFFSAB._.EEpromZentralHandler.eepromChannel[17].mode "argument of SetEEpromInitZyklisch" UBYTE SAB_STANDARD_S2_S3 1 100 0 255 DISPLAY_IDENTIFIER mode.eepromChannel[17].EEpromZentralHandler._.ZFFSAB ECU_ADDRESS 0xFFF97C6A /end MEASUREMENT
/begin MEASUREMENT ZFFSAB._.EEpromZentralHandler.eepromChannel[17].cnt_SetEEpromWriteProtect "Call counter off function" UBYTE SAB_STANDARD_S2_S3 1 100 0 255 DISPLAY_IDENTIFIER cnt_SetEEpromWriteProtect.eepromChannel[17].EEpromZentralHandler._.ZFFSAB ECU_ADDRESS 0xFFF97C6B /end MEASUREMENT
/begin MEASUREMENT ZFFSAB._.EEpromZentralHandler.eepromChannel[18].ZFFSAB._.cEEpromChannel._.cnt_GetEEpromValid "Call counter off function" UBYTE SAB_STANDARD_S2_S3 1 100 0 255 DISPLAY_IDENTIFIER cnt_GetEEpromValid._.cEEpromChannel._.ZFFSAB.eepromChannel[18].EEpromZentralHandler._.ZFFSAB ECU_ADDRESS 0xFFF97C6C /end MEASUREMENT
/begin MEASUREMENT ZFFSAB._.EEpromZentralHandler.eepromChannel[18].ZFFSAB._.cEEpromChannel._.ret_GetEEpromValid "Return value off function" UBYTE SAB_STANDARD_S2_S3 1 100 0 255 DISPLAY_IDENTIFIER ret_GetEEpromValid._.cEEpromChannel._.ZFFSAB.eepromChannel[18].EEpromZentralHandler._.ZFFSAB ECU_ADDRESS 0xFFF97C6D /end MEASUREMENT
/begin MEASUREMENT ZFFSAB._.EEpromZentralHandler.eepromChannel[18].ZFFSAB._.cEEpromChannel._.cnt_GetEEpromUpdate "Call counter off function" UBYTE SAB_STANDARD_S2_S3 1 100 0 255 DISPLAY_IDENTIFIER cnt_GetEEpromUpdate._.cEEpromChannel._.ZFFSAB.eepromChannel[18].EEpromZentralHandler._.ZFFSAB ECU_ADDRESS 0xFFF97C6E /end MEASUREMENT
/begin MEASUREMENT ZFFSAB._.EEpromZentralHandler.eepromChannel[18].ZFFSAB._.cEEpromChannel._.ret_GetEEpromUpdate "Return value off function" UBYTE SAB_STANDARD_S2_S3 1 100 0 255 DISPLAY_IDENTIFIER ret_GetEEpromUpdate._.cEEpromChannel._.ZFFSAB.eepromChannel[18].EEpromZentralHandler._.ZFFSAB ECU_ADDRESS 0xFFF97C6F /end MEASUREMENT
/begin MEASUREMENT ZFFSAB._.EEpromZentralHandler.eepromChannel[18].ZFFSAB._.cEEpromChannel._.cnt_SetEEpromInitZyklisch "Call counter off function" UBYTE SAB_STANDARD_S2_S3 1 100 0 255 DISPLAY_IDENTIFIER cnt_SetEEpromInitZyklisch._.cEEpromChannel._.ZFFSAB.eepromChannel[18].EEpromZentralHandler._.ZFFSAB ECU_ADDRESS 0xFFF97C70 /end MEASUREMENT
/begin MEASUREMENT ZFFSAB._.EEpromZentralHandler.eepromChannel[18].ZFFSAB._.cEEpromChannel._.ret_SetEEpromInitZyklisch "Return value off function" UBYTE SAB_STANDARD_S2_S3 1 100 0 255 DISPLAY_IDENTIFIER ret_SetEEpromInitZyklisch._.cEEpromChannel._.ZFFSAB.eepromChannel[18].EEpromZentralHandler._.ZFFSAB ECU_ADDRESS 0xFFF97C71 /end MEASUREMENT
/begin MEASUREMENT ZFFSAB._.EEpromZentralHandler.eepromChannel[18].ZFFSAB._.cEEpromChannel._.eeprom_info "argument of SetEEpromInitZyklisch" UBYTE SAB_STANDARD_S2_S3 1 100 0 255 DISPLAY_IDENTIFIER eeprom_info._.cEEpromChannel._.ZFFSAB.eepromChannel[18].EEpromZentralHandler._.ZFFSAB ECU_ADDRESS 0xFFF97C72 /end MEASUREMENT
/begin MEASUREMENT ZFFSAB._.EEpromZentralHandler.eepromChannel[18].ZFFSAB._.cEEpromChannel._.cnt_GetSizeofEEpromData "Call counter off function" UBYTE SAB_STANDARD_S2_S3 1 100 0 255 DISPLAY_IDENTIFIER cnt_GetSizeofEEpromData._.cEEpromChannel._.ZFFSAB.eepromChannel[18].EEpromZentralHandler._.ZFFSAB ECU_ADDRESS 0xFFF97C73 /end MEASUREMENT
/begin MEASUREMENT ZFFSAB._.EEpromZentralHandler.eepromChannel[18].ZFFSAB._.cEEpromChannel._.ret_GetSizeofEEpromData "Return value off function" UWORD SAB_STANDARD_S2_S3 1 100 0 65535 DISPLAY_IDENTIFIER ret_GetSizeofEEpromData._.cEEpromChannel._.ZFFSAB.eepromChannel[18].EEpromZentralHandler._.ZFFSAB ECU_ADDRESS 0xFFF97C74 /end MEASUREMENT
/begin MEASUREMENT ZFFSAB._.EEpromZentralHandler.eepromChannel[18].cnt_CallEEpromStoreImmediate "Call counter off function" UBYTE SAB_STANDARD_S2_S3 1 100 0 255 DISPLAY_IDENTIFIER cnt_CallEEpromStoreImmediate.eepromChannel[18].EEpromZentralHandler._.ZFFSAB ECU_ADDRESS 0xFFF97C76 /end MEASUREMENT
/begin MEASUREMENT ZFFSAB._.EEpromZentralHandler.eepromChannel[18].ret_CallEEpromStoreImmediate "Return value off function" UBYTE SAB_STANDARD_S2_S3 1 100 0 255 DISPLAY_IDENTIFIER ret_CallEEpromStoreImmediate.eepromChannel[18].EEpromZentralHandler._.ZFFSAB ECU_ADDRESS 0xFFF97C77 /end MEASUREMENT
/begin MEASUREMENT ZFFSAB._.EEpromZentralHandler.eepromChannel[18].cnt_CallEEpromLoadData "Call counter off function" UBYTE SAB_STANDARD_S2_S3 1 100 0 255 DISPLAY_IDENTIFIER cnt_CallEEpromLoadData.eepromChannel[18].EEpromZentralHandler._.ZFFSAB ECU_ADDRESS 0xFFF97C78 /end MEASUREMENT
/begin MEASUREMENT ZFFSAB._.EEpromZentralHandler.eepromChannel[18].ret_CallEEpromLoadData "Return value off function" UBYTE SAB_STANDARD_S2_S3 1 100 0 255 DISPLAY_IDENTIFIER ret_CallEEpromLoadData.eepromChannel[18].EEpromZentralHandler._.ZFFSAB ECU_ADDRESS 0xFFF97C79 /end MEASUREMENT
/begin MEASUREMENT ZFFSAB._.EEpromZentralHandler.eepromChannel[18].cnt_CallEEpromLoadDataState "Call counter off function" UBYTE SAB_STANDARD_S2_S3 1 100 0 255 DISPLAY_IDENTIFIER cnt_CallEEpromLoadDataState.eepromChannel[18].EEpromZentralHandler._.ZFFSAB ECU_ADDRESS 0xFFF97C7A /end MEASUREMENT
/begin MEASUREMENT ZFFSAB._.EEpromZentralHandler.eepromChannel[18].ret_CallEEpromLoadDataState "Return value off function" UBYTE SAB_STANDARD_S2_S3 1 100 0 255 DISPLAY_IDENTIFIER ret_CallEEpromLoadDataState.eepromChannel[18].EEpromZentralHandler._.ZFFSAB ECU_ADDRESS 0xFFF97C7B /end MEASUREMENT
/begin MEASUREMENT ZFFSAB._.EEpromZentralHandler.eepromChannel[18].mode "argument of SetEEpromInitZyklisch" UBYTE SAB_STANDARD_S2_S3 1 100 0 255 DISPLAY_IDENTIFIER mode.eepromChannel[18].EEpromZentralHandler._.ZFFSAB ECU_ADDRESS 0xFFF97C7C /end MEASUREMENT
/begin MEASUREMENT ZFFSAB._.EEpromZentralHandler.eepromChannel[18].cnt_SetEEpromWriteProtect "Call counter off function" UBYTE SAB_STANDARD_S2_S3 1 100 0 255 DISPLAY_IDENTIFIER cnt_SetEEpromWriteProtect.eepromChannel[18].EEpromZentralHandler._.ZFFSAB ECU_ADDRESS 0xFFF97C7D /end MEASUREMENT
/begin MEASUREMENT ZFFSAB._.EEpromZentralHandler.eepromChannel[19].ZFFSAB._.cEEpromChannel._.cnt_GetEEpromValid "Call counter off function" UBYTE SAB_STANDARD_S2_S3 1 100 0 255 DISPLAY_IDENTIFIER cnt_GetEEpromValid._.cEEpromChannel._.ZFFSAB.eepromChannel[19].EEpromZentralHandler._.ZFFSAB ECU_ADDRESS 0xFFF97C7E /end MEASUREMENT
/begin MEASUREMENT ZFFSAB._.EEpromZentralHandler.eepromChannel[19].ZFFSAB._.cEEpromChannel._.ret_GetEEpromValid "Return value off function" UBYTE SAB_STANDARD_S2_S3 1 100 0 255 DISPLAY_IDENTIFIER ret_GetEEpromValid._.cEEpromChannel._.ZFFSAB.eepromChannel[19].EEpromZentralHandler._.ZFFSAB ECU_ADDRESS 0xFFF97C7F /end MEASUREMENT
/begin MEASUREMENT ZFFSAB._.EEpromZentralHandler.eepromChannel[19].ZFFSAB._.cEEpromChannel._.cnt_GetEEpromUpdate "Call counter off function" UBYTE SAB_STANDARD_S2_S3 1 100 0 255 DISPLAY_IDENTIFIER cnt_GetEEpromUpdate._.cEEpromChannel._.ZFFSAB.eepromChannel[19].EEpromZentralHandler._.ZFFSAB ECU_ADDRESS 0xFFF97C80 /end MEASUREMENT
/begin MEASUREMENT ZFFSAB._.EEpromZentralHandler.eepromChannel[19].ZFFSAB._.cEEpromChannel._.ret_GetEEpromUpdate "Return value off function" UBYTE SAB_STANDARD_S2_S3 1 100 0 255 DISPLAY_IDENTIFIER ret_GetEEpromUpdate._.cEEpromChannel._.ZFFSAB.eepromChannel[19].EEpromZentralHandler._.ZFFSAB ECU_ADDRESS 0xFFF97C81 /end MEASUREMENT
/begin MEASUREMENT ZFFSAB._.EEpromZentralHandler.eepromChannel[19].ZFFSAB._.cEEpromChannel._.cnt_SetEEpromInitZyklisch "Call counter off function" UBYTE SAB_STANDARD_S2_S3 1 100 0 255 DISPLAY_IDENTIFIER cnt_SetEEpromInitZyklisch._.cEEpromChannel._.ZFFSAB.eepromChannel[19].EEpromZentralHandler._.ZFFSAB ECU_ADDRESS 0xFFF97C82 /end MEASUREMENT
/begin MEASUREMENT ZFFSAB._.EEpromZentralHandler.eepromChannel[19].ZFFSAB._.cEEpromChannel._.ret_SetEEpromInitZyklisch "Return value off function" UBYTE SAB_STANDARD_S2_S3 1 100 0 255 DISPLAY_IDENTIFIER ret_SetEEpromInitZyklisch._.cEEpromChannel._.ZFFSAB.eepromChannel[19].EEpromZentralHandler._.ZFFSAB ECU_ADDRESS 0xFFF97C83 /end MEASUREMENT
/begin MEASUREMENT ZFFSAB._.EEpromZentralHandler.eepromChannel[19].ZFFSAB._.cEEpromChannel._.eeprom_info "argument of SetEEpromInitZyklisch" UBYTE SAB_STANDARD_S2_S3 1 100 0 255 DISPLAY_IDENTIFIER eeprom_info._.cEEpromChannel._.ZFFSAB.eepromChannel[19].EEpromZentralHandler._.ZFFSAB ECU_ADDRESS 0xFFF97C84 /end MEASUREMENT
/begin MEASUREMENT ZFFSAB._.EEpromZentralHandler.eepromChannel[19].ZFFSAB._.cEEpromChannel._.cnt_GetSizeofEEpromData "Call counter off function" UBYTE SAB_STANDARD_S2_S3 1 100 0 255 DISPLAY_IDENTIFIER cnt_GetSizeofEEpromData._.cEEpromChannel._.ZFFSAB.eepromChannel[19].EEpromZentralHandler._.ZFFSAB ECU_ADDRESS 0xFFF97C85 /end MEASUREMENT
/begin MEASUREMENT ZFFSAB._.EEpromZentralHandler.eepromChannel[19].ZFFSAB._.cEEpromChannel._.ret_GetSizeofEEpromData "Return value off function" UWORD SAB_STANDARD_S2_S3 1 100 0 65535 DISPLAY_IDENTIFIER ret_GetSizeofEEpromData._.cEEpromChannel._.ZFFSAB.eepromChannel[19].EEpromZentralHandler._.ZFFSAB ECU_ADDRESS 0xFFF97C86 /end MEASUREMENT
/begin MEASUREMENT ZFFSAB._.EEpromZentralHandler.eepromChannel[19].cnt_CallEEpromStoreImmediate "Call counter off function" UBYTE SAB_STANDARD_S2_S3 1 100 0 255 DISPLAY_IDENTIFIER cnt_CallEEpromStoreImmediate.eepromChannel[19].EEpromZentralHandler._.ZFFSAB ECU_ADDRESS 0xFFF97C88 /end MEASUREMENT
/begin MEASUREMENT ZFFSAB._.EEpromZentralHandler.eepromChannel[19].ret_CallEEpromStoreImmediate "Return value off function" UBYTE SAB_STANDARD_S2_S3 1 100 0 255 DISPLAY_IDENTIFIER ret_CallEEpromStoreImmediate.eepromChannel[19].EEpromZentralHandler._.ZFFSAB ECU_ADDRESS 0xFFF97C89 /end MEASUREMENT
/begin MEASUREMENT ZFFSAB._.EEpromZentralHandler.eepromChannel[19].cnt_CallEEpromLoadData "Call counter off function" UBYTE SAB_STANDARD_S2_S3 1 100 0 255 DISPLAY_IDENTIFIER cnt_CallEEpromLoadData.eepromChannel[19].EEpromZentralHandler._.ZFFSAB ECU_ADDRESS 0xFFF97C8A /end MEASUREMENT
/begin MEASUREMENT ZFFSAB._.EEpromZentralHandler.eepromChannel[19].ret_CallEEpromLoadData "Return value off function" UBYTE SAB_STANDARD_S2_S3 1 100 0 255 DISPLAY_IDENTIFIER ret_CallEEpromLoadData.eepromChannel[19].EEpromZentralHandler._.ZFFSAB ECU_ADDRESS 0xFFF97C8B /end MEASUREMENT
/begin MEASUREMENT ZFFSAB._.EEpromZentralHandler.eepromChannel[19].cnt_CallEEpromLoadDataState "Call counter off function" UBYTE SAB_STANDARD_S2_S3 1 100 0 255 DISPLAY_IDENTIFIER cnt_CallEEpromLoadDataState.eepromChannel[19].EEpromZentralHandler._.ZFFSAB ECU_ADDRESS 0xFFF97C8C /end MEASUREMENT
/begin MEASUREMENT ZFFSAB._.EEpromZentralHandler.eepromChannel[19].ret_CallEEpromLoadDataState "Return value off function" UBYTE SAB_STANDARD_S2_S3 1 100 0 255 DISPLAY_IDENTIFIER ret_CallEEpromLoadDataState.eepromChannel[19].EEpromZentralHandler._.ZFFSAB ECU_ADDRESS 0xFFF97C8D /end MEASUREMENT
/begin MEASUREMENT ZFFSAB._.EEpromZentralHandler.eepromChannel[19].mode "argument of SetEEpromInitZyklisch" UBYTE SAB_STANDARD_S2_S3 1 100 0 255 DISPLAY_IDENTIFIER mode.eepromChannel[19].EEpromZentralHandler._.ZFFSAB ECU_ADDRESS 0xFFF97C8E /end MEASUREMENT
/begin MEASUREMENT ZFFSAB._.EEpromZentralHandler.eepromChannel[19].cnt_SetEEpromWriteProtect "Call counter off function" UBYTE SAB_STANDARD_S2_S3 1 100 0 255 DISPLAY_IDENTIFIER cnt_SetEEpromWriteProtect.eepromChannel[19].EEpromZentralHandler._.ZFFSAB ECU_ADDRESS 0xFFF97C8F /end MEASUREMENT
/begin MEASUREMENT ZFFSAB._.EEpromZentralHandler.eepromChannel[20].ZFFSAB._.cEEpromChannel._.cnt_GetEEpromValid "Call counter off function" UBYTE SAB_STANDARD_S2_S3 1 100 0 255 DISPLAY_IDENTIFIER cnt_GetEEpromValid._.cEEpromChannel._.ZFFSAB.eepromChannel[20].EEpromZentralHandler._.ZFFSAB ECU_ADDRESS 0xFFF97C90 /end MEASUREMENT
/begin MEASUREMENT ZFFSAB._.EEpromZentralHandler.eepromChannel[20].ZFFSAB._.cEEpromChannel._.ret_GetEEpromValid "Return value off function" UBYTE SAB_STANDARD_S2_S3 1 100 0 255 DISPLAY_IDENTIFIER ret_GetEEpromValid._.cEEpromChannel._.ZFFSAB.eepromChannel[20].EEpromZentralHandler._.ZFFSAB ECU_ADDRESS 0xFFF97C91 /end MEASUREMENT
/begin MEASUREMENT ZFFSAB._.EEpromZentralHandler.eepromChannel[20].ZFFSAB._.cEEpromChannel._.cnt_GetEEpromUpdate "Call counter off function" UBYTE SAB_STANDARD_S2_S3 1 100 0 255 DISPLAY_IDENTIFIER cnt_GetEEpromUpdate._.cEEpromChannel._.ZFFSAB.eepromChannel[20].EEpromZentralHandler._.ZFFSAB ECU_ADDRESS 0xFFF97C92 /end MEASUREMENT
/begin MEASUREMENT ZFFSAB._.EEpromZentralHandler.eepromChannel[20].ZFFSAB._.cEEpromChannel._.ret_GetEEpromUpdate "Return value off function" UBYTE SAB_STANDARD_S2_S3 1 100 0 255 DISPLAY_IDENTIFIER ret_GetEEpromUpdate._.cEEpromChannel._.ZFFSAB.eepromChannel[20].EEpromZentralHandler._.ZFFSAB ECU_ADDRESS 0xFFF97C93 /end MEASUREMENT
/begin MEASUREMENT ZFFSAB._.EEpromZentralHandler.eepromChannel[20].ZFFSAB._.cEEpromChannel._.cnt_SetEEpromInitZyklisch "Call counter off function" UBYTE SAB_STANDARD_S2_S3 1 100 0 255 DISPLAY_IDENTIFIER cnt_SetEEpromInitZyklisch._.cEEpromChannel._.ZFFSAB.eepromChannel[20].EEpromZentralHandler._.ZFFSAB ECU_ADDRESS 0xFFF97C94 /end MEASUREMENT
/begin MEASUREMENT ZFFSAB._.EEpromZentralHandler.eepromChannel[20].ZFFSAB._.cEEpromChannel._.ret_SetEEpromInitZyklisch "Return value off function" UBYTE SAB_STANDARD_S2_S3 1 100 0 255 DISPLAY_IDENTIFIER ret_SetEEpromInitZyklisch._.cEEpromChannel._.ZFFSAB.eepromChannel[20].EEpromZentralHandler._.ZFFSAB ECU_ADDRESS 0xFFF97C95 /end MEASUREMENT
/begin MEASUREMENT ZFFSAB._.EEpromZentralHandler.eepromChannel[20].ZFFSAB._.cEEpromChannel._.eeprom_info "argument of SetEEpromInitZyklisch" UBYTE SAB_STANDARD_S2_S3 1 100 0 255 DISPLAY_IDENTIFIER eeprom_info._.cEEpromChannel._.ZFFSAB.eepromChannel[20].EEpromZentralHandler._.ZFFSAB ECU_ADDRESS 0xFFF97C96 /end MEASUREMENT
/begin MEASUREMENT ZFFSAB._.EEpromZentralHandler.eepromChannel[20].ZFFSAB._.cEEpromChannel._.cnt_GetSizeofEEpromData "Call counter off function" UBYTE SAB_STANDARD_S2_S3 1 100 0 255 DISPLAY_IDENTIFIER cnt_GetSizeofEEpromData._.cEEpromChannel._.ZFFSAB.eepromChannel[20].EEpromZentralHandler._.ZFFSAB ECU_ADDRESS 0xFFF97C97 /end MEASUREMENT
/begin MEASUREMENT ZFFSAB._.EEpromZentralHandler.eepromChannel[20].ZFFSAB._.cEEpromChannel._.ret_GetSizeofEEpromData "Return value off function" UWORD SAB_STANDARD_S2_S3 1 100 0 65535 DISPLAY_IDENTIFIER ret_GetSizeofEEpromData._.cEEpromChannel._.ZFFSAB.eepromChannel[20].EEpromZentralHandler._.ZFFSAB ECU_ADDRESS 0xFFF97C98 /end MEASUREMENT
/begin MEASUREMENT ZFFSAB._.EEpromZentralHandler.eepromChannel[20].cnt_CallEEpromStoreImmediate "Call counter off function" UBYTE SAB_STANDARD_S2_S3 1 100 0 255 DISPLAY_IDENTIFIER cnt_CallEEpromStoreImmediate.eepromChannel[20].EEpromZentralHandler._.ZFFSAB ECU_ADDRESS 0xFFF97C9A /end MEASUREMENT
/begin MEASUREMENT ZFFSAB._.EEpromZentralHandler.eepromChannel[20].ret_CallEEpromStoreImmediate "Return value off function" UBYTE SAB_STANDARD_S2_S3 1 100 0 255 DISPLAY_IDENTIFIER ret_CallEEpromStoreImmediate.eepromChannel[20].EEpromZentralHandler._.ZFFSAB ECU_ADDRESS 0xFFF97C9B /end MEASUREMENT
/begin MEASUREMENT ZFFSAB._.EEpromZentralHandler.eepromChannel[20].cnt_CallEEpromLoadData "Call counter off function" UBYTE SAB_STANDARD_S2_S3 1 100 0 255 DISPLAY_IDENTIFIER cnt_CallEEpromLoadData.eepromChannel[20].EEpromZentralHandler._.ZFFSAB ECU_ADDRESS 0xFFF97C9C /end MEASUREMENT
/begin MEASUREMENT ZFFSAB._.EEpromZentralHandler.eepromChannel[20].ret_CallEEpromLoadData "Return value off function" UBYTE SAB_STANDARD_S2_S3 1 100 0 255 DISPLAY_IDENTIFIER ret_CallEEpromLoadData.eepromChannel[20].EEpromZentralHandler._.ZFFSAB ECU_ADDRESS 0xFFF97C9D /end MEASUREMENT
/begin MEASUREMENT ZFFSAB._.EEpromZentralHandler.eepromChannel[20].cnt_CallEEpromLoadDataState "Call counter off function" UBYTE SAB_STANDARD_S2_S3 1 100 0 255 DISPLAY_IDENTIFIER cnt_CallEEpromLoadDataState.eepromChannel[20].EEpromZentralHandler._.ZFFSAB ECU_ADDRESS 0xFFF97C9E /end MEASUREMENT
/begin MEASUREMENT ZFFSAB._.EEpromZentralHandler.eepromChannel[20].ret_CallEEpromLoadDataState "Return value off function" UBYTE SAB_STANDARD_S2_S3 1 100 0 255 DISPLAY_IDENTIFIER ret_CallEEpromLoadDataState.eepromChannel[20].EEpromZentralHandler._.ZFFSAB ECU_ADDRESS 0xFFF97C9F /end MEASUREMENT
/begin MEASUREMENT ZFFSAB._.EEpromZentralHandler.eepromChannel[20].mode "argument of SetEEpromInitZyklisch" UBYTE SAB_STANDARD_S2_S3 1 100 0 255 DISPLAY_IDENTIFIER mode.eepromChannel[20].EEpromZentralHandler._.ZFFSAB ECU_ADDRESS 0xFFF97CA0 /end MEASUREMENT
/begin MEASUREMENT ZFFSAB._.EEpromZentralHandler.eepromChannel[20].cnt_SetEEpromWriteProtect "Call counter off function" UBYTE SAB_STANDARD_S2_S3 1 100 0 255 DISPLAY_IDENTIFIER cnt_SetEEpromWriteProtect.eepromChannel[20].EEpromZentralHandler._.ZFFSAB ECU_ADDRESS 0xFFF97CA1 /end MEASUREMENT
/begin MEASUREMENT ZFFSAB._.EEpromZentralHandler.eepromChannel[21].ZFFSAB._.cEEpromChannel._.cnt_GetEEpromValid "Call counter off function" UBYTE SAB_STANDARD_S2_S3 1 100 0 255 DISPLAY_IDENTIFIER cnt_GetEEpromValid._.cEEpromChannel._.ZFFSAB.eepromChannel[21].EEpromZentralHandler._.ZFFSAB ECU_ADDRESS 0xFFF97CA2 /end MEASUREMENT
/begin MEASUREMENT ZFFSAB._.EEpromZentralHandler.eepromChannel[21].ZFFSAB._.cEEpromChannel._.ret_GetEEpromValid "Return value off function" UBYTE SAB_STANDARD_S2_S3 1 100 0 255 DISPLAY_IDENTIFIER ret_GetEEpromValid._.cEEpromChannel._.ZFFSAB.eepromChannel[21].EEpromZentralHandler._.ZFFSAB ECU_ADDRESS 0xFFF97CA3 /end MEASUREMENT
/begin MEASUREMENT ZFFSAB._.EEpromZentralHandler.eepromChannel[21].ZFFSAB._.cEEpromChannel._.cnt_GetEEpromUpdate "Call counter off function" UBYTE SAB_STANDARD_S2_S3 1 100 0 255 DISPLAY_IDENTIFIER cnt_GetEEpromUpdate._.cEEpromChannel._.ZFFSAB.eepromChannel[21].EEpromZentralHandler._.ZFFSAB ECU_ADDRESS 0xFFF97CA4 /end MEASUREMENT
/begin MEASUREMENT ZFFSAB._.EEpromZentralHandler.eepromChannel[21].ZFFSAB._.cEEpromChannel._.ret_GetEEpromUpdate "Return value off function" UBYTE SAB_STANDARD_S2_S3 1 100 0 255 DISPLAY_IDENTIFIER ret_GetEEpromUpdate._.cEEpromChannel._.ZFFSAB.eepromChannel[21].EEpromZentralHandler._.ZFFSAB ECU_ADDRESS 0xFFF97CA5 /end MEASUREMENT
/begin MEASUREMENT ZFFSAB._.EEpromZentralHandler.eepromChannel[21].ZFFSAB._.cEEpromChannel._.cnt_SetEEpromInitZyklisch "Call counter off function" UBYTE SAB_STANDARD_S2_S3 1 100 0 255 DISPLAY_IDENTIFIER cnt_SetEEpromInitZyklisch._.cEEpromChannel._.ZFFSAB.eepromChannel[21].EEpromZentralHandler._.ZFFSAB ECU_ADDRESS 0xFFF97CA6 /end MEASUREMENT
/begin MEASUREMENT ZFFSAB._.EEpromZentralHandler.eepromChannel[21].ZFFSAB._.cEEpromChannel._.ret_SetEEpromInitZyklisch "Return value off function" UBYTE SAB_STANDARD_S2_S3 1 100 0 255 DISPLAY_IDENTIFIER ret_SetEEpromInitZyklisch._.cEEpromChannel._.ZFFSAB.eepromChannel[21].EEpromZentralHandler._.ZFFSAB ECU_ADDRESS 0xFFF97CA7 /end MEASUREMENT
/begin MEASUREMENT ZFFSAB._.EEpromZentralHandler.eepromChannel[21].ZFFSAB._.cEEpromChannel._.eeprom_info "argument of SetEEpromInitZyklisch" UBYTE SAB_STANDARD_S2_S3 1 100 0 255 DISPLAY_IDENTIFIER eeprom_info._.cEEpromChannel._.ZFFSAB.eepromChannel[21].EEpromZentralHandler._.ZFFSAB ECU_ADDRESS 0xFFF97CA8 /end MEASUREMENT
/begin MEASUREMENT ZFFSAB._.EEpromZentralHandler.eepromChannel[21].ZFFSAB._.cEEpromChannel._.cnt_GetSizeofEEpromData "Call counter off function" UBYTE SAB_STANDARD_S2_S3 1 100 0 255 DISPLAY_IDENTIFIER cnt_GetSizeofEEpromData._.cEEpromChannel._.ZFFSAB.eepromChannel[21].EEpromZentralHandler._.ZFFSAB ECU_ADDRESS 0xFFF97CA9 /end MEASUREMENT
/begin MEASUREMENT ZFFSAB._.EEpromZentralHandler.eepromChannel[21].ZFFSAB._.cEEpromChannel._.ret_GetSizeofEEpromData "Return value off function" UWORD SAB_STANDARD_S2_S3 1 100 0 65535 DISPLAY_IDENTIFIER ret_GetSizeofEEpromData._.cEEpromChannel._.ZFFSAB.eepromChannel[21].EEpromZentralHandler._.ZFFSAB ECU_ADDRESS 0xFFF97CAA /end MEASUREMENT
/begin MEASUREMENT ZFFSAB._.EEpromZentralHandler.eepromChannel[21].cnt_CallEEpromStoreImmediate "Call counter off function" UBYTE SAB_STANDARD_S2_S3 1 100 0 255 DISPLAY_IDENTIFIER cnt_CallEEpromStoreImmediate.eepromChannel[21].EEpromZentralHandler._.ZFFSAB ECU_ADDRESS 0xFFF97CAC /end MEASUREMENT
/begin MEASUREMENT ZFFSAB._.EEpromZentralHandler.eepromChannel[21].ret_CallEEpromStoreImmediate "Return value off function" UBYTE SAB_STANDARD_S2_S3 1 100 0 255 DISPLAY_IDENTIFIER ret_CallEEpromStoreImmediate.eepromChannel[21].EEpromZentralHandler._.ZFFSAB ECU_ADDRESS 0xFFF97CAD /end MEASUREMENT
/begin MEASUREMENT ZFFSAB._.EEpromZentralHandler.eepromChannel[21].cnt_CallEEpromLoadData "Call counter off function" UBYTE SAB_STANDARD_S2_S3 1 100 0 255 DISPLAY_IDENTIFIER cnt_CallEEpromLoadData.eepromChannel[21].EEpromZentralHandler._.ZFFSAB ECU_ADDRESS 0xFFF97CAE /end MEASUREMENT
/begin MEASUREMENT ZFFSAB._.EEpromZentralHandler.eepromChannel[21].ret_CallEEpromLoadData "Return value off function" UBYTE SAB_STANDARD_S2_S3 1 100 0 255 DISPLAY_IDENTIFIER ret_CallEEpromLoadData.eepromChannel[21].EEpromZentralHandler._.ZFFSAB ECU_ADDRESS 0xFFF97CAF /end MEASUREMENT
/begin MEASUREMENT ZFFSAB._.EEpromZentralHandler.eepromChannel[21].cnt_CallEEpromLoadDataState "Call counter off function" UBYTE SAB_STANDARD_S2_S3 1 100 0 255 DISPLAY_IDENTIFIER cnt_CallEEpromLoadDataState.eepromChannel[21].EEpromZentralHandler._.ZFFSAB ECU_ADDRESS 0xFFF97CB0 /end MEASUREMENT
/begin MEASUREMENT ZFFSAB._.EEpromZentralHandler.eepromChannel[21].ret_CallEEpromLoadDataState "Return value off function" UBYTE SAB_STANDARD_S2_S3 1 100 0 255 DISPLAY_IDENTIFIER ret_CallEEpromLoadDataState.eepromChannel[21].EEpromZentralHandler._.ZFFSAB ECU_ADDRESS 0xFFF97CB1 /end MEASUREMENT
/begin MEASUREMENT ZFFSAB._.EEpromZentralHandler.eepromChannel[21].mode "argument of SetEEpromInitZyklisch" UBYTE SAB_STANDARD_S2_S3 1 100 0 255 DISPLAY_IDENTIFIER mode.eepromChannel[21].EEpromZentralHandler._.ZFFSAB ECU_ADDRESS 0xFFF97CB2 /end MEASUREMENT
/begin MEASUREMENT ZFFSAB._.EEpromZentralHandler.eepromChannel[21].cnt_SetEEpromWriteProtect "Call counter off function" UBYTE SAB_STANDARD_S2_S3 1 100 0 255 DISPLAY_IDENTIFIER cnt_SetEEpromWriteProtect.eepromChannel[21].EEpromZentralHandler._.ZFFSAB ECU_ADDRESS 0xFFF97CB3 /end MEASUREMENT
/begin MEASUREMENT ZFFSAB._.EEpromZentralHandler.eepromChannel[22].ZFFSAB._.cEEpromChannel._.cnt_GetEEpromValid "Call counter off function" UBYTE SAB_STANDARD_S2_S3 1 100 0 255 DISPLAY_IDENTIFIER cnt_GetEEpromValid._.cEEpromChannel._.ZFFSAB.eepromChannel[22].EEpromZentralHandler._.ZFFSAB ECU_ADDRESS 0xFFF97CB4 /end MEASUREMENT
/begin MEASUREMENT ZFFSAB._.EEpromZentralHandler.eepromChannel[22].ZFFSAB._.cEEpromChannel._.ret_GetEEpromValid "Return value off function" UBYTE SAB_STANDARD_S2_S3 1 100 0 255 DISPLAY_IDENTIFIER ret_GetEEpromValid._.cEEpromChannel._.ZFFSAB.eepromChannel[22].EEpromZentralHandler._.ZFFSAB ECU_ADDRESS 0xFFF97CB5 /end MEASUREMENT
/begin MEASUREMENT ZFFSAB._.EEpromZentralHandler.eepromChannel[22].ZFFSAB._.cEEpromChannel._.cnt_GetEEpromUpdate "Call counter off function" UBYTE SAB_STANDARD_S2_S3 1 100 0 255 DISPLAY_IDENTIFIER cnt_GetEEpromUpdate._.cEEpromChannel._.ZFFSAB.eepromChannel[22].EEpromZentralHandler._.ZFFSAB ECU_ADDRESS 0xFFF97CB6 /end MEASUREMENT
/begin MEASUREMENT ZFFSAB._.EEpromZentralHandler.eepromChannel[22].ZFFSAB._.cEEpromChannel._.ret_GetEEpromUpdate "Return value off function" UBYTE SAB_STANDARD_S2_S3 1 100 0 255 DISPLAY_IDENTIFIER ret_GetEEpromUpdate._.cEEpromChannel._.ZFFSAB.eepromChannel[22].EEpromZentralHandler._.ZFFSAB ECU_ADDRESS 0xFFF97CB7 /end MEASUREMENT
/begin MEASUREMENT ZFFSAB._.EEpromZentralHandler.eepromChannel[22].ZFFSAB._.cEEpromChannel._.cnt_SetEEpromInitZyklisch "Call counter off function" UBYTE SAB_STANDARD_S2_S3 1 100 0 255 DISPLAY_IDENTIFIER cnt_SetEEpromInitZyklisch._.cEEpromChannel._.ZFFSAB.eepromChannel[22].EEpromZentralHandler._.ZFFSAB ECU_ADDRESS 0xFFF97CB8 /end MEASUREMENT
/begin MEASUREMENT ZFFSAB._.EEpromZentralHandler.eepromChannel[22].ZFFSAB._.cEEpromChannel._.ret_SetEEpromInitZyklisch "Return value off function" UBYTE SAB_STANDARD_S2_S3 1 100 0 255 DISPLAY_IDENTIFIER ret_SetEEpromInitZyklisch._.cEEpromChannel._.ZFFSAB.eepromChannel[22].EEpromZentralHandler._.ZFFSAB ECU_ADDRESS 0xFFF97CB9 /end MEASUREMENT
/begin MEASUREMENT ZFFSAB._.EEpromZentralHandler.eepromChannel[22].ZFFSAB._.cEEpromChannel._.eeprom_info "argument of SetEEpromInitZyklisch" UBYTE SAB_STANDARD_S2_S3 1 100 0 255 DISPLAY_IDENTIFIER eeprom_info._.cEEpromChannel._.ZFFSAB.eepromChannel[22].EEpromZentralHandler._.ZFFSAB ECU_ADDRESS 0xFFF97CBA /end MEASUREMENT
/begin MEASUREMENT ZFFSAB._.EEpromZentralHandler.eepromChannel[22].ZFFSAB._.cEEpromChannel._.cnt_GetSizeofEEpromData "Call counter off function" UBYTE SAB_STANDARD_S2_S3 1 100 0 255 DISPLAY_IDENTIFIER cnt_GetSizeofEEpromData._.cEEpromChannel._.ZFFSAB.eepromChannel[22].EEpromZentralHandler._.ZFFSAB ECU_ADDRESS 0xFFF97CBB /end MEASUREMENT
/begin MEASUREMENT ZFFSAB._.EEpromZentralHandler.eepromChannel[22].ZFFSAB._.cEEpromChannel._.ret_GetSizeofEEpromData "Return value off function" UWORD SAB_STANDARD_S2_S3 1 100 0 65535 DISPLAY_IDENTIFIER ret_GetSizeofEEpromData._.cEEpromChannel._.ZFFSAB.eepromChannel[22].EEpromZentralHandler._.ZFFSAB ECU_ADDRESS 0xFFF97CBC /end MEASUREMENT
/begin MEASUREMENT ZFFSAB._.EEpromZentralHandler.eepromChannel[22].cnt_CallEEpromStoreImmediate "Call counter off function" UBYTE SAB_STANDARD_S2_S3 1 100 0 255 DISPLAY_IDENTIFIER cnt_CallEEpromStoreImmediate.eepromChannel[22].EEpromZentralHandler._.ZFFSAB ECU_ADDRESS 0xFFF97CBE /end MEASUREMENT
/begin MEASUREMENT ZFFSAB._.EEpromZentralHandler.eepromChannel[22].ret_CallEEpromStoreImmediate "Return value off function" UBYTE SAB_STANDARD_S2_S3 1 100 0 255 DISPLAY_IDENTIFIER ret_CallEEpromStoreImmediate.eepromChannel[22].EEpromZentralHandler._.ZFFSAB ECU_ADDRESS 0xFFF97CBF /end MEASUREMENT
/begin MEASUREMENT ZFFSAB._.EEpromZentralHandler.eepromChannel[22].cnt_CallEEpromLoadData "Call counter off function" UBYTE SAB_STANDARD_S2_S3 1 100 0 255 DISPLAY_IDENTIFIER cnt_CallEEpromLoadData.eepromChannel[22].EEpromZentralHandler._.ZFFSAB ECU_ADDRESS 0xFFF97CC0 /end MEASUREMENT
/begin MEASUREMENT ZFFSAB._.EEpromZentralHandler.eepromChannel[22].ret_CallEEpromLoadData "Return value off function" UBYTE SAB_STANDARD_S2_S3 1 100 0 255 DISPLAY_IDENTIFIER ret_CallEEpromLoadData.eepromChannel[22].EEpromZentralHandler._.ZFFSAB ECU_ADDRESS 0xFFF97CC1 /end MEASUREMENT
/begin MEASUREMENT ZFFSAB._.EEpromZentralHandler.eepromChannel[22].cnt_CallEEpromLoadDataState "Call counter off function" UBYTE SAB_STANDARD_S2_S3 1 100 0 255 DISPLAY_IDENTIFIER cnt_CallEEpromLoadDataState.eepromChannel[22].EEpromZentralHandler._.ZFFSAB ECU_ADDRESS 0xFFF97CC2 /end MEASUREMENT
/begin MEASUREMENT ZFFSAB._.EEpromZentralHandler.eepromChannel[22].ret_CallEEpromLoadDataState "Return value off function" UBYTE SAB_STANDARD_S2_S3 1 100 0 255 DISPLAY_IDENTIFIER ret_CallEEpromLoadDataState.eepromChannel[22].EEpromZentralHandler._.ZFFSAB ECU_ADDRESS 0xFFF97CC3 /end MEASUREMENT
/begin MEASUREMENT ZFFSAB._.EEpromZentralHandler.eepromChannel[22].mode "argument of SetEEpromInitZyklisch" UBYTE SAB_STANDARD_S2_S3 1 100 0 255 DISPLAY_IDENTIFIER mode.eepromChannel[22].EEpromZentralHandler._.ZFFSAB ECU_ADDRESS 0xFFF97CC4 /end MEASUREMENT
/begin MEASUREMENT ZFFSAB._.EEpromZentralHandler.eepromChannel[22].cnt_SetEEpromWriteProtect "Call counter off function" UBYTE SAB_STANDARD_S2_S3 1 100 0 255 DISPLAY_IDENTIFIER cnt_SetEEpromWriteProtect.eepromChannel[22].EEpromZentralHandler._.ZFFSAB ECU_ADDRESS 0xFFF97CC5 /end MEASUREMENT
/begin MEASUREMENT ZFFSAB._.EEpromZentralHandler.eepromChannel[23].ZFFSAB._.cEEpromChannel._.cnt_GetEEpromValid "Call counter off function" UBYTE SAB_STANDARD_S2_S3 1 100 0 255 DISPLAY_IDENTIFIER cnt_GetEEpromValid._.cEEpromChannel._.ZFFSAB.eepromChannel[23].EEpromZentralHandler._.ZFFSAB ECU_ADDRESS 0xFFF97CC6 /end MEASUREMENT
/begin MEASUREMENT ZFFSAB._.EEpromZentralHandler.eepromChannel[23].ZFFSAB._.cEEpromChannel._.ret_GetEEpromValid "Return value off function" UBYTE SAB_STANDARD_S2_S3 1 100 0 255 DISPLAY_IDENTIFIER ret_GetEEpromValid._.cEEpromChannel._.ZFFSAB.eepromChannel[23].EEpromZentralHandler._.ZFFSAB ECU_ADDRESS 0xFFF97CC7 /end MEASUREMENT
/begin MEASUREMENT ZFFSAB._.EEpromZentralHandler.eepromChannel[23].ZFFSAB._.cEEpromChannel._.cnt_GetEEpromUpdate "Call counter off function" UBYTE SAB_STANDARD_S2_S3 1 100 0 255 DISPLAY_IDENTIFIER cnt_GetEEpromUpdate._.cEEpromChannel._.ZFFSAB.eepromChannel[23].EEpromZentralHandler._.ZFFSAB ECU_ADDRESS 0xFFF97CC8 /end MEASUREMENT
/begin MEASUREMENT ZFFSAB._.EEpromZentralHandler.eepromChannel[23].ZFFSAB._.cEEpromChannel._.ret_GetEEpromUpdate "Return value off function" UBYTE SAB_STANDARD_S2_S3 1 100 0 255 DISPLAY_IDENTIFIER ret_GetEEpromUpdate._.cEEpromChannel._.ZFFSAB.eepromChannel[23].EEpromZentralHandler._.ZFFSAB ECU_ADDRESS 0xFFF97CC9 /end MEASUREMENT
/begin MEASUREMENT ZFFSAB._.EEpromZentralHandler.eepromChannel[23].ZFFSAB._.cEEpromChannel._.cnt_SetEEpromInitZyklisch "Call counter off function" UBYTE SAB_STANDARD_S2_S3 1 100 0 255 DISPLAY_IDENTIFIER cnt_SetEEpromInitZyklisch._.cEEpromChannel._.ZFFSAB.eepromChannel[23].EEpromZentralHandler._.ZFFSAB ECU_ADDRESS 0xFFF97CCA /end MEASUREMENT
/begin MEASUREMENT ZFFSAB._.EEpromZentralHandler.eepromChannel[23].ZFFSAB._.cEEpromChannel._.ret_SetEEpromInitZyklisch "Return value off function" UBYTE SAB_STANDARD_S2_S3 1 100 0 255 DISPLAY_IDENTIFIER ret_SetEEpromInitZyklisch._.cEEpromChannel._.ZFFSAB.eepromChannel[23].EEpromZentralHandler._.ZFFSAB ECU_ADDRESS 0xFFF97CCB /end MEASUREMENT
/begin MEASUREMENT ZFFSAB._.EEpromZentralHandler.eepromChannel[23].ZFFSAB._.cEEpromChannel._.eeprom_info "argument of SetEEpromInitZyklisch" UBYTE SAB_STANDARD_S2_S3 1 100 0 255 DISPLAY_IDENTIFIER eeprom_info._.cEEpromChannel._.ZFFSAB.eepromChannel[23].EEpromZentralHandler._.ZFFSAB ECU_ADDRESS 0xFFF97CCC /end MEASUREMENT
/begin MEASUREMENT ZFFSAB._.EEpromZentralHandler.eepromChannel[23].ZFFSAB._.cEEpromChannel._.cnt_GetSizeofEEpromData "Call counter off function" UBYTE SAB_STANDARD_S2_S3 1 100 0 255 DISPLAY_IDENTIFIER cnt_GetSizeofEEpromData._.cEEpromChannel._.ZFFSAB.eepromChannel[23].EEpromZentralHandler._.ZFFSAB ECU_ADDRESS 0xFFF97CCD /end MEASUREMENT
/begin MEASUREMENT ZFFSAB._.EEpromZentralHandler.eepromChannel[23].ZFFSAB._.cEEpromChannel._.ret_GetSizeofEEpromData "Return value off function" UWORD SAB_STANDARD_S2_S3 1 100 0 65535 DISPLAY_IDENTIFIER ret_GetSizeofEEpromData._.cEEpromChannel._.ZFFSAB.eepromChannel[23].EEpromZentralHandler._.ZFFSAB ECU_ADDRESS 0xFFF97CCE /end MEASUREMENT
/begin MEASUREMENT ZFFSAB._.EEpromZentralHandler.eepromChannel[23].cnt_CallEEpromStoreImmediate "Call counter off function" UBYTE SAB_STANDARD_S2_S3 1 100 0 255 DISPLAY_IDENTIFIER cnt_CallEEpromStoreImmediate.eepromChannel[23].EEpromZentralHandler._.ZFFSAB ECU_ADDRESS 0xFFF97CD0 /end MEASUREMENT
/begin MEASUREMENT ZFFSAB._.EEpromZentralHandler.eepromChannel[23].ret_CallEEpromStoreImmediate "Return value off function" UBYTE SAB_STANDARD_S2_S3 1 100 0 255 DISPLAY_IDENTIFIER ret_CallEEpromStoreImmediate.eepromChannel[23].EEpromZentralHandler._.ZFFSAB ECU_ADDRESS 0xFFF97CD1 /end MEASUREMENT
/begin MEASUREMENT ZFFSAB._.EEpromZentralHandler.eepromChannel[23].cnt_CallEEpromLoadData "Call counter off function" UBYTE SAB_STANDARD_S2_S3 1 100 0 255 DISPLAY_IDENTIFIER cnt_CallEEpromLoadData.eepromChannel[23].EEpromZentralHandler._.ZFFSAB ECU_ADDRESS 0xFFF97CD2 /end MEASUREMENT
/begin MEASUREMENT ZFFSAB._.EEpromZentralHandler.eepromChannel[23].ret_CallEEpromLoadData "Return value off function" UBYTE SAB_STANDARD_S2_S3 1 100 0 255 DISPLAY_IDENTIFIER ret_CallEEpromLoadData.eepromChannel[23].EEpromZentralHandler._.ZFFSAB ECU_ADDRESS 0xFFF97CD3 /end MEASUREMENT
/begin MEASUREMENT ZFFSAB._.EEpromZentralHandler.eepromChannel[23].cnt_CallEEpromLoadDataState "Call counter off function" UBYTE SAB_STANDARD_S2_S3 1 100 0 255 DISPLAY_IDENTIFIER cnt_CallEEpromLoadDataState.eepromChannel[23].EEpromZentralHandler._.ZFFSAB ECU_ADDRESS 0xFFF97CD4 /end MEASUREMENT
/begin MEASUREMENT ZFFSAB._.EEpromZentralHandler.eepromChannel[23].ret_CallEEpromLoadDataState "Return value off function" UBYTE SAB_STANDARD_S2_S3 1 100 0 255 DISPLAY_IDENTIFIER ret_CallEEpromLoadDataState.eepromChannel[23].EEpromZentralHandler._.ZFFSAB ECU_ADDRESS 0xFFF97CD5 /end MEASUREMENT
/begin MEASUREMENT ZFFSAB._.EEpromZentralHandler.eepromChannel[23].mode "argument of SetEEpromInitZyklisch" UBYTE SAB_STANDARD_S2_S3 1 100 0 255 DISPLAY_IDENTIFIER mode.eepromChannel[23].EEpromZentralHandler._.ZFFSAB ECU_ADDRESS 0xFFF97CD6 /end MEASUREMENT
/begin MEASUREMENT ZFFSAB._.EEpromZentralHandler.eepromChannel[23].cnt_SetEEpromWriteProtect "Call counter off function" UBYTE SAB_STANDARD_S2_S3 1 100 0 255 DISPLAY_IDENTIFIER cnt_SetEEpromWriteProtect.eepromChannel[23].EEpromZentralHandler._.ZFFSAB ECU_ADDRESS 0xFFF97CD7 /end MEASUREMENT
/begin MEASUREMENT ZFFSAB._.EEpromZentralHandler.eepromChannel[24].ZFFSAB._.cEEpromChannel._.cnt_GetEEpromValid "Call counter off function" UBYTE SAB_STANDARD_S2_S3 1 100 0 255 DISPLAY_IDENTIFIER cnt_GetEEpromValid._.cEEpromChannel._.ZFFSAB.eepromChannel[24].EEpromZentralHandler._.ZFFSAB ECU_ADDRESS 0xFFF97CD8 /end MEASUREMENT
/begin MEASUREMENT ZFFSAB._.EEpromZentralHandler.eepromChannel[24].ZFFSAB._.cEEpromChannel._.ret_GetEEpromValid "Return value off function" UBYTE SAB_STANDARD_S2_S3 1 100 0 255 DISPLAY_IDENTIFIER ret_GetEEpromValid._.cEEpromChannel._.ZFFSAB.eepromChannel[24].EEpromZentralHandler._.ZFFSAB ECU_ADDRESS 0xFFF97CD9 /end MEASUREMENT
/begin MEASUREMENT ZFFSAB._.EEpromZentralHandler.eepromChannel[24].ZFFSAB._.cEEpromChannel._.cnt_GetEEpromUpdate "Call counter off function" UBYTE SAB_STANDARD_S2_S3 1 100 0 255 DISPLAY_IDENTIFIER cnt_GetEEpromUpdate._.cEEpromChannel._.ZFFSAB.eepromChannel[24].EEpromZentralHandler._.ZFFSAB ECU_ADDRESS 0xFFF97CDA /end MEASUREMENT
/begin MEASUREMENT ZFFSAB._.EEpromZentralHandler.eepromChannel[24].ZFFSAB._.cEEpromChannel._.ret_GetEEpromUpdate "Return value off function" UBYTE SAB_STANDARD_S2_S3 1 100 0 255 DISPLAY_IDENTIFIER ret_GetEEpromUpdate._.cEEpromChannel._.ZFFSAB.eepromChannel[24].EEpromZentralHandler._.ZFFSAB ECU_ADDRESS 0xFFF97CDB /end MEASUREMENT
/begin MEASUREMENT ZFFSAB._.EEpromZentralHandler.eepromChannel[24].ZFFSAB._.cEEpromChannel._.cnt_SetEEpromInitZyklisch "Call counter off function" UBYTE SAB_STANDARD_S2_S3 1 100 0 255 DISPLAY_IDENTIFIER cnt_SetEEpromInitZyklisch._.cEEpromChannel._.ZFFSAB.eepromChannel[24].EEpromZentralHandler._.ZFFSAB ECU_ADDRESS 0xFFF97CDC /end MEASUREMENT
/begin MEASUREMENT ZFFSAB._.EEpromZentralHandler.eepromChannel[24].ZFFSAB._.cEEpromChannel._.ret_SetEEpromInitZyklisch "Return value off function" UBYTE SAB_STANDARD_S2_S3 1 100 0 255 DISPLAY_IDENTIFIER ret_SetEEpromInitZyklisch._.cEEpromChannel._.ZFFSAB.eepromChannel[24].EEpromZentralHandler._.ZFFSAB ECU_ADDRESS 0xFFF97CDD /end MEASUREMENT
/begin MEASUREMENT ZFFSAB._.EEpromZentralHandler.eepromChannel[24].ZFFSAB._.cEEpromChannel._.eeprom_info "argument of SetEEpromInitZyklisch" UBYTE SAB_STANDARD_S2_S3 1 100 0 255 DISPLAY_IDENTIFIER eeprom_info._.cEEpromChannel._.ZFFSAB.eepromChannel[24].EEpromZentralHandler._.ZFFSAB ECU_ADDRESS 0xFFF97CDE /end MEASUREMENT
/begin MEASUREMENT ZFFSAB._.EEpromZentralHandler.eepromChannel[24].ZFFSAB._.cEEpromChannel._.cnt_GetSizeofEEpromData "Call counter off function" UBYTE SAB_STANDARD_S2_S3 1 100 0 255 DISPLAY_IDENTIFIER cnt_GetSizeofEEpromData._.cEEpromChannel._.ZFFSAB.eepromChannel[24].EEpromZentralHandler._.ZFFSAB ECU_ADDRESS 0xFFF97CDF /end MEASUREMENT
/begin MEASUREMENT ZFFSAB._.EEpromZentralHandler.eepromChannel[24].ZFFSAB._.cEEpromChannel._.ret_GetSizeofEEpromData "Return value off function" UWORD SAB_STANDARD_S2_S3 1 100 0 65535 DISPLAY_IDENTIFIER ret_GetSizeofEEpromData._.cEEpromChannel._.ZFFSAB.eepromChannel[24].EEpromZentralHandler._.ZFFSAB ECU_ADDRESS 0xFFF97CE0 /end MEASUREMENT
/begin MEASUREMENT ZFFSAB._.EEpromZentralHandler.eepromChannel[24].cnt_CallEEpromStoreImmediate "Call counter off function" UBYTE SAB_STANDARD_S2_S3 1 100 0 255 DISPLAY_IDENTIFIER cnt_CallEEpromStoreImmediate.eepromChannel[24].EEpromZentralHandler._.ZFFSAB ECU_ADDRESS 0xFFF97CE2 /end MEASUREMENT
/begin MEASUREMENT ZFFSAB._.EEpromZentralHandler.eepromChannel[24].ret_CallEEpromStoreImmediate "Return value off function" UBYTE SAB_STANDARD_S2_S3 1 100 0 255 DISPLAY_IDENTIFIER ret_CallEEpromStoreImmediate.eepromChannel[24].EEpromZentralHandler._.ZFFSAB ECU_ADDRESS 0xFFF97CE3 /end MEASUREMENT
/begin MEASUREMENT ZFFSAB._.EEpromZentralHandler.eepromChannel[24].cnt_CallEEpromLoadData "Call counter off function" UBYTE SAB_STANDARD_S2_S3 1 100 0 255 DISPLAY_IDENTIFIER cnt_CallEEpromLoadData.eepromChannel[24].EEpromZentralHandler._.ZFFSAB ECU_ADDRESS 0xFFF97CE4 /end MEASUREMENT
/begin MEASUREMENT ZFFSAB._.EEpromZentralHandler.eepromChannel[24].ret_CallEEpromLoadData "Return value off function" UBYTE SAB_STANDARD_S2_S3 1 100 0 255 DISPLAY_IDENTIFIER ret_CallEEpromLoadData.eepromChannel[24].EEpromZentralHandler._.ZFFSAB ECU_ADDRESS 0xFFF97CE5 /end MEASUREMENT
/begin MEASUREMENT ZFFSAB._.EEpromZentralHandler.eepromChannel[24].cnt_CallEEpromLoadDataState "Call counter off function" UBYTE SAB_STANDARD_S2_S3 1 100 0 255 DISPLAY_IDENTIFIER cnt_CallEEpromLoadDataState.eepromChannel[24].EEpromZentralHandler._.ZFFSAB ECU_ADDRESS 0xFFF97CE6 /end MEASUREMENT
/begin MEASUREMENT ZFFSAB._.EEpromZentralHandler.eepromChannel[24].ret_CallEEpromLoadDataState "Return value off function" UBYTE SAB_STANDARD_S2_S3 1 100 0 255 DISPLAY_IDENTIFIER ret_CallEEpromLoadDataState.eepromChannel[24].EEpromZentralHandler._.ZFFSAB ECU_ADDRESS 0xFFF97CE7 /end MEASUREMENT
/begin MEASUREMENT ZFFSAB._.EEpromZentralHandler.eepromChannel[24].mode "argument of SetEEpromInitZyklisch" UBYTE SAB_STANDARD_S2_S3 1 100 0 255 DISPLAY_IDENTIFIER mode.eepromChannel[24].EEpromZentralHandler._.ZFFSAB ECU_ADDRESS 0xFFF97CE8 /end MEASUREMENT
/begin MEASUREMENT ZFFSAB._.EEpromZentralHandler.eepromChannel[24].cnt_SetEEpromWriteProtect "Call counter off function" UBYTE SAB_STANDARD_S2_S3 1 100 0 255 DISPLAY_IDENTIFIER cnt_SetEEpromWriteProtect.eepromChannel[24].EEpromZentralHandler._.ZFFSAB ECU_ADDRESS 0xFFF97CE9 /end MEASUREMENT
/begin MEASUREMENT ZFFSAB._.EEpromZentralHandler.eepromChannel[25].ZFFSAB._.cEEpromChannel._.cnt_GetEEpromValid "Call counter off function" UBYTE SAB_STANDARD_S2_S3 1 100 0 255 DISPLAY_IDENTIFIER cnt_GetEEpromValid._.cEEpromChannel._.ZFFSAB.eepromChannel[25].EEpromZentralHandler._.ZFFSAB ECU_ADDRESS 0xFFF97CEA /end MEASUREMENT
/begin MEASUREMENT ZFFSAB._.EEpromZentralHandler.eepromChannel[25].ZFFSAB._.cEEpromChannel._.ret_GetEEpromValid "Return value off function" UBYTE SAB_STANDARD_S2_S3 1 100 0 255 DISPLAY_IDENTIFIER ret_GetEEpromValid._.cEEpromChannel._.ZFFSAB.eepromChannel[25].EEpromZentralHandler._.ZFFSAB ECU_ADDRESS 0xFFF97CEB /end MEASUREMENT
/begin MEASUREMENT ZFFSAB._.EEpromZentralHandler.eepromChannel[25].ZFFSAB._.cEEpromChannel._.cnt_GetEEpromUpdate "Call counter off function" UBYTE SAB_STANDARD_S2_S3 1 100 0 255 DISPLAY_IDENTIFIER cnt_GetEEpromUpdate._.cEEpromChannel._.ZFFSAB.eepromChannel[25].EEpromZentralHandler._.ZFFSAB ECU_ADDRESS 0xFFF97CEC /end MEASUREMENT
/begin MEASUREMENT ZFFSAB._.EEpromZentralHandler.eepromChannel[25].ZFFSAB._.cEEpromChannel._.ret_GetEEpromUpdate "Return value off function" UBYTE SAB_STANDARD_S2_S3 1 100 0 255 DISPLAY_IDENTIFIER ret_GetEEpromUpdate._.cEEpromChannel._.ZFFSAB.eepromChannel[25].EEpromZentralHandler._.ZFFSAB ECU_ADDRESS 0xFFF97CED /end MEASUREMENT
/begin MEASUREMENT ZFFSAB._.EEpromZentralHandler.eepromChannel[25].ZFFSAB._.cEEpromChannel._.cnt_SetEEpromInitZyklisch "Call counter off function" UBYTE SAB_STANDARD_S2_S3 1 100 0 255 DISPLAY_IDENTIFIER cnt_SetEEpromInitZyklisch._.cEEpromChannel._.ZFFSAB.eepromChannel[25].EEpromZentralHandler._.ZFFSAB ECU_ADDRESS 0xFFF97CEE /end MEASUREMENT
/begin MEASUREMENT ZFFSAB._.EEpromZentralHandler.eepromChannel[25].ZFFSAB._.cEEpromChannel._.ret_SetEEpromInitZyklisch "Return value off function" UBYTE SAB_STANDARD_S2_S3 1 100 0 255 DISPLAY_IDENTIFIER ret_SetEEpromInitZyklisch._.cEEpromChannel._.ZFFSAB.eepromChannel[25].EEpromZentralHandler._.ZFFSAB ECU_ADDRESS 0xFFF97CEF /end MEASUREMENT
/begin MEASUREMENT ZFFSAB._.EEpromZentralHandler.eepromChannel[25].ZFFSAB._.cEEpromChannel._.eeprom_info "argument of SetEEpromInitZyklisch" UBYTE SAB_STANDARD_S2_S3 1 100 0 255 DISPLAY_IDENTIFIER eeprom_info._.cEEpromChannel._.ZFFSAB.eepromChannel[25].EEpromZentralHandler._.ZFFSAB ECU_ADDRESS 0xFFF97CF0 /end MEASUREMENT
/begin MEASUREMENT ZFFSAB._.EEpromZentralHandler.eepromChannel[25].ZFFSAB._.cEEpromChannel._.cnt_GetSizeofEEpromData "Call counter off function" UBYTE SAB_STANDARD_S2_S3 1 100 0 255 DISPLAY_IDENTIFIER cnt_GetSizeofEEpromData._.cEEpromChannel._.ZFFSAB.eepromChannel[25].EEpromZentralHandler._.ZFFSAB ECU_ADDRESS 0xFFF97CF1 /end MEASUREMENT
/begin MEASUREMENT ZFFSAB._.EEpromZentralHandler.eepromChannel[25].ZFFSAB._.cEEpromChannel._.ret_GetSizeofEEpromData "Return value off function" UWORD SAB_STANDARD_S2_S3 1 100 0 65535 DISPLAY_IDENTIFIER ret_GetSizeofEEpromData._.cEEpromChannel._.ZFFSAB.eepromChannel[25].EEpromZentralHandler._.ZFFSAB ECU_ADDRESS 0xFFF97CF2 /end MEASUREMENT
/begin MEASUREMENT ZFFSAB._.EEpromZentralHandler.eepromChannel[25].cnt_CallEEpromStoreImmediate "Call counter off function" UBYTE SAB_STANDARD_S2_S3 1 100 0 255 DISPLAY_IDENTIFIER cnt_CallEEpromStoreImmediate.eepromChannel[25].EEpromZentralHandler._.ZFFSAB ECU_ADDRESS 0xFFF97CF4 /end MEASUREMENT
/begin MEASUREMENT ZFFSAB._.EEpromZentralHandler.eepromChannel[25].ret_CallEEpromStoreImmediate "Return value off function" UBYTE SAB_STANDARD_S2_S3 1 100 0 255 DISPLAY_IDENTIFIER ret_CallEEpromStoreImmediate.eepromChannel[25].EEpromZentralHandler._.ZFFSAB ECU_ADDRESS 0xFFF97CF5 /end MEASUREMENT
/begin MEASUREMENT ZFFSAB._.EEpromZentralHandler.eepromChannel[25].cnt_CallEEpromLoadData "Call counter off function" UBYTE SAB_STANDARD_S2_S3 1 100 0 255 DISPLAY_IDENTIFIER cnt_CallEEpromLoadData.eepromChannel[25].EEpromZentralHandler._.ZFFSAB ECU_ADDRESS 0xFFF97CF6 /end MEASUREMENT
/begin MEASUREMENT ZFFSAB._.EEpromZentralHandler.eepromChannel[25].ret_CallEEpromLoadData "Return value off function" UBYTE SAB_STANDARD_S2_S3 1 100 0 255 DISPLAY_IDENTIFIER ret_CallEEpromLoadData.eepromChannel[25].EEpromZentralHandler._.ZFFSAB ECU_ADDRESS 0xFFF97CF7 /end MEASUREMENT
/begin MEASUREMENT ZFFSAB._.EEpromZentralHandler.eepromChannel[25].cnt_CallEEpromLoadDataState "Call counter off function" UBYTE SAB_STANDARD_S2_S3 1 100 0 255 DISPLAY_IDENTIFIER cnt_CallEEpromLoadDataState.eepromChannel[25].EEpromZentralHandler._.ZFFSAB ECU_ADDRESS 0xFFF97CF8 /end MEASUREMENT
/begin MEASUREMENT ZFFSAB._.EEpromZentralHandler.eepromChannel[25].ret_CallEEpromLoadDataState "Return value off function" UBYTE SAB_STANDARD_S2_S3 1 100 0 255 DISPLAY_IDENTIFIER ret_CallEEpromLoadDataState.eepromChannel[25].EEpromZentralHandler._.ZFFSAB ECU_ADDRESS 0xFFF97CF9 /end MEASUREMENT
/begin MEASUREMENT ZFFSAB._.EEpromZentralHandler.eepromChannel[25].mode "argument of SetEEpromInitZyklisch" UBYTE SAB_STANDARD_S2_S3 1 100 0 255 DISPLAY_IDENTIFIER mode.eepromChannel[25].EEpromZentralHandler._.ZFFSAB ECU_ADDRESS 0xFFF97CFA /end MEASUREMENT
/begin MEASUREMENT ZFFSAB._.EEpromZentralHandler.eepromChannel[25].cnt_SetEEpromWriteProtect "Call counter off function" UBYTE SAB_STANDARD_S2_S3 1 100 0 255 DISPLAY_IDENTIFIER cnt_SetEEpromWriteProtect.eepromChannel[25].EEpromZentralHandler._.ZFFSAB ECU_ADDRESS 0xFFF97CFB /end MEASUREMENT
/begin MEASUREMENT ZFFSAB._.EEpromZentralHandler.eepromChannel[26].ZFFSAB._.cEEpromChannel._.cnt_GetEEpromValid "Call counter off function" UBYTE SAB_STANDARD_S2_S3 1 100 0 255 DISPLAY_IDENTIFIER cnt_GetEEpromValid._.cEEpromChannel._.ZFFSAB.eepromChannel[26].EEpromZentralHandler._.ZFFSAB ECU_ADDRESS 0xFFF97CFC /end MEASUREMENT
/begin MEASUREMENT ZFFSAB._.EEpromZentralHandler.eepromChannel[26].ZFFSAB._.cEEpromChannel._.ret_GetEEpromValid "Return value off function" UBYTE SAB_STANDARD_S2_S3 1 100 0 255 DISPLAY_IDENTIFIER ret_GetEEpromValid._.cEEpromChannel._.ZFFSAB.eepromChannel[26].EEpromZentralHandler._.ZFFSAB ECU_ADDRESS 0xFFF97CFD /end MEASUREMENT
/begin MEASUREMENT ZFFSAB._.EEpromZentralHandler.eepromChannel[26].ZFFSAB._.cEEpromChannel._.cnt_GetEEpromUpdate "Call counter off function" UBYTE SAB_STANDARD_S2_S3 1 100 0 255 DISPLAY_IDENTIFIER cnt_GetEEpromUpdate._.cEEpromChannel._.ZFFSAB.eepromChannel[26].EEpromZentralHandler._.ZFFSAB ECU_ADDRESS 0xFFF97CFE /end MEASUREMENT
/begin MEASUREMENT ZFFSAB._.EEpromZentralHandler.eepromChannel[26].ZFFSAB._.cEEpromChannel._.ret_GetEEpromUpdate "Return value off function" UBYTE SAB_STANDARD_S2_S3 1 100 0 255 DISPLAY_IDENTIFIER ret_GetEEpromUpdate._.cEEpromChannel._.ZFFSAB.eepromChannel[26].EEpromZentralHandler._.ZFFSAB ECU_ADDRESS 0xFFF97CFF /end MEASUREMENT
/begin MEASUREMENT ZFFSAB._.EEpromZentralHandler.eepromChannel[26].ZFFSAB._.cEEpromChannel._.cnt_SetEEpromInitZyklisch "Call counter off function" UBYTE SAB_STANDARD_S2_S3 1 100 0 255 DISPLAY_IDENTIFIER cnt_SetEEpromInitZyklisch._.cEEpromChannel._.ZFFSAB.eepromChannel[26].EEpromZentralHandler._.ZFFSAB ECU_ADDRESS 0xFFF97D00 /end MEASUREMENT
/begin MEASUREMENT ZFFSAB._.EEpromZentralHandler.eepromChannel[26].ZFFSAB._.cEEpromChannel._.ret_SetEEpromInitZyklisch "Return value off function" UBYTE SAB_STANDARD_S2_S3 1 100 0 255 DISPLAY_IDENTIFIER ret_SetEEpromInitZyklisch._.cEEpromChannel._.ZFFSAB.eepromChannel[26].EEpromZentralHandler._.ZFFSAB ECU_ADDRESS 0xFFF97D01 /end MEASUREMENT
/begin MEASUREMENT ZFFSAB._.EEpromZentralHandler.eepromChannel[26].ZFFSAB._.cEEpromChannel._.eeprom_info "argument of SetEEpromInitZyklisch" UBYTE SAB_STANDARD_S2_S3 1 100 0 255 DISPLAY_IDENTIFIER eeprom_info._.cEEpromChannel._.ZFFSAB.eepromChannel[26].EEpromZentralHandler._.ZFFSAB ECU_ADDRESS 0xFFF97D02 /end MEASUREMENT
/begin MEASUREMENT ZFFSAB._.EEpromZentralHandler.eepromChannel[26].ZFFSAB._.cEEpromChannel._.cnt_GetSizeofEEpromData "Call counter off function" UBYTE SAB_STANDARD_S2_S3 1 100 0 255 DISPLAY_IDENTIFIER cnt_GetSizeofEEpromData._.cEEpromChannel._.ZFFSAB.eepromChannel[26].EEpromZentralHandler._.ZFFSAB ECU_ADDRESS 0xFFF97D03 /end MEASUREMENT
/begin MEASUREMENT ZFFSAB._.EEpromZentralHandler.eepromChannel[26].ZFFSAB._.cEEpromChannel._.ret_GetSizeofEEpromData "Return value off function" UWORD SAB_STANDARD_S2_S3 1 100 0 65535 DISPLAY_IDENTIFIER ret_GetSizeofEEpromData._.cEEpromChannel._.ZFFSAB.eepromChannel[26].EEpromZentralHandler._.ZFFSAB ECU_ADDRESS 0xFFF97D04 /end MEASUREMENT
/begin MEASUREMENT ZFFSAB._.EEpromZentralHandler.eepromChannel[26].cnt_CallEEpromStoreImmediate "Call counter off function" UBYTE SAB_STANDARD_S2_S3 1 100 0 255 DISPLAY_IDENTIFIER cnt_CallEEpromStoreImmediate.eepromChannel[26].EEpromZentralHandler._.ZFFSAB ECU_ADDRESS 0xFFF97D06 /end MEASUREMENT
/begin MEASUREMENT ZFFSAB._.EEpromZentralHandler.eepromChannel[26].ret_CallEEpromStoreImmediate "Return value off function" UBYTE SAB_STANDARD_S2_S3 1 100 0 255 DISPLAY_IDENTIFIER ret_CallEEpromStoreImmediate.eepromChannel[26].EEpromZentralHandler._.ZFFSAB ECU_ADDRESS 0xFFF97D07 /end MEASUREMENT
/begin MEASUREMENT ZFFSAB._.EEpromZentralHandler.eepromChannel[26].cnt_CallEEpromLoadData "Call counter off function" UBYTE SAB_STANDARD_S2_S3 1 100 0 255 DISPLAY_IDENTIFIER cnt_CallEEpromLoadData.eepromChannel[26].EEpromZentralHandler._.ZFFSAB ECU_ADDRESS 0xFFF97D08 /end MEASUREMENT
/begin MEASUREMENT ZFFSAB._.EEpromZentralHandler.eepromChannel[26].ret_CallEEpromLoadData "Return value off function" UBYTE SAB_STANDARD_S2_S3 1 100 0 255 DISPLAY_IDENTIFIER ret_CallEEpromLoadData.eepromChannel[26].EEpromZentralHandler._.ZFFSAB ECU_ADDRESS 0xFFF97D09 /end MEASUREMENT
/begin MEASUREMENT ZFFSAB._.EEpromZentralHandler.eepromChannel[26].cnt_CallEEpromLoadDataState "Call counter off function" UBYTE SAB_STANDARD_S2_S3 1 100 0 255 DISPLAY_IDENTIFIER cnt_CallEEpromLoadDataState.eepromChannel[26].EEpromZentralHandler._.ZFFSAB ECU_ADDRESS 0xFFF97D0A /end MEASUREMENT
/begin MEASUREMENT ZFFSAB._.EEpromZentralHandler.eepromChannel[26].ret_CallEEpromLoadDataState "Return value off function" UBYTE SAB_STANDARD_S2_S3 1 100 0 255 DISPLAY_IDENTIFIER ret_CallEEpromLoadDataState.eepromChannel[26].EEpromZentralHandler._.ZFFSAB ECU_ADDRESS 0xFFF97D0B /end MEASUREMENT
/begin MEASUREMENT ZFFSAB._.EEpromZentralHandler.eepromChannel[26].mode "argument of SetEEpromInitZyklisch" UBYTE SAB_STANDARD_S2_S3 1 100 0 255 DISPLAY_IDENTIFIER mode.eepromChannel[26].EEpromZentralHandler._.ZFFSAB ECU_ADDRESS 0xFFF97D0C /end MEASUREMENT
/begin MEASUREMENT ZFFSAB._.EEpromZentralHandler.eepromChannel[26].cnt_SetEEpromWriteProtect "Call counter off function" UBYTE SAB_STANDARD_S2_S3 1 100 0 255 DISPLAY_IDENTIFIER cnt_SetEEpromWriteProtect.eepromChannel[26].EEpromZentralHandler._.ZFFSAB ECU_ADDRESS 0xFFF97D0D /end MEASUREMENT
/begin MEASUREMENT ZFFSAB._.EEpromZentralHandler.eepromChannel[27].ZFFSAB._.cEEpromChannel._.cnt_GetEEpromValid "Call counter off function" UBYTE SAB_STANDARD_S2_S3 1 100 0 255 DISPLAY_IDENTIFIER cnt_GetEEpromValid._.cEEpromChannel._.ZFFSAB.eepromChannel[27].EEpromZentralHandler._.ZFFSAB ECU_ADDRESS 0xFFF97D0E /end MEASUREMENT
/begin MEASUREMENT ZFFSAB._.EEpromZentralHandler.eepromChannel[27].ZFFSAB._.cEEpromChannel._.ret_GetEEpromValid "Return value off function" UBYTE SAB_STANDARD_S2_S3 1 100 0 255 DISPLAY_IDENTIFIER ret_GetEEpromValid._.cEEpromChannel._.ZFFSAB.eepromChannel[27].EEpromZentralHandler._.ZFFSAB ECU_ADDRESS 0xFFF97D0F /end MEASUREMENT
/begin MEASUREMENT ZFFSAB._.EEpromZentralHandler.eepromChannel[27].ZFFSAB._.cEEpromChannel._.cnt_GetEEpromUpdate "Call counter off function" UBYTE SAB_STANDARD_S2_S3 1 100 0 255 DISPLAY_IDENTIFIER cnt_GetEEpromUpdate._.cEEpromChannel._.ZFFSAB.eepromChannel[27].EEpromZentralHandler._.ZFFSAB ECU_ADDRESS 0xFFF97D10 /end MEASUREMENT
/begin MEASUREMENT ZFFSAB._.EEpromZentralHandler.eepromChannel[27].ZFFSAB._.cEEpromChannel._.ret_GetEEpromUpdate "Return value off function" UBYTE SAB_STANDARD_S2_S3 1 100 0 255 DISPLAY_IDENTIFIER ret_GetEEpromUpdate._.cEEpromChannel._.ZFFSAB.eepromChannel[27].EEpromZentralHandler._.ZFFSAB ECU_ADDRESS 0xFFF97D11 /end MEASUREMENT
/begin MEASUREMENT ZFFSAB._.EEpromZentralHandler.eepromChannel[27].ZFFSAB._.cEEpromChannel._.cnt_SetEEpromInitZyklisch "Call counter off function" UBYTE SAB_STANDARD_S2_S3 1 100 0 255 DISPLAY_IDENTIFIER cnt_SetEEpromInitZyklisch._.cEEpromChannel._.ZFFSAB.eepromChannel[27].EEpromZentralHandler._.ZFFSAB ECU_ADDRESS 0xFFF97D12 /end MEASUREMENT
/begin MEASUREMENT ZFFSAB._.EEpromZentralHandler.eepromChannel[27].ZFFSAB._.cEEpromChannel._.ret_SetEEpromInitZyklisch "Return value off function" UBYTE SAB_STANDARD_S2_S3 1 100 0 255 DISPLAY_IDENTIFIER ret_SetEEpromInitZyklisch._.cEEpromChannel._.ZFFSAB.eepromChannel[27].EEpromZentralHandler._.ZFFSAB ECU_ADDRESS 0xFFF97D13 /end MEASUREMENT
/begin MEASUREMENT ZFFSAB._.EEpromZentralHandler.eepromChannel[27].ZFFSAB._.cEEpromChannel._.eeprom_info "argument of SetEEpromInitZyklisch" UBYTE SAB_STANDARD_S2_S3 1 100 0 255 DISPLAY_IDENTIFIER eeprom_info._.cEEpromChannel._.ZFFSAB.eepromChannel[27].EEpromZentralHandler._.ZFFSAB ECU_ADDRESS 0xFFF97D14 /end MEASUREMENT
/begin MEASUREMENT ZFFSAB._.EEpromZentralHandler.eepromChannel[27].ZFFSAB._.cEEpromChannel._.cnt_GetSizeofEEpromData "Call counter off function" UBYTE SAB_STANDARD_S2_S3 1 100 0 255 DISPLAY_IDENTIFIER cnt_GetSizeofEEpromData._.cEEpromChannel._.ZFFSAB.eepromChannel[27].EEpromZentralHandler._.ZFFSAB ECU_ADDRESS 0xFFF97D15 /end MEASUREMENT
/begin MEASUREMENT ZFFSAB._.EEpromZentralHandler.eepromChannel[27].ZFFSAB._.cEEpromChannel._.ret_GetSizeofEEpromData "Return value off function" UWORD SAB_STANDARD_S2_S3 1 100 0 65535 DISPLAY_IDENTIFIER ret_GetSizeofEEpromData._.cEEpromChannel._.ZFFSAB.eepromChannel[27].EEpromZentralHandler._.ZFFSAB ECU_ADDRESS 0xFFF97D16 /end MEASUREMENT
/begin MEASUREMENT ZFFSAB._.EEpromZentralHandler.eepromChannel[27].cnt_CallEEpromStoreImmediate "Call counter off function" UBYTE SAB_STANDARD_S2_S3 1 100 0 255 DISPLAY_IDENTIFIER cnt_CallEEpromStoreImmediate.eepromChannel[27].EEpromZentralHandler._.ZFFSAB ECU_ADDRESS 0xFFF97D18 /end MEASUREMENT
/begin MEASUREMENT ZFFSAB._.EEpromZentralHandler.eepromChannel[27].ret_CallEEpromStoreImmediate "Return value off function" UBYTE SAB_STANDARD_S2_S3 1 100 0 255 DISPLAY_IDENTIFIER ret_CallEEpromStoreImmediate.eepromChannel[27].EEpromZentralHandler._.ZFFSAB ECU_ADDRESS 0xFFF97D19 /end MEASUREMENT
/begin MEASUREMENT ZFFSAB._.EEpromZentralHandler.eepromChannel[27].cnt_CallEEpromLoadData "Call counter off function" UBYTE SAB_STANDARD_S2_S3 1 100 0 255 DISPLAY_IDENTIFIER cnt_CallEEpromLoadData.eepromChannel[27].EEpromZentralHandler._.ZFFSAB ECU_ADDRESS 0xFFF97D1A /end MEASUREMENT
/begin MEASUREMENT ZFFSAB._.EEpromZentralHandler.eepromChannel[27].ret_CallEEpromLoadData "Return value off function" UBYTE SAB_STANDARD_S2_S3 1 100 0 255 DISPLAY_IDENTIFIER ret_CallEEpromLoadData.eepromChannel[27].EEpromZentralHandler._.ZFFSAB ECU_ADDRESS 0xFFF97D1B /end MEASUREMENT
/begin MEASUREMENT ZFFSAB._.EEpromZentralHandler.eepromChannel[27].cnt_CallEEpromLoadDataState "Call counter off function" UBYTE SAB_STANDARD_S2_S3 1 100 0 255 DISPLAY_IDENTIFIER cnt_CallEEpromLoadDataState.eepromChannel[27].EEpromZentralHandler._.ZFFSAB ECU_ADDRESS 0xFFF97D1C /end MEASUREMENT
/begin MEASUREMENT ZFFSAB._.EEpromZentralHandler.eepromChannel[27].ret_CallEEpromLoadDataState "Return value off function" UBYTE SAB_STANDARD_S2_S3 1 100 0 255 DISPLAY_IDENTIFIER ret_CallEEpromLoadDataState.eepromChannel[27].EEpromZentralHandler._.ZFFSAB ECU_ADDRESS 0xFFF97D1D /end MEASUREMENT
/begin MEASUREMENT ZFFSAB._.EEpromZentralHandler.eepromChannel[27].mode "argument of SetEEpromInitZyklisch" UBYTE SAB_STANDARD_S2_S3 1 100 0 255 DISPLAY_IDENTIFIER mode.eepromChannel[27].EEpromZentralHandler._.ZFFSAB ECU_ADDRESS 0xFFF97D1E /end MEASUREMENT
/begin MEASUREMENT ZFFSAB._.EEpromZentralHandler.eepromChannel[27].cnt_SetEEpromWriteProtect "Call counter off function" UBYTE SAB_STANDARD_S2_S3 1 100 0 255 DISPLAY_IDENTIFIER cnt_SetEEpromWriteProtect.eepromChannel[27].EEpromZentralHandler._.ZFFSAB ECU_ADDRESS 0xFFF97D1F /end MEASUREMENT
/begin MEASUREMENT ZFFSAB._.EEpromZentralHandler.eepromChannel[28].ZFFSAB._.cEEpromChannel._.cnt_GetEEpromValid "Call counter off function" UBYTE SAB_STANDARD_S2_S3 1 100 0 255 DISPLAY_IDENTIFIER cnt_GetEEpromValid._.cEEpromChannel._.ZFFSAB.eepromChannel[28].EEpromZentralHandler._.ZFFSAB ECU_ADDRESS 0xFFF97D20 /end MEASUREMENT
/begin MEASUREMENT ZFFSAB._.EEpromZentralHandler.eepromChannel[28].ZFFSAB._.cEEpromChannel._.ret_GetEEpromValid "Return value off function" UBYTE SAB_STANDARD_S2_S3 1 100 0 255 DISPLAY_IDENTIFIER ret_GetEEpromValid._.cEEpromChannel._.ZFFSAB.eepromChannel[28].EEpromZentralHandler._.ZFFSAB ECU_ADDRESS 0xFFF97D21 /end MEASUREMENT
/begin MEASUREMENT ZFFSAB._.EEpromZentralHandler.eepromChannel[28].ZFFSAB._.cEEpromChannel._.cnt_GetEEpromUpdate "Call counter off function" UBYTE SAB_STANDARD_S2_S3 1 100 0 255 DISPLAY_IDENTIFIER cnt_GetEEpromUpdate._.cEEpromChannel._.ZFFSAB.eepromChannel[28].EEpromZentralHandler._.ZFFSAB ECU_ADDRESS 0xFFF97D22 /end MEASUREMENT
/begin MEASUREMENT ZFFSAB._.EEpromZentralHandler.eepromChannel[28].ZFFSAB._.cEEpromChannel._.ret_GetEEpromUpdate "Return value off function" UBYTE SAB_STANDARD_S2_S3 1 100 0 255 DISPLAY_IDENTIFIER ret_GetEEpromUpdate._.cEEpromChannel._.ZFFSAB.eepromChannel[28].EEpromZentralHandler._.ZFFSAB ECU_ADDRESS 0xFFF97D23 /end MEASUREMENT
/begin MEASUREMENT ZFFSAB._.EEpromZentralHandler.eepromChannel[28].ZFFSAB._.cEEpromChannel._.cnt_SetEEpromInitZyklisch "Call counter off function" UBYTE SAB_STANDARD_S2_S3 1 100 0 255 DISPLAY_IDENTIFIER cnt_SetEEpromInitZyklisch._.cEEpromChannel._.ZFFSAB.eepromChannel[28].EEpromZentralHandler._.ZFFSAB ECU_ADDRESS 0xFFF97D24 /end MEASUREMENT
/begin MEASUREMENT ZFFSAB._.EEpromZentralHandler.eepromChannel[28].ZFFSAB._.cEEpromChannel._.ret_SetEEpromInitZyklisch "Return value off function" UBYTE SAB_STANDARD_S2_S3 1 100 0 255 DISPLAY_IDENTIFIER ret_SetEEpromInitZyklisch._.cEEpromChannel._.ZFFSAB.eepromChannel[28].EEpromZentralHandler._.ZFFSAB ECU_ADDRESS 0xFFF97D25 /end MEASUREMENT
/begin MEASUREMENT ZFFSAB._.EEpromZentralHandler.eepromChannel[28].ZFFSAB._.cEEpromChannel._.eeprom_info "argument of SetEEpromInitZyklisch" UBYTE SAB_STANDARD_S2_S3 1 100 0 255 DISPLAY_IDENTIFIER eeprom_info._.cEEpromChannel._.ZFFSAB.eepromChannel[28].EEpromZentralHandler._.ZFFSAB ECU_ADDRESS 0xFFF97D26 /end MEASUREMENT
/begin MEASUREMENT ZFFSAB._.EEpromZentralHandler.eepromChannel[28].ZFFSAB._.cEEpromChannel._.cnt_GetSizeofEEpromData "Call counter off function" UBYTE SAB_STANDARD_S2_S3 1 100 0 255 DISPLAY_IDENTIFIER cnt_GetSizeofEEpromData._.cEEpromChannel._.ZFFSAB.eepromChannel[28].EEpromZentralHandler._.ZFFSAB ECU_ADDRESS 0xFFF97D27 /end MEASUREMENT
/begin MEASUREMENT ZFFSAB._.EEpromZentralHandler.eepromChannel[28].ZFFSAB._.cEEpromChannel._.ret_GetSizeofEEpromData "Return value off function" UWORD SAB_STANDARD_S2_S3 1 100 0 65535 DISPLAY_IDENTIFIER ret_GetSizeofEEpromData._.cEEpromChannel._.ZFFSAB.eepromChannel[28].EEpromZentralHandler._.ZFFSAB ECU_ADDRESS 0xFFF97D28 /end MEASUREMENT
/begin MEASUREMENT ZFFSAB._.EEpromZentralHandler.eepromChannel[28].cnt_CallEEpromStoreImmediate "Call counter off function" UBYTE SAB_STANDARD_S2_S3 1 100 0 255 DISPLAY_IDENTIFIER cnt_CallEEpromStoreImmediate.eepromChannel[28].EEpromZentralHandler._.ZFFSAB ECU_ADDRESS 0xFFF97D2A /end MEASUREMENT
/begin MEASUREMENT ZFFSAB._.EEpromZentralHandler.eepromChannel[28].ret_CallEEpromStoreImmediate "Return value off function" UBYTE SAB_STANDARD_S2_S3 1 100 0 255 DISPLAY_IDENTIFIER ret_CallEEpromStoreImmediate.eepromChannel[28].EEpromZentralHandler._.ZFFSAB ECU_ADDRESS 0xFFF97D2B /end MEASUREMENT
/begin MEASUREMENT ZFFSAB._.EEpromZentralHandler.eepromChannel[28].cnt_CallEEpromLoadData "Call counter off function" UBYTE SAB_STANDARD_S2_S3 1 100 0 255 DISPLAY_IDENTIFIER cnt_CallEEpromLoadData.eepromChannel[28].EEpromZentralHandler._.ZFFSAB ECU_ADDRESS 0xFFF97D2C /end MEASUREMENT
/begin MEASUREMENT ZFFSAB._.EEpromZentralHandler.eepromChannel[28].ret_CallEEpromLoadData "Return value off function" UBYTE SAB_STANDARD_S2_S3 1 100 0 255 DISPLAY_IDENTIFIER ret_CallEEpromLoadData.eepromChannel[28].EEpromZentralHandler._.ZFFSAB ECU_ADDRESS 0xFFF97D2D /end MEASUREMENT
/begin MEASUREMENT ZFFSAB._.EEpromZentralHandler.eepromChannel[28].cnt_CallEEpromLoadDataState "Call counter off function" UBYTE SAB_STANDARD_S2_S3 1 100 0 255 DISPLAY_IDENTIFIER cnt_CallEEpromLoadDataState.eepromChannel[28].EEpromZentralHandler._.ZFFSAB ECU_ADDRESS 0xFFF97D2E /end MEASUREMENT
/begin MEASUREMENT ZFFSAB._.EEpromZentralHandler.eepromChannel[28].ret_CallEEpromLoadDataState "Return value off function" UBYTE SAB_STANDARD_S2_S3 1 100 0 255 DISPLAY_IDENTIFIER ret_CallEEpromLoadDataState.eepromChannel[28].EEpromZentralHandler._.ZFFSAB ECU_ADDRESS 0xFFF97D2F /end MEASUREMENT
/begin MEASUREMENT ZFFSAB._.EEpromZentralHandler.eepromChannel[28].mode "argument of SetEEpromInitZyklisch" UBYTE SAB_STANDARD_S2_S3 1 100 0 255 DISPLAY_IDENTIFIER mode.eepromChannel[28].EEpromZentralHandler._.ZFFSAB ECU_ADDRESS 0xFFF97D30 /end MEASUREMENT
/begin MEASUREMENT ZFFSAB._.EEpromZentralHandler.eepromChannel[28].cnt_SetEEpromWriteProtect "Call counter off function" UBYTE SAB_STANDARD_S2_S3 1 100 0 255 DISPLAY_IDENTIFIER cnt_SetEEpromWriteProtect.eepromChannel[28].EEpromZentralHandler._.ZFFSAB ECU_ADDRESS 0xFFF97D31 /end MEASUREMENT
/begin MEASUREMENT ZFFSAB._.EEpromZentralHandler.eepromChannel[29].ZFFSAB._.cEEpromChannel._.cnt_GetEEpromValid "Call counter off function" UBYTE SAB_STANDARD_S2_S3 1 100 0 255 DISPLAY_IDENTIFIER cnt_GetEEpromValid._.cEEpromChannel._.ZFFSAB.eepromChannel[29].EEpromZentralHandler._.ZFFSAB ECU_ADDRESS 0xFFF97D32 /end MEASUREMENT
/begin MEASUREMENT ZFFSAB._.EEpromZentralHandler.eepromChannel[29].ZFFSAB._.cEEpromChannel._.ret_GetEEpromValid "Return value off function" UBYTE SAB_STANDARD_S2_S3 1 100 0 255 DISPLAY_IDENTIFIER ret_GetEEpromValid._.cEEpromChannel._.ZFFSAB.eepromChannel[29].EEpromZentralHandler._.ZFFSAB ECU_ADDRESS 0xFFF97D33 /end MEASUREMENT
/begin MEASUREMENT ZFFSAB._.EEpromZentralHandler.eepromChannel[29].ZFFSAB._.cEEpromChannel._.cnt_GetEEpromUpdate "Call counter off function" UBYTE SAB_STANDARD_S2_S3 1 100 0 255 DISPLAY_IDENTIFIER cnt_GetEEpromUpdate._.cEEpromChannel._.ZFFSAB.eepromChannel[29].EEpromZentralHandler._.ZFFSAB ECU_ADDRESS 0xFFF97D34 /end MEASUREMENT
/begin MEASUREMENT ZFFSAB._.EEpromZentralHandler.eepromChannel[29].ZFFSAB._.cEEpromChannel._.ret_GetEEpromUpdate "Return value off function" UBYTE SAB_STANDARD_S2_S3 1 100 0 255 DISPLAY_IDENTIFIER ret_GetEEpromUpdate._.cEEpromChannel._.ZFFSAB.eepromChannel[29].EEpromZentralHandler._.ZFFSAB ECU_ADDRESS 0xFFF97D35 /end MEASUREMENT
/begin MEASUREMENT ZFFSAB._.EEpromZentralHandler.eepromChannel[29].ZFFSAB._.cEEpromChannel._.cnt_SetEEpromInitZyklisch "Call counter off function" UBYTE SAB_STANDARD_S2_S3 1 100 0 255 DISPLAY_IDENTIFIER cnt_SetEEpromInitZyklisch._.cEEpromChannel._.ZFFSAB.eepromChannel[29].EEpromZentralHandler._.ZFFSAB ECU_ADDRESS 0xFFF97D36 /end MEASUREMENT
/begin MEASUREMENT ZFFSAB._.EEpromZentralHandler.eepromChannel[29].ZFFSAB._.cEEpromChannel._.ret_SetEEpromInitZyklisch "Return value off function" UBYTE SAB_STANDARD_S2_S3 1 100 0 255 DISPLAY_IDENTIFIER ret_SetEEpromInitZyklisch._.cEEpromChannel._.ZFFSAB.eepromChannel[29].EEpromZentralHandler._.ZFFSAB ECU_ADDRESS 0xFFF97D37 /end MEASUREMENT
/begin MEASUREMENT ZFFSAB._.EEpromZentralHandler.eepromChannel[29].ZFFSAB._.cEEpromChannel._.eeprom_info "argument of SetEEpromInitZyklisch" UBYTE SAB_STANDARD_S2_S3 1 100 0 255 DISPLAY_IDENTIFIER eeprom_info._.cEEpromChannel._.ZFFSAB.eepromChannel[29].EEpromZentralHandler._.ZFFSAB ECU_ADDRESS 0xFFF97D38 /end MEASUREMENT
/begin MEASUREMENT ZFFSAB._.EEpromZentralHandler.eepromChannel[29].ZFFSAB._.cEEpromChannel._.cnt_GetSizeofEEpromData "Call counter off function" UBYTE SAB_STANDARD_S2_S3 1 100 0 255 DISPLAY_IDENTIFIER cnt_GetSizeofEEpromData._.cEEpromChannel._.ZFFSAB.eepromChannel[29].EEpromZentralHandler._.ZFFSAB ECU_ADDRESS 0xFFF97D39 /end MEASUREMENT
/begin MEASUREMENT ZFFSAB._.EEpromZentralHandler.eepromChannel[29].ZFFSAB._.cEEpromChannel._.ret_GetSizeofEEpromData "Return value off function" UWORD SAB_STANDARD_S2_S3 1 100 0 65535 DISPLAY_IDENTIFIER ret_GetSizeofEEpromData._.cEEpromChannel._.ZFFSAB.eepromChannel[29].EEpromZentralHandler._.ZFFSAB ECU_ADDRESS 0xFFF97D3A /end MEASUREMENT
/begin MEASUREMENT ZFFSAB._.EEpromZentralHandler.eepromChannel[29].cnt_CallEEpromStoreImmediate "Call counter off function" UBYTE SAB_STANDARD_S2_S3 1 100 0 255 DISPLAY_IDENTIFIER cnt_CallEEpromStoreImmediate.eepromChannel[29].EEpromZentralHandler._.ZFFSAB ECU_ADDRESS 0xFFF97D3C /end MEASUREMENT
/begin MEASUREMENT ZFFSAB._.EEpromZentralHandler.eepromChannel[29].ret_CallEEpromStoreImmediate "Return value off function" UBYTE SAB_STANDARD_S2_S3 1 100 0 255 DISPLAY_IDENTIFIER ret_CallEEpromStoreImmediate.eepromChannel[29].EEpromZentralHandler._.ZFFSAB ECU_ADDRESS 0xFFF97D3D /end MEASUREMENT
/begin MEASUREMENT ZFFSAB._.EEpromZentralHandler.eepromChannel[29].cnt_CallEEpromLoadData "Call counter off function" UBYTE SAB_STANDARD_S2_S3 1 100 0 255 DISPLAY_IDENTIFIER cnt_CallEEpromLoadData.eepromChannel[29].EEpromZentralHandler._.ZFFSAB ECU_ADDRESS 0xFFF97D3E /end MEASUREMENT
/begin MEASUREMENT ZFFSAB._.EEpromZentralHandler.eepromChannel[29].ret_CallEEpromLoadData "Return value off function" UBYTE SAB_STANDARD_S2_S3 1 100 0 255 DISPLAY_IDENTIFIER ret_CallEEpromLoadData.eepromChannel[29].EEpromZentralHandler._.ZFFSAB ECU_ADDRESS 0xFFF97D3F /end MEASUREMENT
/begin MEASUREMENT ZFFSAB._.EEpromZentralHandler.eepromChannel[29].cnt_CallEEpromLoadDataState "Call counter off function" UBYTE SAB_STANDARD_S2_S3 1 100 0 255 DISPLAY_IDENTIFIER cnt_CallEEpromLoadDataState.eepromChannel[29].EEpromZentralHandler._.ZFFSAB ECU_ADDRESS 0xFFF97D40 /end MEASUREMENT
/begin MEASUREMENT ZFFSAB._.EEpromZentralHandler.eepromChannel[29].ret_CallEEpromLoadDataState "Return value off function" UBYTE SAB_STANDARD_S2_S3 1 100 0 255 DISPLAY_IDENTIFIER ret_CallEEpromLoadDataState.eepromChannel[29].EEpromZentralHandler._.ZFFSAB ECU_ADDRESS 0xFFF97D41 /end MEASUREMENT
/begin MEASUREMENT ZFFSAB._.EEpromZentralHandler.eepromChannel[29].mode "argument of SetEEpromInitZyklisch" UBYTE SAB_STANDARD_S2_S3 1 100 0 255 DISPLAY_IDENTIFIER mode.eepromChannel[29].EEpromZentralHandler._.ZFFSAB ECU_ADDRESS 0xFFF97D42 /end MEASUREMENT
/begin MEASUREMENT ZFFSAB._.EEpromZentralHandler.eepromChannel[29].cnt_SetEEpromWriteProtect "Call counter off function" UBYTE SAB_STANDARD_S2_S3 1 100 0 255 DISPLAY_IDENTIFIER cnt_SetEEpromWriteProtect.eepromChannel[29].EEpromZentralHandler._.ZFFSAB ECU_ADDRESS 0xFFF97D43 /end MEASUREMENT
/begin MEASUREMENT ZFFSAB._.EEpromZentralHandler.eepromChannel[30].ZFFSAB._.cEEpromChannel._.cnt_GetEEpromValid "Call counter off function" UBYTE SAB_STANDARD_S2_S3 1 100 0 255 DISPLAY_IDENTIFIER cnt_GetEEpromValid._.cEEpromChannel._.ZFFSAB.eepromChannel[30].EEpromZentralHandler._.ZFFSAB ECU_ADDRESS 0xFFF97D44 /end MEASUREMENT
/begin MEASUREMENT ZFFSAB._.EEpromZentralHandler.eepromChannel[30].ZFFSAB._.cEEpromChannel._.ret_GetEEpromValid "Return value off function" UBYTE SAB_STANDARD_S2_S3 1 100 0 255 DISPLAY_IDENTIFIER ret_GetEEpromValid._.cEEpromChannel._.ZFFSAB.eepromChannel[30].EEpromZentralHandler._.ZFFSAB ECU_ADDRESS 0xFFF97D45 /end MEASUREMENT
/begin MEASUREMENT ZFFSAB._.EEpromZentralHandler.eepromChannel[30].ZFFSAB._.cEEpromChannel._.cnt_GetEEpromUpdate "Call counter off function" UBYTE SAB_STANDARD_S2_S3 1 100 0 255 DISPLAY_IDENTIFIER cnt_GetEEpromUpdate._.cEEpromChannel._.ZFFSAB.eepromChannel[30].EEpromZentralHandler._.ZFFSAB ECU_ADDRESS 0xFFF97D46 /end MEASUREMENT
/begin MEASUREMENT ZFFSAB._.EEpromZentralHandler.eepromChannel[30].ZFFSAB._.cEEpromChannel._.ret_GetEEpromUpdate "Return value off function" UBYTE SAB_STANDARD_S2_S3 1 100 0 255 DISPLAY_IDENTIFIER ret_GetEEpromUpdate._.cEEpromChannel._.ZFFSAB.eepromChannel[30].EEpromZentralHandler._.ZFFSAB ECU_ADDRESS 0xFFF97D47 /end MEASUREMENT
/begin MEASUREMENT ZFFSAB._.EEpromZentralHandler.eepromChannel[30].ZFFSAB._.cEEpromChannel._.cnt_SetEEpromInitZyklisch "Call counter off function" UBYTE SAB_STANDARD_S2_S3 1 100 0 255 DISPLAY_IDENTIFIER cnt_SetEEpromInitZyklisch._.cEEpromChannel._.ZFFSAB.eepromChannel[30].EEpromZentralHandler._.ZFFSAB ECU_ADDRESS 0xFFF97D48 /end MEASUREMENT
/begin MEASUREMENT ZFFSAB._.EEpromZentralHandler.eepromChannel[30].ZFFSAB._.cEEpromChannel._.ret_SetEEpromInitZyklisch "Return value off function" UBYTE SAB_STANDARD_S2_S3 1 100 0 255 DISPLAY_IDENTIFIER ret_SetEEpromInitZyklisch._.cEEpromChannel._.ZFFSAB.eepromChannel[30].EEpromZentralHandler._.ZFFSAB ECU_ADDRESS 0xFFF97D49 /end MEASUREMENT
/begin MEASUREMENT ZFFSAB._.EEpromZentralHandler.eepromChannel[30].ZFFSAB._.cEEpromChannel._.eeprom_info "argument of SetEEpromInitZyklisch" UBYTE SAB_STANDARD_S2_S3 1 100 0 255 DISPLAY_IDENTIFIER eeprom_info._.cEEpromChannel._.ZFFSAB.eepromChannel[30].EEpromZentralHandler._.ZFFSAB ECU_ADDRESS 0xFFF97D4A /end MEASUREMENT
/begin MEASUREMENT ZFFSAB._.EEpromZentralHandler.eepromChannel[30].ZFFSAB._.cEEpromChannel._.cnt_GetSizeofEEpromData "Call counter off function" UBYTE SAB_STANDARD_S2_S3 1 100 0 255 DISPLAY_IDENTIFIER cnt_GetSizeofEEpromData._.cEEpromChannel._.ZFFSAB.eepromChannel[30].EEpromZentralHandler._.ZFFSAB ECU_ADDRESS 0xFFF97D4B /end MEASUREMENT
/begin MEASUREMENT ZFFSAB._.EEpromZentralHandler.eepromChannel[30].ZFFSAB._.cEEpromChannel._.ret_GetSizeofEEpromData "Return value off function" UWORD SAB_STANDARD_S2_S3 1 100 0 65535 DISPLAY_IDENTIFIER ret_GetSizeofEEpromData._.cEEpromChannel._.ZFFSAB.eepromChannel[30].EEpromZentralHandler._.ZFFSAB ECU_ADDRESS 0xFFF97D4C /end MEASUREMENT
/begin MEASUREMENT ZFFSAB._.EEpromZentralHandler.eepromChannel[30].cnt_CallEEpromStoreImmediate "Call counter off function" UBYTE SAB_STANDARD_S2_S3 1 100 0 255 DISPLAY_IDENTIFIER cnt_CallEEpromStoreImmediate.eepromChannel[30].EEpromZentralHandler._.ZFFSAB ECU_ADDRESS 0xFFF97D4E /end MEASUREMENT
/begin MEASUREMENT ZFFSAB._.EEpromZentralHandler.eepromChannel[30].ret_CallEEpromStoreImmediate "Return value off function" UBYTE SAB_STANDARD_S2_S3 1 100 0 255 DISPLAY_IDENTIFIER ret_CallEEpromStoreImmediate.eepromChannel[30].EEpromZentralHandler._.ZFFSAB ECU_ADDRESS 0xFFF97D4F /end MEASUREMENT
/begin MEASUREMENT ZFFSAB._.EEpromZentralHandler.eepromChannel[30].cnt_CallEEpromLoadData "Call counter off function" UBYTE SAB_STANDARD_S2_S3 1 100 0 255 DISPLAY_IDENTIFIER cnt_CallEEpromLoadData.eepromChannel[30].EEpromZentralHandler._.ZFFSAB ECU_ADDRESS 0xFFF97D50 /end MEASUREMENT
/begin MEASUREMENT ZFFSAB._.EEpromZentralHandler.eepromChannel[30].ret_CallEEpromLoadData "Return value off function" UBYTE SAB_STANDARD_S2_S3 1 100 0 255 DISPLAY_IDENTIFIER ret_CallEEpromLoadData.eepromChannel[30].EEpromZentralHandler._.ZFFSAB ECU_ADDRESS 0xFFF97D51 /end MEASUREMENT
/begin MEASUREMENT ZFFSAB._.EEpromZentralHandler.eepromChannel[30].cnt_CallEEpromLoadDataState "Call counter off function" UBYTE SAB_STANDARD_S2_S3 1 100 0 255 DISPLAY_IDENTIFIER cnt_CallEEpromLoadDataState.eepromChannel[30].EEpromZentralHandler._.ZFFSAB ECU_ADDRESS 0xFFF97D52 /end MEASUREMENT
/begin MEASUREMENT ZFFSAB._.EEpromZentralHandler.eepromChannel[30].ret_CallEEpromLoadDataState "Return value off function" UBYTE SAB_STANDARD_S2_S3 1 100 0 255 DISPLAY_IDENTIFIER ret_CallEEpromLoadDataState.eepromChannel[30].EEpromZentralHandler._.ZFFSAB ECU_ADDRESS 0xFFF97D53 /end MEASUREMENT
/begin MEASUREMENT ZFFSAB._.EEpromZentralHandler.eepromChannel[30].mode "argument of SetEEpromInitZyklisch" UBYTE SAB_STANDARD_S2_S3 1 100 0 255 DISPLAY_IDENTIFIER mode.eepromChannel[30].EEpromZentralHandler._.ZFFSAB ECU_ADDRESS 0xFFF97D54 /end MEASUREMENT
/begin MEASUREMENT ZFFSAB._.EEpromZentralHandler.eepromChannel[30].cnt_SetEEpromWriteProtect "Call counter off function" UBYTE SAB_STANDARD_S2_S3 1 100 0 255 DISPLAY_IDENTIFIER cnt_SetEEpromWriteProtect.eepromChannel[30].EEpromZentralHandler._.ZFFSAB ECU_ADDRESS 0xFFF97D55 /end MEASUREMENT
/begin MEASUREMENT ZFFSAB._.EEpromZentralHandler.eepromChannel[31].ZFFSAB._.cEEpromChannel._.cnt_GetEEpromValid "Call counter off function" UBYTE SAB_STANDARD_S2_S3 1 100 0 255 DISPLAY_IDENTIFIER cnt_GetEEpromValid._.cEEpromChannel._.ZFFSAB.eepromChannel[31].EEpromZentralHandler._.ZFFSAB ECU_ADDRESS 0xFFF97D56 /end MEASUREMENT
/begin MEASUREMENT ZFFSAB._.EEpromZentralHandler.eepromChannel[31].ZFFSAB._.cEEpromChannel._.ret_GetEEpromValid "Return value off function" UBYTE SAB_STANDARD_S2_S3 1 100 0 255 DISPLAY_IDENTIFIER ret_GetEEpromValid._.cEEpromChannel._.ZFFSAB.eepromChannel[31].EEpromZentralHandler._.ZFFSAB ECU_ADDRESS 0xFFF97D57 /end MEASUREMENT
/begin MEASUREMENT ZFFSAB._.EEpromZentralHandler.eepromChannel[31].ZFFSAB._.cEEpromChannel._.cnt_GetEEpromUpdate "Call counter off function" UBYTE SAB_STANDARD_S2_S3 1 100 0 255 DISPLAY_IDENTIFIER cnt_GetEEpromUpdate._.cEEpromChannel._.ZFFSAB.eepromChannel[31].EEpromZentralHandler._.ZFFSAB ECU_ADDRESS 0xFFF97D58 /end MEASUREMENT
/begin MEASUREMENT ZFFSAB._.EEpromZentralHandler.eepromChannel[31].ZFFSAB._.cEEpromChannel._.ret_GetEEpromUpdate "Return value off function" UBYTE SAB_STANDARD_S2_S3 1 100 0 255 DISPLAY_IDENTIFIER ret_GetEEpromUpdate._.cEEpromChannel._.ZFFSAB.eepromChannel[31].EEpromZentralHandler._.ZFFSAB ECU_ADDRESS 0xFFF97D59 /end MEASUREMENT
/begin MEASUREMENT ZFFSAB._.EEpromZentralHandler.eepromChannel[31].ZFFSAB._.cEEpromChannel._.cnt_SetEEpromInitZyklisch "Call counter off function" UBYTE SAB_STANDARD_S2_S3 1 100 0 255 DISPLAY_IDENTIFIER cnt_SetEEpromInitZyklisch._.cEEpromChannel._.ZFFSAB.eepromChannel[31].EEpromZentralHandler._.ZFFSAB ECU_ADDRESS 0xFFF97D5A /end MEASUREMENT
/begin MEASUREMENT ZFFSAB._.EEpromZentralHandler.eepromChannel[31].ZFFSAB._.cEEpromChannel._.ret_SetEEpromInitZyklisch "Return value off function" UBYTE SAB_STANDARD_S2_S3 1 100 0 255 DISPLAY_IDENTIFIER ret_SetEEpromInitZyklisch._.cEEpromChannel._.ZFFSAB.eepromChannel[31].EEpromZentralHandler._.ZFFSAB ECU_ADDRESS 0xFFF97D5B /end MEASUREMENT
/begin MEASUREMENT ZFFSAB._.EEpromZentralHandler.eepromChannel[31].ZFFSAB._.cEEpromChannel._.eeprom_info "argument of SetEEpromInitZyklisch" UBYTE SAB_STANDARD_S2_S3 1 100 0 255 DISPLAY_IDENTIFIER eeprom_info._.cEEpromChannel._.ZFFSAB.eepromChannel[31].EEpromZentralHandler._.ZFFSAB ECU_ADDRESS 0xFFF97D5C /end MEASUREMENT
/begin MEASUREMENT ZFFSAB._.EEpromZentralHandler.eepromChannel[31].ZFFSAB._.cEEpromChannel._.cnt_GetSizeofEEpromData "Call counter off function" UBYTE SAB_STANDARD_S2_S3 1 100 0 255 DISPLAY_IDENTIFIER cnt_GetSizeofEEpromData._.cEEpromChannel._.ZFFSAB.eepromChannel[31].EEpromZentralHandler._.ZFFSAB ECU_ADDRESS 0xFFF97D5D /end MEASUREMENT
/begin MEASUREMENT ZFFSAB._.EEpromZentralHandler.eepromChannel[31].ZFFSAB._.cEEpromChannel._.ret_GetSizeofEEpromData "Return value off function" UWORD SAB_STANDARD_S2_S3 1 100 0 65535 DISPLAY_IDENTIFIER ret_GetSizeofEEpromData._.cEEpromChannel._.ZFFSAB.eepromChannel[31].EEpromZentralHandler._.ZFFSAB ECU_ADDRESS 0xFFF97D5E /end MEASUREMENT
/begin MEASUREMENT ZFFSAB._.EEpromZentralHandler.eepromChannel[31].cnt_CallEEpromStoreImmediate "Call counter off function" UBYTE SAB_STANDARD_S2_S3 1 100 0 255 DISPLAY_IDENTIFIER cnt_CallEEpromStoreImmediate.eepromChannel[31].EEpromZentralHandler._.ZFFSAB ECU_ADDRESS 0xFFF97D60 /end MEASUREMENT
/begin MEASUREMENT ZFFSAB._.EEpromZentralHandler.eepromChannel[31].ret_CallEEpromStoreImmediate "Return value off function" UBYTE SAB_STANDARD_S2_S3 1 100 0 255 DISPLAY_IDENTIFIER ret_CallEEpromStoreImmediate.eepromChannel[31].EEpromZentralHandler._.ZFFSAB ECU_ADDRESS 0xFFF97D61 /end MEASUREMENT
/begin MEASUREMENT ZFFSAB._.EEpromZentralHandler.eepromChannel[31].cnt_CallEEpromLoadData "Call counter off function" UBYTE SAB_STANDARD_S2_S3 1 100 0 255 DISPLAY_IDENTIFIER cnt_CallEEpromLoadData.eepromChannel[31].EEpromZentralHandler._.ZFFSAB ECU_ADDRESS 0xFFF97D62 /end MEASUREMENT
/begin MEASUREMENT ZFFSAB._.EEpromZentralHandler.eepromChannel[31].ret_CallEEpromLoadData "Return value off function" UBYTE SAB_STANDARD_S2_S3 1 100 0 255 DISPLAY_IDENTIFIER ret_CallEEpromLoadData.eepromChannel[31].EEpromZentralHandler._.ZFFSAB ECU_ADDRESS 0xFFF97D63 /end MEASUREMENT
/begin MEASUREMENT ZFFSAB._.EEpromZentralHandler.eepromChannel[31].cnt_CallEEpromLoadDataState "Call counter off function" UBYTE SAB_STANDARD_S2_S3 1 100 0 255 DISPLAY_IDENTIFIER cnt_CallEEpromLoadDataState.eepromChannel[31].EEpromZentralHandler._.ZFFSAB ECU_ADDRESS 0xFFF97D64 /end MEASUREMENT
/begin MEASUREMENT ZFFSAB._.EEpromZentralHandler.eepromChannel[31].ret_CallEEpromLoadDataState "Return value off function" UBYTE SAB_STANDARD_S2_S3 1 100 0 255 DISPLAY_IDENTIFIER ret_CallEEpromLoadDataState.eepromChannel[31].EEpromZentralHandler._.ZFFSAB ECU_ADDRESS 0xFFF97D65 /end MEASUREMENT
/begin MEASUREMENT ZFFSAB._.EEpromZentralHandler.eepromChannel[31].mode "argument of SetEEpromInitZyklisch" UBYTE SAB_STANDARD_S2_S3 1 100 0 255 DISPLAY_IDENTIFIER mode.eepromChannel[31].EEpromZentralHandler._.ZFFSAB ECU_ADDRESS 0xFFF97D66 /end MEASUREMENT
/begin MEASUREMENT ZFFSAB._.EEpromZentralHandler.eepromChannel[31].cnt_SetEEpromWriteProtect "Call counter off function" UBYTE SAB_STANDARD_S2_S3 1 100 0 255 DISPLAY_IDENTIFIER cnt_SetEEpromWriteProtect.eepromChannel[31].EEpromZentralHandler._.ZFFSAB ECU_ADDRESS 0xFFF97D67 /end MEASUREMENT
/begin MEASUREMENT ZFFSAB._.EEpromZentralHandler.eepromChannel[32].ZFFSAB._.cEEpromChannel._.cnt_GetEEpromValid "Call counter off function" UBYTE SAB_STANDARD_S2_S3 1 100 0 255 DISPLAY_IDENTIFIER cnt_GetEEpromValid._.cEEpromChannel._.ZFFSAB.eepromChannel[32].EEpromZentralHandler._.ZFFSAB ECU_ADDRESS 0xFFF97D68 /end MEASUREMENT
/begin MEASUREMENT ZFFSAB._.EEpromZentralHandler.eepromChannel[32].ZFFSAB._.cEEpromChannel._.ret_GetEEpromValid "Return value off function" UBYTE SAB_STANDARD_S2_S3 1 100 0 255 DISPLAY_IDENTIFIER ret_GetEEpromValid._.cEEpromChannel._.ZFFSAB.eepromChannel[32].EEpromZentralHandler._.ZFFSAB ECU_ADDRESS 0xFFF97D69 /end MEASUREMENT
/begin MEASUREMENT ZFFSAB._.EEpromZentralHandler.eepromChannel[32].ZFFSAB._.cEEpromChannel._.cnt_GetEEpromUpdate "Call counter off function" UBYTE SAB_STANDARD_S2_S3 1 100 0 255 DISPLAY_IDENTIFIER cnt_GetEEpromUpdate._.cEEpromChannel._.ZFFSAB.eepromChannel[32].EEpromZentralHandler._.ZFFSAB ECU_ADDRESS 0xFFF97D6A /end MEASUREMENT
/begin MEASUREMENT ZFFSAB._.EEpromZentralHandler.eepromChannel[32].ZFFSAB._.cEEpromChannel._.ret_GetEEpromUpdate "Return value off function" UBYTE SAB_STANDARD_S2_S3 1 100 0 255 DISPLAY_IDENTIFIER ret_GetEEpromUpdate._.cEEpromChannel._.ZFFSAB.eepromChannel[32].EEpromZentralHandler._.ZFFSAB ECU_ADDRESS 0xFFF97D6B /end MEASUREMENT
/begin MEASUREMENT ZFFSAB._.EEpromZentralHandler.eepromChannel[32].ZFFSAB._.cEEpromChannel._.cnt_SetEEpromInitZyklisch "Call counter off function" UBYTE SAB_STANDARD_S2_S3 1 100 0 255 DISPLAY_IDENTIFIER cnt_SetEEpromInitZyklisch._.cEEpromChannel._.ZFFSAB.eepromChannel[32].EEpromZentralHandler._.ZFFSAB ECU_ADDRESS 0xFFF97D6C /end MEASUREMENT
/begin MEASUREMENT ZFFSAB._.EEpromZentralHandler.eepromChannel[32].ZFFSAB._.cEEpromChannel._.ret_SetEEpromInitZyklisch "Return value off function" UBYTE SAB_STANDARD_S2_S3 1 100 0 255 DISPLAY_IDENTIFIER ret_SetEEpromInitZyklisch._.cEEpromChannel._.ZFFSAB.eepromChannel[32].EEpromZentralHandler._.ZFFSAB ECU_ADDRESS 0xFFF97D6D /end MEASUREMENT
/begin MEASUREMENT ZFFSAB._.EEpromZentralHandler.eepromChannel[32].ZFFSAB._.cEEpromChannel._.eeprom_info "argument of SetEEpromInitZyklisch" UBYTE SAB_STANDARD_S2_S3 1 100 0 255 DISPLAY_IDENTIFIER eeprom_info._.cEEpromChannel._.ZFFSAB.eepromChannel[32].EEpromZentralHandler._.ZFFSAB ECU_ADDRESS 0xFFF97D6E /end MEASUREMENT
/begin MEASUREMENT ZFFSAB._.EEpromZentralHandler.eepromChannel[32].ZFFSAB._.cEEpromChannel._.cnt_GetSizeofEEpromData "Call counter off function" UBYTE SAB_STANDARD_S2_S3 1 100 0 255 DISPLAY_IDENTIFIER cnt_GetSizeofEEpromData._.cEEpromChannel._.ZFFSAB.eepromChannel[32].EEpromZentralHandler._.ZFFSAB ECU_ADDRESS 0xFFF97D6F /end MEASUREMENT
/begin MEASUREMENT ZFFSAB._.EEpromZentralHandler.eepromChannel[32].ZFFSAB._.cEEpromChannel._.ret_GetSizeofEEpromData "Return value off function" UWORD SAB_STANDARD_S2_S3 1 100 0 65535 DISPLAY_IDENTIFIER ret_GetSizeofEEpromData._.cEEpromChannel._.ZFFSAB.eepromChannel[32].EEpromZentralHandler._.ZFFSAB ECU_ADDRESS 0xFFF97D70 /end MEASUREMENT
/begin MEASUREMENT ZFFSAB._.EEpromZentralHandler.eepromChannel[32].cnt_CallEEpromStoreImmediate "Call counter off function" UBYTE SAB_STANDARD_S2_S3 1 100 0 255 DISPLAY_IDENTIFIER cnt_CallEEpromStoreImmediate.eepromChannel[32].EEpromZentralHandler._.ZFFSAB ECU_ADDRESS 0xFFF97D72 /end MEASUREMENT
/begin MEASUREMENT ZFFSAB._.EEpromZentralHandler.eepromChannel[32].ret_CallEEpromStoreImmediate "Return value off function" UBYTE SAB_STANDARD_S2_S3 1 100 0 255 DISPLAY_IDENTIFIER ret_CallEEpromStoreImmediate.eepromChannel[32].EEpromZentralHandler._.ZFFSAB ECU_ADDRESS 0xFFF97D73 /end MEASUREMENT
/begin MEASUREMENT ZFFSAB._.EEpromZentralHandler.eepromChannel[32].cnt_CallEEpromLoadData "Call counter off function" UBYTE SAB_STANDARD_S2_S3 1 100 0 255 DISPLAY_IDENTIFIER cnt_CallEEpromLoadData.eepromChannel[32].EEpromZentralHandler._.ZFFSAB ECU_ADDRESS 0xFFF97D74 /end MEASUREMENT
/begin MEASUREMENT ZFFSAB._.EEpromZentralHandler.eepromChannel[32].ret_CallEEpromLoadData "Return value off function" UBYTE SAB_STANDARD_S2_S3 1 100 0 255 DISPLAY_IDENTIFIER ret_CallEEpromLoadData.eepromChannel[32].EEpromZentralHandler._.ZFFSAB ECU_ADDRESS 0xFFF97D75 /end MEASUREMENT
/begin MEASUREMENT ZFFSAB._.EEpromZentralHandler.eepromChannel[32].cnt_CallEEpromLoadDataState "Call counter off function" UBYTE SAB_STANDARD_S2_S3 1 100 0 255 DISPLAY_IDENTIFIER cnt_CallEEpromLoadDataState.eepromChannel[32].EEpromZentralHandler._.ZFFSAB ECU_ADDRESS 0xFFF97D76 /end MEASUREMENT
/begin MEASUREMENT ZFFSAB._.EEpromZentralHandler.eepromChannel[32].ret_CallEEpromLoadDataState "Return value off function" UBYTE SAB_STANDARD_S2_S3 1 100 0 255 DISPLAY_IDENTIFIER ret_CallEEpromLoadDataState.eepromChannel[32].EEpromZentralHandler._.ZFFSAB ECU_ADDRESS 0xFFF97D77 /end MEASUREMENT
/begin MEASUREMENT ZFFSAB._.EEpromZentralHandler.eepromChannel[32].mode "argument of SetEEpromInitZyklisch" UBYTE SAB_STANDARD_S2_S3 1 100 0 255 DISPLAY_IDENTIFIER mode.eepromChannel[32].EEpromZentralHandler._.ZFFSAB ECU_ADDRESS 0xFFF97D78 /end MEASUREMENT
/begin MEASUREMENT ZFFSAB._.EEpromZentralHandler.eepromChannel[32].cnt_SetEEpromWriteProtect "Call counter off function" UBYTE SAB_STANDARD_S2_S3 1 100 0 255 DISPLAY_IDENTIFIER cnt_SetEEpromWriteProtect.eepromChannel[32].EEpromZentralHandler._.ZFFSAB ECU_ADDRESS 0xFFF97D79 /end MEASUREMENT
/begin MEASUREMENT ZFFSAB._.EEpromZentralHandler.eepromChannel[33].ZFFSAB._.cEEpromChannel._.cnt_GetEEpromValid "Call counter off function" UBYTE SAB_STANDARD_S2_S3 1 100 0 255 DISPLAY_IDENTIFIER cnt_GetEEpromValid._.cEEpromChannel._.ZFFSAB.eepromChannel[33].EEpromZentralHandler._.ZFFSAB ECU_ADDRESS 0xFFF97D7A /end MEASUREMENT
/begin MEASUREMENT ZFFSAB._.EEpromZentralHandler.eepromChannel[33].ZFFSAB._.cEEpromChannel._.ret_GetEEpromValid "Return value off function" UBYTE SAB_STANDARD_S2_S3 1 100 0 255 DISPLAY_IDENTIFIER ret_GetEEpromValid._.cEEpromChannel._.ZFFSAB.eepromChannel[33].EEpromZentralHandler._.ZFFSAB ECU_ADDRESS 0xFFF97D7B /end MEASUREMENT
/begin MEASUREMENT ZFFSAB._.EEpromZentralHandler.eepromChannel[33].ZFFSAB._.cEEpromChannel._.cnt_GetEEpromUpdate "Call counter off function" UBYTE SAB_STANDARD_S2_S3 1 100 0 255 DISPLAY_IDENTIFIER cnt_GetEEpromUpdate._.cEEpromChannel._.ZFFSAB.eepromChannel[33].EEpromZentralHandler._.ZFFSAB ECU_ADDRESS 0xFFF97D7C /end MEASUREMENT
/begin MEASUREMENT ZFFSAB._.EEpromZentralHandler.eepromChannel[33].ZFFSAB._.cEEpromChannel._.ret_GetEEpromUpdate "Return value off function" UBYTE SAB_STANDARD_S2_S3 1 100 0 255 DISPLAY_IDENTIFIER ret_GetEEpromUpdate._.cEEpromChannel._.ZFFSAB.eepromChannel[33].EEpromZentralHandler._.ZFFSAB ECU_ADDRESS 0xFFF97D7D /end MEASUREMENT
/begin MEASUREMENT ZFFSAB._.EEpromZentralHandler.eepromChannel[33].ZFFSAB._.cEEpromChannel._.cnt_SetEEpromInitZyklisch "Call counter off function" UBYTE SAB_STANDARD_S2_S3 1 100 0 255 DISPLAY_IDENTIFIER cnt_SetEEpromInitZyklisch._.cEEpromChannel._.ZFFSAB.eepromChannel[33].EEpromZentralHandler._.ZFFSAB ECU_ADDRESS 0xFFF97D7E /end MEASUREMENT
/begin MEASUREMENT ZFFSAB._.EEpromZentralHandler.eepromChannel[33].ZFFSAB._.cEEpromChannel._.ret_SetEEpromInitZyklisch "Return value off function" UBYTE SAB_STANDARD_S2_S3 1 100 0 255 DISPLAY_IDENTIFIER ret_SetEEpromInitZyklisch._.cEEpromChannel._.ZFFSAB.eepromChannel[33].EEpromZentralHandler._.ZFFSAB ECU_ADDRESS 0xFFF97D7F /end MEASUREMENT
/begin MEASUREMENT ZFFSAB._.EEpromZentralHandler.eepromChannel[33].ZFFSAB._.cEEpromChannel._.eeprom_info "argument of SetEEpromInitZyklisch" UBYTE SAB_STANDARD_S2_S3 1 100 0 255 DISPLAY_IDENTIFIER eeprom_info._.cEEpromChannel._.ZFFSAB.eepromChannel[33].EEpromZentralHandler._.ZFFSAB ECU_ADDRESS 0xFFF97D80 /end MEASUREMENT
/begin MEASUREMENT ZFFSAB._.EEpromZentralHandler.eepromChannel[33].ZFFSAB._.cEEpromChannel._.cnt_GetSizeofEEpromData "Call counter off function" UBYTE SAB_STANDARD_S2_S3 1 100 0 255 DISPLAY_IDENTIFIER cnt_GetSizeofEEpromData._.cEEpromChannel._.ZFFSAB.eepromChannel[33].EEpromZentralHandler._.ZFFSAB ECU_ADDRESS 0xFFF97D81 /end MEASUREMENT
/begin MEASUREMENT ZFFSAB._.EEpromZentralHandler.eepromChannel[33].ZFFSAB._.cEEpromChannel._.ret_GetSizeofEEpromData "Return value off function" UWORD SAB_STANDARD_S2_S3 1 100 0 65535 DISPLAY_IDENTIFIER ret_GetSizeofEEpromData._.cEEpromChannel._.ZFFSAB.eepromChannel[33].EEpromZentralHandler._.ZFFSAB ECU_ADDRESS 0xFFF97D82 /end MEASUREMENT
/begin MEASUREMENT ZFFSAB._.EEpromZentralHandler.eepromChannel[33].cnt_CallEEpromStoreImmediate "Call counter off function" UBYTE SAB_STANDARD_S2_S3 1 100 0 255 DISPLAY_IDENTIFIER cnt_CallEEpromStoreImmediate.eepromChannel[33].EEpromZentralHandler._.ZFFSAB ECU_ADDRESS 0xFFF97D84 /end MEASUREMENT
/begin MEASUREMENT ZFFSAB._.EEpromZentralHandler.eepromChannel[33].ret_CallEEpromStoreImmediate "Return value off function" UBYTE SAB_STANDARD_S2_S3 1 100 0 255 DISPLAY_IDENTIFIER ret_CallEEpromStoreImmediate.eepromChannel[33].EEpromZentralHandler._.ZFFSAB ECU_ADDRESS 0xFFF97D85 /end MEASUREMENT
/begin MEASUREMENT ZFFSAB._.EEpromZentralHandler.eepromChannel[33].cnt_CallEEpromLoadData "Call counter off function" UBYTE SAB_STANDARD_S2_S3 1 100 0 255 DISPLAY_IDENTIFIER cnt_CallEEpromLoadData.eepromChannel[33].EEpromZentralHandler._.ZFFSAB ECU_ADDRESS 0xFFF97D86 /end MEASUREMENT
/begin MEASUREMENT ZFFSAB._.EEpromZentralHandler.eepromChannel[33].ret_CallEEpromLoadData "Return value off function" UBYTE SAB_STANDARD_S2_S3 1 100 0 255 DISPLAY_IDENTIFIER ret_CallEEpromLoadData.eepromChannel[33].EEpromZentralHandler._.ZFFSAB ECU_ADDRESS 0xFFF97D87 /end MEASUREMENT
/begin MEASUREMENT ZFFSAB._.EEpromZentralHandler.eepromChannel[33].cnt_CallEEpromLoadDataState "Call counter off function" UBYTE SAB_STANDARD_S2_S3 1 100 0 255 DISPLAY_IDENTIFIER cnt_CallEEpromLoadDataState.eepromChannel[33].EEpromZentralHandler._.ZFFSAB ECU_ADDRESS 0xFFF97D88 /end MEASUREMENT
/begin MEASUREMENT ZFFSAB._.EEpromZentralHandler.eepromChannel[33].ret_CallEEpromLoadDataState "Return value off function" UBYTE SAB_STANDARD_S2_S3 1 100 0 255 DISPLAY_IDENTIFIER ret_CallEEpromLoadDataState.eepromChannel[33].EEpromZentralHandler._.ZFFSAB ECU_ADDRESS 0xFFF97D89 /end MEASUREMENT
/begin MEASUREMENT ZFFSAB._.EEpromZentralHandler.eepromChannel[33].mode "argument of SetEEpromInitZyklisch" UBYTE SAB_STANDARD_S2_S3 1 100 0 255 DISPLAY_IDENTIFIER mode.eepromChannel[33].EEpromZentralHandler._.ZFFSAB ECU_ADDRESS 0xFFF97D8A /end MEASUREMENT
/begin MEASUREMENT ZFFSAB._.EEpromZentralHandler.eepromChannel[33].cnt_SetEEpromWriteProtect "Call counter off function" UBYTE SAB_STANDARD_S2_S3 1 100 0 255 DISPLAY_IDENTIFIER cnt_SetEEpromWriteProtect.eepromChannel[33].EEpromZentralHandler._.ZFFSAB ECU_ADDRESS 0xFFF97D8B /end MEASUREMENT
/begin MEASUREMENT ZFFSAB._.EEpromZentralHandler.eepromChannel[34].ZFFSAB._.cEEpromChannel._.cnt_GetEEpromValid "Call counter off function" UBYTE SAB_STANDARD_S2_S3 1 100 0 255 DISPLAY_IDENTIFIER cnt_GetEEpromValid._.cEEpromChannel._.ZFFSAB.eepromChannel[34].EEpromZentralHandler._.ZFFSAB ECU_ADDRESS 0xFFF97D8C /end MEASUREMENT
/begin MEASUREMENT ZFFSAB._.EEpromZentralHandler.eepromChannel[34].ZFFSAB._.cEEpromChannel._.ret_GetEEpromValid "Return value off function" UBYTE SAB_STANDARD_S2_S3 1 100 0 255 DISPLAY_IDENTIFIER ret_GetEEpromValid._.cEEpromChannel._.ZFFSAB.eepromChannel[34].EEpromZentralHandler._.ZFFSAB ECU_ADDRESS 0xFFF97D8D /end MEASUREMENT
/begin MEASUREMENT ZFFSAB._.EEpromZentralHandler.eepromChannel[34].ZFFSAB._.cEEpromChannel._.cnt_GetEEpromUpdate "Call counter off function" UBYTE SAB_STANDARD_S2_S3 1 100 0 255 DISPLAY_IDENTIFIER cnt_GetEEpromUpdate._.cEEpromChannel._.ZFFSAB.eepromChannel[34].EEpromZentralHandler._.ZFFSAB ECU_ADDRESS 0xFFF97D8E /end MEASUREMENT
/begin MEASUREMENT ZFFSAB._.EEpromZentralHandler.eepromChannel[34].ZFFSAB._.cEEpromChannel._.ret_GetEEpromUpdate "Return value off function" UBYTE SAB_STANDARD_S2_S3 1 100 0 255 DISPLAY_IDENTIFIER ret_GetEEpromUpdate._.cEEpromChannel._.ZFFSAB.eepromChannel[34].EEpromZentralHandler._.ZFFSAB ECU_ADDRESS 0xFFF97D8F /end MEASUREMENT
/begin MEASUREMENT ZFFSAB._.EEpromZentralHandler.eepromChannel[34].ZFFSAB._.cEEpromChannel._.cnt_SetEEpromInitZyklisch "Call counter off function" UBYTE SAB_STANDARD_S2_S3 1 100 0 255 DISPLAY_IDENTIFIER cnt_SetEEpromInitZyklisch._.cEEpromChannel._.ZFFSAB.eepromChannel[34].EEpromZentralHandler._.ZFFSAB ECU_ADDRESS 0xFFF97D90 /end MEASUREMENT
/begin MEASUREMENT ZFFSAB._.EEpromZentralHandler.eepromChannel[34].ZFFSAB._.cEEpromChannel._.ret_SetEEpromInitZyklisch "Return value off function" UBYTE SAB_STANDARD_S2_S3 1 100 0 255 DISPLAY_IDENTIFIER ret_SetEEpromInitZyklisch._.cEEpromChannel._.ZFFSAB.eepromChannel[34].EEpromZentralHandler._.ZFFSAB ECU_ADDRESS 0xFFF97D91 /end MEASUREMENT
/begin MEASUREMENT ZFFSAB._.EEpromZentralHandler.eepromChannel[34].ZFFSAB._.cEEpromChannel._.eeprom_info "argument of SetEEpromInitZyklisch" UBYTE SAB_STANDARD_S2_S3 1 100 0 255 DISPLAY_IDENTIFIER eeprom_info._.cEEpromChannel._.ZFFSAB.eepromChannel[34].EEpromZentralHandler._.ZFFSAB ECU_ADDRESS 0xFFF97D92 /end MEASUREMENT
/begin MEASUREMENT ZFFSAB._.EEpromZentralHandler.eepromChannel[34].ZFFSAB._.cEEpromChannel._.cnt_GetSizeofEEpromData "Call counter off function" UBYTE SAB_STANDARD_S2_S3 1 100 0 255 DISPLAY_IDENTIFIER cnt_GetSizeofEEpromData._.cEEpromChannel._.ZFFSAB.eepromChannel[34].EEpromZentralHandler._.ZFFSAB ECU_ADDRESS 0xFFF97D93 /end MEASUREMENT
/begin MEASUREMENT ZFFSAB._.EEpromZentralHandler.eepromChannel[34].ZFFSAB._.cEEpromChannel._.ret_GetSizeofEEpromData "Return value off function" UWORD SAB_STANDARD_S2_S3 1 100 0 65535 DISPLAY_IDENTIFIER ret_GetSizeofEEpromData._.cEEpromChannel._.ZFFSAB.eepromChannel[34].EEpromZentralHandler._.ZFFSAB ECU_ADDRESS 0xFFF97D94 /end MEASUREMENT
/begin MEASUREMENT ZFFSAB._.EEpromZentralHandler.eepromChannel[34].cnt_CallEEpromStoreImmediate "Call counter off function" UBYTE SAB_STANDARD_S2_S3 1 100 0 255 DISPLAY_IDENTIFIER cnt_CallEEpromStoreImmediate.eepromChannel[34].EEpromZentralHandler._.ZFFSAB ECU_ADDRESS 0xFFF97D96 /end MEASUREMENT
/begin MEASUREMENT ZFFSAB._.EEpromZentralHandler.eepromChannel[34].ret_CallEEpromStoreImmediate "Return value off function" UBYTE SAB_STANDARD_S2_S3 1 100 0 255 DISPLAY_IDENTIFIER ret_CallEEpromStoreImmediate.eepromChannel[34].EEpromZentralHandler._.ZFFSAB ECU_ADDRESS 0xFFF97D97 /end MEASUREMENT
/begin MEASUREMENT ZFFSAB._.EEpromZentralHandler.eepromChannel[34].cnt_CallEEpromLoadData "Call counter off function" UBYTE SAB_STANDARD_S2_S3 1 100 0 255 DISPLAY_IDENTIFIER cnt_CallEEpromLoadData.eepromChannel[34].EEpromZentralHandler._.ZFFSAB ECU_ADDRESS 0xFFF97D98 /end MEASUREMENT
/begin MEASUREMENT ZFFSAB._.EEpromZentralHandler.eepromChannel[34].ret_CallEEpromLoadData "Return value off function" UBYTE SAB_STANDARD_S2_S3 1 100 0 255 DISPLAY_IDENTIFIER ret_CallEEpromLoadData.eepromChannel[34].EEpromZentralHandler._.ZFFSAB ECU_ADDRESS 0xFFF97D99 /end MEASUREMENT
/begin MEASUREMENT ZFFSAB._.EEpromZentralHandler.eepromChannel[34].cnt_CallEEpromLoadDataState "Call counter off function" UBYTE SAB_STANDARD_S2_S3 1 100 0 255 DISPLAY_IDENTIFIER cnt_CallEEpromLoadDataState.eepromChannel[34].EEpromZentralHandler._.ZFFSAB ECU_ADDRESS 0xFFF97D9A /end MEASUREMENT
/begin MEASUREMENT ZFFSAB._.EEpromZentralHandler.eepromChannel[34].ret_CallEEpromLoadDataState "Return value off function" UBYTE SAB_STANDARD_S2_S3 1 100 0 255 DISPLAY_IDENTIFIER ret_CallEEpromLoadDataState.eepromChannel[34].EEpromZentralHandler._.ZFFSAB ECU_ADDRESS 0xFFF97D9B /end MEASUREMENT
/begin MEASUREMENT ZFFSAB._.EEpromZentralHandler.eepromChannel[34].mode "argument of SetEEpromInitZyklisch" UBYTE SAB_STANDARD_S2_S3 1 100 0 255 DISPLAY_IDENTIFIER mode.eepromChannel[34].EEpromZentralHandler._.ZFFSAB ECU_ADDRESS 0xFFF97D9C /end MEASUREMENT
/begin MEASUREMENT ZFFSAB._.EEpromZentralHandler.eepromChannel[34].cnt_SetEEpromWriteProtect "Call counter off function" UBYTE SAB_STANDARD_S2_S3 1 100 0 255 DISPLAY_IDENTIFIER cnt_SetEEpromWriteProtect.eepromChannel[34].EEpromZentralHandler._.ZFFSAB ECU_ADDRESS 0xFFF97D9D /end MEASUREMENT
/begin MEASUREMENT ZFFSAB._.EEpromZentralHandler.eepromChannel[35].ZFFSAB._.cEEpromChannel._.cnt_GetEEpromValid "Call counter off function" UBYTE SAB_STANDARD_S2_S3 1 100 0 255 DISPLAY_IDENTIFIER cnt_GetEEpromValid._.cEEpromChannel._.ZFFSAB.eepromChannel[35].EEpromZentralHandler._.ZFFSAB ECU_ADDRESS 0xFFF97D9E /end MEASUREMENT
/begin MEASUREMENT ZFFSAB._.EEpromZentralHandler.eepromChannel[35].ZFFSAB._.cEEpromChannel._.ret_GetEEpromValid "Return value off function" UBYTE SAB_STANDARD_S2_S3 1 100 0 255 DISPLAY_IDENTIFIER ret_GetEEpromValid._.cEEpromChannel._.ZFFSAB.eepromChannel[35].EEpromZentralHandler._.ZFFSAB ECU_ADDRESS 0xFFF97D9F /end MEASUREMENT
/begin MEASUREMENT ZFFSAB._.EEpromZentralHandler.eepromChannel[35].ZFFSAB._.cEEpromChannel._.cnt_GetEEpromUpdate "Call counter off function" UBYTE SAB_STANDARD_S2_S3 1 100 0 255 DISPLAY_IDENTIFIER cnt_GetEEpromUpdate._.cEEpromChannel._.ZFFSAB.eepromChannel[35].EEpromZentralHandler._.ZFFSAB ECU_ADDRESS 0xFFF97DA0 /end MEASUREMENT
/begin MEASUREMENT ZFFSAB._.EEpromZentralHandler.eepromChannel[35].ZFFSAB._.cEEpromChannel._.ret_GetEEpromUpdate "Return value off function" UBYTE SAB_STANDARD_S2_S3 1 100 0 255 DISPLAY_IDENTIFIER ret_GetEEpromUpdate._.cEEpromChannel._.ZFFSAB.eepromChannel[35].EEpromZentralHandler._.ZFFSAB ECU_ADDRESS 0xFFF97DA1 /end MEASUREMENT
/begin MEASUREMENT ZFFSAB._.EEpromZentralHandler.eepromChannel[35].ZFFSAB._.cEEpromChannel._.cnt_SetEEpromInitZyklisch "Call counter off function" UBYTE SAB_STANDARD_S2_S3 1 100 0 255 DISPLAY_IDENTIFIER cnt_SetEEpromInitZyklisch._.cEEpromChannel._.ZFFSAB.eepromChannel[35].EEpromZentralHandler._.ZFFSAB ECU_ADDRESS 0xFFF97DA2 /end MEASUREMENT
/begin MEASUREMENT ZFFSAB._.EEpromZentralHandler.eepromChannel[35].ZFFSAB._.cEEpromChannel._.ret_SetEEpromInitZyklisch "Return value off function" UBYTE SAB_STANDARD_S2_S3 1 100 0 255 DISPLAY_IDENTIFIER ret_SetEEpromInitZyklisch._.cEEpromChannel._.ZFFSAB.eepromChannel[35].EEpromZentralHandler._.ZFFSAB ECU_ADDRESS 0xFFF97DA3 /end MEASUREMENT
/begin MEASUREMENT ZFFSAB._.EEpromZentralHandler.eepromChannel[35].ZFFSAB._.cEEpromChannel._.eeprom_info "argument of SetEEpromInitZyklisch" UBYTE SAB_STANDARD_S2_S3 1 100 0 255 DISPLAY_IDENTIFIER eeprom_info._.cEEpromChannel._.ZFFSAB.eepromChannel[35].EEpromZentralHandler._.ZFFSAB ECU_ADDRESS 0xFFF97DA4 /end MEASUREMENT
/begin MEASUREMENT ZFFSAB._.EEpromZentralHandler.eepromChannel[35].ZFFSAB._.cEEpromChannel._.cnt_GetSizeofEEpromData "Call counter off function" UBYTE SAB_STANDARD_S2_S3 1 100 0 255 DISPLAY_IDENTIFIER cnt_GetSizeofEEpromData._.cEEpromChannel._.ZFFSAB.eepromChannel[35].EEpromZentralHandler._.ZFFSAB ECU_ADDRESS 0xFFF97DA5 /end MEASUREMENT
/begin MEASUREMENT ZFFSAB._.EEpromZentralHandler.eepromChannel[35].ZFFSAB._.cEEpromChannel._.ret_GetSizeofEEpromData "Return value off function" UWORD SAB_STANDARD_S2_S3 1 100 0 65535 DISPLAY_IDENTIFIER ret_GetSizeofEEpromData._.cEEpromChannel._.ZFFSAB.eepromChannel[35].EEpromZentralHandler._.ZFFSAB ECU_ADDRESS 0xFFF97DA6 /end MEASUREMENT
/begin MEASUREMENT ZFFSAB._.EEpromZentralHandler.eepromChannel[35].cnt_CallEEpromStoreImmediate "Call counter off function" UBYTE SAB_STANDARD_S2_S3 1 100 0 255 DISPLAY_IDENTIFIER cnt_CallEEpromStoreImmediate.eepromChannel[35].EEpromZentralHandler._.ZFFSAB ECU_ADDRESS 0xFFF97DA8 /end MEASUREMENT
/begin MEASUREMENT ZFFSAB._.EEpromZentralHandler.eepromChannel[35].ret_CallEEpromStoreImmediate "Return value off function" UBYTE SAB_STANDARD_S2_S3 1 100 0 255 DISPLAY_IDENTIFIER ret_CallEEpromStoreImmediate.eepromChannel[35].EEpromZentralHandler._.ZFFSAB ECU_ADDRESS 0xFFF97DA9 /end MEASUREMENT
/begin MEASUREMENT ZFFSAB._.EEpromZentralHandler.eepromChannel[35].cnt_CallEEpromLoadData "Call counter off function" UBYTE SAB_STANDARD_S2_S3 1 100 0 255 DISPLAY_IDENTIFIER cnt_CallEEpromLoadData.eepromChannel[35].EEpromZentralHandler._.ZFFSAB ECU_ADDRESS 0xFFF97DAA /end MEASUREMENT
/begin MEASUREMENT ZFFSAB._.EEpromZentralHandler.eepromChannel[35].ret_CallEEpromLoadData "Return value off function" UBYTE SAB_STANDARD_S2_S3 1 100 0 255 DISPLAY_IDENTIFIER ret_CallEEpromLoadData.eepromChannel[35].EEpromZentralHandler._.ZFFSAB ECU_ADDRESS 0xFFF97DAB /end MEASUREMENT
/begin MEASUREMENT ZFFSAB._.EEpromZentralHandler.eepromChannel[35].cnt_CallEEpromLoadDataState "Call counter off function" UBYTE SAB_STANDARD_S2_S3 1 100 0 255 DISPLAY_IDENTIFIER cnt_CallEEpromLoadDataState.eepromChannel[35].EEpromZentralHandler._.ZFFSAB ECU_ADDRESS 0xFFF97DAC /end MEASUREMENT
/begin MEASUREMENT ZFFSAB._.EEpromZentralHandler.eepromChannel[35].ret_CallEEpromLoadDataState "Return value off function" UBYTE SAB_STANDARD_S2_S3 1 100 0 255 DISPLAY_IDENTIFIER ret_CallEEpromLoadDataState.eepromChannel[35].EEpromZentralHandler._.ZFFSAB ECU_ADDRESS 0xFFF97DAD /end MEASUREMENT
/begin MEASUREMENT ZFFSAB._.EEpromZentralHandler.eepromChannel[35].mode "argument of SetEEpromInitZyklisch" UBYTE SAB_STANDARD_S2_S3 1 100 0 255 DISPLAY_IDENTIFIER mode.eepromChannel[35].EEpromZentralHandler._.ZFFSAB ECU_ADDRESS 0xFFF97DAE /end MEASUREMENT
/begin MEASUREMENT ZFFSAB._.EEpromZentralHandler.eepromChannel[35].cnt_SetEEpromWriteProtect "Call counter off function" UBYTE SAB_STANDARD_S2_S3 1 100 0 255 DISPLAY_IDENTIFIER cnt_SetEEpromWriteProtect.eepromChannel[35].EEpromZentralHandler._.ZFFSAB ECU_ADDRESS 0xFFF97DAF /end MEASUREMENT
/begin MEASUREMENT ZFFSAB._.EEpromZentralHandler.eepromChannel[36].ZFFSAB._.cEEpromChannel._.cnt_GetEEpromValid "Call counter off function" UBYTE SAB_STANDARD_S2_S3 1 100 0 255 DISPLAY_IDENTIFIER cnt_GetEEpromValid._.cEEpromChannel._.ZFFSAB.eepromChannel[36].EEpromZentralHandler._.ZFFSAB ECU_ADDRESS 0xFFF97DB0 /end MEASUREMENT
/begin MEASUREMENT ZFFSAB._.EEpromZentralHandler.eepromChannel[36].ZFFSAB._.cEEpromChannel._.ret_GetEEpromValid "Return value off function" UBYTE SAB_STANDARD_S2_S3 1 100 0 255 DISPLAY_IDENTIFIER ret_GetEEpromValid._.cEEpromChannel._.ZFFSAB.eepromChannel[36].EEpromZentralHandler._.ZFFSAB ECU_ADDRESS 0xFFF97DB1 /end MEASUREMENT
/begin MEASUREMENT ZFFSAB._.EEpromZentralHandler.eepromChannel[36].ZFFSAB._.cEEpromChannel._.cnt_GetEEpromUpdate "Call counter off function" UBYTE SAB_STANDARD_S2_S3 1 100 0 255 DISPLAY_IDENTIFIER cnt_GetEEpromUpdate._.cEEpromChannel._.ZFFSAB.eepromChannel[36].EEpromZentralHandler._.ZFFSAB ECU_ADDRESS 0xFFF97DB2 /end MEASUREMENT
/begin MEASUREMENT ZFFSAB._.EEpromZentralHandler.eepromChannel[36].ZFFSAB._.cEEpromChannel._.ret_GetEEpromUpdate "Return value off function" UBYTE SAB_STANDARD_S2_S3 1 100 0 255 DISPLAY_IDENTIFIER ret_GetEEpromUpdate._.cEEpromChannel._.ZFFSAB.eepromChannel[36].EEpromZentralHandler._.ZFFSAB ECU_ADDRESS 0xFFF97DB3 /end MEASUREMENT
/begin MEASUREMENT ZFFSAB._.EEpromZentralHandler.eepromChannel[36].ZFFSAB._.cEEpromChannel._.cnt_SetEEpromInitZyklisch "Call counter off function" UBYTE SAB_STANDARD_S2_S3 1 100 0 255 DISPLAY_IDENTIFIER cnt_SetEEpromInitZyklisch._.cEEpromChannel._.ZFFSAB.eepromChannel[36].EEpromZentralHandler._.ZFFSAB ECU_ADDRESS 0xFFF97DB4 /end MEASUREMENT
/begin MEASUREMENT ZFFSAB._.EEpromZentralHandler.eepromChannel[36].ZFFSAB._.cEEpromChannel._.ret_SetEEpromInitZyklisch "Return value off function" UBYTE SAB_STANDARD_S2_S3 1 100 0 255 DISPLAY_IDENTIFIER ret_SetEEpromInitZyklisch._.cEEpromChannel._.ZFFSAB.eepromChannel[36].EEpromZentralHandler._.ZFFSAB ECU_ADDRESS 0xFFF97DB5 /end MEASUREMENT
/begin MEASUREMENT ZFFSAB._.EEpromZentralHandler.eepromChannel[36].ZFFSAB._.cEEpromChannel._.eeprom_info "argument of SetEEpromInitZyklisch" UBYTE SAB_STANDARD_S2_S3 1 100 0 255 DISPLAY_IDENTIFIER eeprom_info._.cEEpromChannel._.ZFFSAB.eepromChannel[36].EEpromZentralHandler._.ZFFSAB ECU_ADDRESS 0xFFF97DB6 /end MEASUREMENT
/begin MEASUREMENT ZFFSAB._.EEpromZentralHandler.eepromChannel[36].ZFFSAB._.cEEpromChannel._.cnt_GetSizeofEEpromData "Call counter off function" UBYTE SAB_STANDARD_S2_S3 1 100 0 255 DISPLAY_IDENTIFIER cnt_GetSizeofEEpromData._.cEEpromChannel._.ZFFSAB.eepromChannel[36].EEpromZentralHandler._.ZFFSAB ECU_ADDRESS 0xFFF97DB7 /end MEASUREMENT
/begin MEASUREMENT ZFFSAB._.EEpromZentralHandler.eepromChannel[36].ZFFSAB._.cEEpromChannel._.ret_GetSizeofEEpromData "Return value off function" UWORD SAB_STANDARD_S2_S3 1 100 0 65535 DISPLAY_IDENTIFIER ret_GetSizeofEEpromData._.cEEpromChannel._.ZFFSAB.eepromChannel[36].EEpromZentralHandler._.ZFFSAB ECU_ADDRESS 0xFFF97DB8 /end MEASUREMENT
/begin MEASUREMENT ZFFSAB._.EEpromZentralHandler.eepromChannel[36].cnt_CallEEpromStoreImmediate "Call counter off function" UBYTE SAB_STANDARD_S2_S3 1 100 0 255 DISPLAY_IDENTIFIER cnt_CallEEpromStoreImmediate.eepromChannel[36].EEpromZentralHandler._.ZFFSAB ECU_ADDRESS 0xFFF97DBA /end MEASUREMENT
/begin MEASUREMENT ZFFSAB._.EEpromZentralHandler.eepromChannel[36].ret_CallEEpromStoreImmediate "Return value off function" UBYTE SAB_STANDARD_S2_S3 1 100 0 255 DISPLAY_IDENTIFIER ret_CallEEpromStoreImmediate.eepromChannel[36].EEpromZentralHandler._.ZFFSAB ECU_ADDRESS 0xFFF97DBB /end MEASUREMENT
/begin MEASUREMENT ZFFSAB._.EEpromZentralHandler.eepromChannel[36].cnt_CallEEpromLoadData "Call counter off function" UBYTE SAB_STANDARD_S2_S3 1 100 0 255 DISPLAY_IDENTIFIER cnt_CallEEpromLoadData.eepromChannel[36].EEpromZentralHandler._.ZFFSAB ECU_ADDRESS 0xFFF97DBC /end MEASUREMENT
/begin MEASUREMENT ZFFSAB._.EEpromZentralHandler.eepromChannel[36].ret_CallEEpromLoadData "Return value off function" UBYTE SAB_STANDARD_S2_S3 1 100 0 255 DISPLAY_IDENTIFIER ret_CallEEpromLoadData.eepromChannel[36].EEpromZentralHandler._.ZFFSAB ECU_ADDRESS 0xFFF97DBD /end MEASUREMENT
/begin MEASUREMENT ZFFSAB._.EEpromZentralHandler.eepromChannel[36].cnt_CallEEpromLoadDataState "Call counter off function" UBYTE SAB_STANDARD_S2_S3 1 100 0 255 DISPLAY_IDENTIFIER cnt_CallEEpromLoadDataState.eepromChannel[36].EEpromZentralHandler._.ZFFSAB ECU_ADDRESS 0xFFF97DBE /end MEASUREMENT
/begin MEASUREMENT ZFFSAB._.EEpromZentralHandler.eepromChannel[36].ret_CallEEpromLoadDataState "Return value off function" UBYTE SAB_STANDARD_S2_S3 1 100 0 255 DISPLAY_IDENTIFIER ret_CallEEpromLoadDataState.eepromChannel[36].EEpromZentralHandler._.ZFFSAB ECU_ADDRESS 0xFFF97DBF /end MEASUREMENT
/begin MEASUREMENT ZFFSAB._.EEpromZentralHandler.eepromChannel[36].mode "argument of SetEEpromInitZyklisch" UBYTE SAB_STANDARD_S2_S3 1 100 0 255 DISPLAY_IDENTIFIER mode.eepromChannel[36].EEpromZentralHandler._.ZFFSAB ECU_ADDRESS 0xFFF97DC0 /end MEASUREMENT
/begin MEASUREMENT ZFFSAB._.EEpromZentralHandler.eepromChannel[36].cnt_SetEEpromWriteProtect "Call counter off function" UBYTE SAB_STANDARD_S2_S3 1 100 0 255 DISPLAY_IDENTIFIER cnt_SetEEpromWriteProtect.eepromChannel[36].EEpromZentralHandler._.ZFFSAB ECU_ADDRESS 0xFFF97DC1 /end MEASUREMENT
/begin MEASUREMENT ZFFSAB._.EEpromZentralHandler.eepromChannel[37].ZFFSAB._.cEEpromChannel._.cnt_GetEEpromValid "Call counter off function" UBYTE SAB_STANDARD_S2_S3 1 100 0 255 DISPLAY_IDENTIFIER cnt_GetEEpromValid._.cEEpromChannel._.ZFFSAB.eepromChannel[37].EEpromZentralHandler._.ZFFSAB ECU_ADDRESS 0xFFF97DC2 /end MEASUREMENT
/begin MEASUREMENT ZFFSAB._.EEpromZentralHandler.eepromChannel[37].ZFFSAB._.cEEpromChannel._.ret_GetEEpromValid "Return value off function" UBYTE SAB_STANDARD_S2_S3 1 100 0 255 DISPLAY_IDENTIFIER ret_GetEEpromValid._.cEEpromChannel._.ZFFSAB.eepromChannel[37].EEpromZentralHandler._.ZFFSAB ECU_ADDRESS 0xFFF97DC3 /end MEASUREMENT
/begin MEASUREMENT ZFFSAB._.EEpromZentralHandler.eepromChannel[37].ZFFSAB._.cEEpromChannel._.cnt_GetEEpromUpdate "Call counter off function" UBYTE SAB_STANDARD_S2_S3 1 100 0 255 DISPLAY_IDENTIFIER cnt_GetEEpromUpdate._.cEEpromChannel._.ZFFSAB.eepromChannel[37].EEpromZentralHandler._.ZFFSAB ECU_ADDRESS 0xFFF97DC4 /end MEASUREMENT
/begin MEASUREMENT ZFFSAB._.EEpromZentralHandler.eepromChannel[37].ZFFSAB._.cEEpromChannel._.ret_GetEEpromUpdate "Return value off function" UBYTE SAB_STANDARD_S2_S3 1 100 0 255 DISPLAY_IDENTIFIER ret_GetEEpromUpdate._.cEEpromChannel._.ZFFSAB.eepromChannel[37].EEpromZentralHandler._.ZFFSAB ECU_ADDRESS 0xFFF97DC5 /end MEASUREMENT
/begin MEASUREMENT ZFFSAB._.EEpromZentralHandler.eepromChannel[37].ZFFSAB._.cEEpromChannel._.cnt_SetEEpromInitZyklisch "Call counter off function" UBYTE SAB_STANDARD_S2_S3 1 100 0 255 DISPLAY_IDENTIFIER cnt_SetEEpromInitZyklisch._.cEEpromChannel._.ZFFSAB.eepromChannel[37].EEpromZentralHandler._.ZFFSAB ECU_ADDRESS 0xFFF97DC6 /end MEASUREMENT
/begin MEASUREMENT ZFFSAB._.EEpromZentralHandler.eepromChannel[37].ZFFSAB._.cEEpromChannel._.ret_SetEEpromInitZyklisch "Return value off function" UBYTE SAB_STANDARD_S2_S3 1 100 0 255 DISPLAY_IDENTIFIER ret_SetEEpromInitZyklisch._.cEEpromChannel._.ZFFSAB.eepromChannel[37].EEpromZentralHandler._.ZFFSAB ECU_ADDRESS 0xFFF97DC7 /end MEASUREMENT
/begin MEASUREMENT ZFFSAB._.EEpromZentralHandler.eepromChannel[37].ZFFSAB._.cEEpromChannel._.eeprom_info "argument of SetEEpromInitZyklisch" UBYTE SAB_STANDARD_S2_S3 1 100 0 255 DISPLAY_IDENTIFIER eeprom_info._.cEEpromChannel._.ZFFSAB.eepromChannel[37].EEpromZentralHandler._.ZFFSAB ECU_ADDRESS 0xFFF97DC8 /end MEASUREMENT
/begin MEASUREMENT ZFFSAB._.EEpromZentralHandler.eepromChannel[37].ZFFSAB._.cEEpromChannel._.cnt_GetSizeofEEpromData "Call counter off function" UBYTE SAB_STANDARD_S2_S3 1 100 0 255 DISPLAY_IDENTIFIER cnt_GetSizeofEEpromData._.cEEpromChannel._.ZFFSAB.eepromChannel[37].EEpromZentralHandler._.ZFFSAB ECU_ADDRESS 0xFFF97DC9 /end MEASUREMENT
/begin MEASUREMENT ZFFSAB._.EEpromZentralHandler.eepromChannel[37].ZFFSAB._.cEEpromChannel._.ret_GetSizeofEEpromData "Return value off function" UWORD SAB_STANDARD_S2_S3 1 100 0 65535 DISPLAY_IDENTIFIER ret_GetSizeofEEpromData._.cEEpromChannel._.ZFFSAB.eepromChannel[37].EEpromZentralHandler._.ZFFSAB ECU_ADDRESS 0xFFF97DCA /end MEASUREMENT
/begin MEASUREMENT ZFFSAB._.EEpromZentralHandler.eepromChannel[37].cnt_CallEEpromStoreImmediate "Call counter off function" UBYTE SAB_STANDARD_S2_S3 1 100 0 255 DISPLAY_IDENTIFIER cnt_CallEEpromStoreImmediate.eepromChannel[37].EEpromZentralHandler._.ZFFSAB ECU_ADDRESS 0xFFF97DCC /end MEASUREMENT
/begin MEASUREMENT ZFFSAB._.EEpromZentralHandler.eepromChannel[37].ret_CallEEpromStoreImmediate "Return value off function" UBYTE SAB_STANDARD_S2_S3 1 100 0 255 DISPLAY_IDENTIFIER ret_CallEEpromStoreImmediate.eepromChannel[37].EEpromZentralHandler._.ZFFSAB ECU_ADDRESS 0xFFF97DCD /end MEASUREMENT
/begin MEASUREMENT ZFFSAB._.EEpromZentralHandler.eepromChannel[37].cnt_CallEEpromLoadData "Call counter off function" UBYTE SAB_STANDARD_S2_S3 1 100 0 255 DISPLAY_IDENTIFIER cnt_CallEEpromLoadData.eepromChannel[37].EEpromZentralHandler._.ZFFSAB ECU_ADDRESS 0xFFF97DCE /end MEASUREMENT
/begin MEASUREMENT ZFFSAB._.EEpromZentralHandler.eepromChannel[37].ret_CallEEpromLoadData "Return value off function" UBYTE SAB_STANDARD_S2_S3 1 100 0 255 DISPLAY_IDENTIFIER ret_CallEEpromLoadData.eepromChannel[37].EEpromZentralHandler._.ZFFSAB ECU_ADDRESS 0xFFF97DCF /end MEASUREMENT
/begin MEASUREMENT ZFFSAB._.EEpromZentralHandler.eepromChannel[37].cnt_CallEEpromLoadDataState "Call counter off function" UBYTE SAB_STANDARD_S2_S3 1 100 0 255 DISPLAY_IDENTIFIER cnt_CallEEpromLoadDataState.eepromChannel[37].EEpromZentralHandler._.ZFFSAB ECU_ADDRESS 0xFFF97DD0 /end MEASUREMENT
/begin MEASUREMENT ZFFSAB._.EEpromZentralHandler.eepromChannel[37].ret_CallEEpromLoadDataState "Return value off function" UBYTE SAB_STANDARD_S2_S3 1 100 0 255 DISPLAY_IDENTIFIER ret_CallEEpromLoadDataState.eepromChannel[37].EEpromZentralHandler._.ZFFSAB ECU_ADDRESS 0xFFF97DD1 /end MEASUREMENT
/begin MEASUREMENT ZFFSAB._.EEpromZentralHandler.eepromChannel[37].mode "argument of SetEEpromInitZyklisch" UBYTE SAB_STANDARD_S2_S3 1 100 0 255 DISPLAY_IDENTIFIER mode.eepromChannel[37].EEpromZentralHandler._.ZFFSAB ECU_ADDRESS 0xFFF97DD2 /end MEASUREMENT
/begin MEASUREMENT ZFFSAB._.EEpromZentralHandler.eepromChannel[37].cnt_SetEEpromWriteProtect "Call counter off function" UBYTE SAB_STANDARD_S2_S3 1 100 0 255 DISPLAY_IDENTIFIER cnt_SetEEpromWriteProtect.eepromChannel[37].EEpromZentralHandler._.ZFFSAB ECU_ADDRESS 0xFFF97DD3 /end MEASUREMENT
/begin MEASUREMENT ZFFSAB._.EEpromZentralHandler.eepromChannel[38].ZFFSAB._.cEEpromChannel._.cnt_GetEEpromValid "Call counter off function" UBYTE SAB_STANDARD_S2_S3 1 100 0 255 DISPLAY_IDENTIFIER cnt_GetEEpromValid._.cEEpromChannel._.ZFFSAB.eepromChannel[38].EEpromZentralHandler._.ZFFSAB ECU_ADDRESS 0xFFF97DD4 /end MEASUREMENT
/begin MEASUREMENT ZFFSAB._.EEpromZentralHandler.eepromChannel[38].ZFFSAB._.cEEpromChannel._.ret_GetEEpromValid "Return value off function" UBYTE SAB_STANDARD_S2_S3 1 100 0 255 DISPLAY_IDENTIFIER ret_GetEEpromValid._.cEEpromChannel._.ZFFSAB.eepromChannel[38].EEpromZentralHandler._.ZFFSAB ECU_ADDRESS 0xFFF97DD5 /end MEASUREMENT
/begin MEASUREMENT ZFFSAB._.EEpromZentralHandler.eepromChannel[38].ZFFSAB._.cEEpromChannel._.cnt_GetEEpromUpdate "Call counter off function" UBYTE SAB_STANDARD_S2_S3 1 100 0 255 DISPLAY_IDENTIFIER cnt_GetEEpromUpdate._.cEEpromChannel._.ZFFSAB.eepromChannel[38].EEpromZentralHandler._.ZFFSAB ECU_ADDRESS 0xFFF97DD6 /end MEASUREMENT
/begin MEASUREMENT ZFFSAB._.EEpromZentralHandler.eepromChannel[38].ZFFSAB._.cEEpromChannel._.ret_GetEEpromUpdate "Return value off function" UBYTE SAB_STANDARD_S2_S3 1 100 0 255 DISPLAY_IDENTIFIER ret_GetEEpromUpdate._.cEEpromChannel._.ZFFSAB.eepromChannel[38].EEpromZentralHandler._.ZFFSAB ECU_ADDRESS 0xFFF97DD7 /end MEASUREMENT
/begin MEASUREMENT ZFFSAB._.EEpromZentralHandler.eepromChannel[38].ZFFSAB._.cEEpromChannel._.cnt_SetEEpromInitZyklisch "Call counter off function" UBYTE SAB_STANDARD_S2_S3 1 100 0 255 DISPLAY_IDENTIFIER cnt_SetEEpromInitZyklisch._.cEEpromChannel._.ZFFSAB.eepromChannel[38].EEpromZentralHandler._.ZFFSAB ECU_ADDRESS 0xFFF97DD8 /end MEASUREMENT
/begin MEASUREMENT ZFFSAB._.EEpromZentralHandler.eepromChannel[38].ZFFSAB._.cEEpromChannel._.ret_SetEEpromInitZyklisch "Return value off function" UBYTE SAB_STANDARD_S2_S3 1 100 0 255 DISPLAY_IDENTIFIER ret_SetEEpromInitZyklisch._.cEEpromChannel._.ZFFSAB.eepromChannel[38].EEpromZentralHandler._.ZFFSAB ECU_ADDRESS 0xFFF97DD9 /end MEASUREMENT
/begin MEASUREMENT ZFFSAB._.EEpromZentralHandler.eepromChannel[38].ZFFSAB._.cEEpromChannel._.eeprom_info "argument of SetEEpromInitZyklisch" UBYTE SAB_STANDARD_S2_S3 1 100 0 255 DISPLAY_IDENTIFIER eeprom_info._.cEEpromChannel._.ZFFSAB.eepromChannel[38].EEpromZentralHandler._.ZFFSAB ECU_ADDRESS 0xFFF97DDA /end MEASUREMENT
/begin MEASUREMENT ZFFSAB._.EEpromZentralHandler.eepromChannel[38].ZFFSAB._.cEEpromChannel._.cnt_GetSizeofEEpromData "Call counter off function" UBYTE SAB_STANDARD_S2_S3 1 100 0 255 DISPLAY_IDENTIFIER cnt_GetSizeofEEpromData._.cEEpromChannel._.ZFFSAB.eepromChannel[38].EEpromZentralHandler._.ZFFSAB ECU_ADDRESS 0xFFF97DDB /end MEASUREMENT
/begin MEASUREMENT ZFFSAB._.EEpromZentralHandler.eepromChannel[38].ZFFSAB._.cEEpromChannel._.ret_GetSizeofEEpromData "Return value off function" UWORD SAB_STANDARD_S2_S3 1 100 0 65535 DISPLAY_IDENTIFIER ret_GetSizeofEEpromData._.cEEpromChannel._.ZFFSAB.eepromChannel[38].EEpromZentralHandler._.ZFFSAB ECU_ADDRESS 0xFFF97DDC /end MEASUREMENT
/begin MEASUREMENT ZFFSAB._.EEpromZentralHandler.eepromChannel[38].cnt_CallEEpromStoreImmediate "Call counter off function" UBYTE SAB_STANDARD_S2_S3 1 100 0 255 DISPLAY_IDENTIFIER cnt_CallEEpromStoreImmediate.eepromChannel[38].EEpromZentralHandler._.ZFFSAB ECU_ADDRESS 0xFFF97DDE /end MEASUREMENT
/begin MEASUREMENT ZFFSAB._.EEpromZentralHandler.eepromChannel[38].ret_CallEEpromStoreImmediate "Return value off function" UBYTE SAB_STANDARD_S2_S3 1 100 0 255 DISPLAY_IDENTIFIER ret_CallEEpromStoreImmediate.eepromChannel[38].EEpromZentralHandler._.ZFFSAB ECU_ADDRESS 0xFFF97DDF /end MEASUREMENT
/begin MEASUREMENT ZFFSAB._.EEpromZentralHandler.eepromChannel[38].cnt_CallEEpromLoadData "Call counter off function" UBYTE SAB_STANDARD_S2_S3 1 100 0 255 DISPLAY_IDENTIFIER cnt_CallEEpromLoadData.eepromChannel[38].EEpromZentralHandler._.ZFFSAB ECU_ADDRESS 0xFFF97DE0 /end MEASUREMENT
/begin MEASUREMENT ZFFSAB._.EEpromZentralHandler.eepromChannel[38].ret_CallEEpromLoadData "Return value off function" UBYTE SAB_STANDARD_S2_S3 1 100 0 255 DISPLAY_IDENTIFIER ret_CallEEpromLoadData.eepromChannel[38].EEpromZentralHandler._.ZFFSAB ECU_ADDRESS 0xFFF97DE1 /end MEASUREMENT
/begin MEASUREMENT ZFFSAB._.EEpromZentralHandler.eepromChannel[38].cnt_CallEEpromLoadDataState "Call counter off function" UBYTE SAB_STANDARD_S2_S3 1 100 0 255 DISPLAY_IDENTIFIER cnt_CallEEpromLoadDataState.eepromChannel[38].EEpromZentralHandler._.ZFFSAB ECU_ADDRESS 0xFFF97DE2 /end MEASUREMENT
/begin MEASUREMENT ZFFSAB._.EEpromZentralHandler.eepromChannel[38].ret_CallEEpromLoadDataState "Return value off function" UBYTE SAB_STANDARD_S2_S3 1 100 0 255 DISPLAY_IDENTIFIER ret_CallEEpromLoadDataState.eepromChannel[38].EEpromZentralHandler._.ZFFSAB ECU_ADDRESS 0xFFF97DE3 /end MEASUREMENT
/begin MEASUREMENT ZFFSAB._.EEpromZentralHandler.eepromChannel[38].mode "argument of SetEEpromInitZyklisch" UBYTE SAB_STANDARD_S2_S3 1 100 0 255 DISPLAY_IDENTIFIER mode.eepromChannel[38].EEpromZentralHandler._.ZFFSAB ECU_ADDRESS 0xFFF97DE4 /end MEASUREMENT
/begin MEASUREMENT ZFFSAB._.EEpromZentralHandler.eepromChannel[38].cnt_SetEEpromWriteProtect "Call counter off function" UBYTE SAB_STANDARD_S2_S3 1 100 0 255 DISPLAY_IDENTIFIER cnt_SetEEpromWriteProtect.eepromChannel[38].EEpromZentralHandler._.ZFFSAB ECU_ADDRESS 0xFFF97DE5 /end MEASUREMENT
/begin MEASUREMENT ZFFSAB._.EEpromZentralHandler.eepromChannel[39].ZFFSAB._.cEEpromChannel._.cnt_GetEEpromValid "Call counter off function" UBYTE SAB_STANDARD_S2_S3 1 100 0 255 DISPLAY_IDENTIFIER cnt_GetEEpromValid._.cEEpromChannel._.ZFFSAB.eepromChannel[39].EEpromZentralHandler._.ZFFSAB ECU_ADDRESS 0xFFF97DE6 /end MEASUREMENT
/begin MEASUREMENT ZFFSAB._.EEpromZentralHandler.eepromChannel[39].ZFFSAB._.cEEpromChannel._.ret_GetEEpromValid "Return value off function" UBYTE SAB_STANDARD_S2_S3 1 100 0 255 DISPLAY_IDENTIFIER ret_GetEEpromValid._.cEEpromChannel._.ZFFSAB.eepromChannel[39].EEpromZentralHandler._.ZFFSAB ECU_ADDRESS 0xFFF97DE7 /end MEASUREMENT
/begin MEASUREMENT ZFFSAB._.EEpromZentralHandler.eepromChannel[39].ZFFSAB._.cEEpromChannel._.cnt_GetEEpromUpdate "Call counter off function" UBYTE SAB_STANDARD_S2_S3 1 100 0 255 DISPLAY_IDENTIFIER cnt_GetEEpromUpdate._.cEEpromChannel._.ZFFSAB.eepromChannel[39].EEpromZentralHandler._.ZFFSAB ECU_ADDRESS 0xFFF97DE8 /end MEASUREMENT
/begin MEASUREMENT ZFFSAB._.EEpromZentralHandler.eepromChannel[39].ZFFSAB._.cEEpromChannel._.ret_GetEEpromUpdate "Return value off function" UBYTE SAB_STANDARD_S2_S3 1 100 0 255 DISPLAY_IDENTIFIER ret_GetEEpromUpdate._.cEEpromChannel._.ZFFSAB.eepromChannel[39].EEpromZentralHandler._.ZFFSAB ECU_ADDRESS 0xFFF97DE9 /end MEASUREMENT
/begin MEASUREMENT ZFFSAB._.EEpromZentralHandler.eepromChannel[39].ZFFSAB._.cEEpromChannel._.cnt_SetEEpromInitZyklisch "Call counter off function" UBYTE SAB_STANDARD_S2_S3 1 100 0 255 DISPLAY_IDENTIFIER cnt_SetEEpromInitZyklisch._.cEEpromChannel._.ZFFSAB.eepromChannel[39].EEpromZentralHandler._.ZFFSAB ECU_ADDRESS 0xFFF97DEA /end MEASUREMENT
/begin MEASUREMENT ZFFSAB._.EEpromZentralHandler.eepromChannel[39].ZFFSAB._.cEEpromChannel._.ret_SetEEpromInitZyklisch "Return value off function" UBYTE SAB_STANDARD_S2_S3 1 100 0 255 DISPLAY_IDENTIFIER ret_SetEEpromInitZyklisch._.cEEpromChannel._.ZFFSAB.eepromChannel[39].EEpromZentralHandler._.ZFFSAB ECU_ADDRESS 0xFFF97DEB /end MEASUREMENT
/begin MEASUREMENT ZFFSAB._.EEpromZentralHandler.eepromChannel[39].ZFFSAB._.cEEpromChannel._.eeprom_info "argument of SetEEpromInitZyklisch" UBYTE SAB_STANDARD_S2_S3 1 100 0 255 DISPLAY_IDENTIFIER eeprom_info._.cEEpromChannel._.ZFFSAB.eepromChannel[39].EEpromZentralHandler._.ZFFSAB ECU_ADDRESS 0xFFF97DEC /end MEASUREMENT
/begin MEASUREMENT ZFFSAB._.EEpromZentralHandler.eepromChannel[39].ZFFSAB._.cEEpromChannel._.cnt_GetSizeofEEpromData "Call counter off function" UBYTE SAB_STANDARD_S2_S3 1 100 0 255 DISPLAY_IDENTIFIER cnt_GetSizeofEEpromData._.cEEpromChannel._.ZFFSAB.eepromChannel[39].EEpromZentralHandler._.ZFFSAB ECU_ADDRESS 0xFFF97DED /end MEASUREMENT
/begin MEASUREMENT ZFFSAB._.EEpromZentralHandler.eepromChannel[39].ZFFSAB._.cEEpromChannel._.ret_GetSizeofEEpromData "Return value off function" UWORD SAB_STANDARD_S2_S3 1 100 0 65535 DISPLAY_IDENTIFIER ret_GetSizeofEEpromData._.cEEpromChannel._.ZFFSAB.eepromChannel[39].EEpromZentralHandler._.ZFFSAB ECU_ADDRESS 0xFFF97DEE /end MEASUREMENT
/begin MEASUREMENT ZFFSAB._.EEpromZentralHandler.eepromChannel[39].cnt_CallEEpromStoreImmediate "Call counter off function" UBYTE SAB_STANDARD_S2_S3 1 100 0 255 DISPLAY_IDENTIFIER cnt_CallEEpromStoreImmediate.eepromChannel[39].EEpromZentralHandler._.ZFFSAB ECU_ADDRESS 0xFFF97DF0 /end MEASUREMENT
/begin MEASUREMENT ZFFSAB._.EEpromZentralHandler.eepromChannel[39].ret_CallEEpromStoreImmediate "Return value off function" UBYTE SAB_STANDARD_S2_S3 1 100 0 255 DISPLAY_IDENTIFIER ret_CallEEpromStoreImmediate.eepromChannel[39].EEpromZentralHandler._.ZFFSAB ECU_ADDRESS 0xFFF97DF1 /end MEASUREMENT
/begin MEASUREMENT ZFFSAB._.EEpromZentralHandler.eepromChannel[39].cnt_CallEEpromLoadData "Call counter off function" UBYTE SAB_STANDARD_S2_S3 1 100 0 255 DISPLAY_IDENTIFIER cnt_CallEEpromLoadData.eepromChannel[39].EEpromZentralHandler._.ZFFSAB ECU_ADDRESS 0xFFF97DF2 /end MEASUREMENT
/begin MEASUREMENT ZFFSAB._.EEpromZentralHandler.eepromChannel[39].ret_CallEEpromLoadData "Return value off function" UBYTE SAB_STANDARD_S2_S3 1 100 0 255 DISPLAY_IDENTIFIER ret_CallEEpromLoadData.eepromChannel[39].EEpromZentralHandler._.ZFFSAB ECU_ADDRESS 0xFFF97DF3 /end MEASUREMENT
/begin MEASUREMENT ZFFSAB._.EEpromZentralHandler.eepromChannel[39].cnt_CallEEpromLoadDataState "Call counter off function" UBYTE SAB_STANDARD_S2_S3 1 100 0 255 DISPLAY_IDENTIFIER cnt_CallEEpromLoadDataState.eepromChannel[39].EEpromZentralHandler._.ZFFSAB ECU_ADDRESS 0xFFF97DF4 /end MEASUREMENT
/begin MEASUREMENT ZFFSAB._.EEpromZentralHandler.eepromChannel[39].ret_CallEEpromLoadDataState "Return value off function" UBYTE SAB_STANDARD_S2_S3 1 100 0 255 DISPLAY_IDENTIFIER ret_CallEEpromLoadDataState.eepromChannel[39].EEpromZentralHandler._.ZFFSAB ECU_ADDRESS 0xFFF97DF5 /end MEASUREMENT
/begin MEASUREMENT ZFFSAB._.EEpromZentralHandler.eepromChannel[39].mode "argument of SetEEpromInitZyklisch" UBYTE SAB_STANDARD_S2_S3 1 100 0 255 DISPLAY_IDENTIFIER mode.eepromChannel[39].EEpromZentralHandler._.ZFFSAB ECU_ADDRESS 0xFFF97DF6 /end MEASUREMENT
/begin MEASUREMENT ZFFSAB._.EEpromZentralHandler.eepromChannel[39].cnt_SetEEpromWriteProtect "Call counter off function" UBYTE SAB_STANDARD_S2_S3 1 100 0 255 DISPLAY_IDENTIFIER cnt_SetEEpromWriteProtect.eepromChannel[39].EEpromZentralHandler._.ZFFSAB ECU_ADDRESS 0xFFF97DF7 /end MEASUREMENT
/begin MEASUREMENT ZFFSAB._.EEpromZentralHandler.eepromChannel[40].ZFFSAB._.cEEpromChannel._.cnt_GetEEpromValid "Call counter off function" UBYTE SAB_STANDARD_S2_S3 1 100 0 255 DISPLAY_IDENTIFIER cnt_GetEEpromValid._.cEEpromChannel._.ZFFSAB.eepromChannel[40].EEpromZentralHandler._.ZFFSAB ECU_ADDRESS 0xFFF97DF8 /end MEASUREMENT
/begin MEASUREMENT ZFFSAB._.EEpromZentralHandler.eepromChannel[40].ZFFSAB._.cEEpromChannel._.ret_GetEEpromValid "Return value off function" UBYTE SAB_STANDARD_S2_S3 1 100 0 255 DISPLAY_IDENTIFIER ret_GetEEpromValid._.cEEpromChannel._.ZFFSAB.eepromChannel[40].EEpromZentralHandler._.ZFFSAB ECU_ADDRESS 0xFFF97DF9 /end MEASUREMENT
/begin MEASUREMENT ZFFSAB._.EEpromZentralHandler.eepromChannel[40].ZFFSAB._.cEEpromChannel._.cnt_GetEEpromUpdate "Call counter off function" UBYTE SAB_STANDARD_S2_S3 1 100 0 255 DISPLAY_IDENTIFIER cnt_GetEEpromUpdate._.cEEpromChannel._.ZFFSAB.eepromChannel[40].EEpromZentralHandler._.ZFFSAB ECU_ADDRESS 0xFFF97DFA /end MEASUREMENT
/begin MEASUREMENT ZFFSAB._.EEpromZentralHandler.eepromChannel[40].ZFFSAB._.cEEpromChannel._.ret_GetEEpromUpdate "Return value off function" UBYTE SAB_STANDARD_S2_S3 1 100 0 255 DISPLAY_IDENTIFIER ret_GetEEpromUpdate._.cEEpromChannel._.ZFFSAB.eepromChannel[40].EEpromZentralHandler._.ZFFSAB ECU_ADDRESS 0xFFF97DFB /end MEASUREMENT
/begin MEASUREMENT ZFFSAB._.EEpromZentralHandler.eepromChannel[40].ZFFSAB._.cEEpromChannel._.cnt_SetEEpromInitZyklisch "Call counter off function" UBYTE SAB_STANDARD_S2_S3 1 100 0 255 DISPLAY_IDENTIFIER cnt_SetEEpromInitZyklisch._.cEEpromChannel._.ZFFSAB.eepromChannel[40].EEpromZentralHandler._.ZFFSAB ECU_ADDRESS 0xFFF97DFC /end MEASUREMENT
/begin MEASUREMENT ZFFSAB._.EEpromZentralHandler.eepromChannel[40].ZFFSAB._.cEEpromChannel._.ret_SetEEpromInitZyklisch "Return value off function" UBYTE SAB_STANDARD_S2_S3 1 100 0 255 DISPLAY_IDENTIFIER ret_SetEEpromInitZyklisch._.cEEpromChannel._.ZFFSAB.eepromChannel[40].EEpromZentralHandler._.ZFFSAB ECU_ADDRESS 0xFFF97DFD /end MEASUREMENT
/begin MEASUREMENT ZFFSAB._.EEpromZentralHandler.eepromChannel[40].ZFFSAB._.cEEpromChannel._.eeprom_info "argument of SetEEpromInitZyklisch" UBYTE SAB_STANDARD_S2_S3 1 100 0 255 DISPLAY_IDENTIFIER eeprom_info._.cEEpromChannel._.ZFFSAB.eepromChannel[40].EEpromZentralHandler._.ZFFSAB ECU_ADDRESS 0xFFF97DFE /end MEASUREMENT
/begin MEASUREMENT ZFFSAB._.EEpromZentralHandler.eepromChannel[40].ZFFSAB._.cEEpromChannel._.cnt_GetSizeofEEpromData "Call counter off function" UBYTE SAB_STANDARD_S2_S3 1 100 0 255 DISPLAY_IDENTIFIER cnt_GetSizeofEEpromData._.cEEpromChannel._.ZFFSAB.eepromChannel[40].EEpromZentralHandler._.ZFFSAB ECU_ADDRESS 0xFFF97DFF /end MEASUREMENT
/begin MEASUREMENT ZFFSAB._.EEpromZentralHandler.eepromChannel[40].ZFFSAB._.cEEpromChannel._.ret_GetSizeofEEpromData "Return value off function" UWORD SAB_STANDARD_S2_S3 1 100 0 65535 DISPLAY_IDENTIFIER ret_GetSizeofEEpromData._.cEEpromChannel._.ZFFSAB.eepromChannel[40].EEpromZentralHandler._.ZFFSAB ECU_ADDRESS 0xFFF97E00 /end MEASUREMENT
/begin MEASUREMENT ZFFSAB._.EEpromZentralHandler.eepromChannel[40].cnt_CallEEpromStoreImmediate "Call counter off function" UBYTE SAB_STANDARD_S2_S3 1 100 0 255 DISPLAY_IDENTIFIER cnt_CallEEpromStoreImmediate.eepromChannel[40].EEpromZentralHandler._.ZFFSAB ECU_ADDRESS 0xFFF97E02 /end MEASUREMENT
/begin MEASUREMENT ZFFSAB._.EEpromZentralHandler.eepromChannel[40].cnt_CallEEpromLoadData "Call counter off function" UBYTE SAB_STANDARD_S2_S3 1 100 0 255 DISPLAY_IDENTIFIER cnt_CallEEpromLoadData.eepromChannel[40].EEpromZentralHandler._.ZFFSAB ECU_ADDRESS 0xFFF97E04 /end MEASUREMENT
/begin MEASUREMENT ZFFSAB._.EEpromZentralHandler.eepromChannel[40].cnt_CallEEpromLoadDataState "Call counter off function" UBYTE SAB_STANDARD_S2_S3 1 100 0 255 DISPLAY_IDENTIFIER cnt_CallEEpromLoadDataState.eepromChannel[40].EEpromZentralHandler._.ZFFSAB ECU_ADDRESS 0xFFF97E06 /end MEASUREMENT
/begin MEASUREMENT ZFFSAB._.EEpromZentralHandler.eepromChannel[40].mode "argument of SetEEpromInitZyklisch" UBYTE SAB_STANDARD_S2_S3 1 100 0 255 DISPLAY_IDENTIFIER mode.eepromChannel[40].EEpromZentralHandler._.ZFFSAB ECU_ADDRESS 0xFFF97E08 /end MEASUREMENT
/begin MEASUREMENT ZFFSAB._.EEpromZentralHandler.eepromChannel[40].cnt_SetEEpromWriteProtect "Call counter off function" UBYTE SAB_STANDARD_S2_S3 1 100 0 255 DISPLAY_IDENTIFIER cnt_SetEEpromWriteProtect.eepromChannel[40].EEpromZentralHandler._.ZFFSAB ECU_ADDRESS 0xFFF97E09 /end MEASUREMENT
/begin COMPU_METHOD SAB_STANDARD_S2_S3 "int = ((phys * 1) / 1) - (0) -" RAT_FUNC "%2.0" "-" COEFFS 0 1 -0 0 0 1 /end COMPU_METHOD
/begin FUNCTION zf_SAB_EEpromZentralHandler "desc_en"
 /begin LOC_MEASUREMENT ZFFSAB._.EEpromZentralHandler.eepromChannel[14].ZFFSAB._.cEEpromChannel._.ret_GetEEpromValid ZFFSAB._.EEpromZentralHandler.eepromChannel[14].ZFFSAB._.cEEpromChannel._.ret_GetSizeofEEpromData ZFFSAB._.EEpromZentralHandler.eepromChannel[14].ZFFSAB._.cEEpromChannel._.ret_SetEEpromInitZyklisch ZFFSAB._.EEpromZentralHandler.eepromChannel[14].cnt_CallEEpromLoadData ZFFSAB._.EEpromZentralHandler.eepromChannel[14].cnt_CallEEpromLoadDataState ZFFSAB._.EEpromZentralHandler.eepromChannel[14].cnt_CallEEpromStoreImmediate ZFFSAB._.EEpromZentralHandler.eepromChannel[14].cnt_SetEEpromWriteProtect ZFFSAB._.EEpromZentralHandler.eepromChannel[14].mode ZFFSAB._.EEpromZentralHandler.eepromChannel[14].ret_CallEEpromLoadData ZFFSAB._.EEpromZentralHandler.eepromChannel[14].ret_CallEEpromLoadDataState ZFFSAB._.EEpromZentralHandler.eepromChannel[14].ret_CallEEpromStoreImmediate ZFFSAB._.EEpromZentralHandler.eepromChannel[15].ZFFSAB._.cEEpromChannel._.cnt_GetEEpromUpdate ZFFSAB._.EEpromZentralHandler.eepromChannel[15].ZFFSAB._.cEEpromChannel._.cnt_GetEEpromValid ZFFSAB._.EEpromZentralHandler.eepromChannel[15].ZFFSAB._.cEEpromChannel._.cnt_GetSizeofEEpromData ZFFSAB._.EEpromZentralHandler.eepromChannel[15].ZFFSAB._.cEEpromChannel._.cnt_SetEEpromInitZyklisch ZFFSAB._.EEpromZentralHandler.eepromChannel[15].ZFFSAB._.cEEpromChannel._.eeprom_info ZFFSAB._.EEpromZentralHandler.eepromChannel[15].ZFFSAB._.cEEpromChannel._.ret_GetEEpromUpdate ZFFSAB._.EEpromZentralHandler.eepromChannel[15].ZFFSAB._.cEEpromChannel._.ret_GetEEpromValid ZFFSAB._.EEpromZentralHandler.eepromChannel[15].ZFFSAB._.cEEpromChannel._.ret_GetSizeofEEpromData ZFFSAB._.EEpromZentralHandler.eepromChannel[15].ZFFSAB._.cEEpromChannel._.ret_SetEEpromInitZyklisch ZFFSAB._.EEpromZentralHandler.eepromChannel[15].cnt_CallEEpromLoadData ZFFSAB._.EEpromZentralHandler.eepromChannel[15].cnt_CallEEpromLoadDataState ZFFSAB._.EEpromZentralHandler.eepromChannel[15].cnt_CallEEpromStoreImmediate ZFFSAB._.EEpromZentralHandler.eepromChannel[15].cnt_SetEEpromWriteProtect ZFFSAB._.EEpromZentralHandler.eepromChannel[15].mode ZFFSAB._.EEpromZentralHandler.eepromChannel[15].ret_CallEEpromLoadData ZFFSAB._.EEpromZentralHandler.eepromChannel[15].ret_CallEEpromLoadDataState ZFFSAB._.EEpromZentralHandler.eepromChannel[15].ret_CallEEpromStoreImmediate ZFFSAB._.EEpromZentralHandler.eepromChannel[16].ZFFSAB._.cEEpromChannel._.cnt_GetEEpromUpdate ZFFSAB._.EEpromZentralHandler.eepromChannel[16].ZFFSAB._.cEEpromChannel._.cnt_GetEEpromValid ZFFSAB._.EEpromZentralHandler.eepromChannel[16].ZFFSAB._.cEEpromChannel._.cnt_GetSizeofEEpromData ZFFSAB._.EEpromZentralHandler.eepromChannel[16].ZFFSAB._.cEEpromChannel._.cnt_SetEEpromInitZyklisch ZFFSAB._.EEpromZentralHandler.eepromChannel[16].ZFFSAB._.cEEpromChannel._.eeprom_info ZFFSAB._.EEpromZentralHandler.eepromChannel[16].ZFFSAB._.cEEpromChannel._.ret_GetEEpromUpdate ZFFSAB._.EEpromZentralHandler.eepromChannel[16].ZFFSAB._.cEEpromChannel._.ret_GetEEpromValid ZFFSAB._.EEpromZentralHandler.eepromChannel[16].ZFFSAB._.cEEpromChannel._.ret_GetSizeofEEpromData ZFFSAB._.EEpromZentralHandler.eepromChannel[16].ZFFSAB._.cEEpromChannel._.ret_SetEEpromInitZyklisch ZFFSAB._.EEpromZentralHandler.eepromChannel[16].cnt_CallEEpromLoadData ZFFSAB._.EEpromZentralHandler.eepromChannel[16].cnt_CallEEpromLoadDataState ZFFSAB._.EEpromZentralHandler.eepromChannel[16].cnt_CallEEpromStoreImmediate ZFFSAB._.EEpromZentralHandler.eepromChannel[16].cnt_SetEEpromWriteProtect ZFFSAB._.EEpromZentralHandler.eepromChannel[16].mode ZFFSAB._.EEpromZentralHandler.eepromChannel[16].ret_CallEEpromLoadData ZFFSAB._.EEpromZentralHandler.eepromChannel[16].ret_CallEEpromLoadDataState ZFFSAB._.EEpromZentralHandler.eepromChannel[16].ret_CallEEpromStoreImmediate ZFFSAB._.EEpromZentralHandler.eepromChannel[17].ZFFSAB._.cEEpromChannel._.cnt_GetEEpromUpdate ZFFSAB._.EEpromZentralHandler.eepromChannel[17].ZFFSAB._.cEEpromChannel._.cnt_GetEEpromValid ZFFSAB._.EEpromZentralHandler.eepromChannel[17].ZFFSAB._.cEEpromChannel._.cnt_GetSizeofEEpromData ZFFSAB._.EEpromZentralHandler.eepromChannel[17].ZFFSAB._.cEEpromChannel._.cnt_SetEEpromInitZyklisch ZFFSAB._.EEpromZentralHandler.eepromChannel[17].ZFFSAB._.cEEpromChannel._.eeprom_info ZFFSAB._.EEpromZentralHandler.eepromChannel[17].ZFFSAB._.cEEpromChannel._.ret_GetEEpromUpdate ZFFSAB._.EEpromZentralHandler.eepromChannel[17].ZFFSAB._.cEEpromChannel._.ret_GetEEpromValid ZFFSAB._.EEpromZentralHandler.eepromChannel[17].ZFFSAB._.cEEpromChannel._.ret_GetSizeofEEpromData ZFFSAB._.EEpromZentralHandler.eepromChannel[17].ZFFSAB._.cEEpromChannel._.ret_SetEEpromInitZyklisch ZFFSAB._.EEpromZentralHandler.eepromChannel[17].cnt_CallEEpromLoadData ZFFSAB._.EEpromZentralHandler.eepromChannel[17].cnt_CallEEpromLoadDataState ZFFSAB._.EEpromZentralHandler.eepromChannel[17].cnt_CallEEpromStoreImmediate ZFFSAB._.EEpromZentralHandler.eepromChannel[17].cnt_SetEEpromWriteProtect ZFFSAB._.EEpromZentralHandler.eepromChannel[17].mode ZFFSAB._.EEpromZentralHandler.eepromChannel[17].ret_CallEEpromLoadData ZFFSAB._.EEpromZentralHandler.eepromChannel[17].ret_CallEEpromLoadDataState ZFFSAB._.EEpromZentralHandler.eepromChannel[17].ret_CallEEpromStoreImmediate ZFFSAB._.EEpromZentralHandler.eepromChannel[18].ZFFSAB._.cEEpromChannel._.cnt_GetEEpromUpdate ZFFSAB._.EEpromZentralHandler.eepromChannel[18].ZFFSAB._.cEEpromChannel._.cnt_GetEEpromValid ZFFSAB._.EEpromZentralHandler.eepromChannel[18].ZFFSAB._.cEEpromChannel._.cnt_GetSizeofEEpromData ZFFSAB._.EEpromZentralHandler.eepromChannel[18].ZFFSAB._.cEEpromChannel._.cnt_SetEEpromInitZyklisch ZFFSAB._.EEpromZentralHandler.eepromChannel[18].ZFFSAB._.cEEpromChannel._.eeprom_info ZFFSAB._.EEpromZentralHandler.eepromChannel[18].ZFFSAB._.cEEpromChannel._.ret_GetEEpromUpdate ZFFSAB._.EEpromZentralHandler.eepromChannel[18].ZFFSAB._.cEEpromChannel._.ret_GetEEpromValid ZFFSAB._.EEpromZentralHandler.eepromChannel[18].ZFFSAB._.cEEpromChannel._.ret_GetSizeofEEpromData ZFFSAB._.EEpromZentralHandler.eepromChannel[18].ZFFSAB._.cEEpromChannel._.ret_SetEEpromInitZyklisch ZFFSAB._.EEpromZentralHandler.eepromChannel[18].cnt_CallEEpromLoadData ZFFSAB._.EEpromZentralHandler.eepromChannel[18].cnt_CallEEpromLoadDataState ZFFSAB._.EEpromZentralHandler.eepromChannel[18].cnt_CallEEpromStoreImmediate ZFFSAB._.EEpromZentralHandler.eepromChannel[18].cnt_SetEEpromWriteProtect ZFFSAB._.EEpromZentralHandler.eepromChannel[18].mode ZFFSAB._.EEpromZentralHandler.eepromChannel[18].ret_CallEEpromLoadData ZFFSAB._.EEpromZentralHandler.eepromChannel[18].ret_CallEEpromLoadDataState ZFFSAB._.EEpromZentralHandler.eepromChannel[18].ret_CallEEpromStoreImmediate ZFFSAB._.EEpromZentralHandler.eepromChannel[19].ZFFSAB._.cEEpromChannel._.cnt_GetEEpromUpdate ZFFSAB._.EEpromZentralHandler.eepromChannel[19].ZFFSAB._.cEEpromChannel._.cnt_GetEEpromValid ZFFSAB._.EEpromZentralHandler.eepromChannel[19].ZFFSAB._.cEEpromChannel._.cnt_GetSizeofEEpromData ZFFSAB._.EEpromZentralHandler.eepromChannel[19].ZFFSAB._.cEEpromChannel._.cnt_SetEEpromInitZyklisch ZFFSAB._.EEpromZentralHandler.eepromChannel[19].ZFFSAB._.cEEpromChannel._.eeprom_info ZFFSAB._.EEpromZentralHandler.eepromChannel[19].ZFFSAB._.cEEpromChannel._.ret_GetEEpromUpdate ZFFSAB._.EEpromZentralHandler.eepromChannel[19].ZFFSAB._.cEEpromChannel._.ret_GetEEpromValid ZFFSAB._.EEpromZentralHandler.eepromChannel[19].ZFFSAB._.cEEpromChannel._.ret_GetSizeofEEpromData ZFFSAB._.EEpromZentralHandler.eepromChannel[19].ZFFSAB._.cEEpromChannel._.ret_SetEEpromInitZyklisch ZFFSAB._.EEpromZentralHandler.eepromChannel[19].cnt_CallEEpromLoadData ZFFSAB._.EEpromZentralHandler.eepromChannel[19].cnt_CallEEpromLoadDataState ZFFSAB._.EEpromZentralHandler.eepromChannel[19].cnt_CallEEpromStoreImmediate ZFFSAB._.EEpromZentralHandler.eepromChannel[19].cnt_SetEEpromWriteProtect ZFFSAB._.EEpromZentralHandler.eepromChannel[19].mode ZFFSAB._.EEpromZentralHandler.eepromChannel[19].ret_CallEEpromLoadData ZFFSAB._.EEpromZentralHandler.eepromChannel[19].ret_CallEEpromLoadDataState ZFFSAB._.EEpromZentralHandler.eepromChannel[19].ret_CallEEpromStoreImmediate ZFFSAB._.EEpromZentralHandler.eepromChannel[1].ZFFSAB._.cEEpromChannel._.cnt_GetEEpromUpdate ZFFSAB._.EEpromZentralHandler.eepromChannel[1].ZFFSAB._.cEEpromChannel._.cnt_GetEEpromValid ZFFSAB._.EEpromZentralHandler.eepromChannel[1].ZFFSAB._.cEEpromChannel._.cnt_GetSizeofEEpromData ZFFSAB._.EEpromZentralHandler.eepromChannel[1].ZFFSAB._.cEEpromChannel._.cnt_SetEEpromInitZyklisch ZFFSAB._.EEpromZentralHandler.eepromChannel[1].ZFFSAB._.cEEpromChannel._.eeprom_info ZFFSAB._.EEpromZentralHandler.eepromChannel[1].ZFFSAB._.cEEpromChannel._.ret_GetEEpromUpdate ZFFSAB._.EEpromZentralHandler.eepromChannel[1].ZFFSAB._.cEEpromChannel._.ret_GetEEpromValid ZFFSAB._.EEpromZentralHandler.eepromChannel[1].ZFFSAB._.cEEpromChannel._.ret_GetSizeofEEpromData ZFFSAB._.EEpromZentralHandler.eepromChannel[1].ZFFSAB._.cEEpromChannel._.ret_SetEEpromInitZyklisch ZFFSAB._.EEpromZentralHandler.eepromChannel[1].cnt_CallEEpromLoadData ZFFSAB._.EEpromZentralHandler.eepromChannel[1].cnt_CallEEpromLoadDataState ZFFSAB._.EEpromZentralHandler.eepromChannel[1].cnt_CallEEpromStoreImmediate ZFFSAB._.EEpromZentralHandler.eepromChannel[1].cnt_SetEEpromWriteProtect ZFFSAB._.EEpromZentralHandler.eepromChannel[1].mode ZFFSAB._.EEpromZentralHandler.eepromChannel[1].ret_CallEEpromLoadData ZFFSAB._.EEpromZentralHandler.eepromChannel[1].ret_CallEEpromLoadDataState ZFFSAB._.EEpromZentralHandler.eepromChannel[1].ret_CallEEpromStoreImmediate ZFFSAB._.EEpromZentralHandler.eepromChannel[20].ZFFSAB._.cEEpromChannel._.cnt_GetEEpromUpdate ZFFSAB._.EEpromZentralHandler.eepromChannel[20].ZFFSAB._.cEEpromChannel._.cnt_GetEEpromValid ZFFSAB._.EEpromZentralHandler.eepromChannel[20].ZFFSAB._.cEEpromChannel._.cnt_GetSizeofEEpromData ZFFSAB._.EEpromZentralHandler.eepromChannel[20].ZFFSAB._.cEEpromChannel._.cnt_SetEEpromInitZyklisch ZFFSAB._.EEpromZentralHandler.eepromChannel[20].ZFFSAB._.cEEpromChannel._.eeprom_info ZFFSAB._.EEpromZentralHandler.eepromChannel[20].ZFFSAB._.cEEpromChannel._.ret_GetEEpromUpdate ZFFSAB._.EEpromZentralHandler.eepromChannel[20].ZFFSAB._.cEEpromChannel._.ret_GetEEpromValid ZFFSAB._.EEpromZentralHandler.eepromChannel[20].ZFFSAB._.cEEpromChannel._.ret_GetSizeofEEpromData ZFFSAB._.EEpromZentralHandler.eepromChannel[20].ZFFSAB._.cEEpromChannel._.ret_SetEEpromInitZyklisch ZFFSAB._.EEpromZentralHandler.eepromChannel[20].cnt_CallEEpromLoadData ZFFSAB._.EEpromZentralHandler.eepromChannel[20].cnt_CallEEpromLoadDataState ZFFSAB._.EEpromZentralHandler.eepromChannel[20].cnt_CallEEpromStoreImmediate ZFFSAB._.EEpromZentralHandler.eepromChannel[20].cnt_SetEEpromWriteProtect ZFFSAB._.EEpromZentralHandler.eepromChannel[20].mode ZFFSAB._.EEpromZentralHandler.eepromChannel[20].ret_CallEEpromLoadData ZFFSAB._.EEpromZentralHandler.eepromChannel[20].ret_CallEEpromLoadDataState ZFFSAB._.EEpromZentralHandler.eepromChannel[20].ret_CallEEpromStoreImmediate ZFFSAB._.EEpromZentralHandler.eepromChannel[21].ZFFSAB._.cEEpromChannel._.cnt_GetEEpromUpdate ZFFSAB._.EEpromZentralHandler.eepromChannel[21].ZFFSAB._.cEEpromChannel._.cnt_GetEEpromValid ZFFSAB._.EEpromZentralHandler.eepromChannel[21].ZFFSAB._.cEEpromChannel._.cnt_GetSizeofEEpromData ZFFSAB._.EEpromZentralHandler.eepromChannel[21].ZFFSAB._.cEEpromChannel._.cnt_SetEEpromInitZyklisch ZFFSAB._.EEpromZentralHandler.eepromChannel[21].ZFFSAB._.cEEpromChannel._.eeprom_info ZFFSAB._.EEpromZentralHandler.eepromChannel[21].ZFFSAB._.cEEpromChannel._.ret_GetEEpromUpdate ZFFSAB._.EEpromZentralHandler.eepromChannel[21].ZFFSAB._.cEEpromChannel._.ret_GetEEpromValid ZFFSAB._.EEpromZentralHandler.eepromChannel[21].ZFFSAB._.cEEpromChannel._.ret_GetSizeofEEpromData ZFFSAB._.EEpromZentralHandler.eepromChannel[21].ZFFSAB._.cEEpromChannel._.ret_SetEEpromInitZyklisch ZFFSAB._.EEpromZentralHandler.eepromChannel[21].cnt_CallEEpromLoadData ZFFSAB._.EEpromZentralHandler.eepromChannel[21].cnt_CallEEpromLoadDataState ZFFSAB._.EEpromZentralHandler.eepromChannel[21].cnt_CallEEpromStoreImmediate ZFFSAB._.EEpromZentralHandler.eepromChannel[21].cnt_SetEEpromWriteProtect ZFFSAB._.EEpromZentralHandler.eepromChannel[21].mode ZFFSAB._.EEpromZentralHandler.eepromChannel[21].ret_CallEEpromLoadData ZFFSAB._.EEpromZentralHandler.eepromChannel[21].ret_CallEEpromLoadDataState ZFFSAB._.EEpromZentralHandler.eepromChannel[21].ret_CallEEpromStoreImmediate ZFFSAB._.EEpromZentralHandler.eepromChannel[22].ZFFSAB._.cEEpromChannel._.cnt_GetEEpromUpdate ZFFSAB._.EEpromZentralHandler.eepromChannel[22].ZFFSAB._.cEEpromChannel._.cnt_GetEEpromValid ZFFSAB._.EEpromZentralHandler.eepromChannel[22].ZFFSAB._.cEEpromChannel._.cnt_GetSizeofEEpromData ZFFSAB._.EEpromZentralHandler.eepromChannel[22].ZFFSAB._.cEEpromChannel._.cnt_SetEEpromInitZyklisch ZFFSAB._.EEpromZentralHandler.eepromChannel[22].ZFFSAB._.cEEpromChannel._.eeprom_info ZFFSAB._.EEpromZentralHandler.eepromChannel[22].ZFFSAB._.cEEpromChannel._.ret_GetEEpromUpdate ZFFSAB._.EEpromZentralHandler.eepromChannel[22].ZFFSAB._.cEEpromChannel._.ret_GetEEpromValid ZFFSAB._.EEpromZentralHandler.eepromChannel[22].ZFFSAB._.cEEpromChannel._.ret_GetSizeofEEpromData ZFFSAB._.EEpromZentralHandler.eepromChannel[22].ZFFSAB._.cEEpromChannel._.ret_SetEEpromInitZyklisch ZFFSAB._.EEpromZentralHandler.eepromChannel[22].cnt_CallEEpromLoadData ZFFSAB._.EEpromZentralHandler.eepromChannel[22].cnt_CallEEpromLoadDataState ZFFSAB._.EEpromZentralHandler.eepromChannel[22].cnt_CallEEpromStoreImmediate ZFFSAB._.EEpromZentralHandler.eepromChannel[22].cnt_SetEEpromWriteProtect ZFFSAB._.EEpromZentralHandler.eepromChannel[22].mode ZFFSAB._.EEpromZentralHandler.eepromChannel[22].ret_CallEEpromLoadData ZFFSAB._.EEpromZentralHandler.eepromChannel[22].ret_CallEEpromLoadDataState ZFFSAB._.EEpromZentralHandler.eepromChannel[22].ret_CallEEpromStoreImmediate ZFFSAB._.EEpromZentralHandler.eepromChannel[23].ZFFSAB._.cEEpromChannel._.cnt_GetEEpromUpdate ZFFSAB._.EEpromZentralHandler.eepromChannel[23].ZFFSAB._.cEEpromChannel._.cnt_GetEEpromValid ZFFSAB._.EEpromZentralHandler.eepromChannel[23].ZFFSAB._.cEEpromChannel._.cnt_GetSizeofEEpromData ZFFSAB._.EEpromZentralHandler.eepromChannel[23].ZFFSAB._.cEEpromChannel._.cnt_SetEEpromInitZyklisch ZFFSAB._.EEpromZentralHandler.eepromChannel[23].ZFFSAB._.cEEpromChannel._.eeprom_info ZFFSAB._.EEpromZentralHandler.eepromChannel[23].ZFFSAB._.cEEpromChannel._.ret_GetEEpromUpdate ZFFSAB._.EEpromZentralHandler.eepromChannel[23].ZFFSAB._.cEEpromChannel._.ret_GetEEpromValid ZFFSAB._.EEpromZentralHandler.eepromChannel[23].ZFFSAB._.cEEpromChannel._.ret_GetSizeofEEpromData ZFFSAB._.EEpromZentralHandler.eepromChannel[23].ZFFSAB._.cEEpromChannel._.ret_SetEEpromInitZyklisch ZFFSAB._.EEpromZentralHandler.eepromChannel[23].cnt_CallEEpromLoadData ZFFSAB._.EEpromZentralHandler.eepromChannel[23].cnt_CallEEpromLoadDataState ZFFSAB._.EEpromZentralHandler.eepromChannel[23].cnt_CallEEpromStoreImmediate ZFFSAB._.EEpromZentralHandler.eepromChannel[23].cnt_SetEEpromWriteProtect ZFFSAB._.EEpromZentralHandler.eepromChannel[23].mode ZFFSAB._.EEpromZentralHandler.eepromChannel[23].ret_CallEEpromLoadData ZFFSAB._.EEpromZentralHandler.eepromChannel[23].ret_CallEEpromLoadDataState ZFFSAB._.EEpromZentralHandler.eepromChannel[23].ret_CallEEpromStoreImmediate ZFFSAB._.EEpromZentralHandler.eepromChannel[24].ZFFSAB._.cEEpromChannel._.cnt_GetEEpromUpdate ZFFSAB._.EEpromZentralHandler.eepromChannel[24].ZFFSAB._.cEEpromChannel._.cnt_GetEEpromValid ZFFSAB._.EEpromZentralHandler.eepromChannel[24].ZFFSAB._.cEEpromChannel._.cnt_GetSizeofEEpromData ZFFSAB._.EEpromZentralHandler.eepromChannel[24].ZFFSAB._.cEEpromChannel._.cnt_SetEEpromInitZyklisch ZFFSAB._.EEpromZentralHandler.eepromChannel[24].ZFFSAB._.cEEpromChannel._.eeprom_info ZFFSAB._.EEpromZentralHandler.eepromChannel[24].ZFFSAB._.cEEpromChannel._.ret_GetEEpromUpdate ZFFSAB._.EEpromZentralHandler.eepromChannel[24].ZFFSAB._.cEEpromChannel._.ret_GetEEpromValid ZFFSAB._.EEpromZentralHandler.eepromChannel[24].ZFFSAB._.cEEpromChannel._.ret_GetSizeofEEpromData ZFFSAB._.EEpromZentralHandler.eepromChannel[24].ZFFSAB._.cEEpromChannel._.ret_SetEEpromInitZyklisch ZFFSAB._.EEpromZentralHandler.eepromChannel[24].cnt_CallEEpromLoadData ZFFSAB._.EEpromZentralHandler.eepromChannel[24].cnt_CallEEpromLoadDataState ZFFSAB._.EEpromZentralHandler.eepromChannel[24].cnt_CallEEpromStoreImmediate ZFFSAB._.EEpromZentralHandler.eepromChannel[24].cnt_SetEEpromWriteProtect ZFFSAB._.EEpromZentralHandler.eepromChannel[24].mode ZFFSAB._.EEpromZentralHandler.eepromChannel[24].ret_CallEEpromLoadData ZFFSAB._.EEpromZentralHandler.eepromChannel[24].ret_CallEEpromLoadDataState ZFFSAB._.EEpromZentralHandler.eepromChannel[24].ret_CallEEpromStoreImmediate ZFFSAB._.EEpromZentralHandler.eepromChannel[25].ZFFSAB._.cEEpromChannel._.cnt_GetEEpromUpdate ZFFSAB._.EEpromZentralHandler.eepromChannel[25].ZFFSAB._.cEEpromChannel._.cnt_GetEEpromValid ZFFSAB._.EEpromZentralHandler.eepromChannel[25].ZFFSAB._.cEEpromChannel._.cnt_GetSizeofEEpromData ZFFSAB._.EEpromZentralHandler.eepromChannel[25].ZFFSAB._.cEEpromChannel._.cnt_SetEEpromInitZyklisch ZFFSAB._.EEpromZentralHandler.eepromChannel[25].ZFFSAB._.cEEpromChannel._.eeprom_info ZFFSAB._.EEpromZentralHandler.eepromChannel[25].ZFFSAB._.cEEpromChannel._.ret_GetEEpromUpdate ZFFSAB._.EEpromZentralHandler.eepromChannel[25].ZFFSAB._.cEEpromChannel._.ret_GetEEpromValid ZFFSAB._.EEpromZentralHandler.eepromChannel[25].ZFFSAB._.cEEpromChannel._.ret_GetSizeofEEpromData ZFFSAB._.EEpromZentralHandler.eepromChannel[25].ZFFSAB._.cEEpromChannel._.ret_SetEEpromInitZyklisch ZFFSAB._.EEpromZentralHandler.eepromChannel[25].cnt_CallEEpromLoadData ZFFSAB._.EEpromZentralHandler.eepromChannel[25].cnt_CallEEpromLoadDataState ZFFSAB._.EEpromZentralHandler.eepromChannel[25].cnt_CallEEpromStoreImmediate ZFFSAB._.EEpromZentralHandler.eepromChannel[25].cnt_SetEEpromWriteProtect ZFFSAB._.EEpromZentralHandler.eepromChannel[25].mode ZFFSAB._.EEpromZentralHandler.eepromChannel[25].ret_CallEEpromLoadData ZFFSAB._.EEpromZentralHandler.eepromChannel[25].ret_CallEEpromLoadDataState ZFFSAB._.EEpromZentralHandler.eepromChannel[25].ret_CallEEpromStoreImmediate ZFFSAB._.EEpromZentralHandler.eepromChannel[26].ZFFSAB._.cEEpromChannel._.cnt_GetEEpromUpdate ZFFSAB._.EEpromZentralHandler.eepromChannel[26].ZFFSAB._.cEEpromChannel._.cnt_GetEEpromValid ZFFSAB._.EEpromZentralHandler.eepromChannel[26].ZFFSAB._.cEEpromChannel._.cnt_GetSizeofEEpromData ZFFSAB._.EEpromZentralHandler.eepromChannel[26].ZFFSAB._.cEEpromChannel._.cnt_SetEEpromInitZyklisch ZFFSAB._.EEpromZentralHandler.eepromChannel[26].ZFFSAB._.cEEpromChannel._.eeprom_info ZFFSAB._.EEpromZentralHandler.eepromChannel[26].ZFFSAB._.cEEpromChannel._.ret_GetEEpromUpdate ZFFSAB._.EEpromZentralHandler.eepromChannel[26].ZFFSAB._.cEEpromChannel._.ret_GetEEpromValid ZFFSAB._.EEpromZentralHandler.eepromChannel[26].ZFFSAB._.cEEpromChannel._.ret_GetSizeofEEpromData ZFFSAB._.EEpromZentralHandler.eepromChannel[26].ZFFSAB._.cEEpromChannel._.ret_SetEEpromInitZyklisch ZFFSAB._.EEpromZentralHandler.eepromChannel[26].cnt_CallEEpromLoadData ZFFSAB._.EEpromZentralHandler.eepromChannel[26].cnt_CallEEpromLoadDataState ZFFSAB._.EEpromZentralHandler.eepromChannel[26].cnt_CallEEpromStoreImmediate ZFFSAB._.EEpromZentralHandler.eepromChannel[26].cnt_SetEEpromWriteProtect ZFFSAB._.EEpromZentralHandler.eepromChannel[26].mode ZFFSAB._.EEpromZentralHandler.eepromChannel[26].ret_CallEEpromLoadData ZFFSAB._.EEpromZentralHandler.eepromChannel[26].ret_CallEEpromLoadDataState ZFFSAB._.EEpromZentralHandler.eepromChannel[26].ret_CallEEpromStoreImmediate ZFFSAB._.EEpromZentralHandler.eepromChannel[27].ZFFSAB._.cEEpromChannel._.cnt_GetEEpromUpdate ZFFSAB._.EEpromZentralHandler.eepromChannel[27].ZFFSAB._.cEEpromChannel._.cnt_GetEEpromValid ZFFSAB._.EEpromZentralHandler.eepromChannel[27].ZFFSAB._.cEEpromChannel._.cnt_GetSizeofEEpromData ZFFSAB._.EEpromZentralHandler.eepromChannel[27].ZFFSAB._.cEEpromChannel._.cnt_SetEEpromInitZyklisch ZFFSAB._.EEpromZentralHandler.eepromChannel[27].ZFFSAB._.cEEpromChannel._.eeprom_info ZFFSAB._.EEpromZentralHandler.eepromChannel[27].ZFFSAB._.cEEpromChannel._.ret_GetEEpromUpdate ZFFSAB._.EEpromZentralHandler.eepromChannel[27].ZFFSAB._.cEEpromChannel._.ret_GetEEpromValid ZFFSAB._.EEpromZentralHandler.eepromChannel[27].ZFFSAB._.cEEpromChannel._.ret_GetSizeofEEpromData ZFFSAB._.EEpromZentralHandler.eepromChannel[27].ZFFSAB._.cEEpromChannel._.ret_SetEEpromInitZyklisch ZFFSAB._.EEpromZentralHandler.eepromChannel[27].cnt_CallEEpromLoadData ZFFSAB._.EEpromZentralHandler.eepromChannel[27].cnt_CallEEpromLoadDataState ZFFSAB._.EEpromZentralHandler.eepromChannel[27].cnt_CallEEpromStoreImmediate ZFFSAB._.EEpromZentralHandler.eepromChannel[27].cnt_SetEEpromWriteProtect ZFFSAB._.EEpromZentralHandler.eepromChannel[27].mode ZFFSAB._.EEpromZentralHandler.eepromChannel[27].ret_CallEEpromLoadData ZFFSAB._.EEpromZentralHandler.eepromChannel[27].ret_CallEEpromLoadDataState ZFFSAB._.EEpromZentralHandler.eepromChannel[27].ret_CallEEpromStoreImmediate ZFFSAB._.EEpromZentralHandler.eepromChannel[28].ZFFSAB._.cEEpromChannel._.cnt_GetEEpromUpdate ZFFSAB._.EEpromZentralHandler.eepromChannel[28].ZFFSAB._.cEEpromChannel._.cnt_GetEEpromValid ZFFSAB._.EEpromZentralHandler.eepromChannel[28].ZFFSAB._.cEEpromChannel._.cnt_GetSizeofEEpromData ZFFSAB._.EEpromZentralHandler.eepromChannel[28].ZFFSAB._.cEEpromChannel._.cnt_SetEEpromInitZyklisch ZFFSAB._.EEpromZentralHandler.eepromChannel[28].ZFFSAB._.cEEpromChannel._.eeprom_info ZFFSAB._.EEpromZentralHandler.eepromChannel[28].ZFFSAB._.cEEpromChannel._.ret_GetEEpromUpdate ZFFSAB._.EEpromZentralHandler.eepromChannel[28].ZFFSAB._.cEEpromChannel._.ret_GetEEpromValid ZFFSAB._.EEpromZentralHandler.eepromChannel[28].ZFFSAB._.cEEpromChannel._.ret_GetSizeofEEpromData ZFFSAB._.EEpromZentralHandler.eepromChannel[28].ZFFSAB._.cEEpromChannel._.ret_SetEEpromInitZyklisch ZFFSAB._.EEpromZentralHandler.eepromChannel[28].cnt_CallEEpromLoadData ZFFSAB._.EEpromZentralHandler.eepromChannel[28].cnt_CallEEpromLoadDataState ZFFSAB._.EEpromZentralHandler.eepromChannel[28].cnt_CallEEpromStoreImmediate ZFFSAB._.EEpromZentralHandler.eepromChannel[28].cnt_SetEEpromWriteProtect ZFFSAB._.EEpromZentralHandler.eepromChannel[28].mode ZFFSAB._.EEpromZentralHandler.eepromChannel[28].ret_CallEEpromLoadData ZFFSAB._.EEpromZentralHandler.eepromChannel[28].ret_CallEEpromLoadDataState ZFFSAB._.EEpromZentralHandler.eepromChannel[28].ret_CallEEpromStoreImmediate ZFFSAB._.EEpromZentralHandler.eepromChannel[29].ZFFSAB._.cEEpromChannel._.cnt_GetEEpromUpdate ZFFSAB._.EEpromZentralHandler.eepromChannel[29].ZFFSAB._.cEEpromChannel._.cnt_GetEEpromValid ZFFSAB._.EEpromZentralHandler.eepromChannel[29].ZFFSAB._.cEEpromChannel._.cnt_GetSizeofEEpromData ZFFSAB._.EEpromZentralHandler.eepromChannel[29].ZFFSAB._.cEEpromChannel._.cnt_SetEEpromInitZyklisch ZFFSAB._.EEpromZentralHandler.eepromChannel[29].ZFFSAB._.cEEpromChannel._.eeprom_info ZFFSAB._.EEpromZentralHandler.eepromChannel[29].ZFFSAB._.cEEpromChannel._.ret_GetEEpromUpdate ZFFSAB._.EEpromZentralHandler.eepromChannel[29].ZFFSAB._.cEEpromChannel._.ret_GetEEpromValid ZFFSAB._.EEpromZentralHandler.eepromChannel[29].ZFFSAB._.cEEpromChannel._.ret_GetSizeofEEpromData ZFFSAB._.EEpromZentralHandler.eepromChannel[29].ZFFSAB._.cEEpromChannel._.ret_SetEEpromInitZyklisch ZFFSAB._.EEpromZentralHandler.eepromChannel[29].cnt_CallEEpromLoadData ZFFSAB._.EEpromZentralHandler.eepromChannel[29].cnt_CallEEpromLoadDataState ZFFSAB._.EEpromZentralHandler.eepromChannel[29].cnt_CallEEpromStoreImmediate ZFFSAB._.EEpromZentralHandler.eepromChannel[29].cnt_SetEEpromWriteProtect ZFFSAB._.EEpromZentralHandler.eepromChannel[29].mode ZFFSAB._.EEpromZentralHandler.eepromChannel[29].ret_CallEEpromLoadData ZFFSAB._.EEpromZentralHandler.eepromChannel[29].ret_CallEEpromLoadDataState ZFFSAB._.EEpromZentralHandler.eepromChannel[29].ret_CallEEpromStoreImmediate ZFFSAB._.EEpromZentralHandler.eepromChannel[2].ZFFSAB._.cEEpromChannel._.cnt_GetEEpromUpdate ZFFSAB._.EEpromZentralHandler.eepromChannel[2].ZFFSAB._.cEEpromChannel._.cnt_GetEEpromValid ZFFSAB._.EEpromZentralHandler.eepromChannel[2].ZFFSAB._.cEEpromChannel._.cnt_GetSizeofEEpromData ZFFSAB._.EEpromZentralHandler.eepromChannel[2].ZFFSAB._.cEEpromChannel._.cnt_SetEEpromInitZyklisch ZFFSAB._.EEpromZentralHandler.eepromChannel[2].ZFFSAB._.cEEpromChannel._.eeprom_info ZFFSAB._.EEpromZentralHandler.eepromChannel[2].ZFFSAB._.cEEpromChannel._.ret_GetEEpromUpdate ZFFSAB._.EEpromZentralHandler.eepromChannel[2].ZFFSAB._.cEEpromChannel._.ret_GetEEpromValid ZFFSAB._.EEpromZentralHandler.eepromChannel[2].ZFFSAB._.cEEpromChannel._.ret_GetSizeofEEpromData ZFFSAB._.EEpromZentralHandler.eepromChannel[2].ZFFSAB._.cEEpromChannel._.ret_SetEEpromInitZyklisch ZFFSAB._.EEpromZentralHandler.eepromChannel[2].cnt_CallEEpromLoadData ZFFSAB._.EEpromZentralHandler.eepromChannel[2].cnt_CallEEpromLoadDataState ZFFSAB._.EEpromZentralHandler.eepromChannel[2].cnt_CallEEpromStoreImmediate ZFFSAB._.EEpromZentralHandler.eepromChannel[2].cnt_SetEEpromWriteProtect ZFFSAB._.EEpromZentralHandler.eepromChannel[2].mode ZFFSAB._.EEpromZentralHandler.eepromChannel[2].ret_CallEEpromLoadData ZFFSAB._.EEpromZentralHandler.eepromChannel[2].ret_CallEEpromLoadDataState ZFFSAB._.EEpromZentralHandler.eepromChannel[2].ret_CallEEpromStoreImmediate ZFFSAB._.EEpromZentralHandler.eepromChannel[30].ZFFSAB._.cEEpromChannel._.cnt_GetEEpromUpdate ZFFSAB._.EEpromZentralHandler.eepromChannel[30].ZFFSAB._.cEEpromChannel._.cnt_GetEEpromValid ZFFSAB._.EEpromZentralHandler.eepromChannel[30].ZFFSAB._.cEEpromChannel._.cnt_GetSizeofEEpromData ZFFSAB._.EEpromZentralHandler.eepromChannel[30].ZFFSAB._.cEEpromChannel._.cnt_SetEEpromInitZyklisch ZFFSAB._.EEpromZentralHandler.eepromChannel[30].ZFFSAB._.cEEpromChannel._.eeprom_info ZFFSAB._.EEpromZentralHandler.eepromChannel[30].ZFFSAB._.cEEpromChannel._.ret_GetEEpromUpdate ZFFSAB._.EEpromZentralHandler.eepromChannel[30].ZFFSAB._.cEEpromChannel._.ret_GetEEpromValid ZFFSAB._.EEpromZentralHandler.eepromChannel[30].ZFFSAB._.cEEpromChannel._.ret_GetSizeofEEpromData ZFFSAB._.EEpromZentralHandler.eepromChannel[30].ZFFSAB._.cEEpromChannel._.ret_SetEEpromInitZyklisch ZFFSAB._.EEpromZentralHandler.eepromChannel[30].cnt_CallEEpromLoadData ZFFSAB._.EEpromZentralHandler.eepromChannel[30].cnt_CallEEpromLoadDataState ZFFSAB._.EEpromZentralHandler.eepromChannel[30].cnt_CallEEpromStoreImmediate ZFFSAB._.EEpromZentralHandler.eepromChannel[30].cnt_SetEEpromWriteProtect ZFFSAB._.EEpromZentralHandler.eepromChannel[30].mode ZFFSAB._.EEpromZentralHandler.eepromChannel[30].ret_CallEEpromLoadData ZFFSAB._.EEpromZentralHandler.eepromChannel[30].ret_CallEEpromLoadDataState ZFFSAB._.EEpromZentralHandler.eepromChannel[30].ret_CallEEpromStoreImmediate ZFFSAB._.EEpromZentralHandler.eepromChannel[31].ZFFSAB._.cEEpromChannel._.cnt_GetEEpromUpdate ZFFSAB._.EEpromZentralHandler.eepromChannel[31].ZFFSAB._.cEEpromChannel._.cnt_GetEEpromValid ZFFSAB._.EEpromZentralHandler.eepromChannel[31].ZFFSAB._.cEEpromChannel._.cnt_GetSizeofEEpromData ZFFSAB._.EEpromZentralHandler.eepromChannel[31].ZFFSAB._.cEEpromChannel._.cnt_SetEEpromInitZyklisch ZFFSAB._.EEpromZentralHandler.eepromChannel[31].ZFFSAB._.cEEpromChannel._.eeprom_info ZFFSAB._.EEpromZentralHandler.eepromChannel[31].ZFFSAB._.cEEpromChannel._.ret_GetEEpromUpdate ZFFSAB._.EEpromZentralHandler.eepromChannel[31].ZFFSAB._.cEEpromChannel._.ret_GetEEpromValid ZFFSAB._.EEpromZentralHandler.eepromChannel[31].ZFFSAB._.cEEpromChannel._.ret_GetSizeofEEpromData ZFFSAB._.EEpromZentralHandler.eepromChannel[31].ZFFSAB._.cEEpromChannel._.ret_SetEEpromInitZyklisch ZFFSAB._.EEpromZentralHandler.eepromChannel[31].cnt_CallEEpromLoadData ZFFSAB._.EEpromZentralHandler.eepromChannel[31].cnt_CallEEpromLoadDataState ZFFSAB._.EEpromZentralHandler.eepromChannel[31].cnt_CallEEpromStoreImmediate ZFFSAB._.EEpromZentralHandler.eepromChannel[31].cnt_SetEEpromWriteProtect ZFFSAB._.EEpromZentralHandler.eepromChannel[31].mode ZFFSAB._.EEpromZentralHandler.eepromChannel[31].ret_CallEEpromLoadData ZFFSAB._.EEpromZentralHandler.eepromChannel[31].ret_CallEEpromLoadDataState ZFFSAB._.EEpromZentralHandler.eepromChannel[31].ret_CallEEpromStoreImmediate ZFFSAB._.EEpromZentralHandler.eepromChannel[32].ZFFSAB._.cEEpromChannel._.cnt_GetEEpromUpdate ZFFSAB._.EEpromZentralHandler.eepromChannel[32].ZFFSAB._.cEEpromChannel._.cnt_GetEEpromValid ZFFSAB._.EEpromZentralHandler.eepromChannel[32].ZFFSAB._.cEEpromChannel._.cnt_GetSizeofEEpromData ZFFSAB._.EEpromZentralHandler.eepromChannel[32].ZFFSAB._.cEEpromChannel._.cnt_SetEEpromInitZyklisch ZFFSAB._.EEpromZentralHandler.eepromChannel[32].ZFFSAB._.cEEpromChannel._.eeprom_info ZFFSAB._.EEpromZentralHandler.eepromChannel[32].ZFFSAB._.cEEpromChannel._.ret_GetEEpromUpdate ZFFSAB._.EEpromZentralHandler.eepromChannel[32].ZFFSAB._.cEEpromChannel._.ret_GetEEpromValid ZFFSAB._.EEpromZentralHandler.eepromChannel[32].ZFFSAB._.cEEpromChannel._.ret_GetSizeofEEpromData ZFFSAB._.EEpromZentralHandler.eepromChannel[32].ZFFSAB._.cEEpromChannel._.ret_SetEEpromInitZyklisch ZFFSAB._.EEpromZentralHandler.eepromChannel[32].cnt_CallEEpromLoadData ZFFSAB._.EEpromZentralHandler.eepromChannel[32].cnt_CallEEpromLoadDataState ZFFSAB._.EEpromZentralHandler.eepromChannel[32].cnt_CallEEpromStoreImmediate ZFFSAB._.EEpromZentralHandler.eepromChannel[32].cnt_SetEEpromWriteProtect ZFFSAB._.EEpromZentralHandler.eepromChannel[32].mode ZFFSAB._.EEpromZentralHandler.eepromChannel[32].ret_CallEEpromLoadData ZFFSAB._.EEpromZentralHandler.eepromChannel[32].ret_CallEEpromLoadDataState ZFFSAB._.EEpromZentralHandler.eepromChannel[32].ret_CallEEpromStoreImmediate ZFFSAB._.EEpromZentralHandler.eepromChannel[33].ZFFSAB._.cEEpromChannel._.cnt_GetEEpromUpdate ZFFSAB._.EEpromZentralHandler.eepromChannel[33].ZFFSAB._.cEEpromChannel._.cnt_GetEEpromValid ZFFSAB._.EEpromZentralHandler.eepromChannel[33].ZFFSAB._.cEEpromChannel._.cnt_GetSizeofEEpromData ZFFSAB._.EEpromZentralHandler.eepromChannel[33].ZFFSAB._.cEEpromChannel._.cnt_SetEEpromInitZyklisch ZFFSAB._.EEpromZentralHandler.eepromChannel[33].ZFFSAB._.cEEpromChannel._.eeprom_info ZFFSAB._.EEpromZentralHandler.eepromChannel[33].ZFFSAB._.cEEpromChannel._.ret_GetEEpromUpdate ZFFSAB._.EEpromZentralHandler.eepromChannel[33].ZFFSAB._.cEEpromChannel._.ret_GetEEpromValid ZFFSAB._.EEpromZentralHandler.eepromChannel[33].ZFFSAB._.cEEpromChannel._.ret_GetSizeofEEpromData ZFFSAB._.EEpromZentralHandler.eepromChannel[33].ZFFSAB._.cEEpromChannel._.ret_SetEEpromInitZyklisch ZFFSAB._.EEpromZentralHandler.eepromChannel[33].cnt_CallEEpromLoadData ZFFSAB._.EEpromZentralHandler.eepromChannel[33].cnt_CallEEpromLoadDataState ZFFSAB._.EEpromZentralHandler.eepromChannel[33].cnt_CallEEpromStoreImmediate ZFFSAB._.EEpromZentralHandler.eepromChannel[33].cnt_SetEEpromWriteProtect ZFFSAB._.EEpromZentralHandler.eepromChannel[33].mode ZFFSAB._.EEpromZentralHandler.eepromChannel[33].ret_CallEEpromLoadData ZFFSAB._.EEpromZentralHandler.eepromChannel[33].ret_CallEEpromLoadDataState ZFFSAB._.EEpromZentralHandler.eepromChannel[33].ret_CallEEpromStoreImmediate ZFFSAB._.EEpromZentralHandler.eepromChannel[34].ZFFSAB._.cEEpromChannel._.cnt_GetEEpromUpdate ZFFSAB._.EEpromZentralHandler.eepromChannel[34].ZFFSAB._.cEEpromChannel._.cnt_GetEEpromValid ZFFSAB._.EEpromZentralHandler.eepromChannel[34].ZFFSAB._.cEEpromChannel._.cnt_GetSizeofEEpromData ZFFSAB._.EEpromZentralHandler.eepromChannel[34].ZFFSAB._.cEEpromChannel._.cnt_SetEEpromInitZyklisch ZFFSAB._.EEpromZentralHandler.eepromChannel[34].ZFFSAB._.cEEpromChannel._.eeprom_info ZFFSAB._.EEpromZentralHandler.eepromChannel[34].ZFFSAB._.cEEpromChannel._.ret_GetEEpromUpdate ZFFSAB._.EEpromZentralHandler.eepromChannel[34].ZFFSAB._.cEEpromChannel._.ret_GetEEpromValid ZFFSAB._.EEpromZentralHandler.eepromChannel[34].ZFFSAB._.cEEpromChannel._.ret_GetSizeofEEpromData ZFFSAB._.EEpromZentralHandler.eepromChannel[34].ZFFSAB._.cEEpromChannel._.ret_SetEEpromInitZyklisch ZFFSAB._.EEpromZentralHandler.eepromChannel[34].cnt_CallEEpromLoadData ZFFSAB._.EEpromZentralHandler.eepromChannel[34].cnt_CallEEpromLoadDataState ZFFSAB._.EEpromZentralHandler.eepromChannel[34].cnt_CallEEpromStoreImmediate ZFFSAB._.EEpromZentralHandler.eepromChannel[34].cnt_SetEEpromWriteProtect ZFFSAB._.EEpromZentralHandler.eepromChannel[34].mode ZFFSAB._.EEpromZentralHandler.eepromChannel[34].ret_CallEEpromLoadData ZFFSAB._.EEpromZentralHandler.eepromChannel[34].ret_CallEEpromLoadDataState ZFFSAB._.EEpromZentralHandler.eepromChannel[34].ret_CallEEpromStoreImmediate ZFFSAB._.EEpromZentralHandler.eepromChannel[35].ZFFSAB._.cEEpromChannel._.cnt_GetEEpromUpdate ZFFSAB._.EEpromZentralHandler.eepromChannel[35].ZFFSAB._.cEEpromChannel._.cnt_GetEEpromValid ZFFSAB._.EEpromZentralHandler.eepromChannel[35].ZFFSAB._.cEEpromChannel._.cnt_GetSizeofEEpromData ZFFSAB._.EEpromZentralHandler.eepromChannel[35].ZFFSAB._.cEEpromChannel._.cnt_SetEEpromInitZyklisch ZFFSAB._.EEpromZentralHandler.eepromChannel[35].ZFFSAB._.cEEpromChannel._.eeprom_info ZFFSAB._.EEpromZentralHandler.eepromChannel[35].ZFFSAB._.cEEpromChannel._.ret_GetEEpromUpdate ZFFSAB._.EEpromZentralHandler.eepromChannel[35].ZFFSAB._.cEEpromChannel._.ret_GetEEpromValid ZFFSAB._.EEpromZentralHandler.eepromChannel[35].ZFFSAB._.cEEpromChannel._.ret_GetSizeofEEpromData ZFFSAB._.EEpromZentralHandler.eepromChannel[35].ZFFSAB._.cEEpromChannel._.ret_SetEEpromInitZyklisch ZFFSAB._.EEpromZentralHandler.eepromChannel[35].cnt_CallEEpromLoadData ZFFSAB._.EEpromZentralHandler.eepromChannel[35].cnt_CallEEpromLoadDataState ZFFSAB._.EEpromZentralHandler.eepromChannel[35].cnt_CallEEpromStoreImmediate ZFFSAB._.EEpromZentralHandler.eepromChannel[35].cnt_SetEEpromWriteProtect ZFFSAB._.EEpromZentralHandler.eepromChannel[35].mode ZFFSAB._.EEpromZentralHandler.eepromChannel[35].ret_CallEEpromLoadData ZFFSAB._.EEpromZentralHandler.eepromChannel[35].ret_CallEEpromLoadDataState ZFFSAB._.EEpromZentralHandler.eepromChannel[35].ret_CallEEpromStoreImmediate ZFFSAB._.EEpromZentralHandler.eepromChannel[36].ZFFSAB._.cEEpromChannel._.cnt_GetEEpromUpdate ZFFSAB._.EEpromZentralHandler.eepromChannel[36].ZFFSAB._.cEEpromChannel._.cnt_GetEEpromValid ZFFSAB._.EEpromZentralHandler.eepromChannel[36].ZFFSAB._.cEEpromChannel._.cnt_GetSizeofEEpromData ZFFSAB._.EEpromZentralHandler.eepromChannel[36].ZFFSAB._.cEEpromChannel._.cnt_SetEEpromInitZyklisch ZFFSAB._.EEpromZentralHandler.eepromChannel[36].ZFFSAB._.cEEpromChannel._.eeprom_info ZFFSAB._.EEpromZentralHandler.eepromChannel[36].ZFFSAB._.cEEpromChannel._.ret_GetEEpromUpdate ZFFSAB._.EEpromZentralHandler.eepromChannel[36].ZFFSAB._.cEEpromChannel._.ret_GetEEpromValid ZFFSAB._.EEpromZentralHandler.eepromChannel[36].ZFFSAB._.cEEpromChannel._.ret_GetSizeofEEpromData ZFFSAB._.EEpromZentralHandler.eepromChannel[36].ZFFSAB._.cEEpromChannel._.ret_SetEEpromInitZyklisch ZFFSAB._.EEpromZentralHandler.eepromChannel[36].cnt_CallEEpromLoadData ZFFSAB._.EEpromZentralHandler.eepromChannel[36].cnt_CallEEpromLoadDataState ZFFSAB._.EEpromZentralHandler.eepromChannel[36].cnt_CallEEpromStoreImmediate ZFFSAB._.EEpromZentralHandler.eepromChannel[36].cnt_SetEEpromWriteProtect ZFFSAB._.EEpromZentralHandler.eepromChannel[36].mode ZFFSAB._.EEpromZentralHandler.eepromChannel[36].ret_CallEEpromLoadData ZFFSAB._.EEpromZentralHandler.eepromChannel[36].ret_CallEEpromLoadDataState ZFFSAB._.EEpromZentralHandler.eepromChannel[36].ret_CallEEpromStoreImmediate ZFFSAB._.EEpromZentralHandler.eepromChannel[37].ZFFSAB._.cEEpromChannel._.cnt_GetEEpromUpdate ZFFSAB._.EEpromZentralHandler.eepromChannel[37].ZFFSAB._.cEEpromChannel._.cnt_GetEEpromValid ZFFSAB._.EEpromZentralHandler.eepromChannel[37].ZFFSAB._.cEEpromChannel._.cnt_GetSizeofEEpromData ZFFSAB._.EEpromZentralHandler.eepromChannel[37].ZFFSAB._.cEEpromChannel._.cnt_SetEEpromInitZyklisch ZFFSAB._.EEpromZentralHandler.eepromChannel[37].ZFFSAB._.cEEpromChannel._.eeprom_info ZFFSAB._.EEpromZentralHandler.eepromChannel[37].ZFFSAB._.cEEpromChannel._.ret_GetEEpromUpdate ZFFSAB._.EEpromZentralHandler.eepromChannel[37].ZFFSAB._.cEEpromChannel._.ret_GetEEpromValid ZFFSAB._.EEpromZentralHandler.eepromChannel[37].ZFFSAB._.cEEpromChannel._.ret_GetSizeofEEpromData ZFFSAB._.EEpromZentralHandler.eepromChannel[37].ZFFSAB._.cEEpromChannel._.ret_SetEEpromInitZyklisch ZFFSAB._.EEpromZentralHandler.eepromChannel[37].cnt_CallEEpromLoadData ZFFSAB._.EEpromZentralHandler.eepromChannel[37].cnt_CallEEpromLoadDataState ZFFSAB._.EEpromZentralHandler.eepromChannel[37].cnt_CallEEpromStoreImmediate ZFFSAB._.EEpromZentralHandler.eepromChannel[37].cnt_SetEEpromWriteProtect ZFFSAB._.EEpromZentralHandler.eepromChannel[37].mode ZFFSAB._.EEpromZentralHandler.eepromChannel[37].ret_CallEEpromLoadData ZFFSAB._.EEpromZentralHandler.eepromChannel[37].ret_CallEEpromLoadDataState ZFFSAB._.EEpromZentralHandler.eepromChannel[37].ret_CallEEpromStoreImmediate ZFFSAB._.EEpromZentralHandler.eepromChannel[38].ZFFSAB._.cEEpromChannel._.cnt_GetEEpromUpdate ZFFSAB._.EEpromZentralHandler.eepromChannel[38].ZFFSAB._.cEEpromChannel._.cnt_GetEEpromValid ZFFSAB._.EEpromZentralHandler.eepromChannel[38].ZFFSAB._.cEEpromChannel._.cnt_GetSizeofEEpromData ZFFSAB._.EEpromZentralHandler.eepromChannel[38].ZFFSAB._.cEEpromChannel._.cnt_SetEEpromInitZyklisch ZFFSAB._.EEpromZentralHandler.eepromChannel[38].ZFFSAB._.cEEpromChannel._.eeprom_info ZFFSAB._.EEpromZentralHandler.eepromChannel[38].ZFFSAB._.cEEpromChannel._.ret_GetEEpromUpdate ZFFSAB._.EEpromZentralHandler.eepromChannel[38].ZFFSAB._.cEEpromChannel._.ret_GetEEpromValid ZFFSAB._.EEpromZentralHandler.eepromChannel[38].ZFFSAB._.cEEpromChannel._.ret_GetSizeofEEpromData ZFFSAB._.EEpromZentralHandler.eepromChannel[38].ZFFSAB._.cEEpromChannel._.ret_SetEEpromInitZyklisch ZFFSAB._.EEpromZentralHandler.eepromChannel[38].cnt_CallEEpromLoadData ZFFSAB._.EEpromZentralHandler.eepromChannel[38].cnt_CallEEpromLoadDataState ZFFSAB._.EEpromZentralHandler.eepromChannel[38].cnt_CallEEpromStoreImmediate ZFFSAB._.EEpromZentralHandler.eepromChannel[38].cnt_SetEEpromWriteProtect ZFFSAB._.EEpromZentralHandler.eepromChannel[38].mode ZFFSAB._.EEpromZentralHandler.eepromChannel[38].ret_CallEEpromLoadData ZFFSAB._.EEpromZentralHandler.eepromChannel[38].ret_CallEEpromLoadDataState ZFFSAB._.EEpromZentralHandler.eepromChannel[38].ret_CallEEpromStoreImmediate ZFFSAB._.EEpromZentralHandler.eepromChannel[39].ZFFSAB._.cEEpromChannel._.cnt_GetEEpromUpdate ZFFSAB._.EEpromZentralHandler.eepromChannel[39].ZFFSAB._.cEEpromChannel._.cnt_GetEEpromValid ZFFSAB._.EEpromZentralHandler.eepromChannel[39].ZFFSAB._.cEEpromChannel._.cnt_GetSizeofEEpromData ZFFSAB._.EEpromZentralHandler.eepromChannel[39].ZFFSAB._.cEEpromChannel._.cnt_SetEEpromInitZyklisch ZFFSAB._.EEpromZentralHandler.eepromChannel[39].ZFFSAB._.cEEpromChannel._.eeprom_info ZFFSAB._.EEpromZentralHandler.eepromChannel[39].ZFFSAB._.cEEpromChannel._.ret_GetEEpromUpdate ZFFSAB._.EEpromZentralHandler.eepromChannel[39].ZFFSAB._.cEEpromChannel._.ret_GetEEpromValid ZFFSAB._.EEpromZentralHandler.eepromChannel[39].ZFFSAB._.cEEpromChannel._.ret_GetSizeofEEpromData ZFFSAB._.EEpromZentralHandler.eepromChannel[39].ZFFSAB._.cEEpromChannel._.ret_SetEEpromInitZyklisch ZFFSAB._.EEpromZentralHandler.eepromChannel[39].cnt_CallEEpromLoadData ZFFSAB._.EEpromZentralHandler.eepromChannel[39].cnt_CallEEpromLoadDataState ZFFSAB._.EEpromZentralHandler.eepromChannel[39].cnt_CallEEpromStoreImmediate ZFFSAB._.EEpromZentralHandler.eepromChannel[39].cnt_SetEEpromWriteProtect ZFFSAB._.EEpromZentralHandler.eepromChannel[39].mode ZFFSAB._.EEpromZentralHandler.eepromChannel[39].ret_CallEEpromLoadData ZFFSAB._.EEpromZentralHandler.eepromChannel[39].ret_CallEEpromLoadDataState ZFFSAB._.EEpromZentralHandler.eepromChannel[39].ret_CallEEpromStoreImmediate ZFFSAB._.EEpromZentralHandler.eepromChannel[3].ZFFSAB._.cEEpromChannel._.cnt_GetEEpromUpdate ZFFSAB._.EEpromZentralHandler.eepromChannel[3].ZFFSAB._.cEEpromChannel._.cnt_GetEEpromValid ZFFSAB._.EEpromZentralHandler.eepromChannel[3].ZFFSAB._.cEEpromChannel._.cnt_GetSizeofEEpromData ZFFSAB._.EEpromZentralHandler.eepromChannel[3].ZFFSAB._.cEEpromChannel._.cnt_SetEEpromInitZyklisch ZFFSAB._.EEpromZentralHandler.eepromChannel[3].ZFFSAB._.cEEpromChannel._.eeprom_info ZFFSAB._.EEpromZentralHandler.eepromChannel[3].ZFFSAB._.cEEpromChannel._.ret_GetEEpromUpdate ZFFSAB._.EEpromZentralHandler.eepromChannel[3].ZFFSAB._.cEEpromChannel._.ret_GetEEpromValid ZFFSAB._.EEpromZentralHandler.eepromChannel[3].ZFFSAB._.cEEpromChannel._.ret_GetSizeofEEpromData ZFFSAB._.EEpromZentralHandler.eepromChannel[3].ZFFSAB._.cEEpromChannel._.ret_SetEEpromInitZyklisch ZFFSAB._.EEpromZentralHandler.eepromChannel[3].cnt_CallEEpromLoadData ZFFSAB._.EEpromZentralHandler.eepromChannel[3].cnt_CallEEpromLoadDataState ZFFSAB._.EEpromZentralHandler.eepromChannel[3].cnt_CallEEpromStoreImmediate ZFFSAB._.EEpromZentralHandler.eepromChannel[3].cnt_SetEEpromWriteProtect ZFFSAB._.EEpromZentralHandler.eepromChannel[3].mode ZFFSAB._.EEpromZentralHandler.eepromChannel[3].ret_CallEEpromLoadData ZFFSAB._.EEpromZentralHandler.eepromChannel[3].ret_CallEEpromLoadDataState ZFFSAB._.EEpromZentralHandler.eepromChannel[3].ret_CallEEpromStoreImmediate ZFFSAB._.EEpromZentralHandler.eepromChannel[40].ZFFSAB._.cEEpromChannel._.cnt_GetEEpromUpdate ZFFSAB._.EEpromZentralHandler.eepromChannel[40].ZFFSAB._.cEEpromChannel._.cnt_GetEEpromValid ZFFSAB._.EEpromZentralHandler.eepromChannel[40].ZFFSAB._.cEEpromChannel._.cnt_GetSizeofEEpromData ZFFSAB._.EEpromZentralHandler.eepromChannel[40].ZFFSAB._.cEEpromChannel._.cnt_SetEEpromInitZyklisch ZFFSAB._.EEpromZentralHandler.eepromChannel[40].ZFFSAB._.cEEpromChannel._.eeprom_info ZFFSAB._.EEpromZentralHandler.eepromChannel[40].ZFFSAB._.cEEpromChannel._.ret_GetEEpromUpdate ZFFSAB._.EEpromZentralHandler.eepromChannel[40].ZFFSAB._.cEEpromChannel._.ret_GetEEpromValid ZFFSAB._.EEpromZentralHandler.eepromChannel[40].ZFFSAB._.cEEpromChannel._.ret_GetSizeofEEpromData ZFFSAB._.EEpromZentralHandler.eepromChannel[40].ZFFSAB._.cEEpromChannel._.ret_SetEEpromInitZyklisch ZFFSAB._.EEpromZentralHandler.eepromChannel[40].cnt_CallEEpromLoadData ZFFSAB._.EEpromZentralHandler.eepromChannel[40].cnt_CallEEpromLoadDataState ZFFSAB._.EEpromZentralHandler.eepromChannel[40].cnt_CallEEpromStoreImmediate ZFFSAB._.EEpromZentralHandler.eepromChannel[40].cnt_SetEEpromWriteProtect ZFFSAB._.EEpromZentralHandler.eepromChannel[40].mode /end LOC_MEASUREMENT
/end FUNCTION
/end MODULE
/end PROJECT
